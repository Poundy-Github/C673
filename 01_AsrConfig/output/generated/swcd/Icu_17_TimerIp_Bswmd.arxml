AUTOSAR XML (schema 4-0-3)
package /AUTOSAR_Icu/BswModuleDescriptions
  bsw module description Icu_17_TimerIp: module-id=122, provided-entrys=Icu_17_TimerIp_Init
    bsw internal behavior InternalBehavior_0
      4 x exclusive area:
        GtmEnableEdgeCount
        GtmGetDutyCycle
        ResetEdgeCount
        SetActivationCondition
      bsw called entity Icu_17_TimerIp_Init: can-enter-exclusive-area=[GtmEnableEdgeCount, GtmGetDutyCycle, ResetEdgeCount, SetActivationCondition], implemented-entry=Icu_17_TimerIp_Init, scheduler-name-prefix=Prefix_Icu_17_TimerIp
      bsw scheduler name prefix Prefix_Icu_17_TimerIp: symbol=Icu_17_TimerIp
package /AUTOSAR_Icu/BswModuleEntrys
  bsw module entry Icu_17_TimerIp_Init: service-id=1000, is-reentrant=false, is-synchronous=true, call-type=REGULAR, execution-context=UNSPECIFIED, sw-service-impl-policy=STANDARD
package /Icu_Aurix2GAS422/Implementations
  bsw implementation BswImplementation_0: programming-language=C, sw-version=20.0.1, vendor-id=17, ar-release-version=4.2.2, behavior=InternalBehavior_0, vendor-specific-module-def=Icu
    code-descriptors:
      code Files: artifact-descriptors=[{short-label=make::Icu_defs.mak, category=SWMAKE}, {short-label=make::Icu_rules.mak, category=SWMAKE}]
    resource consumption ResourceConsumption
      22 x memory section, all with options=safetyAsilB:
        VAR_CLEARED_ASIL_B_CORE0_32: alignment=32, sw-addrmethod=VAR_CLEARED_ASIL_B
        CONFIG_DATA_ASIL_B_CORE0_UNSPECIFIED: alignment=UNSPECIFIED, sw-addrmethod=CONFIG_DATA_ASIL_B
        VAR_INIT_ASIL_B_CORE0_32: alignment=32, sw-addrmethod=VAR_INIT_ASIL_B
        VAR_CLEARED_ASIL_B_CORE1_32: alignment=32, sw-addrmethod=VAR_CLEARED_ASIL_B
        CONFIG_DATA_ASIL_B_CORE1_UNSPECIFIED: alignment=UNSPECIFIED, sw-addrmethod=CONFIG_DATA_ASIL_B
        VAR_INIT_ASIL_B_CORE1_32: alignment=32, sw-addrmethod=VAR_INIT_ASIL_B
        VAR_CLEARED_ASIL_B_CORE2_32: alignment=32, sw-addrmethod=VAR_CLEARED_ASIL_B
        CONFIG_DATA_ASIL_B_CORE2_UNSPECIFIED: alignment=UNSPECIFIED, sw-addrmethod=CONFIG_DATA_ASIL_B
        VAR_INIT_ASIL_B_CORE2_32: alignment=32, sw-addrmethod=VAR_INIT_ASIL_B
        VAR_CLEARED_ASIL_B_CORE3_32: alignment=32, sw-addrmethod=VAR_CLEARED_ASIL_B
        CONFIG_DATA_ASIL_B_CORE3_UNSPECIFIED: alignment=UNSPECIFIED, sw-addrmethod=CONFIG_DATA_ASIL_B
        VAR_INIT_ASIL_B_CORE3_32: alignment=32, sw-addrmethod=VAR_INIT_ASIL_B
        VAR_CLEARED_ASIL_B_CORE4_32: alignment=32, sw-addrmethod=VAR_CLEARED_ASIL_B
        CONFIG_DATA_ASIL_B_CORE4_UNSPECIFIED: alignment=UNSPECIFIED, sw-addrmethod=CONFIG_DATA_ASIL_B
        VAR_INIT_ASIL_B_CORE4_32: alignment=32, sw-addrmethod=VAR_INIT_ASIL_B
        VAR_CLEARED_ASIL_B_CORE5_32: alignment=32, sw-addrmethod=VAR_CLEARED_ASIL_B
        CONFIG_DATA_ASIL_B_CORE5_UNSPECIFIED: alignment=UNSPECIFIED, sw-addrmethod=CONFIG_DATA_ASIL_B
        VAR_INIT_ASIL_B_CORE5_32: alignment=32, sw-addrmethod=VAR_INIT_ASIL_B
        CONST_ASIL_B_GLOBAL_32: alignment=32, sw-addrmethod=CONST_ASIL_B
        VAR_CLEARED_ASIL_B_GLOBAL_32: alignment=32, sw-addrmethod=VAR_CLEARED_ASIL_B
        CONFIG_DATA_ASIL_B_GLOBAL_UNSPECIFIED: alignment=UNSPECIFIED, sw-addrmethod=CONFIG_DATA_ASIL_B
        CODE_ASIL_B_GLOBAL: alignment=UNSPECIFIED, sw-addrmethod=CODE_ASIL_B
      section name prefix ICU_17_TIMERIP
