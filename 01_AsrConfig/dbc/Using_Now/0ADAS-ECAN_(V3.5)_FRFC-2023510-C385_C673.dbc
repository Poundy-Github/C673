VERSION ""

NS_ :

BS_:
BU_: FR FC ADC

BO_ 283 FR_11B: 64 FR
 SG_ FR_OBJ22_Ax : 482|7@0+ (0.2000000000,-13.0000000000) [-13.0000000000|12.6000000000] "m/s2"  FR,ADC,FC
 SG_ FR_OBJ22_Ay : 473|7@0+ (0.2000000000,-13.0000000000) [-13.0000000000|12.6000000000] "m/s2"  FR,ADC,FC
 SG_ FR_OBJ22_Vx : 466|9@0+ (0.2000000000,-51.0000000000) [-51.0000000000|51.2000000000] "m/s"  FR,ADC,FC
 SG_ FR_OBJ22_Vy : 459|9@0+ (0.2000000000,-51.0000000000) [-51.0000000000|51.2000000000] "m/s"  FR,ADC,FC
 SG_ FR_OBJ21_Ax : 450|7@0+ (0.2000000000,-13.0000000000) [-13.0000000000|12.6000000000] "m/s2"  FR,ADC,FC
 SG_ FR_OBJ21_Ay : 441|7@0+ (0.2000000000,-13.0000000000) [-13.0000000000|12.6000000000] "m/s2"  FR,ADC,FC
 SG_ FR_OBJ21_Vx : 434|9@0+ (0.2000000000,-51.0000000000) [-51.0000000000|51.2000000000] "m/s"  FR,ADC,FC
 SG_ FR_OBJ21_Vy : 427|9@0+ (0.2000000000,-51.0000000000) [-51.0000000000|51.2000000000] "m/s"  FR,ADC,FC
 SG_ FR_OBJ22_FeaturePoint : 431|4@0+ (1.0000000000,0.0000000000) [0.0000000000|9.0000000000] "-"  FR,ADC,FC
 SG_ FR_OBJ21_FeaturePoint : 419|4@0+ (1.0000000000,0.0000000000) [0.0000000000|9.0000000000] "-"  FR,ADC,FC
 SG_ FR_CRCCheck_11B : 503|16@0+ (1.0000000000,0.0000000000) [0.0000000000|65535.0000000000] ""  FR,ADC,FC
 SG_ FR_RollingCounter_11B : 491|4@0+ (1.0000000000,0.0000000000) [0.0000000000|15.0000000000] ""  FR,ADC,FC
 SG_ FR_OBJ22_HeightGround : 211|9@0+ (0.1000000000,0.0000000000) [0.0000000000|51.1000000000] "m"  FR,ADC,FC
 SG_ FR_OBJ22_MotionStatusConf : 397|6@0+ (2.0000000000,0.0000000000) [0.0000000000|63.0000000000] "-"  FR,ADC,FC
 SG_ FR_OBJ22_ClassConf : 377|6@0+ (2.0000000000,0.0000000000) [0.0000000000|63.0000000000] "-"  FR,ADC,FC
 SG_ FR_OBJ22_MotionStatus : 370|3@0+ (1.0000000000,0.0000000000) [0.0000000000|7.0000000000] ""  FR,ADC,FC
 SG_ FR_OBJ22_Location : 375|2@0+ (1.0000000000,0.0000000000) [0.0000000000|3.0000000000] ""  FR,ADC,FC
 SG_ FR_OBJ22_Measured : 363|2@0+ (1.0000000000,0.0000000000) [0.0000000000|3.0000000000] ""  FR,ADC,FC
 SG_ FR_OBJ22_valid : 366|1@0+ (1.0000000000,0.0000000000) [0.0000000000|1.0000000000] ""  FR,ADC,FC
 SG_ FR_OBJ22_Track_Age : 359|8@0+ (1.0000000000,0.0000000000) [0.0000000000|255.0000000000] ""  FR,ADC,FC
 SG_ FR_OBJ22_Track_ID : 351|8@0+ (1.0000000000,0.0000000000) [0.0000000000|255.0000000000] ""  FR,ADC,FC
 SG_ FR_OBJ22_ObstacleProb : 341|6@0+ (2.0000000000,0.0000000000) [0.0000000000|100.0000000000] "%"  FR,ADC,FC
 SG_ FR_OBJ22_ExistProb : 331|6@0+ (2.0000000000,0.0000000000) [0.0000000000|100.0000000000] "%"  FR,ADC,FC
 SG_ FR_OBJ22_RelAx : 325|10@0+ (0.0312500000,-16.0000000000) [-16.0000000000|15.9687500000] "m/s2"  FR,ADC,FC
 SG_ FR_OBJ22_RelAy : 318|9@0+ (0.0625000000,-16.0000000000) [-16.0000000000|15.9375000000] "m/s2"  FR,ADC,FC
 SG_ FR_OBJ22_RelVx_std : 298|12@0+ (0.0625000000,0.0000000000) [0.0000000000|255.9375000000] "m/s"  FR,ADC,FC
 SG_ FR_OBJ22_RelVx : 294|12@0+ (0.0625000000,-128.0000000000) [-128.0000000000|127.9375000000] "m/s"  FR,ADC,FC
 SG_ FR_OBJ22_RelVy_std : 272|10@0+ (0.1250000000,0.0000000000) [0.0000000000|127.8750000000] "m/s"  FR,ADC,FC
 SG_ FR_OBJ22_RelVy : 266|10@0+ (0.1250000000,-64.0000000000) [-64.0000000000|63.8750000000] "m/s"  FR,ADC,FC
 SG_ FR_OBJ22_Dx_Vnce : 248|14@0+ (0.0500000000,0.0000000000) [0.0000000000|50.0000000000] "m2"  FR,ADC,FC
 SG_ FR_OBJ22_Dx : 245|13@0+ (0.0625000000,-100.0000000000) [-100.0000000000|411.9375000000] "m"  FR,ADC,FC
 SG_ FR_OBJ22_Dy_Vnce : 239|10@0+ (0.0200000000,0.0000000000) [0.0000000000|20.0000000000] "m2"  FR,ADC,FC
 SG_ FR_OBJ22_Dy : 218|11@0+ (0.1250000000,-128.0000000000) [-128.0000000000|127.8750000000] "m"  FR,ADC,FC
 SG_ FR_OBJ22_HeadingAngle : 413|10@0+ (0.0100000000,-3.1400000000) [-3.1400000000|3.1400000000] "rad"  FR,ADC,FC
 SG_ FR_OBJ22_Length : 204|9@0+ (0.0500000000,0.0000000000) [0.0000000000|25.5000000000] "m"  FR,ADC,FC
 SG_ FR_OBJ22_Height : 197|9@0+ (0.0100000000,0.0000000000) [0.0000000000|5.1100000000] "m"  FR,ADC,FC
 SG_ FR_OBJ22_Width : 176|11@0+ (0.0100000000,0.0000000000) [0.0000000000|12.0000000000] "m"  FR,ADC,FC
 SG_ FR_OBJ22_Class : 179|3@0+ (1.0000000000,0.0000000000) [0.0000000000|7.0000000000] ""  FR,ADC,FC
 SG_ FR_OBJ21_HeightGround : 39|9@0+ (0.1000000000,0.0000000000) [0.0000000000|51.1000000000] "m"  FR,ADC,FC
 SG_ FR_OBJ21_MotionStatusConf : 387|6@0+ (2.0000000000,0.0000000000) [0.0000000000|63.0000000000] "-"  FR,ADC,FC
 SG_ FR_OBJ21_ClassConf : 383|6@0+ (2.0000000000,0.0000000000) [0.0000000000|63.0000000000] "-"  FR,ADC,FC
 SG_ FR_OBJ21_MotionStatus : 373|3@0+ (1.0000000000,0.0000000000) [0.0000000000|7.0000000000] ""  FR,ADC,FC
 SG_ FR_OBJ21_Location : 361|2@0+ (1.0000000000,0.0000000000) [0.0000000000|3.0000000000] ""  FR,ADC,FC
 SG_ FR_OBJ21_Measured : 365|2@0+ (1.0000000000,0.0000000000) [0.0000000000|3.0000000000] ""  FR,ADC,FC
 SG_ FR_OBJ21_valid : 367|1@0+ (1.0000000000,0.0000000000) [0.0000000000|1.0000000000] ""  FR,ADC,FC
 SG_ FR_OBJ21_Track_Age : 171|8@0+ (1.0000000000,0.0000000000) [0.0000000000|255.0000000000] ""  FR,ADC,FC
 SG_ FR_OBJ21_Track_ID : 163|8@0+ (1.0000000000,0.0000000000) [0.0000000000|255.0000000000] ""  FR,ADC,FC
 SG_ FR_OBJ21_ObstacleProb : 153|6@0+ (2.0000000000,0.0000000000) [0.0000000000|100.0000000000] "%"  FR,ADC,FC
 SG_ FR_OBJ21_ExistProb : 159|6@0+ (2.0000000000,0.0000000000) [0.0000000000|100.0000000000] "%"  FR,ADC,FC
 SG_ FR_OBJ21_RelAx : 137|10@0+ (0.0312500000,-16.0000000000) [-16.0000000000|15.9687500000] "m/s2"  FR,ADC,FC
 SG_ FR_OBJ21_RelAy : 130|9@0+ (0.0625000000,-16.0000000000) [-16.0000000000|15.9375000000] "m/s2"  FR,ADC,FC
 SG_ FR_OBJ21_RelVx_std : 126|12@0+ (0.0625000000,0.0000000000) [0.0000000000|255.9375000000] "m/s"  FR,ADC,FC
 SG_ FR_OBJ21_RelVx : 106|12@0+ (0.0625000000,-128.0000000000) [-128.0000000000|127.9375000000] "m/s"  FR,ADC,FC
 SG_ FR_OBJ21_RelVy_std : 100|10@0+ (0.1250000000,0.0000000000) [0.0000000000|127.8750000000] "m/s"  FR,ADC,FC
 SG_ FR_OBJ21_RelVy : 94|10@0+ (0.1250000000,-64.0000000000) [-64.0000000000|63.8750000000] "m/s"  FR,ADC,FC
 SG_ FR_OBJ21_Dx_Vnce : 76|14@0+ (0.0500000000,0.0000000000) [0.0000000000|50.0000000000] "m2"  FR,ADC,FC
 SG_ FR_OBJ21_Dx : 57|13@0+ (0.0625000000,-100.0000000000) [-100.0000000000|411.9375000000] "m"  FR,ADC,FC
 SG_ FR_OBJ21_Dy_Vnce : 51|10@0+ (0.0200000000,0.0000000000) [0.0000000000|20.0000000000] "m2"  FR,ADC,FC
 SG_ FR_OBJ21_Dy : 46|11@0+ (0.1250000000,-128.0000000000) [-128.0000000000|127.8750000000] "m"  FR,ADC,FC
 SG_ FR_OBJ21_HeadingAngle : 407|10@0+ (0.0100000000,-3.1400000000) [-3.1400000000|3.1400000000] "rad"  FR,ADC,FC
 SG_ FR_OBJ21_Length : 16|9@0+ (0.0500000000,0.0000000000) [0.0000000000|25.5000000000] "m"  FR,ADC,FC
 SG_ FR_OBJ21_Height : 9|9@0+ (0.0100000000,0.0000000000) [0.0000000000|5.1100000000] "m"  FR,ADC,FC
 SG_ FR_OBJ21_Width : 4|11@0+ (0.0100000000,0.0000000000) [0.0000000000|12.0000000000] "m"  FR,ADC,FC
 SG_ FR_OBJ21_Class : 7|3@0+ (1.0000000000,0.0000000000) [0.0000000000|7.0000000000] ""  FR,ADC,FC

BO_ 284 FR_11C: 64 FR
 SG_ FR_OBJ24_Ax : 482|7@0+ (0.2000000000,-13.0000000000) [-13.0000000000|12.6000000000] "m/s2"  FR,ADC,FC
 SG_ FR_OBJ24_Ay : 473|7@0+ (0.2000000000,-13.0000000000) [-13.0000000000|12.6000000000] "m/s2"  FR,ADC,FC
 SG_ FR_OBJ24_Vx : 466|9@0+ (0.2000000000,-51.0000000000) [-51.0000000000|51.2000000000] "m/s"  FR,ADC,FC
 SG_ FR_OBJ24_Vy : 459|9@0+ (0.2000000000,-51.0000000000) [-51.0000000000|51.2000000000] "m/s"  FR,ADC,FC
 SG_ FR_OBJ23_Ax : 450|7@0+ (0.2000000000,-13.0000000000) [-13.0000000000|12.6000000000] "m/s2"  FR,ADC,FC
 SG_ FR_OBJ23_Ay : 441|7@0+ (0.2000000000,-13.0000000000) [-13.0000000000|12.6000000000] "m/s2"  FR,ADC,FC
 SG_ FR_OBJ23_Vx : 434|9@0+ (0.2000000000,-51.0000000000) [-51.0000000000|51.2000000000] "m/s"  FR,ADC,FC
 SG_ FR_OBJ23_Vy : 427|9@0+ (0.2000000000,-51.0000000000) [-51.0000000000|51.2000000000] "m/s"  FR,ADC,FC
 SG_ FR_OBJ24_FeaturePoint : 431|4@0+ (1.0000000000,0.0000000000) [0.0000000000|9.0000000000] "-"  FR,ADC,FC
 SG_ FR_OBJ23_FeaturePoint : 419|4@0+ (1.0000000000,0.0000000000) [0.0000000000|9.0000000000] "-"  FR,ADC,FC
 SG_ FR_CRCCheck_11C : 503|16@0+ (1.0000000000,0.0000000000) [0.0000000000|65535.0000000000] ""  FR,ADC,FC
 SG_ FR_RollingCounter_11C : 491|4@0+ (1.0000000000,0.0000000000) [0.0000000000|15.0000000000] ""  FR,ADC,FC
 SG_ FR_OBJ24_HeightGround : 211|9@0+ (0.1000000000,0.0000000000) [0.0000000000|51.1000000000] "m"  FR,ADC,FC
 SG_ FR_OBJ24_MotionStatusConf : 397|6@0+ (2.0000000000,0.0000000000) [0.0000000000|63.0000000000] "-"  FR,ADC,FC
 SG_ FR_OBJ24_ClassConf : 377|6@0+ (2.0000000000,0.0000000000) [0.0000000000|63.0000000000] "-"  FR,ADC,FC
 SG_ FR_OBJ24_MotionStatus : 370|3@0+ (1.0000000000,0.0000000000) [0.0000000000|7.0000000000] ""  FR,ADC,FC
 SG_ FR_OBJ24_Location : 375|2@0+ (1.0000000000,0.0000000000) [0.0000000000|3.0000000000] ""  FR,ADC,FC
 SG_ FR_OBJ24_Measured : 363|2@0+ (1.0000000000,0.0000000000) [0.0000000000|3.0000000000] ""  FR,ADC,FC
 SG_ FR_OBJ24_valid : 366|1@0+ (1.0000000000,0.0000000000) [0.0000000000|1.0000000000] ""  FR,ADC,FC
 SG_ FR_OBJ24_Track_Age : 359|8@0+ (1.0000000000,0.0000000000) [0.0000000000|255.0000000000] ""  FR,ADC,FC
 SG_ FR_OBJ24_Track_ID : 351|8@0+ (1.0000000000,0.0000000000) [0.0000000000|255.0000000000] ""  FR,ADC,FC
 SG_ FR_OBJ24_ObstacleProb : 341|6@0+ (2.0000000000,0.0000000000) [0.0000000000|100.0000000000] "%"  FR,ADC,FC
 SG_ FR_OBJ24_ExistProb : 331|6@0+ (2.0000000000,0.0000000000) [0.0000000000|100.0000000000] "%"  FR,ADC,FC
 SG_ FR_OBJ24_RelAx : 325|10@0+ (0.0312500000,-16.0000000000) [-16.0000000000|15.9687500000] "m/s2"  FR,ADC,FC
 SG_ FR_OBJ24_RelAy : 318|9@0+ (0.0625000000,-16.0000000000) [-16.0000000000|15.9375000000] "m/s2"  FR,ADC,FC
 SG_ FR_OBJ24_RelVx_std : 298|12@0+ (0.0625000000,0.0000000000) [0.0000000000|255.9375000000] "m/s"  FR,ADC,FC
 SG_ FR_OBJ24_RelVx : 294|12@0+ (0.0625000000,-128.0000000000) [-128.0000000000|127.9375000000] "m/s"  FR,ADC,FC
 SG_ FR_OBJ24_RelVy_std : 272|10@0+ (0.1250000000,0.0000000000) [0.0000000000|127.8750000000] "m/s"  FR,ADC,FC
 SG_ FR_OBJ24_RelVy : 266|10@0+ (0.1250000000,-64.0000000000) [-64.0000000000|63.8750000000] "m/s"  FR,ADC,FC
 SG_ FR_OBJ24_Dx_Vnce : 248|14@0+ (0.0500000000,0.0000000000) [0.0000000000|50.0000000000] "m2"  FR,ADC,FC
 SG_ FR_OBJ24_Dx : 245|13@0+ (0.0625000000,-100.0000000000) [-100.0000000000|411.9375000000] "m"  FR,ADC,FC
 SG_ FR_OBJ24_Dy_Vnce : 239|10@0+ (0.0200000000,0.0000000000) [0.0000000000|20.0000000000] "m2"  FR,ADC,FC
 SG_ FR_OBJ24_Dy : 218|11@0+ (0.1250000000,-128.0000000000) [-128.0000000000|127.8750000000] "m"  FR,ADC,FC
 SG_ FR_OBJ24_HeadingAngle : 413|10@0+ (0.0100000000,-3.1400000000) [-3.1400000000|3.1400000000] "rad"  FR,ADC,FC
 SG_ FR_OBJ24_Length : 204|9@0+ (0.0500000000,0.0000000000) [0.0000000000|25.5000000000] "m"  FR,ADC,FC
 SG_ FR_OBJ24_Height : 197|9@0+ (0.0100000000,0.0000000000) [0.0000000000|5.1100000000] "m"  FR,ADC,FC
 SG_ FR_OBJ24_Width : 176|11@0+ (0.0100000000,0.0000000000) [0.0000000000|12.0000000000] "m"  FR,ADC,FC
 SG_ FR_OBJ24_Class : 179|3@0+ (1.0000000000,0.0000000000) [0.0000000000|7.0000000000] ""  FR,ADC,FC
 SG_ FR_OBJ23_HeightGround : 39|9@0+ (0.1000000000,0.0000000000) [0.0000000000|51.1000000000] "m"  FR,ADC,FC
 SG_ FR_OBJ23_MotionStatusConf : 387|6@0+ (2.0000000000,0.0000000000) [0.0000000000|63.0000000000] "-"  FR,ADC,FC
 SG_ FR_OBJ23_ClassConf : 383|6@0+ (2.0000000000,0.0000000000) [0.0000000000|63.0000000000] "-"  FR,ADC,FC
 SG_ FR_OBJ23_MotionStatus : 373|3@0+ (1.0000000000,0.0000000000) [0.0000000000|7.0000000000] ""  FR,ADC,FC
 SG_ FR_OBJ23_Location : 361|2@0+ (1.0000000000,0.0000000000) [0.0000000000|3.0000000000] ""  FR,ADC,FC
 SG_ FR_OBJ23_Measured : 365|2@0+ (1.0000000000,0.0000000000) [0.0000000000|3.0000000000] ""  FR,ADC,FC
 SG_ FR_OBJ23_valid : 367|1@0+ (1.0000000000,0.0000000000) [0.0000000000|1.0000000000] ""  FR,ADC,FC
 SG_ FR_OBJ23_Track_Age : 171|8@0+ (1.0000000000,0.0000000000) [0.0000000000|255.0000000000] ""  FR,ADC,FC
 SG_ FR_OBJ23_Track_ID : 163|8@0+ (1.0000000000,0.0000000000) [0.0000000000|255.0000000000] ""  FR,ADC,FC
 SG_ FR_OBJ23_ObstacleProb : 153|6@0+ (2.0000000000,0.0000000000) [0.0000000000|100.0000000000] "%"  FR,ADC,FC
 SG_ FR_OBJ23_ExistProb : 159|6@0+ (2.0000000000,0.0000000000) [0.0000000000|100.0000000000] "%"  FR,ADC,FC
 SG_ FR_OBJ23_RelAx : 137|10@0+ (0.0312500000,-16.0000000000) [-16.0000000000|15.9687500000] "m/s2"  FR,ADC,FC
 SG_ FR_OBJ23_RelAy : 130|9@0+ (0.0625000000,-16.0000000000) [-16.0000000000|15.9375000000] "m/s2"  FR,ADC,FC
 SG_ FR_OBJ23_RelVx_std : 126|12@0+ (0.0625000000,0.0000000000) [0.0000000000|255.9375000000] "m/s"  FR,ADC,FC
 SG_ FR_OBJ23_RelVx : 106|12@0+ (0.0625000000,-128.0000000000) [-128.0000000000|127.9375000000] "m/s"  FR,ADC,FC
 SG_ FR_OBJ23_RelVy_std : 100|10@0+ (0.1250000000,0.0000000000) [0.0000000000|127.8750000000] "m/s"  FR,ADC,FC
 SG_ FR_OBJ23_RelVy : 94|10@0+ (0.1250000000,-64.0000000000) [-64.0000000000|63.8750000000] "m/s"  FR,ADC,FC
 SG_ FR_OBJ23_Dx_Vnce : 76|14@0+ (0.0500000000,0.0000000000) [0.0000000000|50.0000000000] "m2"  FR,ADC,FC
 SG_ FR_OBJ23_Dx : 57|13@0+ (0.0625000000,-100.0000000000) [-100.0000000000|411.9375000000] "m"  FR,ADC,FC
 SG_ FR_OBJ23_Dy_Vnce : 51|10@0+ (0.0200000000,0.0000000000) [0.0000000000|20.0000000000] "m2"  FR,ADC,FC
 SG_ FR_OBJ23_Dy : 46|11@0+ (0.1250000000,-128.0000000000) [-128.0000000000|127.8750000000] "m"  FR,ADC,FC
 SG_ FR_OBJ23_HeadingAngle : 407|10@0+ (0.0100000000,-3.1400000000) [-3.1400000000|3.1400000000] "rad"  FR,ADC,FC
 SG_ FR_OBJ23_Length : 16|9@0+ (0.0500000000,0.0000000000) [0.0000000000|25.5000000000] "m"  FR,ADC,FC
 SG_ FR_OBJ23_Height : 9|9@0+ (0.0100000000,0.0000000000) [0.0000000000|5.1100000000] "m"  FR,ADC,FC
 SG_ FR_OBJ23_Width : 4|11@0+ (0.0100000000,0.0000000000) [0.0000000000|12.0000000000] "m"  FR,ADC,FC
 SG_ FR_OBJ23_Class : 7|3@0+ (1.0000000000,0.0000000000) [0.0000000000|7.0000000000] ""  FR,ADC,FC

BO_ 285 FR_11D: 64 FR
 SG_ FR_OBJ26_Ax : 482|7@0+ (0.2000000000,-13.0000000000) [-13.0000000000|12.6000000000] "m/s2"  FR,ADC,FC
 SG_ FR_OBJ26_Ay : 473|7@0+ (0.2000000000,-13.0000000000) [-13.0000000000|12.6000000000] "m/s2"  FR,ADC,FC
 SG_ FR_OBJ26_Vx : 466|9@0+ (0.2000000000,-51.0000000000) [-51.0000000000|51.2000000000] "m/s"  FR,ADC,FC
 SG_ FR_OBJ26_Vy : 459|9@0+ (0.2000000000,-51.0000000000) [-51.0000000000|51.2000000000] "m/s"  FR,ADC,FC
 SG_ FR_OBJ25_Ax : 450|7@0+ (0.2000000000,-13.0000000000) [-13.0000000000|12.6000000000] "m/s2"  FR,ADC,FC
 SG_ FR_OBJ25_Ay : 441|7@0+ (0.2000000000,-13.0000000000) [-13.0000000000|12.6000000000] "m/s2"  FR,ADC,FC
 SG_ FR_OBJ25_Vx : 434|9@0+ (0.2000000000,-51.0000000000) [-51.0000000000|51.2000000000] "m/s"  FR,ADC,FC
 SG_ FR_OBJ25_Vy : 427|9@0+ (0.2000000000,-51.0000000000) [-51.0000000000|51.2000000000] "m/s"  FR,ADC,FC
 SG_ FR_OBJ26_FeaturePoint : 431|4@0+ (1.0000000000,0.0000000000) [0.0000000000|9.0000000000] "-"  FR,ADC,FC
 SG_ FR_OBJ25_FeaturePoint : 419|4@0+ (1.0000000000,0.0000000000) [0.0000000000|9.0000000000] "-"  FR,ADC,FC
 SG_ FR_CRCCheck_11D : 503|16@0+ (1.0000000000,0.0000000000) [0.0000000000|65535.0000000000] ""  FR,ADC,FC
 SG_ FR_RollingCounter_11D : 491|4@0+ (1.0000000000,0.0000000000) [0.0000000000|15.0000000000] ""  FR,ADC,FC
 SG_ FR_OBJ26_HeightGround : 211|9@0+ (0.1000000000,0.0000000000) [0.0000000000|51.1000000000] "m"  FR,ADC,FC
 SG_ FR_OBJ26_MotionStatusConf : 397|6@0+ (2.0000000000,0.0000000000) [0.0000000000|63.0000000000] "-"  FR,ADC,FC
 SG_ FR_OBJ26_ClassConf : 377|6@0+ (2.0000000000,0.0000000000) [0.0000000000|63.0000000000] "-"  FR,ADC,FC
 SG_ FR_OBJ26_MotionStatus : 370|3@0+ (1.0000000000,0.0000000000) [0.0000000000|7.0000000000] ""  FR,ADC,FC
 SG_ FR_OBJ26_Location : 375|2@0+ (1.0000000000,0.0000000000) [0.0000000000|3.0000000000] ""  FR,ADC,FC
 SG_ FR_OBJ26_Measured : 363|2@0+ (1.0000000000,0.0000000000) [0.0000000000|3.0000000000] ""  FR,ADC,FC
 SG_ FR_OBJ26_valid : 366|1@0+ (1.0000000000,0.0000000000) [0.0000000000|1.0000000000] ""  FR,ADC,FC
 SG_ FR_OBJ26_Track_Age : 359|8@0+ (1.0000000000,0.0000000000) [0.0000000000|255.0000000000] ""  FR,ADC,FC
 SG_ FR_OBJ26_Track_ID : 351|8@0+ (1.0000000000,0.0000000000) [0.0000000000|255.0000000000] ""  FR,ADC,FC
 SG_ FR_OBJ26_ObstacleProb : 341|6@0+ (2.0000000000,0.0000000000) [0.0000000000|100.0000000000] "%"  FR,ADC,FC
 SG_ FR_OBJ26_ExistProb : 331|6@0+ (2.0000000000,0.0000000000) [0.0000000000|100.0000000000] "%"  FR,ADC,FC
 SG_ FR_OBJ26_RelAx : 325|10@0+ (0.0312500000,-16.0000000000) [-16.0000000000|15.9687500000] "m/s2"  FR,ADC,FC
 SG_ FR_OBJ26_RelAy : 318|9@0+ (0.0625000000,-16.0000000000) [-16.0000000000|15.9375000000] "m/s2"  FR,ADC,FC
 SG_ FR_OBJ26_RelVx_std : 298|12@0+ (0.0625000000,0.0000000000) [0.0000000000|255.9375000000] "m/s"  FR,ADC,FC
 SG_ FR_OBJ26_RelVx : 294|12@0+ (0.0625000000,-128.0000000000) [-128.0000000000|127.9375000000] "m/s"  FR,ADC,FC
 SG_ FR_OBJ26_RelVy_std : 272|10@0+ (0.1250000000,0.0000000000) [0.0000000000|127.8750000000] "m/s"  FR,ADC,FC
 SG_ FR_OBJ26_RelVy : 266|10@0+ (0.1250000000,-64.0000000000) [-64.0000000000|63.8750000000] "m/s"  FR,ADC,FC
 SG_ FR_OBJ26_Dx_Vnce : 248|14@0+ (0.0500000000,0.0000000000) [0.0000000000|50.0000000000] "m2"  FR,ADC,FC
 SG_ FR_OBJ26_Dx : 245|13@0+ (0.0625000000,-100.0000000000) [-100.0000000000|411.9375000000] "m"  FR,ADC,FC
 SG_ FR_OBJ26_Dy_Vnce : 239|10@0+ (0.0200000000,0.0000000000) [0.0000000000|20.0000000000] "m2"  FR,ADC,FC
 SG_ FR_OBJ26_Dy : 218|11@0+ (0.1250000000,-128.0000000000) [-128.0000000000|127.8750000000] "m"  FR,ADC,FC
 SG_ FR_OBJ26_HeadingAngle : 413|10@0+ (0.0100000000,-3.1400000000) [-3.1400000000|3.1400000000] "rad"  FR,ADC,FC
 SG_ FR_OBJ26_Length : 204|9@0+ (0.0500000000,0.0000000000) [0.0000000000|25.5000000000] "m"  FR,ADC,FC
 SG_ FR_OBJ26_Height : 197|9@0+ (0.0100000000,0.0000000000) [0.0000000000|5.1100000000] "m"  FR,ADC,FC
 SG_ FR_OBJ26_Width : 176|11@0+ (0.0100000000,0.0000000000) [0.0000000000|12.0000000000] "m"  FR,ADC,FC
 SG_ FR_OBJ26_Class : 179|3@0+ (1.0000000000,0.0000000000) [0.0000000000|7.0000000000] ""  FR,ADC,FC
 SG_ FR_OBJ25_HeightGround : 39|9@0+ (0.1000000000,0.0000000000) [0.0000000000|51.1000000000] "m"  FR,ADC,FC
 SG_ FR_OBJ25_MotionStatusConf : 387|6@0+ (2.0000000000,0.0000000000) [0.0000000000|63.0000000000] "-"  FR,ADC,FC
 SG_ FR_OBJ25_ClassConf : 383|6@0+ (2.0000000000,0.0000000000) [0.0000000000|63.0000000000] "-"  FR,ADC,FC
 SG_ FR_OBJ25_MotionStatus : 373|3@0+ (1.0000000000,0.0000000000) [0.0000000000|7.0000000000] ""  FR,ADC,FC
 SG_ FR_OBJ25_Location : 361|2@0+ (1.0000000000,0.0000000000) [0.0000000000|3.0000000000] ""  FR,ADC,FC
 SG_ FR_OBJ25_Measured : 365|2@0+ (1.0000000000,0.0000000000) [0.0000000000|3.0000000000] ""  FR,ADC,FC
 SG_ FR_OBJ25_valid : 367|1@0+ (1.0000000000,0.0000000000) [0.0000000000|1.0000000000] ""  FR,ADC,FC
 SG_ FR_OBJ25_Track_Age : 171|8@0+ (1.0000000000,0.0000000000) [0.0000000000|255.0000000000] ""  FR,ADC,FC
 SG_ FR_OBJ25_Track_ID : 163|8@0+ (1.0000000000,0.0000000000) [0.0000000000|255.0000000000] ""  FR,ADC,FC
 SG_ FR_OBJ25_ObstacleProb : 153|6@0+ (2.0000000000,0.0000000000) [0.0000000000|100.0000000000] "%"  FR,ADC,FC
 SG_ FR_OBJ25_ExistProb : 159|6@0+ (2.0000000000,0.0000000000) [0.0000000000|100.0000000000] "%"  FR,ADC,FC
 SG_ FR_OBJ25_RelAx : 137|10@0+ (0.0312500000,-16.0000000000) [-16.0000000000|15.9687500000] "m/s2"  FR,ADC,FC
 SG_ FR_OBJ25_RelAy : 130|9@0+ (0.0625000000,-16.0000000000) [-16.0000000000|15.9375000000] "m/s2"  FR,ADC,FC
 SG_ FR_OBJ25_RelVx_std : 126|12@0+ (0.0625000000,0.0000000000) [0.0000000000|255.9375000000] "m/s"  FR,ADC,FC
 SG_ FR_OBJ25_RelVx : 106|12@0+ (0.0625000000,-128.0000000000) [-128.0000000000|127.9375000000] "m/s"  FR,ADC,FC
 SG_ FR_OBJ25_RelVy_std : 100|10@0+ (0.1250000000,0.0000000000) [0.0000000000|127.8750000000] "m/s"  FR,ADC,FC
 SG_ FR_OBJ25_RelVy : 94|10@0+ (0.1250000000,-64.0000000000) [-64.0000000000|63.8750000000] "m/s"  FR,ADC,FC
 SG_ FR_OBJ25_Dx_Vnce : 76|14@0+ (0.0500000000,0.0000000000) [0.0000000000|50.0000000000] "m2"  FR,ADC,FC
 SG_ FR_OBJ25_Dx : 57|13@0+ (0.0625000000,-100.0000000000) [-100.0000000000|411.9375000000] "m"  FR,ADC,FC
 SG_ FR_OBJ25_Dy_Vnce : 51|10@0+ (0.0200000000,0.0000000000) [0.0000000000|20.0000000000] "m2"  FR,ADC,FC
 SG_ FR_OBJ25_Dy : 46|11@0+ (0.1250000000,-128.0000000000) [-128.0000000000|127.8750000000] "m"  FR,ADC,FC
 SG_ FR_OBJ25_HeadingAngle : 407|10@0+ (0.0100000000,-3.1400000000) [-3.1400000000|3.1400000000] "rad"  FR,ADC,FC
 SG_ FR_OBJ25_Length : 16|9@0+ (0.0500000000,0.0000000000) [0.0000000000|25.5000000000] "m"  FR,ADC,FC
 SG_ FR_OBJ25_Height : 9|9@0+ (0.0100000000,0.0000000000) [0.0000000000|5.1100000000] "m"  FR,ADC,FC
 SG_ FR_OBJ25_Width : 4|11@0+ (0.0100000000,0.0000000000) [0.0000000000|12.0000000000] "m"  FR,ADC,FC
 SG_ FR_OBJ25_Class : 7|3@0+ (1.0000000000,0.0000000000) [0.0000000000|7.0000000000] ""  FR,ADC,FC

BO_ 286 FR_11E: 64 FR
 SG_ FR_OBJ28_Ax : 482|7@0+ (0.2000000000,-13.0000000000) [-13.0000000000|12.6000000000] "m/s2"  FR,ADC,FC
 SG_ FR_OBJ28_Ay : 473|7@0+ (0.2000000000,-13.0000000000) [-13.0000000000|12.6000000000] "m/s2"  FR,ADC,FC
 SG_ FR_OBJ28_Vx : 466|9@0+ (0.2000000000,-51.0000000000) [-51.0000000000|51.2000000000] "m/s"  FR,ADC,FC
 SG_ FR_OBJ28_Vy : 459|9@0+ (0.2000000000,-51.0000000000) [-51.0000000000|51.2000000000] "m/s"  FR,ADC,FC
 SG_ FR_OBJ27_Ax : 450|7@0+ (0.2000000000,-13.0000000000) [-13.0000000000|12.6000000000] "m/s2"  FR,ADC,FC
 SG_ FR_OBJ27_Ay : 441|7@0+ (0.2000000000,-13.0000000000) [-13.0000000000|12.6000000000] "m/s2"  FR,ADC,FC
 SG_ FR_OBJ27_Vx : 434|9@0+ (0.2000000000,-51.0000000000) [-51.0000000000|51.2000000000] "m/s"  FR,ADC,FC
 SG_ FR_OBJ27_Vy : 427|9@0+ (0.2000000000,-51.0000000000) [-51.0000000000|51.2000000000] "m/s"  FR,ADC,FC
 SG_ FR_OBJ28_FeaturePoint : 431|4@0+ (1.0000000000,0.0000000000) [0.0000000000|9.0000000000] "-"  FR,ADC,FC
 SG_ FR_OBJ27_FeaturePoint : 419|4@0+ (1.0000000000,0.0000000000) [0.0000000000|9.0000000000] "-"  FR,ADC,FC
 SG_ ER_CRCCheck_11E : 503|16@0+ (1.0000000000,0.0000000000) [0.0000000000|65535.0000000000] ""  FR,ADC,FC
 SG_ ER_RollingCounter_11E : 491|4@0+ (1.0000000000,0.0000000000) [0.0000000000|15.0000000000] ""  FR,ADC,FC
 SG_ FR_OBJ28_HeightGround : 211|9@0+ (0.1000000000,0.0000000000) [0.0000000000|51.1000000000] "m"  FR,ADC,FC
 SG_ FR_OBJ28_MotionStatusConf : 397|6@0+ (2.0000000000,0.0000000000) [0.0000000000|63.0000000000] "-"  FR,ADC,FC
 SG_ FR_OBJ28_ClassConf : 377|6@0+ (2.0000000000,0.0000000000) [0.0000000000|63.0000000000] "-"  FR,ADC,FC
 SG_ FR_OBJ28_MotionStatus : 370|3@0+ (1.0000000000,0.0000000000) [0.0000000000|7.0000000000] ""  FR,ADC,FC
 SG_ FR_OBJ28_Location : 375|2@0+ (1.0000000000,0.0000000000) [0.0000000000|3.0000000000] ""  FR,ADC,FC
 SG_ FR_OBJ28_Measured : 363|2@0+ (1.0000000000,0.0000000000) [0.0000000000|3.0000000000] ""  FR,ADC,FC
 SG_ FR_OBJ28_valid : 366|1@0+ (1.0000000000,0.0000000000) [0.0000000000|1.0000000000] ""  FR,ADC,FC
 SG_ FR_OBJ28_Track_Age : 359|8@0+ (1.0000000000,0.0000000000) [0.0000000000|255.0000000000] ""  FR,ADC,FC
 SG_ FR_OBJ28_Track_ID : 351|8@0+ (1.0000000000,0.0000000000) [0.0000000000|255.0000000000] ""  FR,ADC,FC
 SG_ FR_OBJ28_ObstacleProb : 341|6@0+ (2.0000000000,0.0000000000) [0.0000000000|100.0000000000] "%"  FR,ADC,FC
 SG_ FR_OBJ28_ExistProb : 331|6@0+ (2.0000000000,0.0000000000) [0.0000000000|100.0000000000] "%"  FR,ADC,FC
 SG_ FR_OBJ28_RelAx : 325|10@0+ (0.0312500000,-16.0000000000) [-16.0000000000|15.9687500000] "m/s2"  FR,ADC,FC
 SG_ FR_OBJ28_RelAy : 318|9@0+ (0.0625000000,-16.0000000000) [-16.0000000000|15.9375000000] "m/s2"  FR,ADC,FC
 SG_ FR_OBJ28_RelVx_std : 298|12@0+ (0.0625000000,0.0000000000) [0.0000000000|255.9375000000] "m/s"  FR,ADC,FC
 SG_ FR_OBJ28_RelVx : 294|12@0+ (0.0625000000,-128.0000000000) [-128.0000000000|127.9375000000] "m/s"  FR,ADC,FC
 SG_ FR_OBJ28_RelVy_std : 272|10@0+ (0.1250000000,0.0000000000) [0.0000000000|127.8750000000] "m/s"  FR,ADC,FC
 SG_ FR_OBJ28_RelVy : 266|10@0+ (0.1250000000,-64.0000000000) [-64.0000000000|63.8750000000] "m/s"  FR,ADC,FC
 SG_ FR_OBJ28_Dx_Vnce : 248|14@0+ (0.0500000000,0.0000000000) [0.0000000000|50.0000000000] "m2"  FR,ADC,FC
 SG_ FR_OBJ28_Dx : 245|13@0+ (0.0625000000,-100.0000000000) [-100.0000000000|411.9375000000] "m"  FR,ADC,FC
 SG_ FR_OBJ28_Dy_Vnce : 239|10@0+ (0.0200000000,0.0000000000) [0.0000000000|20.0000000000] "m2"  FR,ADC,FC
 SG_ FR_OBJ28_Dy : 218|11@0+ (0.1250000000,-128.0000000000) [-128.0000000000|127.8750000000] "m"  FR,ADC,FC
 SG_ FR_OBJ28_HeadingAngle : 413|10@0+ (0.0100000000,-3.1400000000) [-3.1400000000|3.1400000000] "rad"  FR,ADC,FC
 SG_ FR_OBJ28_Length : 204|9@0+ (0.0500000000,0.0000000000) [0.0000000000|25.5000000000] "m"  FR,ADC,FC
 SG_ FR_OBJ28_Height : 197|9@0+ (0.0100000000,0.0000000000) [0.0000000000|5.1100000000] "m"  FR,ADC,FC
 SG_ FR_OBJ28_Width : 176|11@0+ (0.0100000000,0.0000000000) [0.0000000000|12.0000000000] "m"  FR,ADC,FC
 SG_ FR_OBJ28_Class : 179|3@0+ (1.0000000000,0.0000000000) [0.0000000000|7.0000000000] ""  FR,ADC,FC
 SG_ FR_OBJ27_HeightGround : 39|9@0+ (0.1000000000,0.0000000000) [0.0000000000|51.1000000000] "m"  FR,ADC,FC
 SG_ FR_OBJ27_MotionStatusConf : 387|6@0+ (2.0000000000,0.0000000000) [0.0000000000|63.0000000000] "-"  FR,ADC,FC
 SG_ FR_OBJ27_ClassConf : 383|6@0+ (2.0000000000,0.0000000000) [0.0000000000|63.0000000000] "-"  FR,ADC,FC
 SG_ FR_OBJ27_MotionStatus : 373|3@0+ (1.0000000000,0.0000000000) [0.0000000000|7.0000000000] ""  FR,ADC,FC
 SG_ FR_OBJ27_Location : 361|2@0+ (1.0000000000,0.0000000000) [0.0000000000|3.0000000000] ""  FR,ADC,FC
 SG_ FR_OBJ27_Measured : 365|2@0+ (1.0000000000,0.0000000000) [0.0000000000|3.0000000000] ""  FR,ADC,FC
 SG_ FR_OBJ27_valid : 367|1@0+ (1.0000000000,0.0000000000) [0.0000000000|1.0000000000] ""  FR,ADC,FC
 SG_ FR_OBJ27_Track_Age : 171|8@0+ (1.0000000000,0.0000000000) [0.0000000000|255.0000000000] ""  FR,ADC,FC
 SG_ FR_OBJ27_Track_ID : 163|8@0+ (1.0000000000,0.0000000000) [0.0000000000|255.0000000000] ""  FR,ADC,FC
 SG_ FR_OBJ27_ObstacleProb : 153|6@0+ (2.0000000000,0.0000000000) [0.0000000000|100.0000000000] "%"  FR,ADC,FC
 SG_ FR_OBJ27_ExistProb : 159|6@0+ (2.0000000000,0.0000000000) [0.0000000000|100.0000000000] "%"  FR,ADC,FC
 SG_ FR_OBJ27_RelAx : 137|10@0+ (0.0312500000,-16.0000000000) [-16.0000000000|15.9687500000] "m/s2"  FR,ADC,FC
 SG_ FR_OBJ27_RelAy : 130|9@0+ (0.0625000000,-16.0000000000) [-16.0000000000|15.9375000000] "m/s2"  FR,ADC,FC
 SG_ FR_OBJ27_RelVx_std : 126|12@0+ (0.0625000000,0.0000000000) [0.0000000000|255.9375000000] "m/s"  FR,ADC,FC
 SG_ FR_OBJ27_RelVx : 106|12@0+ (0.0625000000,-128.0000000000) [-128.0000000000|127.9375000000] "m/s"  FR,ADC,FC
 SG_ FR_OBJ27_RelVy_std : 100|10@0+ (0.1250000000,0.0000000000) [0.0000000000|127.8750000000] "m/s"  FR,ADC,FC
 SG_ FR_OBJ27_RelVy : 94|10@0+ (0.1250000000,-64.0000000000) [-64.0000000000|63.8750000000] "m/s"  FR,ADC,FC
 SG_ FR_OBJ27_Dx_Vnce : 76|14@0+ (0.0500000000,0.0000000000) [0.0000000000|50.0000000000] "m2"  FR,ADC,FC
 SG_ FR_OBJ27_Dx : 57|13@0+ (0.0625000000,-100.0000000000) [-100.0000000000|411.9375000000] "m"  FR,ADC,FC
 SG_ FR_OBJ27_Dy_Vnce : 51|10@0+ (0.0200000000,0.0000000000) [0.0000000000|20.0000000000] "m2"  FR,ADC,FC
 SG_ FR_OBJ27_Dy : 46|11@0+ (0.1250000000,-128.0000000000) [-128.0000000000|127.8750000000] "m"  FR,ADC,FC
 SG_ FR_OBJ27_HeadingAngle : 407|10@0+ (0.0100000000,-3.1400000000) [-3.1400000000|3.1400000000] "rad"  FR,ADC,FC
 SG_ FR_OBJ27_Length : 16|9@0+ (0.0500000000,0.0000000000) [0.0000000000|25.5000000000] "m"  FR,ADC,FC
 SG_ FR_OBJ27_Height : 9|9@0+ (0.0100000000,0.0000000000) [0.0000000000|5.1100000000] "m"  FR,ADC,FC
 SG_ FR_OBJ27_Width : 4|11@0+ (0.0100000000,0.0000000000) [0.0000000000|12.0000000000] "m"  FR,ADC,FC
 SG_ FR_OBJ27_Class : 7|3@0+ (1.0000000000,0.0000000000) [0.0000000000|7.0000000000] ""  FR,ADC,FC

BO_ 287 FR_11F: 64 FR
 SG_ FR_OBJ30_Ax : 482|7@0+ (0.2000000000,-13.0000000000) [-13.0000000000|12.6000000000] "m/s2"  FR,ADC,FC
 SG_ FR_OBJ30_Ay : 473|7@0+ (0.2000000000,-13.0000000000) [-13.0000000000|12.6000000000] "m/s2"  FR,ADC,FC
 SG_ FR_OBJ30_Vx : 466|9@0+ (0.2000000000,-51.0000000000) [-51.0000000000|51.2000000000] "m/s"  FR,ADC,FC
 SG_ FR_OBJ30_Vy : 459|9@0+ (0.2000000000,-51.0000000000) [-51.0000000000|51.2000000000] "m/s"  FR,ADC,FC
 SG_ FR_OBJ29_Ax : 450|7@0+ (0.2000000000,-13.0000000000) [-13.0000000000|12.6000000000] "m/s2"  FR,ADC,FC
 SG_ FR_OBJ29_Ay : 441|7@0+ (0.2000000000,-13.0000000000) [-13.0000000000|12.6000000000] "m/s2"  FR,ADC,FC
 SG_ FR_OBJ29_Vx : 434|9@0+ (0.2000000000,-51.0000000000) [-51.0000000000|51.2000000000] "m/s"  FR,ADC,FC
 SG_ FR_OBJ29_Vy : 427|9@0+ (0.2000000000,-51.0000000000) [-51.0000000000|51.2000000000] "m/s"  FR,ADC,FC
 SG_ FR_OBJ30_FeaturePoint : 431|4@0+ (1.0000000000,0.0000000000) [0.0000000000|9.0000000000] "-"  FR,ADC,FC
 SG_ FR_OBJ29_FeaturePoint : 419|4@0+ (1.0000000000,0.0000000000) [0.0000000000|9.0000000000] "-"  FR,ADC,FC
 SG_ FR_CRCCheck_11F : 503|16@0+ (1.0000000000,0.0000000000) [0.0000000000|65535.0000000000] ""  FR,ADC,FC
 SG_ FR_RollingCounter_11F : 491|4@0+ (1.0000000000,0.0000000000) [0.0000000000|15.0000000000] ""  FR,ADC,FC
 SG_ FR_OBJ30_HeightGround : 211|9@0+ (0.1000000000,0.0000000000) [0.0000000000|51.1000000000] "m"  FR,ADC,FC
 SG_ FR_OBJ30_MotionStatusConf : 397|6@0+ (2.0000000000,0.0000000000) [0.0000000000|63.0000000000] "-"  FR,ADC,FC
 SG_ FR_OBJ30_ClassConf : 377|6@0+ (2.0000000000,0.0000000000) [0.0000000000|63.0000000000] "-"  FR,ADC,FC
 SG_ FR_OBJ30_MotionStatus : 370|3@0+ (1.0000000000,0.0000000000) [0.0000000000|7.0000000000] ""  FR,ADC,FC
 SG_ FR_OBJ30_Location : 375|2@0+ (1.0000000000,0.0000000000) [0.0000000000|3.0000000000] ""  FR,ADC,FC
 SG_ FR_OBJ30_Measured : 363|2@0+ (1.0000000000,0.0000000000) [0.0000000000|3.0000000000] ""  FR,ADC,FC
 SG_ FR_OBJ30_valid : 366|1@0+ (1.0000000000,0.0000000000) [0.0000000000|1.0000000000] ""  FR,ADC,FC
 SG_ FR_OBJ30_Track_Age : 359|8@0+ (1.0000000000,0.0000000000) [0.0000000000|255.0000000000] ""  FR,ADC,FC
 SG_ FR_OBJ30_Track_ID : 351|8@0+ (1.0000000000,0.0000000000) [0.0000000000|255.0000000000] ""  FR,ADC,FC
 SG_ FR_OBJ30_ObstacleProb : 341|6@0+ (2.0000000000,0.0000000000) [0.0000000000|100.0000000000] "%"  FR,ADC,FC
 SG_ FR_OBJ30_ExistProb : 331|6@0+ (2.0000000000,0.0000000000) [0.0000000000|100.0000000000] "%"  FR,ADC,FC
 SG_ FR_OBJ30_RelAx : 325|10@0+ (0.0312500000,-16.0000000000) [-16.0000000000|15.9687500000] "m/s2"  FR,ADC,FC
 SG_ FR_OBJ30_RelAy : 318|9@0+ (0.0625000000,-16.0000000000) [-16.0000000000|15.9375000000] "m/s2"  FR,ADC,FC
 SG_ FR_OBJ30_RelVx_std : 298|12@0+ (0.0625000000,0.0000000000) [0.0000000000|255.9375000000] "m/s"  FR,ADC,FC
 SG_ FR_OBJ30_RelVx : 294|12@0+ (0.0625000000,-128.0000000000) [-128.0000000000|127.9375000000] "m/s"  FR,ADC,FC
 SG_ FR_OBJ30_RelVy_std : 272|10@0+ (0.1250000000,0.0000000000) [0.0000000000|127.8750000000] "m/s"  FR,ADC,FC
 SG_ FR_OBJ30_RelVy : 266|10@0+ (0.1250000000,-64.0000000000) [-64.0000000000|63.8750000000] "m/s"  FR,ADC,FC
 SG_ FR_OBJ30_Dx_Vnce : 248|14@0+ (0.0500000000,0.0000000000) [0.0000000000|50.0000000000] "m2"  FR,ADC,FC
 SG_ FR_OBJ30_Dx : 245|13@0+ (0.0625000000,-100.0000000000) [-100.0000000000|411.9375000000] "m"  FR,ADC,FC
 SG_ FR_OBJ30_Dy_Vnce : 239|10@0+ (0.0200000000,0.0000000000) [0.0000000000|20.0000000000] "m2"  FR,ADC,FC
 SG_ FR_OBJ30_Dy : 218|11@0+ (0.1250000000,-128.0000000000) [-128.0000000000|127.8750000000] "m"  FR,ADC,FC
 SG_ FR_OBJ30_HeadingAngle : 413|10@0+ (0.0100000000,-3.1400000000) [-3.1400000000|3.1400000000] "rad"  FR,ADC,FC
 SG_ FR_OBJ30_Length : 204|9@0+ (0.0500000000,0.0000000000) [0.0000000000|25.5000000000] "m"  FR,ADC,FC
 SG_ FR_OBJ30_Height : 197|9@0+ (0.0100000000,0.0000000000) [0.0000000000|5.1100000000] "m"  FR,ADC,FC
 SG_ FR_OBJ30_Width : 176|11@0+ (0.0100000000,0.0000000000) [0.0000000000|12.0000000000] "m"  FR,ADC,FC
 SG_ FR_OBJ30_Class : 179|3@0+ (1.0000000000,0.0000000000) [0.0000000000|7.0000000000] ""  FR,ADC,FC
 SG_ FR_OBJ29_HeightGround : 39|9@0+ (0.1000000000,0.0000000000) [0.0000000000|51.1000000000] "m"  FR,ADC,FC
 SG_ FR_OBJ29_MotionStatusConf : 387|6@0+ (2.0000000000,0.0000000000) [0.0000000000|63.0000000000] "-"  FR,ADC,FC
 SG_ FR_OBJ29_ClassConf : 383|6@0+ (2.0000000000,0.0000000000) [0.0000000000|63.0000000000] "-"  FR,ADC,FC
 SG_ FR_OBJ29_MotionStatus : 373|3@0+ (1.0000000000,0.0000000000) [0.0000000000|7.0000000000] ""  FR,ADC,FC
 SG_ FR_OBJ29_Location : 361|2@0+ (1.0000000000,0.0000000000) [0.0000000000|3.0000000000] ""  FR,ADC,FC
 SG_ FR_OBJ29_Measured : 365|2@0+ (1.0000000000,0.0000000000) [0.0000000000|3.0000000000] ""  FR,ADC,FC
 SG_ FR_OBJ29_valid : 367|1@0+ (1.0000000000,0.0000000000) [0.0000000000|1.0000000000] ""  FR,ADC,FC
 SG_ FR_OBJ29_Track_Age : 171|8@0+ (1.0000000000,0.0000000000) [0.0000000000|255.0000000000] ""  FR,ADC,FC
 SG_ FR_OBJ29_Track_ID : 163|8@0+ (1.0000000000,0.0000000000) [0.0000000000|255.0000000000] ""  FR,ADC,FC
 SG_ FR_OBJ29_ObstacleProb : 153|6@0+ (2.0000000000,0.0000000000) [0.0000000000|100.0000000000] "%"  FR,ADC,FC
 SG_ FR_OBJ29_ExistProb : 159|6@0+ (2.0000000000,0.0000000000) [0.0000000000|100.0000000000] "%"  FR,ADC,FC
 SG_ FR_OBJ29_RelAx : 137|10@0+ (0.0312500000,-16.0000000000) [-16.0000000000|15.9687500000] "m/s2"  FR,ADC,FC
 SG_ FR_OBJ29_RelAy : 130|9@0+ (0.0625000000,-16.0000000000) [-16.0000000000|15.9375000000] "m/s2"  FR,ADC,FC
 SG_ FR_OBJ29_RelVx_std : 126|12@0+ (0.0625000000,0.0000000000) [0.0000000000|255.9375000000] "m/s"  FR,ADC,FC
 SG_ FR_OBJ29_RelVx : 106|12@0+ (0.0625000000,-128.0000000000) [-128.0000000000|127.9375000000] "m/s"  FR,ADC,FC
 SG_ FR_OBJ29_RelVy_std : 100|10@0+ (0.1250000000,0.0000000000) [0.0000000000|127.8750000000] "m/s"  FR,ADC,FC
 SG_ FR_OBJ29_RelVy : 94|10@0+ (0.1250000000,-64.0000000000) [-64.0000000000|63.8750000000] "m/s"  FR,ADC,FC
 SG_ FR_OBJ29_Dx_Vnce : 76|14@0+ (0.0500000000,0.0000000000) [0.0000000000|50.0000000000] "m2"  FR,ADC,FC
 SG_ FR_OBJ29_Dx : 57|13@0+ (0.0625000000,-100.0000000000) [-100.0000000000|411.9375000000] "m"  FR,ADC,FC
 SG_ FR_OBJ29_Dy_Vnce : 51|10@0+ (0.0200000000,0.0000000000) [0.0000000000|20.0000000000] "m2"  FR,ADC,FC
 SG_ FR_OBJ29_Dy : 46|11@0+ (0.1250000000,-128.0000000000) [-128.0000000000|127.8750000000] "m"  FR,ADC,FC
 SG_ FR_OBJ29_HeadingAngle : 407|10@0+ (0.0100000000,-3.1400000000) [-3.1400000000|3.1400000000] "rad"  FR,ADC,FC
 SG_ FR_OBJ29_Length : 16|9@0+ (0.0500000000,0.0000000000) [0.0000000000|25.5000000000] "m"  FR,ADC,FC
 SG_ FR_OBJ29_Height : 9|9@0+ (0.0100000000,0.0000000000) [0.0000000000|5.1100000000] "m"  FR,ADC,FC
 SG_ FR_OBJ29_Width : 4|11@0+ (0.0100000000,0.0000000000) [0.0000000000|12.0000000000] "m"  FR,ADC,FC
 SG_ FR_OBJ29_Class : 7|3@0+ (1.0000000000,0.0000000000) [0.0000000000|7.0000000000] ""  FR,ADC,FC

BO_ 288 FR_120: 64 FR
 SG_ FR_OBJ32_Ax : 482|7@0+ (0.2000000000,-13.0000000000) [-13.0000000000|12.6000000000] "m/s2"  FR,ADC,FC
 SG_ FR_OBJ32_Ay : 473|7@0+ (0.2000000000,-13.0000000000) [-13.0000000000|12.6000000000] "m/s2"  FR,ADC,FC
 SG_ FR_OBJ32_Vx : 466|9@0+ (0.2000000000,-51.0000000000) [-51.0000000000|51.2000000000] "m/s"  FR,ADC,FC
 SG_ FR_OBJ32_Vy : 459|9@0+ (0.2000000000,-51.0000000000) [-51.0000000000|51.2000000000] "m/s"  FR,ADC,FC
 SG_ FR_OBJ31_Ax : 450|7@0+ (0.2000000000,-13.0000000000) [-13.0000000000|12.6000000000] "m/s2"  FR,ADC,FC
 SG_ FR_OBJ31_Ay : 441|7@0+ (0.2000000000,-13.0000000000) [-13.0000000000|12.6000000000] "m/s2"  FR,ADC,FC
 SG_ FR_OBJ31_Vx : 434|9@0+ (0.2000000000,-51.0000000000) [-51.0000000000|51.2000000000] "m/s"  FR,ADC,FC
 SG_ FR_OBJ31_Vy : 427|9@0+ (0.2000000000,-51.0000000000) [-51.0000000000|51.2000000000] "m/s"  FR,ADC,FC
 SG_ FR_OBJ32_FeaturePoint : 431|4@0+ (1.0000000000,0.0000000000) [0.0000000000|9.0000000000] "-"  FR,ADC,FC
 SG_ FR_OBJ31_FeaturePoint : 419|4@0+ (1.0000000000,0.0000000000) [0.0000000000|9.0000000000] "-"  FR,ADC,FC
 SG_ FR_CRCCheck_120 : 503|16@0+ (1.0000000000,0.0000000000) [0.0000000000|65535.0000000000] ""  FR,ADC,FC
 SG_ FR_RollingCounter_120 : 491|4@0+ (1.0000000000,0.0000000000) [0.0000000000|15.0000000000] ""  FR,ADC,FC
 SG_ FR_OBJ32_HeightGround : 211|9@0+ (0.1000000000,0.0000000000) [0.0000000000|51.1000000000] "m"  FR,ADC,FC
 SG_ FR_OBJ32_MotionStatusConf : 397|6@0+ (2.0000000000,0.0000000000) [0.0000000000|63.0000000000] "-"  FR,ADC,FC
 SG_ FR_OBJ32_ClassConf : 377|6@0+ (2.0000000000,0.0000000000) [0.0000000000|63.0000000000] "-"  FR,ADC,FC
 SG_ FR_OBJ32_MotionStatus : 370|3@0+ (1.0000000000,0.0000000000) [0.0000000000|7.0000000000] ""  FR,ADC,FC
 SG_ FR_OBJ32_Location : 375|2@0+ (1.0000000000,0.0000000000) [0.0000000000|3.0000000000] ""  FR,ADC,FC
 SG_ FR_OBJ32_Measured : 363|2@0+ (1.0000000000,0.0000000000) [0.0000000000|3.0000000000] ""  FR,ADC,FC
 SG_ FR_OBJ32_valid : 366|1@0+ (1.0000000000,0.0000000000) [0.0000000000|1.0000000000] ""  FR,ADC,FC
 SG_ FR_OBJ32_Track_Age : 359|8@0+ (1.0000000000,0.0000000000) [0.0000000000|255.0000000000] ""  FR,ADC,FC
 SG_ FR_OBJ32_Track_ID : 351|8@0+ (1.0000000000,0.0000000000) [0.0000000000|255.0000000000] ""  FR,ADC,FC
 SG_ FR_OBJ32_ObstacleProb : 341|6@0+ (2.0000000000,0.0000000000) [0.0000000000|100.0000000000] "%"  FR,ADC,FC
 SG_ FR_OBJ32_ExistProb : 331|6@0+ (2.0000000000,0.0000000000) [0.0000000000|100.0000000000] "%"  FR,ADC,FC
 SG_ FR_OBJ32_RelAx : 325|10@0+ (0.0312500000,-16.0000000000) [-16.0000000000|15.9687500000] "m/s2"  FR,ADC,FC
 SG_ FR_OBJ32_RelAy : 318|9@0+ (0.0625000000,-16.0000000000) [-16.0000000000|15.9375000000] "m/s2"  FR,ADC,FC
 SG_ FR_OBJ32_RelVx_std : 298|12@0+ (0.0625000000,0.0000000000) [0.0000000000|255.9375000000] "m/s"  FR,ADC,FC
 SG_ FR_OBJ32_RelVx : 294|12@0+ (0.0625000000,-128.0000000000) [-128.0000000000|127.9375000000] "m/s"  FR,ADC,FC
 SG_ FR_OBJ32_RelVy_std : 272|10@0+ (0.1250000000,0.0000000000) [0.0000000000|127.8750000000] "m/s"  FR,ADC,FC
 SG_ FR_OBJ32_RelVy : 266|10@0+ (0.1250000000,-64.0000000000) [-64.0000000000|63.8750000000] "m/s"  FR,ADC,FC
 SG_ FR_OBJ32_Dx_Vnce : 248|14@0+ (0.0500000000,0.0000000000) [0.0000000000|50.0000000000] "m2"  FR,ADC,FC
 SG_ FR_OBJ32_Dx : 245|13@0+ (0.0625000000,-100.0000000000) [-100.0000000000|411.9375000000] "m"  FR,ADC,FC
 SG_ FR_OBJ32_Dy_Vnce : 239|10@0+ (0.0200000000,0.0000000000) [0.0000000000|20.0000000000] "m2"  FR,ADC,FC
 SG_ FR_OBJ32_Dy : 218|11@0+ (0.1250000000,-128.0000000000) [-128.0000000000|127.8750000000] "m"  FR,ADC,FC
 SG_ FR_OBJ32_HeadingAngle : 413|10@0+ (0.0100000000,-3.1400000000) [-3.1400000000|3.1400000000] "rad"  FR,ADC,FC
 SG_ FR_OBJ32_Length : 204|9@0+ (0.0500000000,0.0000000000) [0.0000000000|25.5000000000] "m"  FR,ADC,FC
 SG_ FR_OBJ32_Height : 197|9@0+ (0.0100000000,0.0000000000) [0.0000000000|5.1100000000] "m"  FR,ADC,FC
 SG_ FR_OBJ32_Width : 176|11@0+ (0.0100000000,0.0000000000) [0.0000000000|12.0000000000] "m"  FR,ADC,FC
 SG_ FR_OBJ32_Class : 179|3@0+ (1.0000000000,0.0000000000) [0.0000000000|7.0000000000] ""  FR,ADC,FC
 SG_ FR_OBJ31_HeightGround : 39|9@0+ (0.1000000000,0.0000000000) [0.0000000000|51.1000000000] "m"  FR,ADC,FC
 SG_ FR_OBJ31_MotionStatusConf : 387|6@0+ (2.0000000000,0.0000000000) [0.0000000000|63.0000000000] "-"  FR,ADC,FC
 SG_ FR_OBJ31_ClassConf : 383|6@0+ (2.0000000000,0.0000000000) [0.0000000000|63.0000000000] "-"  FR,ADC,FC
 SG_ FR_OBJ31_MotionStatus : 373|3@0+ (1.0000000000,0.0000000000) [0.0000000000|7.0000000000] ""  FR,ADC,FC
 SG_ FR_OBJ31_Location : 361|2@0+ (1.0000000000,0.0000000000) [0.0000000000|3.0000000000] ""  FR,ADC,FC
 SG_ FR_OBJ31_Measured : 365|2@0+ (1.0000000000,0.0000000000) [0.0000000000|3.0000000000] ""  FR,ADC,FC
 SG_ FR_Obj31_valid : 367|1@0+ (1.0000000000,0.0000000000) [0.0000000000|1.0000000000] ""  FR,ADC,FC
 SG_ FR_OBJ31_Track_Age : 171|8@0+ (1.0000000000,0.0000000000) [0.0000000000|255.0000000000] ""  FR,ADC,FC
 SG_ FR_OBJ31_Track_ID : 163|8@0+ (1.0000000000,0.0000000000) [0.0000000000|255.0000000000] ""  FR,ADC,FC
 SG_ FR_OBJ31_ObstacleProb : 153|6@0+ (2.0000000000,0.0000000000) [0.0000000000|100.0000000000] "%"  FR,ADC,FC
 SG_ FR_OBJ31_ExistProb : 159|6@0+ (2.0000000000,0.0000000000) [0.0000000000|100.0000000000] "%"  FR,ADC,FC
 SG_ FR_OBJ31_RelAx : 137|10@0+ (0.0312500000,-16.0000000000) [-16.0000000000|15.9687500000] "m/s2"  FR,ADC,FC
 SG_ FR_OBJ31_RelAy : 130|9@0+ (0.0625000000,-16.0000000000) [-16.0000000000|15.9375000000] "m/s2"  FR,ADC,FC
 SG_ FR_OBJ31_RelVx_std : 126|12@0+ (0.0625000000,0.0000000000) [0.0000000000|255.9375000000] "m/s"  FR,ADC,FC
 SG_ FR_OBJ31_RelVx : 106|12@0+ (0.0625000000,-128.0000000000) [-128.0000000000|127.9375000000] "m/s"  FR,ADC,FC
 SG_ FR_OBJ31_RelVy_std : 100|10@0+ (0.1250000000,0.0000000000) [0.0000000000|127.8750000000] "m/s"  FR,ADC,FC
 SG_ FR_OBJ31_RelVy : 94|10@0+ (0.1250000000,-64.0000000000) [-64.0000000000|63.8750000000] "m/s"  FR,ADC,FC
 SG_ FR_OBJ31_Dx_Vnce : 76|14@0+ (0.0500000000,0.0000000000) [0.0000000000|50.0000000000] "m2"  FR,ADC,FC
 SG_ FR_OBJ31_Dx : 57|13@0+ (0.0625000000,-100.0000000000) [-100.0000000000|411.9375000000] "m"  FR,ADC,FC
 SG_ FR_OBJ31_Dy_Vnce : 51|10@0+ (0.0200000000,0.0000000000) [0.0000000000|20.0000000000] "m2"  FR,ADC,FC
 SG_ FR_OBJ31_Dy : 46|11@0+ (0.1250000000,-128.0000000000) [-128.0000000000|127.8750000000] "m"  FR,ADC,FC
 SG_ FR_OBJ31_HeadingAngle : 407|10@0+ (0.0100000000,-3.1400000000) [-3.1400000000|3.1400000000] "rad"  FR,ADC,FC
 SG_ FR_OBJ31_Length : 16|9@0+ (0.0500000000,0.0000000000) [0.0000000000|25.5000000000] "m"  FR,ADC,FC
 SG_ FR_OBJ31_Height : 9|9@0+ (0.0100000000,0.0000000000) [0.0000000000|5.1100000000] "m"  FR,ADC,FC
 SG_ FR_OBJ31_Width : 4|11@0+ (0.0100000000,0.0000000000) [0.0000000000|12.0000000000] "m"  FR,ADC,FC
 SG_ FR_OBJ31_Class : 7|3@0+ (1.0000000000,0.0000000000) [0.0000000000|7.0000000000] ""  FR,ADC,FC

BO_ 310 FR_136: 64 FR
 SG_ FR_KidRushoutFlag : 0|1@0+ (1.0000000000,0.0000000000) [0.0000000000|1.0000000000] ""  FR,FC
 SG_ FR_CRCCheck_136 : 503|16@0+ (1.0000000000,0.0000000000) [0.0000000000|65535.0000000000] ""  FR,ADC,FC
 SG_ FR_RollingCounter_136 : 491|4@0+ (1.0000000000,0.0000000000) [0.0000000000|15.0000000000] ""  FR,ADC,FC
 SG_ FR_FrameCount : 71|32@0+ (1.0000000000,0.0000000000) [0.0000000000|4294967295.0000000000] ""  FR,ADC,FC
 SG_ FR_MisAlignment : 58|3@0+ (1.0000000000,0.0000000000) [0.0000000000|7.0000000000] ""  FR,ADC,FC
 SG_ FR_WorkMode : 49|2@0+ (1.0000000000,0.0000000000) [0.0000000000|3.0000000000] ""  FR,ADC,FC
 SG_ FR_RadarFailureStatus : 42|3@0+ (1.0000000000,0.0000000000) [0.0000000000|7.0000000000] ""  FR,ADC,FC
 SG_ FR_FRadarCalibrationStatus : 33|2@0+ (1.0000000000,0.0000000000) [0.0000000000|3.0000000000] ""  FR,ADC,FC
 SG_ FR_Frametime : 23|16@0+ (0.0100000000,0.0000000000) [0.0000000000|655.3500000000] "ms"  FR,ADC,FC
 SG_ FR_ObjCount : 15|8@0+ (1.0000000000,0.0000000000) [0.0000000000|32.0000000000] ""  FR,ADC,FC

BO_ 312 FR_138: 64 FR
 SG_ ADC_CRCCheck_138 : 503|16@0+ (1.0000000000,0.0000000000) [0.0000000000|65535.0000000000] ""  FR,ADC,FC
 SG_ ADC_RollingCounter_138 : 491|4@0+ (1.0000000000,0.0000000000) [0.0000000000|15.0000000000] ""  FR,ADC,FC
 SG_ DiffTime_Time_uS : 151|16@0+ (1.0000000000,0.0000000000) [0.0000000000|65535.0000000000] "um"  FR,ADC,FC
 SG_ FR_TiOut : 37|1@0+ (1.0000000000,0.0000000000) [0.0000000000|1.0000000000] "-"  FR,ADC,FC
 SG_ FR_TiLeap : 38|1@0+ (1.0000000000,0.0000000000) [0.0000000000|1.0000000000] "-"  FR,ADC,FC
 SG_ FR_TiBas : 39|1@0+ (1.0000000000,0.0000000000) [0.0000000000|1.0000000000] "-"  FR,ADC,FC
 SG_ FR_TiStamp : 7|32@0+ (0.0001000000,0.0000000000) [0.0000000000|429496.7295000000] "s"  FR,ADC,FC

BO_ 320 FR_140: 64 FR
 SG_ FR_DTC2_Status : 63|8@0+ (1.0000000000,0.0000000000) [0.0000000000|255.0000000000] ""  FR,ADC
 SG_ FR_DTC2_LowByte : 55|8@0+ (1.0000000000,0.0000000000) [0.0000000000|255.0000000000] ""  FR,ADC
 SG_ FR_DTC2_MiddByte : 47|8@0+ (1.0000000000,0.0000000000) [0.0000000000|255.0000000000] ""  FR,ADC
 SG_ FR_DTC2_HighByte : 39|8@0+ (1.0000000000,0.0000000000) [0.0000000000|255.0000000000] ""  FR,ADC
 SG_ FR_DTC1_Status : 31|8@0+ (1.0000000000,0.0000000000) [0.0000000000|255.0000000000] ""  FR,ADC
 SG_ FR_DTC1_LowByte : 23|8@0+ (1.0000000000,0.0000000000) [0.0000000000|255.0000000000] ""  FR,ADC
 SG_ FR_DTC1_MiddByte : 15|8@0+ (1.0000000000,0.0000000000) [0.0000000000|255.0000000000] ""  FR,ADC
 SG_ FR_DTC1_HighByte : 7|8@0+ (1.0000000000,0.0000000000) [0.0000000000|255.0000000000] ""  FR,ADC

BO_ 336 FC_150: 64 FC
 SG_ FC_CRCCheck_150 : 503|16@0+ (1.0000000000,0.0000000000) [0.0000000000|65535.0000000000] ""  FC,ADC
 SG_ FC_RollingCounter_150 : 491|4@0+ (1.0000000000,0.0000000000) [0.0000000000|15.0000000000] ""  FC,ADC
 SG_ FC_Line_2_exist_prob : 303|6@0+ (2.0000000000,0.0000000000) [0.0000000000|100.0000000000] "%"  FC,ADC
 SG_ FC_Line_2_RMSE : 281|8@0+ (1.0000000000,0.0000000000) [0.0000000000|100.0000000000] "-"  FC,ADC
 SG_ FC_Line_2_ParseConf : 273|8@0+ (1.0000000000,0.0000000000) [0.0000000000|100.0000000000] "-"  FC,ADC
 SG_ FC_Line_2_MeasureType : 276|3@0+ (1.0000000000,0.0000000000) [0.0000000000|7.0000000000] "-"  FC,ADC
 SG_ FC_Line_2_ModelC3 : 256|12@0+ (0.0000001272,-0.0002604200) [-0.0002604200|0.0002604170] "1/m2"  FC,ADC
 SG_ FC_Line_2_ModelC2 : 327|16@0+ (0.0000010000,-0.0320000000) [-0.0320000000|0.0335350000] "1/m"  FC,ADC
 SG_ FC_Line_2_ModelC1 : 235|13@0+ (0.0004882810,-1.6000000000) [-1.6000000000|1.6000000000] "rad"  FC,ADC
 SG_ FC_Line_2_ModelC0 : 231|12@0+ (0.0156250000,-32.0000000000) [-32.0000000000|31.9843750000] "m"  FC,ADC
 SG_ FC_Line_2_dx_End : 202|10@0+ (0.2500000000,0.0000000000) [0.0000000000|255.7500000000] "m"  FC,ADC
 SG_ FC_Line_2_dx_Start : 176|13@0+ (0.0250000000,0.0000000000) [0.0000000000|204.7750000000] "m"  FC,ADC
 SG_ FC_Line_2_Width : 168|8@0+ (0.0100000000,0.0000000000) [0.0000000000|2.5500000000] "m"  FC,ADC
 SG_ FC_Line_2_color : 171|3@0+ (1.0000000000,0.0000000000) [0.0000000000|7.0000000000] ""  FC,ADC
 SG_ FC_Line_2_Id : 163|8@0+ (1.0000000000,0.0000000000) [1.0000000000|255.0000000000] ""  FC,ADC
 SG_ FC_Line_2_TypeConfidence : 153|6@0+ (2.0000000000,0.0000000000) [0.0000000000|100.0000000000] "%"  FC,ADC
 SG_ FC_Line_2_Type : 158|5@0+ (1.0000000000,0.0000000000) [0.0000000000|31.0000000000] ""  FC,ADC
 SG_ FC_Line_1_exist_prob : 136|6@0+ (2.0000000000,0.0000000000) [0.0000000000|100.0000000000] "%"  FC,ADC
 SG_ FC_Line_1_RMSE : 130|8@0+ (1.0000000000,0.0000000000) [0.0000000000|100.0000000000] "-"  FC,ADC
 SG_ FC_Line_1_ParseConf : 122|8@0+ (1.0000000000,0.0000000000) [0.0000000000|100.0000000000] "-"  FC,ADC
 SG_ FC_Line_1_MeasureType : 125|3@0+ (1.0000000000,0.0000000000) [0.0000000000|7.0000000000] "-"  FC,ADC
 SG_ FC_Line_1_ModelC3 : 105|12@0+ (0.0000001272,-0.0002604200) [-0.0002604200|0.0002604170] "1/m2"  FC,ADC
 SG_ FC_Line_1_ModelC2 : 311|16@0+ (0.0000010000,-0.0320000000) [-0.0320000000|0.0335350000] "1/m"  FC,ADC
 SG_ FC_Line_1_ModelC1 : 84|13@0+ (0.0004882810,-1.6000000000) [-1.6000000000|1.6000000000] "rad"  FC,ADC
 SG_ FC_Line_1_ModelC0 : 64|12@0+ (0.0156250000,-32.0000000000) [-32.0000000000|31.9843750000] "m"  FC,ADC
 SG_ FC_Line_1_dx_End : 51|10@0+ (0.2500000000,0.0000000000) [0.0000000000|255.7500000000] "m"  FC,ADC
 SG_ FC_Line_1_dx_Start : 25|13@0+ (0.0250000000,0.0000000000) [0.0000000000|204.7750000000] "m"  FC,ADC
 SG_ FC_Line_1_Width : 17|8@0+ (0.0100000000,0.0000000000) [0.0000000000|2.5500000000] "m"  FC,ADC
 SG_ FC_Line_1_color : 20|3@0+ (1.0000000000,0.0000000000) [0.0000000000|7.0000000000] ""  FC,ADC
 SG_ FC_Line_1_Id : 12|8@0+ (1.0000000000,0.0000000000) [1.0000000000|255.0000000000] ""  FC,ADC
 SG_ FC_Line_1_TypeConfidence : 2|6@0+ (2.0000000000,0.0000000000) [0.0000000000|100.0000000000] "%"  FC,ADC
 SG_ FC_Line_1_Type : 7|5@0+ (1.0000000000,0.0000000000) [0.0000000000|31.0000000000] ""  FC,ADC

BO_ 337 FC_151: 64 FC
 SG_ FC_CRCCheck_151 : 503|16@0+ (1.0000000000,0.0000000000) [0.0000000000|65535.0000000000] ""  FC,ADC
 SG_ FC_RollingCounter_151 : 491|4@0+ (1.0000000000,0.0000000000) [0.0000000000|15.0000000000] ""  FC,ADC
 SG_ FC_Line_4_exist_prob : 303|6@0+ (2.0000000000,0.0000000000) [0.0000000000|100.0000000000] "%"  FC,ADC
 SG_ FC_Line_4_RMSE : 281|8@0+ (1.0000000000,0.0000000000) [0.0000000000|100.0000000000] "-"  FC,ADC
 SG_ FC_Line_4_ParseConf : 273|8@0+ (1.0000000000,0.0000000000) [0.0000000000|100.0000000000] "-"  FC,ADC
 SG_ FC_Line_4_MeasureType : 276|3@0+ (1.0000000000,0.0000000000) [0.0000000000|7.0000000000] "-"  FC,ADC
 SG_ FC_Line_4_ModelC3 : 256|12@0+ (0.0000001272,-0.0002604200) [-0.0002604200|0.0002604170] "1/m2"  FC,ADC
 SG_ FC_Line_4_ModelC2 : 327|16@0+ (0.0000010000,-0.0320000000) [-0.0320000000|0.0335350000] "1/m"  FC,ADC
 SG_ FC_Line_4_ModelC1 : 235|13@0+ (0.0004882810,-1.6000000000) [-1.6000000000|1.6000000000] "rad"  FC,ADC
 SG_ FC_Line_4_ModelC0 : 231|12@0+ (0.0156250000,-32.0000000000) [-32.0000000000|31.9843750000] "m"  FC,ADC
 SG_ FC_Line_4_dx_End : 202|10@0+ (0.2500000000,0.0000000000) [0.0000000000|255.7500000000] "m"  FC,ADC
 SG_ FC_Line_4_dx_Start : 176|13@0+ (0.0250000000,0.0000000000) [0.0000000000|204.7750000000] "m"  FC,ADC
 SG_ FC_Line_4_Width : 168|8@0+ (0.0100000000,0.0000000000) [0.0000000000|2.5500000000] "m"  FC,ADC
 SG_ FC_Line_4_color : 171|3@0+ (1.0000000000,0.0000000000) [0.0000000000|7.0000000000] ""  FC,ADC
 SG_ FC_Line_4_Id : 163|8@0+ (1.0000000000,0.0000000000) [1.0000000000|255.0000000000] ""  FC,ADC
 SG_ FC_Line_4_TypeConfidence : 153|6@0+ (2.0000000000,0.0000000000) [0.0000000000|100.0000000000] "%"  FC,ADC
 SG_ FC_Line_4_Type : 158|5@0+ (1.0000000000,0.0000000000) [0.0000000000|31.0000000000] ""  FC,ADC
 SG_ FC_Line_3_exist_prob : 136|6@0+ (2.0000000000,0.0000000000) [0.0000000000|100.0000000000] "%"  FC,ADC
 SG_ FC_Line_3_RMSE : 130|8@0+ (1.0000000000,0.0000000000) [0.0000000000|100.0000000000] "-"  FC,ADC
 SG_ FC_Line_3_ParseConf : 122|8@0+ (1.0000000000,0.0000000000) [0.0000000000|100.0000000000] "-"  FC,ADC
 SG_ FC_Line_3_MeasureType : 125|3@0+ (1.0000000000,0.0000000000) [0.0000000000|7.0000000000] "-"  FC,ADC
 SG_ FC_Line_3_ModelC3 : 105|12@0+ (0.0000001272,-0.0002604200) [-0.0002604200|0.0002604170] "1/m2"  FC,ADC
 SG_ FC_Line_3_ModelC2 : 311|16@0+ (0.0000010000,-0.0320000000) [-0.0320000000|0.0335350000] "1/m"  FC,ADC
 SG_ FC_Line_3_ModelC1 : 84|13@0+ (0.0004882810,-1.6000000000) [-1.6000000000|1.6000000000] "rad"  FC,ADC
 SG_ FC_Line_3_ModelC0 : 64|12@0+ (0.0156250000,-32.0000000000) [-32.0000000000|31.9843750000] "m"  FC,ADC
 SG_ FC_Line_3_dx_End : 51|10@0+ (0.2500000000,0.0000000000) [0.0000000000|255.7500000000] "m"  FC,ADC
 SG_ FC_Line_3_dx_Start : 25|13@0+ (0.0250000000,0.0000000000) [0.0000000000|204.7750000000] "m"  FC,ADC
 SG_ FC_Line_3_Width : 17|8@0+ (0.0100000000,0.0000000000) [0.0000000000|2.5500000000] "m"  FC,ADC
 SG_ FC_Line_3_color : 20|3@0+ (1.0000000000,0.0000000000) [0.0000000000|7.0000000000] ""  FC,ADC
 SG_ FC_Line_3_Id : 12|8@0+ (1.0000000000,0.0000000000) [1.0000000000|255.0000000000] ""  FC,ADC
 SG_ FC_Line_3_TypeConfidence : 2|6@0+ (2.0000000000,0.0000000000) [0.0000000000|100.0000000000] "%"  FC,ADC
 SG_ FC_Line_3_Type : 7|5@0+ (1.0000000000,0.0000000000) [0.0000000000|31.0000000000] ""  FC,ADC

BO_ 338 FC_152: 64 FC
 SG_ FC_CRCCheck_152 : 503|16@0+ (1.0000000000,0.0000000000) [0.0000000000|65535.0000000000] ""  FC,ADC
 SG_ FC_RollingCounter_152 : 491|4@0+ (1.0000000000,0.0000000000) [0.0000000000|15.0000000000] ""  FC,ADC
 SG_ FC_Line_6_exist_prob : 303|6@0+ (2.0000000000,0.0000000000) [0.0000000000|100.0000000000] "%"  FC,ADC
 SG_ FC_Line_6_RMSE : 281|8@0+ (1.0000000000,0.0000000000) [0.0000000000|100.0000000000] "-"  FC,ADC
 SG_ FC_Line_6_ParseConf : 273|8@0+ (1.0000000000,0.0000000000) [0.0000000000|100.0000000000] "-"  FC,ADC
 SG_ FC_Line_6_MeasureType : 276|3@0+ (1.0000000000,0.0000000000) [0.0000000000|7.0000000000] "-"  FC,ADC
 SG_ FC_Line_6_ModelC3 : 256|12@0+ (0.0000001272,-0.0002604200) [-0.0002604200|0.0002604170] "1/m2"  FC,ADC
 SG_ FC_Line_6_ModelC2 : 327|16@0+ (0.0000010000,-0.0320000000) [-0.0320000000|0.0335350000] "1/m"  FC,ADC
 SG_ FC_Line_6_ModelC1 : 235|13@0+ (0.0004882810,-1.6000000000) [-1.6000000000|1.6000000000] "rad"  FC,ADC
 SG_ FC_Line_6_ModelC0 : 231|12@0+ (0.0156250000,-32.0000000000) [-32.0000000000|31.9843750000] "m"  FC,ADC
 SG_ FC_Line_6_dx_End : 202|10@0+ (0.2500000000,0.0000000000) [0.0000000000|255.7500000000] "m"  FC,ADC
 SG_ FC_Line_6_dx_Start : 176|13@0+ (0.0250000000,0.0000000000) [0.0000000000|204.7750000000] "m"  FC,ADC
 SG_ FC_Line_6_Width : 168|8@0+ (0.0100000000,0.0000000000) [0.0000000000|2.5500000000] "m"  FC,ADC
 SG_ FC_Line_6_color : 171|3@0+ (1.0000000000,0.0000000000) [0.0000000000|7.0000000000] ""  FC,ADC
 SG_ FC_Line_6_Id : 163|8@0+ (1.0000000000,0.0000000000) [1.0000000000|255.0000000000] ""  FC,ADC
 SG_ FC_Line_6_TypeConfidence : 153|6@0+ (2.0000000000,0.0000000000) [0.0000000000|100.0000000000] "%"  FC,ADC
 SG_ FC_Line_6_Type : 158|5@0+ (1.0000000000,0.0000000000) [0.0000000000|31.0000000000] ""  FC,ADC
 SG_ FC_Line_5_exist_prob : 136|6@0+ (2.0000000000,0.0000000000) [0.0000000000|100.0000000000] "%"  FC,ADC
 SG_ FC_Line_5_RMSE : 130|8@0+ (1.0000000000,0.0000000000) [0.0000000000|100.0000000000] "-"  FC,ADC
 SG_ FC_Line_5_ParseConf : 122|8@0+ (1.0000000000,0.0000000000) [0.0000000000|100.0000000000] "-"  FC,ADC
 SG_ FC_Line_5_MeasureType : 125|3@0+ (1.0000000000,0.0000000000) [0.0000000000|7.0000000000] "-"  FC,ADC
 SG_ FC_Line_5_ModelC3 : 105|12@0+ (0.0000001272,-0.0002604200) [-0.0002604200|0.0002604170] "1/m2"  FC,ADC
 SG_ FC_Line_5_ModelC2 : 311|16@0+ (0.0000010000,-0.0320000000) [-0.0320000000|0.0335350000] "1/m"  FC,ADC
 SG_ FC_Line_5_ModelC1 : 84|13@0+ (0.0004882810,-1.6000000000) [-1.6000000000|1.6000000000] "rad"  FC,ADC
 SG_ FC_Line_5_ModelC0 : 64|12@0+ (0.0156250000,-32.0000000000) [-32.0000000000|31.9843750000] "m"  FC,ADC
 SG_ FC_Line_5_dx_End : 51|10@0+ (0.2500000000,0.0000000000) [0.0000000000|255.7500000000] "m"  FC,ADC
 SG_ FC_Line_5_dx_Start : 25|13@0+ (0.0250000000,0.0000000000) [0.0000000000|204.7750000000] "m"  FC,ADC
 SG_ FC_Line_5_Width : 17|8@0+ (0.0100000000,0.0000000000) [0.0000000000|2.5500000000] "m"  FC,ADC
 SG_ FC_Line_5_color : 20|3@0+ (1.0000000000,0.0000000000) [0.0000000000|7.0000000000] ""  FC,ADC
 SG_ FC_Line_5_Id : 12|8@0+ (1.0000000000,0.0000000000) [1.0000000000|255.0000000000] ""  FC,ADC
 SG_ FC_Line_5_TypeConfidence : 2|6@0+ (2.0000000000,0.0000000000) [0.0000000000|100.0000000000] "%"  FC,ADC
 SG_ FC_Line_5_Type : 7|5@0+ (1.0000000000,0.0000000000) [0.0000000000|31.0000000000] ""  FC,ADC

BO_ 339 FC_153: 64 FC
 SG_ FC_CRCCheck_153 : 503|16@0+ (1.0000000000,0.0000000000) [0.0000000000|65535.0000000000] ""  FC,ADC
 SG_ FC_RollingCounter_153 : 491|4@0+ (1.0000000000,0.0000000000) [0.0000000000|15.0000000000] ""  FC,ADC
 SG_ FC_Line_8_exist_prob : 303|6@0+ (2.0000000000,0.0000000000) [0.0000000000|100.0000000000] "%"  FC,ADC
 SG_ FC_Line_8_RMSE : 281|8@0+ (1.0000000000,0.0000000000) [0.0000000000|100.0000000000] "-"  FC,ADC
 SG_ FC_Line_8_ParseConf : 273|8@0+ (1.0000000000,0.0000000000) [0.0000000000|100.0000000000] "-"  FC,ADC
 SG_ FC_Line_8_MeasureType : 276|3@0+ (1.0000000000,0.0000000000) [0.0000000000|7.0000000000] "-"  FC,ADC
 SG_ FC_Line_8_ModelC3 : 256|12@0+ (0.0000001272,-0.0002604200) [-0.0002604200|0.0002604170] "1/m2"  FC,ADC
 SG_ FC_Line_8_ModelC2 : 327|16@0+ (0.0000010000,-0.0320000000) [-0.0320000000|0.0335350000] "1/m"  FC,ADC
 SG_ FC_Line_8_ModelC1 : 235|13@0+ (0.0004882810,-1.6000000000) [-1.6000000000|1.6000000000] "rad"  FC,ADC
 SG_ FC_Line_8_ModelC0 : 231|12@0+ (0.0156250000,-32.0000000000) [-32.0000000000|31.9843750000] "m"  FC,ADC
 SG_ FC_Line_8_dx_End : 202|10@0+ (0.2500000000,0.0000000000) [0.0000000000|255.7500000000] "m"  FC,ADC
 SG_ FC_Line_8_dx_Start : 176|13@0+ (0.0250000000,0.0000000000) [0.0000000000|204.7750000000] "m"  FC,ADC
 SG_ FC_Line_8_Width : 168|8@0+ (0.0100000000,0.0000000000) [0.0000000000|2.5500000000] "m"  FC,ADC
 SG_ FC_Line_8_color : 171|3@0+ (1.0000000000,0.0000000000) [0.0000000000|7.0000000000] ""  FC,ADC
 SG_ FC_Line_8_Id : 163|8@0+ (1.0000000000,0.0000000000) [1.0000000000|255.0000000000] ""  FC,ADC
 SG_ FC_Line_8_TypeConfidence : 153|6@0+ (2.0000000000,0.0000000000) [0.0000000000|100.0000000000] "%"  FC,ADC
 SG_ FC_Line_8_Type : 158|5@0+ (1.0000000000,0.0000000000) [0.0000000000|31.0000000000] ""  FC,ADC
 SG_ FC_Line_7_exist_prob : 136|6@0+ (2.0000000000,0.0000000000) [0.0000000000|100.0000000000] "%"  FC,ADC
 SG_ FC_Line_7_RMSE : 130|8@0+ (1.0000000000,0.0000000000) [0.0000000000|100.0000000000] "-"  FC,ADC
 SG_ FC_Line_7_ParseConf : 122|8@0+ (1.0000000000,0.0000000000) [0.0000000000|100.0000000000] "-"  FC,ADC
 SG_ FC_Line_7_MeasureType : 125|3@0+ (1.0000000000,0.0000000000) [0.0000000000|7.0000000000] "-"  FC,ADC
 SG_ FC_Line_7_ModelC3 : 105|12@0+ (0.0000001272,-0.0002604200) [-0.0002604200|0.0002604170] "1/m2"  FC,ADC
 SG_ FC_Line_7_ModelC2 : 311|16@0+ (0.0000010000,-0.0320000000) [-0.0320000000|0.0335350000] "1/m"  FC,ADC
 SG_ FC_Line_7_ModelC1 : 84|13@0+ (0.0004882810,-1.6000000000) [-1.6000000000|1.6000000000] "rad"  FC,ADC
 SG_ FC_Line_7_ModelC0 : 64|12@0+ (0.0156250000,-32.0000000000) [-32.0000000000|31.9843750000] "m"  FC,ADC
 SG_ FC_Line_7_dx_End : 51|10@0+ (0.2500000000,0.0000000000) [0.0000000000|255.7500000000] "m"  FC,ADC
 SG_ FC_Line_7_dx_Start : 25|13@0+ (0.0250000000,0.0000000000) [0.0000000000|204.7750000000] "m"  FC,ADC
 SG_ FC_Line_7_Width : 17|8@0+ (0.0100000000,0.0000000000) [0.0000000000|2.5500000000] "m"  FC,ADC
 SG_ FC_Line_7_color : 20|3@0+ (1.0000000000,0.0000000000) [0.0000000000|7.0000000000] ""  FC,ADC
 SG_ FC_Line_7_Id : 12|8@0+ (1.0000000000,0.0000000000) [1.0000000000|255.0000000000] ""  FC,ADC
 SG_ FC_Line_7_TypeConfidence : 2|6@0+ (2.0000000000,0.0000000000) [0.0000000000|100.0000000000] "%"  FC,ADC
 SG_ FC_Line_7_Type : 7|5@0+ (1.0000000000,0.0000000000) [0.0000000000|31.0000000000] ""  FC,ADC

BO_ 340 FC_154: 64 FC
 SG_ FC_CRCCheck_154 : 503|16@0+ (1.0000000000,0.0000000000) [0.0000000000|65535.0000000000] ""  FC,ADC
 SG_ FC_RollingCounter_154 : 491|4@0+ (1.0000000000,0.0000000000) [0.0000000000|15.0000000000] ""  FC,ADC
 SG_ FC_LineMCUTiStamp : 207|8@0+ (1.0000000000,0.0000000000) [0.0000000000|255.0000000000] ""  FC,ADC
 SG_ FC_LineTiOut : 196|1@0+ (1.0000000000,0.0000000000) [0.0000000000|1.0000000000] "-"  FC,ADC
 SG_ FC_LineTiLeap : 197|1@0+ (1.0000000000,0.0000000000) [0.0000000000|1.0000000000] "-"  FC,ADC
 SG_ FC_LineTiBas : 198|1@0+ (1.0000000000,0.0000000000) [0.0000000000|1.0000000000] "-"  FC,ADC
 SG_ FC_LineTiStamp : 166|32@0+ (0.0001000000,0.0000000000) [0.0000000000|429496.7295000000] "s"  FC,ADC
 SG_ FC_WeatherType : 154|4@0+ (1.0000000000,0.0000000000) [0.0000000000|15.0000000000] ""  FC,ADC
 SG_ FC_RCrossPiont_StartEnd : 59|2@0+ (1.0000000000,0.0000000000) [0.0000000000|3.0000000000] ""  FC,ADC
 SG_ FC_RCrossPiont_DivMer : 61|2@0+ (1.0000000000,0.0000000000) [0.0000000000|3.0000000000] ""  FC,ADC
 SG_ FC_RCrossPiont_ExistProb : 51|6@0+ (2.0000000000,0.0000000000) [0.0000000000|100.0000000000] "%"  FC,ADC
 SG_ FC_RCrossPiont_Dy : 45|10@0+ (0.1000000000,-50.0000000000) [-50.0000000000|50.0000000000] "m"  FC,ADC
 SG_ FC_RCrossPoint_DX : 24|11@0+ (0.1000000000,0.0000000000) [0.0000000000|200.0000000000] "m"  FC,ADC
 SG_ FC_LCrossPiont_StartEnd : 26|2@0+ (1.0000000000,0.0000000000) [0.0000000000|3.0000000000] ""  FC,ADC
 SG_ FC_LCrossPiont_DivMer : 28|2@0+ (1.0000000000,0.0000000000) [0.0000000000|3.0000000000] ""  FC,ADC
 SG_ FC_LCrossPiont_ExistProb : 18|6@0+ (2.0000000000,0.0000000000) [0.0000000000|100.0000000000] "%"  FC,ADC
 SG_ FC_LCrossPiont_Dy : 12|10@0+ (0.1000000000,-50.0000000000) [-50.0000000000|50.0000000000] "m"  FC,ADC
 SG_ FC_LCrossPoint_DX : 7|11@0+ (0.1000000000,0.0000000000) [0.0000000000|200.0000000000] "m"  FC,ADC

BO_ 352 FC_160: 64 FC
 SG_ FC_Obj1_VehicleDir : 9|3@0+ (1.0000000000,0.0000000000) [0.0000000000|7.0000000000] ""  FC,ADC
 SG_ FC_Obj1ReDoorSts : 11|2@0+ (1.0000000000,0.0000000000) [0.0000000000|3.0000000000] ""  FC,ADC
 SG_ FC_Obj1RiDoorSts : 5|2@0+ (1.0000000000,0.0000000000) [0.0000000000|3.0000000000] ""  FC,ADC
 SG_ FC_Obj1LeDoorSts : 7|2@0+ (1.0000000000,0.0000000000) [0.0000000000|3.0000000000] ""  FC,ADC
 SG_ FC_Obj1WSInfoPosType : 133|4@0+ (1.0000000000,0.0000000000) [0.0000000000|15.0000000000] ""  FC,ADC
 SG_ FC_CRCCheck_160 : 503|16@0+ (1.0000000000,0.0000000000) [0.0000000000|65535.0000000000] ""  FC,ADC
 SG_ FC_RollingCounter_160 : 491|4@0+ (1.0000000000,0.0000000000) [0.0000000000|15.0000000000] ""  FC,ADC
 SG_ FC_Obj1_Img2dBox_RightDown_V : 288|12@0+ (1.0000000000,0.0000000000) [0.0000000000|3000.0000000000] "pix"  FC,ADC
 SG_ FC_Obj1_Img2dBox_LeftTop_V : 284|12@0+ (1.0000000000,0.0000000000) [0.0000000000|3000.0000000000] "pix"  FC,ADC
 SG_ FC_Obj1_Img2dBox_RightDown_U : 264|12@0+ (1.0000000000,0.0000000000) [0.0000000000|4095.0000000000] "pix"  FC,ADC
 SG_ FC_Obj1_Img2dBox_LeftTop_U : 260|12@0+ (1.0000000000,0.0000000000) [0.0000000000|4095.0000000000] "pix"  FC,ADC
 SG_ FC_Obj1_TurnLight : 262|2@0+ (1.0000000000,0.0000000000) [0.0000000000|3.0000000000] ""  FC,ADC
 SG_ FC_Obj1_valid : 263|1@0+ (1.0000000000,0.0000000000) [0.0000000000|1.0000000000] ""  FC,ADC
 SG_ FC_Obj1_Vy_Vnce : 241|10@0+ (0.1250000000,-64.0000000000) [-64.0000000000|63.8750000000] "m/s"  FC,ADC
 SG_ FC_Obj1_Vx_Vnce : 237|12@0+ (0.0625000000,-128.0000000000) [-128.0000000000|127.9375000000] "m/s"  FC,ADC
 SG_ FC_Obj1_CenterAngle : 230|9@0+ (0.0100000000,-1.5700000000) [-1.5700000000|1.5700000000] ""  FC,ADC
 SG_ FC_Obj1_DistInLane : 209|11@0+ (0.0100000000,-10.0000000000) [-10.0000000000|10.0000000000] ""  FC,ADC
 SG_ FC_Obj1_objCutInLane : 211|2@0+ (1.0000000000,0.0000000000) [0.0000000000|2.0000000000] ""  FC,ADC
 SG_ FC_Obj1_objCutInFlag : 201|2@0+ (1.0000000000,0.0000000000) [0.0000000000|2.0000000000] ""  FC,ADC
 SG_ FC_Obj1_CornerPoint_y : 199|14@0+ (0.0100000000,-80.0000000000) [-80.0000000000|80.0000000000] ""  FC,ADC
 SG_ FC_Obj1_CornerPoint_x : 182|15@0+ (0.0100000000,0.0000000000) [0.0000000000|200.0000000000] ""  FC,ADC
 SG_ FC_Obj1_LaneAssignment : 169|3@0+ (1.0000000000,0.0000000000) [0.0000000000|7.0000000000] ""  FC,ADC
 SG_ FC_Obj1_MotionType : 172|3@0+ (1.0000000000,0.0000000000) [0.0000000000|4.0000000000] ""  FC,ADC
 SG_ FC_obj1_Brakelight_Info : 173|1@0+ (1.0000000000,0.0000000000) [0.0000000000|1.0000000000] ""  FC,ADC
 SG_ FC_Obj1_Width : 155|11@0+ (0.0100000000,0.0000000000) [0.0000000000|12.0000000000] "m"  FC,ADC
 SG_ FC_Obj1_Length : 148|9@0+ (0.0500000000,0.0000000000) [0.0000000000|25.5000000000] "m"  FC,ADC
 SG_ FC_Obj1_Height : 141|9@0+ (0.0100000000,0.0000000000) [0.0000000000|5.1100000000] "m"  FC,ADC
 SG_ FC_Obj1_HeadOrientation : 129|4@0+ (1.0000000000,0.0000000000) [0.0000000000|15.0000000000] ""  FC,ADC
 SG_ FC_Obj1_HeadingAngle : 308|10@0+ (0.0100000000,-3.1400000000) [-3.1400000000|3.1400000000] "rad"  FC,ADC
 SG_ FC_Obj1_ExistProb : 112|6@0+ (2.0000000000,0.0000000000) [0.0000000000|100.0000000000] "%"  FC,ADC
 SG_ FC_Obj1_Dy_Vnce : 106|10@0+ (0.0200000000,0.0000000000) [0.0000000000|20.0000000000] "m2"  FC,ADC
 SG_ FC_Obj1_Dy : 88|14@0+ (0.0100000000,-80.0000000000) [-80.0000000000|80.0000000000] "m"  FC,ADC
 SG_ FC_Obj1_Dx_Vnce : 86|14@0+ (0.0500000000,0.0000000000) [0.0000000000|50.0000000000] "m2"  FC,ADC
 SG_ FC_Obj1_Dx : 66|12@0+ (0.0500000000,0.0000000000) [0.0000000000|204.7000000000] "m"  FC,ADC
 SG_ FC_Obj1_RelVy : 60|10@0+ (0.1000000000,-50.0000000000) [-50.0000000000|50.0000000000] "m/s"  FC,ADC
 SG_ FC_Obj1_RelVx : 40|12@0+ (0.1000000000,-154.0000000000) [-154.0000000000|50.0000000000] "m/s"  FC,ADC
 SG_ FC_Obj1_RelAy : 32|8@0+ (0.1000000000,-12.0000000000) [-12.0000000000|12.0000000000] "m/s2"  FC,ADC
 SG_ FC_Obj1_RelAx : 25|9@0+ (0.1000000000,-16.0000000000) [-16.0000000000|16.0000000000] "m/s2"  FC,ADC
 SG_ FC_Obj1_TypeProb : 31|6@0+ (2.0000000000,0.0000000000) [0.0000000000|100.0000000000] "%"  FC,ADC
 SG_ FC_Obj1_Type : 19|4@0+ (1.0000000000,0.0000000000) [0.0000000000|15.0000000000] ""  FC,ADC
 SG_ FC_Obj1_Track_Age : 314|16@0+ (1.0000000000,0.0000000000) [0.0000000000|65535.0000000000] ""  FC,ADC
 SG_ FC_Obj1_Track_ID : 3|8@0+ (1.0000000000,0.0000000000) [0.0000000000|255.0000000000] ""  FC,ADC

BO_ 353 FC_161: 64 FC
 SG_ FC_Obj2_VehicleDir : 9|3@0+ (1.0000000000,0.0000000000) [0.0000000000|7.0000000000] ""  FC,ADC
 SG_ FC_Obj2ReDoorSts : 11|2@0+ (1.0000000000,0.0000000000) [0.0000000000|3.0000000000] ""  FC,ADC
 SG_ FC_Obj2RiDoorSts : 5|2@0+ (1.0000000000,0.0000000000) [0.0000000000|3.0000000000] ""  FC,ADC
 SG_ FC_Obj2LeDoorSts : 7|2@0+ (1.0000000000,0.0000000000) [0.0000000000|3.0000000000] ""  FC,ADC
 SG_ FC_Obj2WSInfoPosType : 133|4@0+ (1.0000000000,0.0000000000) [0.0000000000|15.0000000000] ""  FC,ADC
 SG_ FC_CRCCheck_161 : 503|16@0+ (1.0000000000,0.0000000000) [0.0000000000|65535.0000000000] ""  FC,ADC
 SG_ FC_RollingCounter_161 : 491|4@0+ (1.0000000000,0.0000000000) [0.0000000000|15.0000000000] ""  FC,ADC
 SG_ FC_Obj2_Img2dBox_RightDown_V : 288|12@0+ (1.0000000000,0.0000000000) [0.0000000000|3000.0000000000] "pix"  FC,ADC
 SG_ FC_Obj2_Img2dBox_LeftTop_V : 284|12@0+ (1.0000000000,0.0000000000) [0.0000000000|3000.0000000000] "pix"  FC,ADC
 SG_ FC_Obj2_Img2dBox_RightDown_U : 264|12@0+ (1.0000000000,0.0000000000) [0.0000000000|4095.0000000000] "pix"  FC,ADC
 SG_ FC_Obj2_Img2dBox_LeftTop_U : 260|12@0+ (1.0000000000,0.0000000000) [0.0000000000|4095.0000000000] "pix"  FC,ADC
 SG_ FC_Obj2_TurnLight : 262|2@0+ (1.0000000000,0.0000000000) [0.0000000000|3.0000000000] ""  FC,ADC
 SG_ FC_Obj2_valid : 263|1@0+ (1.0000000000,0.0000000000) [0.0000000000|1.0000000000] ""  FC,ADC
 SG_ FC_Obj2_Vy_Vnce : 241|10@0+ (0.1250000000,-64.0000000000) [-64.0000000000|63.8750000000] "m/s"  FC,ADC
 SG_ FC_Obj2_Vx_Vnce : 237|12@0+ (0.0625000000,-128.0000000000) [-128.0000000000|127.9375000000] "m/s"  FC,ADC
 SG_ FC_Obj2_CenterAngle : 230|9@0+ (0.0100000000,-1.5700000000) [-1.5700000000|1.5700000000] ""  FC,ADC
 SG_ FC_Obj2_DistInLane : 209|11@0+ (0.0100000000,-10.0000000000) [-10.0000000000|10.0000000000] ""  FC,ADC
 SG_ FC_Obj2_objCutInLane : 211|2@0+ (1.0000000000,0.0000000000) [0.0000000000|2.0000000000] ""  FC,ADC
 SG_ FC_Obj2_objCutInFlag : 201|2@0+ (1.0000000000,0.0000000000) [0.0000000000|2.0000000000] ""  FC,ADC
 SG_ FC_Obj2_CornerPoint_y : 199|14@0+ (0.0100000000,-80.0000000000) [-80.0000000000|80.0000000000] ""  FC,ADC
 SG_ FC_Obj2_CornerPoint_x : 182|15@0+ (0.0100000000,0.0000000000) [0.0000000000|200.0000000000] ""  FC,ADC
 SG_ FC_Obj2_LaneAssignment : 169|3@0+ (1.0000000000,0.0000000000) [0.0000000000|7.0000000000] ""  FC,ADC
 SG_ FC_Obj2_MotionType : 172|3@0+ (1.0000000000,0.0000000000) [0.0000000000|4.0000000000] ""  FC,ADC
 SG_ FC_obj2_Brakelight_Info : 173|1@0+ (1.0000000000,0.0000000000) [0.0000000000|1.0000000000] ""  FC,ADC
 SG_ FC_Obj2_Width : 155|11@0+ (0.0100000000,0.0000000000) [0.0000000000|12.0000000000] "m"  FC,ADC
 SG_ FC_Obj2_Length : 148|9@0+ (0.0500000000,0.0000000000) [0.0000000000|25.5000000000] "m"  FC,ADC
 SG_ FC_Obj2_Height : 141|9@0+ (0.0100000000,0.0000000000) [0.0000000000|5.1100000000] "m"  FC,ADC
 SG_ FC_Obj2_HeadOrientation : 129|4@0+ (1.0000000000,0.0000000000) [0.0000000000|15.0000000000] ""  FC,ADC
 SG_ FC_Obj2_HeadingAngle : 308|10@0+ (0.0100000000,-3.1400000000) [-3.1400000000|3.1400000000] "rad"  FC,ADC
 SG_ FC_Obj2_ExistProb : 112|6@0+ (2.0000000000,0.0000000000) [0.0000000000|100.0000000000] "%"  FC,ADC
 SG_ FC_Obj2_Dy_Vnce : 106|10@0+ (0.0200000000,0.0000000000) [0.0000000000|20.0000000000] "m2"  FC,ADC
 SG_ FC_Obj2_Dy : 88|14@0+ (0.0100000000,-80.0000000000) [-80.0000000000|80.0000000000] "m"  FC,ADC
 SG_ FC_Obj2_Dx_Vnce : 86|14@0+ (0.0500000000,0.0000000000) [0.0000000000|50.0000000000] "m2"  FC,ADC
 SG_ FC_Obj2_Dx : 66|12@0+ (0.0500000000,0.0000000000) [0.0000000000|204.7000000000] "m"  FC,ADC
 SG_ FC_Obj2_RelVy : 60|10@0+ (0.1000000000,-50.0000000000) [-50.0000000000|50.0000000000] "m/s"  FC,ADC
 SG_ FC_Obj2_RelVx : 40|12@0+ (0.1000000000,-154.0000000000) [-154.0000000000|50.0000000000] "m/s"  FC,ADC
 SG_ FC_Obj2_RelAy : 32|8@0+ (0.1000000000,-12.0000000000) [-12.0000000000|12.0000000000] "m/s2"  FC,ADC
 SG_ FC_Obj2_RelAx : 25|9@0+ (0.1000000000,-16.0000000000) [-16.0000000000|16.0000000000] "m/s2"  FC,ADC
 SG_ FC_Obj2_TypeProb : 31|6@0+ (2.0000000000,0.0000000000) [0.0000000000|100.0000000000] "%"  FC,ADC
 SG_ FC_Obj2_Type : 19|4@0+ (1.0000000000,0.0000000000) [0.0000000000|15.0000000000] ""  FC,ADC
 SG_ FC_Obj2_Track_Age : 314|16@0+ (1.0000000000,0.0000000000) [0.0000000000|65535.0000000000] ""  FC,ADC
 SG_ FC_Obj2_Track_ID : 3|8@0+ (1.0000000000,0.0000000000) [0.0000000000|255.0000000000] ""  FC,ADC

CM_ BO_ 283  " ";
CM_ SG_ 283 FR_OBJ22_Ax  " ";
CM_ SG_ 283 FR_OBJ22_Ay  " ";
CM_ SG_ 283 FR_OBJ22_Vx  " ";
CM_ SG_ 283 FR_OBJ22_Vy  " ";
CM_ SG_ 283 FR_OBJ21_Ax  " ";
CM_ SG_ 283 FR_OBJ21_Ay  " ";
CM_ SG_ 283 FR_OBJ21_Vx  " ";
CM_ SG_ 283 FR_OBJ21_Vy  " ";
CM_ SG_ 283 FR_OBJ22_FeaturePoint  " ";
CM_ SG_ 283 FR_OBJ21_FeaturePoint  " ";
CM_ SG_ 283 FR_CRCCheck_11B  " ";
CM_ SG_ 283 FR_RollingCounter_11B  " ";
CM_ SG_ 283 FR_OBJ22_HeightGround  "反射点最强点距离地面的高度 ";
CM_ SG_ 283 FR_OBJ22_MotionStatusConf  " ";
CM_ SG_ 283 FR_OBJ22_ClassConf  " ";
CM_ SG_ 283 FR_OBJ22_MotionStatus  " ";
CM_ SG_ 283 FR_OBJ22_Location  " ";
CM_ SG_ 283 FR_OBJ22_Measured  " ";
CM_ SG_ 283 FR_OBJ22_valid  " ";
CM_ SG_ 283 FR_OBJ22_Track_Age  " ";
CM_ SG_ 283 FR_OBJ22_Track_ID  " ";
CM_ SG_ 283 FR_OBJ22_ObstacleProb  " ";
CM_ SG_ 283 FR_OBJ22_ExistProb  " ";
CM_ SG_ 283 FR_OBJ22_RelAx  " ";
CM_ SG_ 283 FR_OBJ22_RelAy  " ";
CM_ SG_ 283 FR_OBJ22_RelVx_std  " ";
CM_ SG_ 283 FR_OBJ22_RelVx  " ";
CM_ SG_ 283 FR_OBJ22_RelVy_std  " ";
CM_ SG_ 283 FR_OBJ22_RelVy  " ";
CM_ SG_ 283 FR_OBJ22_Dx_Vnce  " ";
CM_ SG_ 283 FR_OBJ22_Dx  " ";
CM_ SG_ 283 FR_OBJ22_Dy_Vnce  " ";
CM_ SG_ 283 FR_OBJ22_Dy  " ";
CM_ SG_ 283 FR_OBJ22_HeadingAngle  " ";
CM_ SG_ 283 FR_OBJ22_Length  " ";
CM_ SG_ 283 FR_OBJ22_Height  " ";
CM_ SG_ 283 FR_OBJ22_Width  " ";
CM_ SG_ 283 FR_OBJ22_Class  " ";
CM_ SG_ 283 FR_OBJ21_HeightGround  "反射点最强点距离地面的高度 ";
CM_ SG_ 283 FR_OBJ21_MotionStatusConf  " ";
CM_ SG_ 283 FR_OBJ21_ClassConf  " ";
CM_ SG_ 283 FR_OBJ21_MotionStatus  " ";
CM_ SG_ 283 FR_OBJ21_Location  " ";
CM_ SG_ 283 FR_OBJ21_Measured  " ";
CM_ SG_ 283 FR_OBJ21_valid  " ";
CM_ SG_ 283 FR_OBJ21_Track_Age  " ";
CM_ SG_ 283 FR_OBJ21_Track_ID  " ";
CM_ SG_ 283 FR_OBJ21_ObstacleProb  " ";
CM_ SG_ 283 FR_OBJ21_ExistProb  " ";
CM_ SG_ 283 FR_OBJ21_RelAx  " ";
CM_ SG_ 283 FR_OBJ21_RelAy  " ";
CM_ SG_ 283 FR_OBJ21_RelVx_std  " ";
CM_ SG_ 283 FR_OBJ21_RelVx  " ";
CM_ SG_ 283 FR_OBJ21_RelVy_std  " ";
CM_ SG_ 283 FR_OBJ21_RelVy  " ";
CM_ SG_ 283 FR_OBJ21_Dx_Vnce  " ";
CM_ SG_ 283 FR_OBJ21_Dx  " ";
CM_ SG_ 283 FR_OBJ21_Dy_Vnce  " ";
CM_ SG_ 283 FR_OBJ21_Dy  " ";
CM_ SG_ 283 FR_OBJ21_HeadingAngle  " ";
CM_ SG_ 283 FR_OBJ21_Length  " ";
CM_ SG_ 283 FR_OBJ21_Height  " ";
CM_ SG_ 283 FR_OBJ21_Width  " ";
CM_ SG_ 283 FR_OBJ21_Class  " ";

CM_ BO_ 284  " ";
CM_ SG_ 284 FR_OBJ24_Ax  " ";
CM_ SG_ 284 FR_OBJ24_Ay  " ";
CM_ SG_ 284 FR_OBJ24_Vx  " ";
CM_ SG_ 284 FR_OBJ24_Vy  " ";
CM_ SG_ 284 FR_OBJ23_Ax  " ";
CM_ SG_ 284 FR_OBJ23_Ay  " ";
CM_ SG_ 284 FR_OBJ23_Vx  " ";
CM_ SG_ 284 FR_OBJ23_Vy  " ";
CM_ SG_ 284 FR_OBJ24_FeaturePoint  " ";
CM_ SG_ 284 FR_OBJ23_FeaturePoint  " ";
CM_ SG_ 284 FR_CRCCheck_11C  " ";
CM_ SG_ 284 FR_RollingCounter_11C  " ";
CM_ SG_ 284 FR_OBJ24_HeightGround  "反射点最强点距离地面的高度 ";
CM_ SG_ 284 FR_OBJ24_MotionStatusConf  " ";
CM_ SG_ 284 FR_OBJ24_ClassConf  " ";
CM_ SG_ 284 FR_OBJ24_MotionStatus  " ";
CM_ SG_ 284 FR_OBJ24_Location  " ";
CM_ SG_ 284 FR_OBJ24_Measured  " ";
CM_ SG_ 284 FR_OBJ24_valid  " ";
CM_ SG_ 284 FR_OBJ24_Track_Age  " ";
CM_ SG_ 284 FR_OBJ24_Track_ID  " ";
CM_ SG_ 284 FR_OBJ24_ObstacleProb  " ";
CM_ SG_ 284 FR_OBJ24_ExistProb  " ";
CM_ SG_ 284 FR_OBJ24_RelAx  " ";
CM_ SG_ 284 FR_OBJ24_RelAy  " ";
CM_ SG_ 284 FR_OBJ24_RelVx_std  " ";
CM_ SG_ 284 FR_OBJ24_RelVx  " ";
CM_ SG_ 284 FR_OBJ24_RelVy_std  " ";
CM_ SG_ 284 FR_OBJ24_RelVy  " ";
CM_ SG_ 284 FR_OBJ24_Dx_Vnce  " ";
CM_ SG_ 284 FR_OBJ24_Dx  " ";
CM_ SG_ 284 FR_OBJ24_Dy_Vnce  " ";
CM_ SG_ 284 FR_OBJ24_Dy  " ";
CM_ SG_ 284 FR_OBJ24_HeadingAngle  " ";
CM_ SG_ 284 FR_OBJ24_Length  " ";
CM_ SG_ 284 FR_OBJ24_Height  " ";
CM_ SG_ 284 FR_OBJ24_Width  " ";
CM_ SG_ 284 FR_OBJ24_Class  " ";
CM_ SG_ 284 FR_OBJ23_HeightGround  "反射点最强点距离地面的高度 ";
CM_ SG_ 284 FR_OBJ23_MotionStatusConf  " ";
CM_ SG_ 284 FR_OBJ23_ClassConf  " ";
CM_ SG_ 284 FR_OBJ23_MotionStatus  " ";
CM_ SG_ 284 FR_OBJ23_Location  " ";
CM_ SG_ 284 FR_OBJ23_Measured  " ";
CM_ SG_ 284 FR_OBJ23_valid  " ";
CM_ SG_ 284 FR_OBJ23_Track_Age  " ";
CM_ SG_ 284 FR_OBJ23_Track_ID  " ";
CM_ SG_ 284 FR_OBJ23_ObstacleProb  " ";
CM_ SG_ 284 FR_OBJ23_ExistProb  " ";
CM_ SG_ 284 FR_OBJ23_RelAx  " ";
CM_ SG_ 284 FR_OBJ23_RelAy  " ";
CM_ SG_ 284 FR_OBJ23_RelVx_std  " ";
CM_ SG_ 284 FR_OBJ23_RelVx  " ";
CM_ SG_ 284 FR_OBJ23_RelVy_std  " ";
CM_ SG_ 284 FR_OBJ23_RelVy  " ";
CM_ SG_ 284 FR_OBJ23_Dx_Vnce  " ";
CM_ SG_ 284 FR_OBJ23_Dx  " ";
CM_ SG_ 284 FR_OBJ23_Dy_Vnce  " ";
CM_ SG_ 284 FR_OBJ23_Dy  " ";
CM_ SG_ 284 FR_OBJ23_HeadingAngle  " ";
CM_ SG_ 284 FR_OBJ23_Length  " ";
CM_ SG_ 284 FR_OBJ23_Height  " ";
CM_ SG_ 284 FR_OBJ23_Width  " ";
CM_ SG_ 284 FR_OBJ23_Class  " ";

CM_ BO_ 285  " ";
CM_ SG_ 285 FR_OBJ26_Ax  " ";
CM_ SG_ 285 FR_OBJ26_Ay  " ";
CM_ SG_ 285 FR_OBJ26_Vx  " ";
CM_ SG_ 285 FR_OBJ26_Vy  " ";
CM_ SG_ 285 FR_OBJ25_Ax  " ";
CM_ SG_ 285 FR_OBJ25_Ay  " ";
CM_ SG_ 285 FR_OBJ25_Vx  " ";
CM_ SG_ 285 FR_OBJ25_Vy  " ";
CM_ SG_ 285 FR_OBJ26_FeaturePoint  " ";
CM_ SG_ 285 FR_OBJ25_FeaturePoint  " ";
CM_ SG_ 285 FR_CRCCheck_11D  " ";
CM_ SG_ 285 FR_RollingCounter_11D  " ";
CM_ SG_ 285 FR_OBJ26_HeightGround  "反射点最强点距离地面的高度 ";
CM_ SG_ 285 FR_OBJ26_MotionStatusConf  " ";
CM_ SG_ 285 FR_OBJ26_ClassConf  " ";
CM_ SG_ 285 FR_OBJ26_MotionStatus  " ";
CM_ SG_ 285 FR_OBJ26_Location  " ";
CM_ SG_ 285 FR_OBJ26_Measured  " ";
CM_ SG_ 285 FR_OBJ26_valid  " ";
CM_ SG_ 285 FR_OBJ26_Track_Age  " ";
CM_ SG_ 285 FR_OBJ26_Track_ID  " ";
CM_ SG_ 285 FR_OBJ26_ObstacleProb  " ";
CM_ SG_ 285 FR_OBJ26_ExistProb  " ";
CM_ SG_ 285 FR_OBJ26_RelAx  " ";
CM_ SG_ 285 FR_OBJ26_RelAy  " ";
CM_ SG_ 285 FR_OBJ26_RelVx_std  " ";
CM_ SG_ 285 FR_OBJ26_RelVx  " ";
CM_ SG_ 285 FR_OBJ26_RelVy_std  " ";
CM_ SG_ 285 FR_OBJ26_RelVy  " ";
CM_ SG_ 285 FR_OBJ26_Dx_Vnce  " ";
CM_ SG_ 285 FR_OBJ26_Dx  " ";
CM_ SG_ 285 FR_OBJ26_Dy_Vnce  " ";
CM_ SG_ 285 FR_OBJ26_Dy  " ";
CM_ SG_ 285 FR_OBJ26_HeadingAngle  " ";
CM_ SG_ 285 FR_OBJ26_Length  " ";
CM_ SG_ 285 FR_OBJ26_Height  " ";
CM_ SG_ 285 FR_OBJ26_Width  " ";
CM_ SG_ 285 FR_OBJ26_Class  " ";
CM_ SG_ 285 FR_OBJ25_HeightGround  "反射点最强点距离地面的高度 ";
CM_ SG_ 285 FR_OBJ25_MotionStatusConf  " ";
CM_ SG_ 285 FR_OBJ25_ClassConf  " ";
CM_ SG_ 285 FR_OBJ25_MotionStatus  " ";
CM_ SG_ 285 FR_OBJ25_Location  " ";
CM_ SG_ 285 FR_OBJ25_Measured  " ";
CM_ SG_ 285 FR_OBJ25_valid  " ";
CM_ SG_ 285 FR_OBJ25_Track_Age  " ";
CM_ SG_ 285 FR_OBJ25_Track_ID  " ";
CM_ SG_ 285 FR_OBJ25_ObstacleProb  " ";
CM_ SG_ 285 FR_OBJ25_ExistProb  " ";
CM_ SG_ 285 FR_OBJ25_RelAx  " ";
CM_ SG_ 285 FR_OBJ25_RelAy  " ";
CM_ SG_ 285 FR_OBJ25_RelVx_std  " ";
CM_ SG_ 285 FR_OBJ25_RelVx  " ";
CM_ SG_ 285 FR_OBJ25_RelVy_std  " ";
CM_ SG_ 285 FR_OBJ25_RelVy  " ";
CM_ SG_ 285 FR_OBJ25_Dx_Vnce  " ";
CM_ SG_ 285 FR_OBJ25_Dx  " ";
CM_ SG_ 285 FR_OBJ25_Dy_Vnce  " ";
CM_ SG_ 285 FR_OBJ25_Dy  " ";
CM_ SG_ 285 FR_OBJ25_HeadingAngle  " ";
CM_ SG_ 285 FR_OBJ25_Length  " ";
CM_ SG_ 285 FR_OBJ25_Height  " ";
CM_ SG_ 285 FR_OBJ25_Width  " ";
CM_ SG_ 285 FR_OBJ25_Class  " ";

CM_ BO_ 286  " ";
CM_ SG_ 286 FR_OBJ28_Ax  " ";
CM_ SG_ 286 FR_OBJ28_Ay  " ";
CM_ SG_ 286 FR_OBJ28_Vx  " ";
CM_ SG_ 286 FR_OBJ28_Vy  " ";
CM_ SG_ 286 FR_OBJ27_Ax  " ";
CM_ SG_ 286 FR_OBJ27_Ay  " ";
CM_ SG_ 286 FR_OBJ27_Vx  " ";
CM_ SG_ 286 FR_OBJ27_Vy  " ";
CM_ SG_ 286 FR_OBJ28_FeaturePoint  " ";
CM_ SG_ 286 FR_OBJ27_FeaturePoint  " ";
CM_ SG_ 286 ER_CRCCheck_11E  " ";
CM_ SG_ 286 ER_RollingCounter_11E  " ";
CM_ SG_ 286 FR_OBJ28_HeightGround  "反射点最强点距离地面的高度 ";
CM_ SG_ 286 FR_OBJ28_MotionStatusConf  " ";
CM_ SG_ 286 FR_OBJ28_ClassConf  " ";
CM_ SG_ 286 FR_OBJ28_MotionStatus  " ";
CM_ SG_ 286 FR_OBJ28_Location  " ";
CM_ SG_ 286 FR_OBJ28_Measured  " ";
CM_ SG_ 286 FR_OBJ28_valid  " ";
CM_ SG_ 286 FR_OBJ28_Track_Age  " ";
CM_ SG_ 286 FR_OBJ28_Track_ID  " ";
CM_ SG_ 286 FR_OBJ28_ObstacleProb  " ";
CM_ SG_ 286 FR_OBJ28_ExistProb  " ";
CM_ SG_ 286 FR_OBJ28_RelAx  " ";
CM_ SG_ 286 FR_OBJ28_RelAy  " ";
CM_ SG_ 286 FR_OBJ28_RelVx_std  " ";
CM_ SG_ 286 FR_OBJ28_RelVx  " ";
CM_ SG_ 286 FR_OBJ28_RelVy_std  " ";
CM_ SG_ 286 FR_OBJ28_RelVy  " ";
CM_ SG_ 286 FR_OBJ28_Dx_Vnce  " ";
CM_ SG_ 286 FR_OBJ28_Dx  " ";
CM_ SG_ 286 FR_OBJ28_Dy_Vnce  " ";
CM_ SG_ 286 FR_OBJ28_Dy  " ";
CM_ SG_ 286 FR_OBJ28_HeadingAngle  " ";
CM_ SG_ 286 FR_OBJ28_Length  " ";
CM_ SG_ 286 FR_OBJ28_Height  " ";
CM_ SG_ 286 FR_OBJ28_Width  " ";
CM_ SG_ 286 FR_OBJ28_Class  " ";
CM_ SG_ 286 FR_OBJ27_HeightGround  "反射点最强点距离地面的高度 ";
CM_ SG_ 286 FR_OBJ27_MotionStatusConf  " ";
CM_ SG_ 286 FR_OBJ27_ClassConf  " ";
CM_ SG_ 286 FR_OBJ27_MotionStatus  " ";
CM_ SG_ 286 FR_OBJ27_Location  " ";
CM_ SG_ 286 FR_OBJ27_Measured  " ";
CM_ SG_ 286 FR_OBJ27_valid  " ";
CM_ SG_ 286 FR_OBJ27_Track_Age  " ";
CM_ SG_ 286 FR_OBJ27_Track_ID  " ";
CM_ SG_ 286 FR_OBJ27_ObstacleProb  " ";
CM_ SG_ 286 FR_OBJ27_ExistProb  " ";
CM_ SG_ 286 FR_OBJ27_RelAx  " ";
CM_ SG_ 286 FR_OBJ27_RelAy  " ";
CM_ SG_ 286 FR_OBJ27_RelVx_std  " ";
CM_ SG_ 286 FR_OBJ27_RelVx  " ";
CM_ SG_ 286 FR_OBJ27_RelVy_std  " ";
CM_ SG_ 286 FR_OBJ27_RelVy  " ";
CM_ SG_ 286 FR_OBJ27_Dx_Vnce  " ";
CM_ SG_ 286 FR_OBJ27_Dx  " ";
CM_ SG_ 286 FR_OBJ27_Dy_Vnce  " ";
CM_ SG_ 286 FR_OBJ27_Dy  " ";
CM_ SG_ 286 FR_OBJ27_HeadingAngle  " ";
CM_ SG_ 286 FR_OBJ27_Length  " ";
CM_ SG_ 286 FR_OBJ27_Height  " ";
CM_ SG_ 286 FR_OBJ27_Width  " ";
CM_ SG_ 286 FR_OBJ27_Class  " ";

CM_ BO_ 287  " ";
CM_ SG_ 287 FR_OBJ30_Ax  " ";
CM_ SG_ 287 FR_OBJ30_Ay  " ";
CM_ SG_ 287 FR_OBJ30_Vx  " ";
CM_ SG_ 287 FR_OBJ30_Vy  " ";
CM_ SG_ 287 FR_OBJ29_Ax  " ";
CM_ SG_ 287 FR_OBJ29_Ay  " ";
CM_ SG_ 287 FR_OBJ29_Vx  " ";
CM_ SG_ 287 FR_OBJ29_Vy  " ";
CM_ SG_ 287 FR_OBJ30_FeaturePoint  " ";
CM_ SG_ 287 FR_OBJ29_FeaturePoint  " ";
CM_ SG_ 287 FR_CRCCheck_11F  " ";
CM_ SG_ 287 FR_RollingCounter_11F  " ";
CM_ SG_ 287 FR_OBJ30_HeightGround  "反射点最强点距离地面的高度 ";
CM_ SG_ 287 FR_OBJ30_MotionStatusConf  " ";
CM_ SG_ 287 FR_OBJ30_ClassConf  " ";
CM_ SG_ 287 FR_OBJ30_MotionStatus  " ";
CM_ SG_ 287 FR_OBJ30_Location  " ";
CM_ SG_ 287 FR_OBJ30_Measured  " ";
CM_ SG_ 287 FR_OBJ30_valid  " ";
CM_ SG_ 287 FR_OBJ30_Track_Age  " ";
CM_ SG_ 287 FR_OBJ30_Track_ID  " ";
CM_ SG_ 287 FR_OBJ30_ObstacleProb  " ";
CM_ SG_ 287 FR_OBJ30_ExistProb  " ";
CM_ SG_ 287 FR_OBJ30_RelAx  " ";
CM_ SG_ 287 FR_OBJ30_RelAy  " ";
CM_ SG_ 287 FR_OBJ30_RelVx_std  " ";
CM_ SG_ 287 FR_OBJ30_RelVx  " ";
CM_ SG_ 287 FR_OBJ30_RelVy_std  " ";
CM_ SG_ 287 FR_OBJ30_RelVy  " ";
CM_ SG_ 287 FR_OBJ30_Dx_Vnce  " ";
CM_ SG_ 287 FR_OBJ30_Dx  " ";
CM_ SG_ 287 FR_OBJ30_Dy_Vnce  " ";
CM_ SG_ 287 FR_OBJ30_Dy  " ";
CM_ SG_ 287 FR_OBJ30_HeadingAngle  " ";
CM_ SG_ 287 FR_OBJ30_Length  " ";
CM_ SG_ 287 FR_OBJ30_Height  " ";
CM_ SG_ 287 FR_OBJ30_Width  " ";
CM_ SG_ 287 FR_OBJ30_Class  " ";
CM_ SG_ 287 FR_OBJ29_HeightGround  "反射点最强点距离地面的高度 ";
CM_ SG_ 287 FR_OBJ29_MotionStatusConf  " ";
CM_ SG_ 287 FR_OBJ29_ClassConf  " ";
CM_ SG_ 287 FR_OBJ29_MotionStatus  " ";
CM_ SG_ 287 FR_OBJ29_Location  " ";
CM_ SG_ 287 FR_OBJ29_Measured  " ";
CM_ SG_ 287 FR_OBJ29_valid  " ";
CM_ SG_ 287 FR_OBJ29_Track_Age  " ";
CM_ SG_ 287 FR_OBJ29_Track_ID  " ";
CM_ SG_ 287 FR_OBJ29_ObstacleProb  " ";
CM_ SG_ 287 FR_OBJ29_ExistProb  " ";
CM_ SG_ 287 FR_OBJ29_RelAx  " ";
CM_ SG_ 287 FR_OBJ29_RelAy  " ";
CM_ SG_ 287 FR_OBJ29_RelVx_std  " ";
CM_ SG_ 287 FR_OBJ29_RelVx  " ";
CM_ SG_ 287 FR_OBJ29_RelVy_std  " ";
CM_ SG_ 287 FR_OBJ29_RelVy  " ";
CM_ SG_ 287 FR_OBJ29_Dx_Vnce  " ";
CM_ SG_ 287 FR_OBJ29_Dx  " ";
CM_ SG_ 287 FR_OBJ29_Dy_Vnce  " ";
CM_ SG_ 287 FR_OBJ29_Dy  " ";
CM_ SG_ 287 FR_OBJ29_HeadingAngle  " ";
CM_ SG_ 287 FR_OBJ29_Length  " ";
CM_ SG_ 287 FR_OBJ29_Height  " ";
CM_ SG_ 287 FR_OBJ29_Width  " ";
CM_ SG_ 287 FR_OBJ29_Class  " ";

CM_ BO_ 288  " ";
CM_ SG_ 288 FR_OBJ32_Ax  " ";
CM_ SG_ 288 FR_OBJ32_Ay  " ";
CM_ SG_ 288 FR_OBJ32_Vx  " ";
CM_ SG_ 288 FR_OBJ32_Vy  " ";
CM_ SG_ 288 FR_OBJ31_Ax  " ";
CM_ SG_ 288 FR_OBJ31_Ay  " ";
CM_ SG_ 288 FR_OBJ31_Vx  " ";
CM_ SG_ 288 FR_OBJ31_Vy  " ";
CM_ SG_ 288 FR_OBJ32_FeaturePoint  " ";
CM_ SG_ 288 FR_OBJ31_FeaturePoint  " ";
CM_ SG_ 288 FR_CRCCheck_120  " ";
CM_ SG_ 288 FR_RollingCounter_120  " ";
CM_ SG_ 288 FR_OBJ32_HeightGround  "反射点最强点距离地面的高度 ";
CM_ SG_ 288 FR_OBJ32_MotionStatusConf  " ";
CM_ SG_ 288 FR_OBJ32_ClassConf  " ";
CM_ SG_ 288 FR_OBJ32_MotionStatus  " ";
CM_ SG_ 288 FR_OBJ32_Location  " ";
CM_ SG_ 288 FR_OBJ32_Measured  " ";
CM_ SG_ 288 FR_OBJ32_valid  " ";
CM_ SG_ 288 FR_OBJ32_Track_Age  " ";
CM_ SG_ 288 FR_OBJ32_Track_ID  " ";
CM_ SG_ 288 FR_OBJ32_ObstacleProb  " ";
CM_ SG_ 288 FR_OBJ32_ExistProb  " ";
CM_ SG_ 288 FR_OBJ32_RelAx  " ";
CM_ SG_ 288 FR_OBJ32_RelAy  " ";
CM_ SG_ 288 FR_OBJ32_RelVx_std  " ";
CM_ SG_ 288 FR_OBJ32_RelVx  " ";
CM_ SG_ 288 FR_OBJ32_RelVy_std  " ";
CM_ SG_ 288 FR_OBJ32_RelVy  " ";
CM_ SG_ 288 FR_OBJ32_Dx_Vnce  " ";
CM_ SG_ 288 FR_OBJ32_Dx  " ";
CM_ SG_ 288 FR_OBJ32_Dy_Vnce  " ";
CM_ SG_ 288 FR_OBJ32_Dy  " ";
CM_ SG_ 288 FR_OBJ32_HeadingAngle  " ";
CM_ SG_ 288 FR_OBJ32_Length  " ";
CM_ SG_ 288 FR_OBJ32_Height  " ";
CM_ SG_ 288 FR_OBJ32_Width  " ";
CM_ SG_ 288 FR_OBJ32_Class  " ";
CM_ SG_ 288 FR_OBJ31_HeightGround  "反射点最强点距离地面的高度 ";
CM_ SG_ 288 FR_OBJ31_MotionStatusConf  " ";
CM_ SG_ 288 FR_OBJ31_ClassConf  " ";
CM_ SG_ 288 FR_OBJ31_MotionStatus  " ";
CM_ SG_ 288 FR_OBJ31_Location  " ";
CM_ SG_ 288 FR_OBJ31_Measured  " ";
CM_ SG_ 288 FR_Obj31_valid  " ";
CM_ SG_ 288 FR_OBJ31_Track_Age  " ";
CM_ SG_ 288 FR_OBJ31_Track_ID  " ";
CM_ SG_ 288 FR_OBJ31_ObstacleProb  " ";
CM_ SG_ 288 FR_OBJ31_ExistProb  " ";
CM_ SG_ 288 FR_OBJ31_RelAx  " ";
CM_ SG_ 288 FR_OBJ31_RelAy  " ";
CM_ SG_ 288 FR_OBJ31_RelVx_std  " ";
CM_ SG_ 288 FR_OBJ31_RelVx  " ";
CM_ SG_ 288 FR_OBJ31_RelVy_std  " ";
CM_ SG_ 288 FR_OBJ31_RelVy  " ";
CM_ SG_ 288 FR_OBJ31_Dx_Vnce  " ";
CM_ SG_ 288 FR_OBJ31_Dx  " ";
CM_ SG_ 288 FR_OBJ31_Dy_Vnce  " ";
CM_ SG_ 288 FR_OBJ31_Dy  " ";
CM_ SG_ 288 FR_OBJ31_HeadingAngle  " ";
CM_ SG_ 288 FR_OBJ31_Length  " ";
CM_ SG_ 288 FR_OBJ31_Height  " ";
CM_ SG_ 288 FR_OBJ31_Width  " ";
CM_ SG_ 288 FR_OBJ31_Class  " ";

CM_ BO_ 310  " ";
CM_ SG_ 310 FR_KidRushoutFlag  " ";
CM_ SG_ 310 FR_CRCCheck_136  " ";
CM_ SG_ 310 FR_RollingCounter_136  " ";
CM_ SG_ 310 FR_FrameCount  " ";
CM_ SG_ 310 FR_MisAlignment  " ";
CM_ SG_ 310 FR_WorkMode  " ";
CM_ SG_ 310 FR_RadarFailureStatus  " ";
CM_ SG_ 310 FR_FRadarCalibrationStatus  " ";
CM_ SG_ 310 FR_Frametime  " ";
CM_ SG_ 310 FR_ObjCount  " ";

CM_ BO_ 312  " ";
CM_ SG_ 312 DiffTime_Time_uS  " ";
CM_ SG_ 312 FR_TiOut  " ";
CM_ SG_ 312 FR_TiLeap  " ";
CM_ SG_ 312 FR_TiBas  " ";
CM_ SG_ 312 FR_TiStamp  " ";

CM_ BO_ 320  " ";
CM_ SG_ 320 FR_DTC2_Status  "DTC上传 ";
CM_ SG_ 320 FR_DTC2_LowByte  "DTC上传 ";
CM_ SG_ 320 FR_DTC2_MiddByte  "DTC上传 ";
CM_ SG_ 320 FR_DTC2_HighByte  "DTC上传 ";
CM_ SG_ 320 FR_DTC1_Status  "DTC上传 ";
CM_ SG_ 320 FR_DTC1_LowByte  "DTC上传 ";
CM_ SG_ 320 FR_DTC1_MiddByte  "DTC上传 ";
CM_ SG_ 320 FR_DTC1_HighByte  "DTC上传 ";

CM_ BO_ 336  "1-4对应左、右、左左、右右车道线
5、6对应左、右路沿
7、8对应匝道 ";
CM_ SG_ 336 FC_CRCCheck_150  " ";
CM_ SG_ 336 FC_RollingCounter_150  " ";
CM_ SG_ 336 FC_Line_2_exist_prob  " ";
CM_ SG_ 336 FC_Line_2_RMSE  " ";
CM_ SG_ 336 FC_Line_2_ParseConf  " ";
CM_ SG_ 336 FC_Line_2_MeasureType  " ";
CM_ SG_ 336 FC_Line_2_ModelC3  " ";
CM_ SG_ 336 FC_Line_2_ModelC2  " ";
CM_ SG_ 336 FC_Line_2_ModelC1  " ";
CM_ SG_ 336 FC_Line_2_ModelC0  " ";
CM_ SG_ 336 FC_Line_2_dx_End  " ";
CM_ SG_ 336 FC_Line_2_dx_Start  " ";
CM_ SG_ 336 FC_Line_2_Width  " ";
CM_ SG_ 336 FC_Line_2_color  " ";
CM_ SG_ 336 FC_Line_2_Id  " ";
CM_ SG_ 336 FC_Line_2_TypeConfidence  " ";
CM_ SG_ 336 FC_Line_2_Type  " ";
CM_ SG_ 336 FC_Line_1_exist_prob  " ";
CM_ SG_ 336 FC_Line_1_RMSE  " ";
CM_ SG_ 336 FC_Line_1_ParseConf  " ";
CM_ SG_ 336 FC_Line_1_MeasureType  " ";
CM_ SG_ 336 FC_Line_1_ModelC3  " ";
CM_ SG_ 336 FC_Line_1_ModelC2  " ";
CM_ SG_ 336 FC_Line_1_ModelC1  " ";
CM_ SG_ 336 FC_Line_1_ModelC0  " ";
CM_ SG_ 336 FC_Line_1_dx_End  " ";
CM_ SG_ 336 FC_Line_1_dx_Start  " ";
CM_ SG_ 336 FC_Line_1_Width  " ";
CM_ SG_ 336 FC_Line_1_color  " ";
CM_ SG_ 336 FC_Line_1_Id  " ";
CM_ SG_ 336 FC_Line_1_TypeConfidence  " ";
CM_ SG_ 336 FC_Line_1_Type  " ";

CM_ BO_ 337  " ";
CM_ SG_ 337 FC_CRCCheck_151  " ";
CM_ SG_ 337 FC_RollingCounter_151  " ";
CM_ SG_ 337 FC_Line_4_exist_prob  " ";
CM_ SG_ 337 FC_Line_4_RMSE  " ";
CM_ SG_ 337 FC_Line_4_ParseConf  " ";
CM_ SG_ 337 FC_Line_4_MeasureType  " ";
CM_ SG_ 337 FC_Line_4_ModelC3  " ";
CM_ SG_ 337 FC_Line_4_ModelC2  " ";
CM_ SG_ 337 FC_Line_4_ModelC1  " ";
CM_ SG_ 337 FC_Line_4_ModelC0  " ";
CM_ SG_ 337 FC_Line_4_dx_End  " ";
CM_ SG_ 337 FC_Line_4_dx_Start  " ";
CM_ SG_ 337 FC_Line_4_Width  " ";
CM_ SG_ 337 FC_Line_4_color  " ";
CM_ SG_ 337 FC_Line_4_Id  " ";
CM_ SG_ 337 FC_Line_4_TypeConfidence  " ";
CM_ SG_ 337 FC_Line_4_Type  " ";
CM_ SG_ 337 FC_Line_3_exist_prob  " ";
CM_ SG_ 337 FC_Line_3_RMSE  " ";
CM_ SG_ 337 FC_Line_3_ParseConf  " ";
CM_ SG_ 337 FC_Line_3_MeasureType  " ";
CM_ SG_ 337 FC_Line_3_ModelC3  " ";
CM_ SG_ 337 FC_Line_3_ModelC2  " ";
CM_ SG_ 337 FC_Line_3_ModelC1  " ";
CM_ SG_ 337 FC_Line_3_ModelC0  " ";
CM_ SG_ 337 FC_Line_3_dx_End  " ";
CM_ SG_ 337 FC_Line_3_dx_Start  " ";
CM_ SG_ 337 FC_Line_3_Width  " ";
CM_ SG_ 337 FC_Line_3_color  " ";
CM_ SG_ 337 FC_Line_3_Id  " ";
CM_ SG_ 337 FC_Line_3_TypeConfidence  " ";
CM_ SG_ 337 FC_Line_3_Type  " ";

CM_ BO_ 338  " ";
CM_ SG_ 338 FC_CRCCheck_152  " ";
CM_ SG_ 338 FC_RollingCounter_152  " ";
CM_ SG_ 338 FC_Line_6_exist_prob  " ";
CM_ SG_ 338 FC_Line_6_RMSE  " ";
CM_ SG_ 338 FC_Line_6_ParseConf  " ";
CM_ SG_ 338 FC_Line_6_MeasureType  " ";
CM_ SG_ 338 FC_Line_6_ModelC3  " ";
CM_ SG_ 338 FC_Line_6_ModelC2  " ";
CM_ SG_ 338 FC_Line_6_ModelC1  " ";
CM_ SG_ 338 FC_Line_6_ModelC0  " ";
CM_ SG_ 338 FC_Line_6_dx_End  " ";
CM_ SG_ 338 FC_Line_6_dx_Start  " ";
CM_ SG_ 338 FC_Line_6_Width  " ";
CM_ SG_ 338 FC_Line_6_color  " ";
CM_ SG_ 338 FC_Line_6_Id  " ";
CM_ SG_ 338 FC_Line_6_TypeConfidence  " ";
CM_ SG_ 338 FC_Line_6_Type  " ";
CM_ SG_ 338 FC_Line_5_exist_prob  " ";
CM_ SG_ 338 FC_Line_5_RMSE  " ";
CM_ SG_ 338 FC_Line_5_ParseConf  " ";
CM_ SG_ 338 FC_Line_5_MeasureType  " ";
CM_ SG_ 338 FC_Line_5_ModelC3  " ";
CM_ SG_ 338 FC_Line_5_ModelC2  " ";
CM_ SG_ 338 FC_Line_5_ModelC1  " ";
CM_ SG_ 338 FC_Line_5_ModelC0  " ";
CM_ SG_ 338 FC_Line_5_dx_End  " ";
CM_ SG_ 338 FC_Line_5_dx_Start  " ";
CM_ SG_ 338 FC_Line_5_Width  " ";
CM_ SG_ 338 FC_Line_5_color  " ";
CM_ SG_ 338 FC_Line_5_Id  " ";
CM_ SG_ 338 FC_Line_5_TypeConfidence  " ";
CM_ SG_ 338 FC_Line_5_Type  " ";

CM_ BO_ 339  " ";
CM_ SG_ 339 FC_CRCCheck_153  " ";
CM_ SG_ 339 FC_RollingCounter_153  " ";
CM_ SG_ 339 FC_Line_8_exist_prob  " ";
CM_ SG_ 339 FC_Line_8_RMSE  " ";
CM_ SG_ 339 FC_Line_8_ParseConf  " ";
CM_ SG_ 339 FC_Line_8_MeasureType  " ";
CM_ SG_ 339 FC_Line_8_ModelC3  " ";
CM_ SG_ 339 FC_Line_8_ModelC2  " ";
CM_ SG_ 339 FC_Line_8_ModelC1  " ";
CM_ SG_ 339 FC_Line_8_ModelC0  " ";
CM_ SG_ 339 FC_Line_8_dx_End  " ";
CM_ SG_ 339 FC_Line_8_dx_Start  " ";
CM_ SG_ 339 FC_Line_8_Width  " ";
CM_ SG_ 339 FC_Line_8_color  " ";
CM_ SG_ 339 FC_Line_8_Id  " ";
CM_ SG_ 339 FC_Line_8_TypeConfidence  " ";
CM_ SG_ 339 FC_Line_8_Type  " ";
CM_ SG_ 339 FC_Line_7_exist_prob  " ";
CM_ SG_ 339 FC_Line_7_RMSE  " ";
CM_ SG_ 339 FC_Line_7_ParseConf  " ";
CM_ SG_ 339 FC_Line_7_MeasureType  " ";
CM_ SG_ 339 FC_Line_7_ModelC3  " ";
CM_ SG_ 339 FC_Line_7_ModelC2  " ";
CM_ SG_ 339 FC_Line_7_ModelC1  " ";
CM_ SG_ 339 FC_Line_7_ModelC0  " ";
CM_ SG_ 339 FC_Line_7_dx_End  " ";
CM_ SG_ 339 FC_Line_7_dx_Start  " ";
CM_ SG_ 339 FC_Line_7_Width  " ";
CM_ SG_ 339 FC_Line_7_color  " ";
CM_ SG_ 339 FC_Line_7_Id  " ";
CM_ SG_ 339 FC_Line_7_TypeConfidence  " ";
CM_ SG_ 339 FC_Line_7_Type  " ";

CM_ BO_ 340  " ";
CM_ SG_ 340 FC_CRCCheck_154  " ";
CM_ SG_ 340 FC_RollingCounter_154  " ";
CM_ SG_ 340 FC_LineMCUTiStamp  " ";
CM_ SG_ 340 FC_LineTiOut  " ";
CM_ SG_ 340 FC_LineTiLeap  " ";
CM_ SG_ 340 FC_LineTiBas  " ";
CM_ SG_ 340 FC_LineTiStamp  " ";
CM_ SG_ 340 FC_WeatherType  " ";
CM_ SG_ 340 FC_RCrossPiont_StartEnd  " ";
CM_ SG_ 340 FC_RCrossPiont_DivMer  " ";
CM_ SG_ 340 FC_RCrossPiont_ExistProb  " ";
CM_ SG_ 340 FC_RCrossPiont_Dy  " ";
CM_ SG_ 340 FC_RCrossPoint_DX  " ";
CM_ SG_ 340 FC_LCrossPiont_StartEnd  " ";
CM_ SG_ 340 FC_LCrossPiont_DivMer  " ";
CM_ SG_ 340 FC_LCrossPiont_ExistProb  " ";
CM_ SG_ 340 FC_LCrossPiont_Dy  " ";
CM_ SG_ 340 FC_LCrossPoint_DX  " ";

CM_ BO_ 352  " ";
CM_ SG_ 352 FC_Obj1_VehicleDir  " ";
CM_ SG_ 352 FC_Obj1ReDoorSts  " ";
CM_ SG_ 352 FC_Obj1RiDoorSts  " ";
CM_ SG_ 352 FC_Obj1LeDoorSts  " ";
CM_ SG_ 352 FC_Obj1WSInfoPosType  " ";
CM_ SG_ 352 FC_CRCCheck_160  " ";
CM_ SG_ 352 FC_RollingCounter_160  " ";
CM_ SG_ 352 FC_Obj1_Img2dBox_RightDown_V  " ";
CM_ SG_ 352 FC_Obj1_Img2dBox_LeftTop_V  " ";
CM_ SG_ 352 FC_Obj1_Img2dBox_RightDown_U  " ";
CM_ SG_ 352 FC_Obj1_Img2dBox_LeftTop_U  " ";
CM_ SG_ 352 FC_Obj1_TurnLight  " ";
CM_ SG_ 352 FC_Obj1_valid  "未收敛目标，输出invalid状态，输出valid状态，信号必须是可性的 ";
CM_ SG_ 352 FC_Obj1_Vy_Vnce  " ";
CM_ SG_ 352 FC_Obj1_Vx_Vnce  " ";
CM_ SG_ 352 FC_Obj1_CenterAngle  " ";
CM_ SG_ 352 FC_Obj1_DistInLane  " ";
CM_ SG_ 352 FC_Obj1_objCutInLane  " ";
CM_ SG_ 352 FC_Obj1_objCutInFlag  " ";
CM_ SG_ 352 FC_Obj1_CornerPoint_y  " ";
CM_ SG_ 352 FC_Obj1_CornerPoint_x  " ";
CM_ SG_ 352 FC_Obj1_LaneAssignment  " ";
CM_ SG_ 352 FC_Obj1_MotionType  " ";
CM_ SG_ 352 FC_obj1_Brakelight_Info  " ";
CM_ SG_ 352 FC_Obj1_Width  " ";
CM_ SG_ 352 FC_Obj1_Length  " ";
CM_ SG_ 352 FC_Obj1_Height  " ";
CM_ SG_ 352 FC_Obj1_HeadOrientation  " ";
CM_ SG_ 352 FC_Obj1_HeadingAngle  " ";
CM_ SG_ 352 FC_Obj1_ExistProb  " ";
CM_ SG_ 352 FC_Obj1_Dy_Vnce  " ";
CM_ SG_ 352 FC_Obj1_Dy  " ";
CM_ SG_ 352 FC_Obj1_Dx_Vnce  " ";
CM_ SG_ 352 FC_Obj1_Dx  " ";
CM_ SG_ 352 FC_Obj1_RelVy  " ";
CM_ SG_ 352 FC_Obj1_RelVx  " ";
CM_ SG_ 352 FC_Obj1_RelAy  " ";
CM_ SG_ 352 FC_Obj1_RelAx  " ";
CM_ SG_ 352 FC_Obj1_TypeProb  " ";
CM_ SG_ 352 FC_Obj1_Type  " ";
CM_ SG_ 352 FC_Obj1_Track_Age  " ";
CM_ SG_ 352 FC_Obj1_Track_ID  " ";

CM_ BO_ 353  " ";
CM_ SG_ 353 FC_Obj2_VehicleDir  " ";
CM_ SG_ 353 FC_Obj2ReDoorSts  " ";
CM_ SG_ 353 FC_Obj2RiDoorSts  " ";
CM_ SG_ 353 FC_Obj2LeDoorSts  " ";
CM_ SG_ 353 FC_Obj2WSInfoPosType  " ";
CM_ SG_ 353 FC_CRCCheck_161  " ";
CM_ SG_ 353 FC_RollingCounter_161  " ";
CM_ SG_ 353 FC_Obj2_Img2dBox_RightDown_V  " ";
CM_ SG_ 353 FC_Obj2_Img2dBox_LeftTop_V  " ";
CM_ SG_ 353 FC_Obj2_Img2dBox_RightDown_U  " ";
CM_ SG_ 353 FC_Obj2_Img2dBox_LeftTop_U  " ";
CM_ SG_ 353 FC_Obj2_TurnLight  " ";
CM_ SG_ 353 FC_Obj2_valid  "未收敛目标，输出invalid状态，输出valid状态，信号必须是可性的 ";
CM_ SG_ 353 FC_Obj2_Vy_Vnce  " ";
CM_ SG_ 353 FC_Obj2_Vx_Vnce  " ";
CM_ SG_ 353 FC_Obj2_CenterAngle  " ";
CM_ SG_ 353 FC_Obj2_DistInLane  " ";
CM_ SG_ 353 FC_Obj2_objCutInLane  " ";
CM_ SG_ 353 FC_Obj2_objCutInFlag  " ";
CM_ SG_ 353 FC_Obj2_CornerPoint_y  " ";
CM_ SG_ 353 FC_Obj2_CornerPoint_x  " ";
CM_ SG_ 353 FC_Obj2_LaneAssignment  " ";
CM_ SG_ 353 FC_Obj2_MotionType  " ";
CM_ SG_ 353 FC_obj2_Brakelight_Info  " ";
CM_ SG_ 353 FC_Obj2_Width  " ";
CM_ SG_ 353 FC_Obj2_Length  " ";
CM_ SG_ 353 FC_Obj2_Height  " ";
CM_ SG_ 353 FC_Obj2_HeadOrientation  " ";
CM_ SG_ 353 FC_Obj2_HeadingAngle  " ";
CM_ SG_ 353 FC_Obj2_ExistProb  " ";
CM_ SG_ 353 FC_Obj2_Dy_Vnce  " ";
CM_ SG_ 353 FC_Obj2_Dy  " ";
CM_ SG_ 353 FC_Obj2_Dx_Vnce  " ";
CM_ SG_ 353 FC_Obj2_Dx  " ";
CM_ SG_ 353 FC_Obj2_RelVy  " ";
CM_ SG_ 353 FC_Obj2_RelVx  " ";
CM_ SG_ 353 FC_Obj2_RelAy  " ";
CM_ SG_ 353 FC_Obj2_RelAx  " ";
CM_ SG_ 353 FC_Obj2_TypeProb  " ";
CM_ SG_ 353 FC_Obj2_Type  " ";
CM_ SG_ 353 FC_Obj2_Track_Age  " ";
CM_ SG_ 353 FC_Obj2_Track_ID  " ";

BA_DEF_ SG_  "GenSigStartValue" INT 0 0;
BA_DEF_ SG_  "GenSigInvalidValue" STRING  ;
BA_DEF_ SG_  "GenSigCycleTime" INT 0 0;
BA_DEF_ SG_  "GenSigSendType" ENUM  "Cyclic","OnWrite","OnWriteWithRepetition","OnChange","OnChangeWithRepetition","IfActive","IfActiveWithRepetition","NoSigSendType","NotUsed","NotUsed","NotUsed","NotUsed","NotUsed";
BA_DEF_ BO_  "GenMsgSendType" ENUM  "Cyclic","Event","NotUsed","NotUsed","NotUsed","Cyclic","NotUsed","IfActive","NoMsgSendType","NotUsed";
BA_DEF_ BO_  "GenMsgILSupport" ENUM  "No","Yes";
BA_DEF_ BO_  "GenMsgCycleTime" INT 0 65535;
BA_DEF_ BO_  "CANFD_BRS" ENUM  "0","1";
BA_DEF_ BO_  "VFrameFormat" ENUM  "StandardCAN","ExtendedCAN","reserved","reserved","reserved","reserved","reserved","reserved","reserved","reserved","reserved","reserved","reserved","reserved","StandardCAN_FD","ExtendedCAN_FD";
BA_DEF_DEF_  "GenSigStartValue" 0;
BA_DEF_DEF_  "GenSigInvalidValue" "/";
BA_DEF_DEF_  "GenSigCycleTime" 0;
BA_DEF_DEF_  "GenSigSendType" "Cyclic";
BA_DEF_DEF_  "GenMsgSendType" "NoMsgSendType";
BA_DEF_DEF_  "GenMsgILSupport" "Yes";
BA_DEF_DEF_  "GenMsgCycleTime" 0;
BA_DEF_DEF_  "CANFD_BRS" "1";
BA_DEF_DEF_  "VFrameFormat" "StandardCAN";
BA_ "GenMsgCycleTime" BO_ 283 70;
BA_ "GenMsgSendType" BO_ 283 0;
BA_ "VFrameFormat" BO_ 283 14;
BA_ "GenMsgCycleTime" BO_ 284 70;
BA_ "GenMsgSendType" BO_ 284 0;
BA_ "VFrameFormat" BO_ 284 14;
BA_ "GenMsgCycleTime" BO_ 285 70;
BA_ "GenMsgSendType" BO_ 285 0;
BA_ "VFrameFormat" BO_ 285 14;
BA_ "GenMsgCycleTime" BO_ 286 70;
BA_ "GenMsgSendType" BO_ 286 0;
BA_ "VFrameFormat" BO_ 286 14;
BA_ "GenMsgCycleTime" BO_ 287 70;
BA_ "GenMsgSendType" BO_ 287 0;
BA_ "VFrameFormat" BO_ 287 14;
BA_ "GenMsgCycleTime" BO_ 288 70;
BA_ "GenMsgSendType" BO_ 288 0;
BA_ "VFrameFormat" BO_ 288 14;
BA_ "GenMsgCycleTime" BO_ 310 50;
BA_ "GenMsgSendType" BO_ 310 0;
BA_ "VFrameFormat" BO_ 310 14;
BA_ "GenMsgCycleTime" BO_ 312 70;
BA_ "GenMsgSendType" BO_ 312 0;
BA_ "VFrameFormat" BO_ 312 14;
BA_ "GenMsgCycleTime" BO_ 320 500;
BA_ "GenMsgSendType" BO_ 320 0;
BA_ "VFrameFormat" BO_ 320 14;
BA_ "GenMsgCycleTime" BO_ 336 30;
BA_ "GenMsgSendType" BO_ 336 0;
BA_ "VFrameFormat" BO_ 336 14;
BA_ "GenMsgCycleTime" BO_ 337 30;
BA_ "GenMsgSendType" BO_ 337 0;
BA_ "VFrameFormat" BO_ 337 14;
BA_ "GenMsgCycleTime" BO_ 338 30;
BA_ "GenMsgSendType" BO_ 338 0;
BA_ "VFrameFormat" BO_ 338 14;
BA_ "GenMsgCycleTime" BO_ 339 30;
BA_ "GenMsgSendType" BO_ 339 0;
BA_ "VFrameFormat" BO_ 339 14;
BA_ "GenMsgCycleTime" BO_ 340 30;
BA_ "GenMsgSendType" BO_ 340 0;
BA_ "VFrameFormat" BO_ 340 14;
BA_ "GenMsgCycleTime" BO_ 352 60;
BA_ "GenMsgSendType" BO_ 352 0;
BA_ "VFrameFormat" BO_ 352 14;
BA_ "GenMsgCycleTime" BO_ 353 60;
BA_ "GenMsgSendType" BO_ 353 0;
BA_ "VFrameFormat" BO_ 353 14;

BA_ "GenSigCycleTime" SG_ 283 FR_OBJ22_Ax 70;
BA_ "GenSigCycleTime" SG_ 283 FR_OBJ22_Ay 70;
BA_ "GenSigCycleTime" SG_ 283 FR_OBJ22_Vx 70;
BA_ "GenSigCycleTime" SG_ 283 FR_OBJ22_Vy 70;
BA_ "GenSigCycleTime" SG_ 283 FR_OBJ21_Ax 70;
BA_ "GenSigCycleTime" SG_ 283 FR_OBJ21_Ay 70;
BA_ "GenSigCycleTime" SG_ 283 FR_OBJ21_Vx 70;
BA_ "GenSigCycleTime" SG_ 283 FR_OBJ21_Vy 70;
BA_ "GenSigCycleTime" SG_ 283 FR_OBJ22_FeaturePoint 70;
BA_ "GenSigCycleTime" SG_ 283 FR_OBJ21_FeaturePoint 70;
BA_ "GenSigCycleTime" SG_ 283 FR_CRCCheck_11B 70;
BA_ "GenSigCycleTime" SG_ 283 FR_RollingCounter_11B 70;
BA_ "GenSigCycleTime" SG_ 283 FR_OBJ22_HeightGround 70;
BA_ "GenSigCycleTime" SG_ 283 FR_OBJ22_MotionStatusConf 70;
BA_ "GenSigCycleTime" SG_ 283 FR_OBJ22_ClassConf 70;
BA_ "GenSigCycleTime" SG_ 283 FR_OBJ22_MotionStatus 70;
BA_ "GenSigCycleTime" SG_ 283 FR_OBJ22_Location 70;
BA_ "GenSigCycleTime" SG_ 283 FR_OBJ22_Measured 70;
BA_ "GenSigCycleTime" SG_ 283 FR_OBJ22_valid 70;
BA_ "GenSigCycleTime" SG_ 283 FR_OBJ22_Track_Age 70;
BA_ "GenSigCycleTime" SG_ 283 FR_OBJ22_Track_ID 70;
BA_ "GenSigInvalidValue" SG_ 283 FR_OBJ22_Track_ID "0";
BA_ "GenSigCycleTime" SG_ 283 FR_OBJ22_ObstacleProb 70;
BA_ "GenSigCycleTime" SG_ 283 FR_OBJ22_ExistProb 70;
BA_ "GenSigCycleTime" SG_ 283 FR_OBJ22_RelAx 70;
BA_ "GenSigCycleTime" SG_ 283 FR_OBJ22_RelAy 70;
BA_ "GenSigCycleTime" SG_ 283 FR_OBJ22_RelVx_std 70;
BA_ "GenSigInvalidValue" SG_ 283 FR_OBJ22_RelVx_std "4095";
BA_ "GenSigCycleTime" SG_ 283 FR_OBJ22_RelVx 70;
BA_ "GenSigCycleTime" SG_ 283 FR_OBJ22_RelVy_std 70;
BA_ "GenSigInvalidValue" SG_ 283 FR_OBJ22_RelVy_std "1023";
BA_ "GenSigCycleTime" SG_ 283 FR_OBJ22_RelVy 70;
BA_ "GenSigCycleTime" SG_ 283 FR_OBJ22_Dx_Vnce 70;
BA_ "GenSigInvalidValue" SG_ 283 FR_OBJ22_Dx_Vnce "16383";
BA_ "GenSigCycleTime" SG_ 283 FR_OBJ22_Dx 70;
BA_ "GenSigCycleTime" SG_ 283 FR_OBJ22_Dy_Vnce 70;
BA_ "GenSigInvalidValue" SG_ 283 FR_OBJ22_Dy_Vnce "1023";
BA_ "GenSigCycleTime" SG_ 283 FR_OBJ22_Dy 70;
BA_ "GenSigCycleTime" SG_ 283 FR_OBJ22_HeadingAngle 70;
BA_ "GenSigCycleTime" SG_ 283 FR_OBJ22_Length 70;
BA_ "GenSigCycleTime" SG_ 283 FR_OBJ22_Height 70;
BA_ "GenSigCycleTime" SG_ 283 FR_OBJ22_Width 70;
BA_ "GenSigCycleTime" SG_ 283 FR_OBJ22_Class 70;
BA_ "GenSigCycleTime" SG_ 283 FR_OBJ21_HeightGround 70;
BA_ "GenSigCycleTime" SG_ 283 FR_OBJ21_MotionStatusConf 70;
BA_ "GenSigCycleTime" SG_ 283 FR_OBJ21_ClassConf 70;
BA_ "GenSigCycleTime" SG_ 283 FR_OBJ21_MotionStatus 70;
BA_ "GenSigCycleTime" SG_ 283 FR_OBJ21_Location 70;
BA_ "GenSigCycleTime" SG_ 283 FR_OBJ21_Measured 70;
BA_ "GenSigCycleTime" SG_ 283 FR_OBJ21_valid 70;
BA_ "GenSigCycleTime" SG_ 283 FR_OBJ21_Track_Age 70;
BA_ "GenSigCycleTime" SG_ 283 FR_OBJ21_Track_ID 70;
BA_ "GenSigInvalidValue" SG_ 283 FR_OBJ21_Track_ID "0";
BA_ "GenSigCycleTime" SG_ 283 FR_OBJ21_ObstacleProb 70;
BA_ "GenSigCycleTime" SG_ 283 FR_OBJ21_ExistProb 70;
BA_ "GenSigCycleTime" SG_ 283 FR_OBJ21_RelAx 70;
BA_ "GenSigCycleTime" SG_ 283 FR_OBJ21_RelAy 70;
BA_ "GenSigCycleTime" SG_ 283 FR_OBJ21_RelVx_std 70;
BA_ "GenSigInvalidValue" SG_ 283 FR_OBJ21_RelVx_std "4095";
BA_ "GenSigCycleTime" SG_ 283 FR_OBJ21_RelVx 70;
BA_ "GenSigCycleTime" SG_ 283 FR_OBJ21_RelVy_std 70;
BA_ "GenSigInvalidValue" SG_ 283 FR_OBJ21_RelVy_std "1023";
BA_ "GenSigCycleTime" SG_ 283 FR_OBJ21_RelVy 70;
BA_ "GenSigCycleTime" SG_ 283 FR_OBJ21_Dx_Vnce 70;
BA_ "GenSigInvalidValue" SG_ 283 FR_OBJ21_Dx_Vnce "16383";
BA_ "GenSigCycleTime" SG_ 283 FR_OBJ21_Dx 70;
BA_ "GenSigCycleTime" SG_ 283 FR_OBJ21_Dy_Vnce 70;
BA_ "GenSigInvalidValue" SG_ 283 FR_OBJ21_Dy_Vnce "1023";
BA_ "GenSigCycleTime" SG_ 283 FR_OBJ21_Dy 70;
BA_ "GenSigCycleTime" SG_ 283 FR_OBJ21_HeadingAngle 70;
BA_ "GenSigCycleTime" SG_ 283 FR_OBJ21_Length 70;
BA_ "GenSigCycleTime" SG_ 283 FR_OBJ21_Height 70;
BA_ "GenSigCycleTime" SG_ 283 FR_OBJ21_Width 70;
BA_ "GenSigCycleTime" SG_ 283 FR_OBJ21_Class 70;

BA_ "GenSigCycleTime" SG_ 284 FR_OBJ24_Ax 70;
BA_ "GenSigCycleTime" SG_ 284 FR_OBJ24_Ay 70;
BA_ "GenSigCycleTime" SG_ 284 FR_OBJ24_Vx 70;
BA_ "GenSigCycleTime" SG_ 284 FR_OBJ24_Vy 70;
BA_ "GenSigCycleTime" SG_ 284 FR_OBJ23_Ax 70;
BA_ "GenSigCycleTime" SG_ 284 FR_OBJ23_Ay 70;
BA_ "GenSigCycleTime" SG_ 284 FR_OBJ23_Vx 70;
BA_ "GenSigCycleTime" SG_ 284 FR_OBJ23_Vy 70;
BA_ "GenSigCycleTime" SG_ 284 FR_OBJ24_FeaturePoint 70;
BA_ "GenSigCycleTime" SG_ 284 FR_OBJ23_FeaturePoint 70;
BA_ "GenSigCycleTime" SG_ 284 FR_CRCCheck_11C 70;
BA_ "GenSigCycleTime" SG_ 284 FR_RollingCounter_11C 70;
BA_ "GenSigCycleTime" SG_ 284 FR_OBJ24_HeightGround 70;
BA_ "GenSigCycleTime" SG_ 284 FR_OBJ24_MotionStatusConf 70;
BA_ "GenSigCycleTime" SG_ 284 FR_OBJ24_ClassConf 70;
BA_ "GenSigCycleTime" SG_ 284 FR_OBJ24_MotionStatus 70;
BA_ "GenSigCycleTime" SG_ 284 FR_OBJ24_Location 70;
BA_ "GenSigCycleTime" SG_ 284 FR_OBJ24_Measured 70;
BA_ "GenSigCycleTime" SG_ 284 FR_OBJ24_valid 70;
BA_ "GenSigCycleTime" SG_ 284 FR_OBJ24_Track_Age 70;
BA_ "GenSigCycleTime" SG_ 284 FR_OBJ24_Track_ID 70;
BA_ "GenSigInvalidValue" SG_ 284 FR_OBJ24_Track_ID "0";
BA_ "GenSigCycleTime" SG_ 284 FR_OBJ24_ObstacleProb 70;
BA_ "GenSigCycleTime" SG_ 284 FR_OBJ24_ExistProb 70;
BA_ "GenSigCycleTime" SG_ 284 FR_OBJ24_RelAx 70;
BA_ "GenSigCycleTime" SG_ 284 FR_OBJ24_RelAy 70;
BA_ "GenSigCycleTime" SG_ 284 FR_OBJ24_RelVx_std 70;
BA_ "GenSigInvalidValue" SG_ 284 FR_OBJ24_RelVx_std "4095";
BA_ "GenSigCycleTime" SG_ 284 FR_OBJ24_RelVx 70;
BA_ "GenSigCycleTime" SG_ 284 FR_OBJ24_RelVy_std 70;
BA_ "GenSigInvalidValue" SG_ 284 FR_OBJ24_RelVy_std "1023";
BA_ "GenSigCycleTime" SG_ 284 FR_OBJ24_RelVy 70;
BA_ "GenSigCycleTime" SG_ 284 FR_OBJ24_Dx_Vnce 70;
BA_ "GenSigInvalidValue" SG_ 284 FR_OBJ24_Dx_Vnce "16383";
BA_ "GenSigCycleTime" SG_ 284 FR_OBJ24_Dx 70;
BA_ "GenSigCycleTime" SG_ 284 FR_OBJ24_Dy_Vnce 70;
BA_ "GenSigInvalidValue" SG_ 284 FR_OBJ24_Dy_Vnce "1023";
BA_ "GenSigCycleTime" SG_ 284 FR_OBJ24_Dy 70;
BA_ "GenSigCycleTime" SG_ 284 FR_OBJ24_HeadingAngle 70;
BA_ "GenSigCycleTime" SG_ 284 FR_OBJ24_Length 70;
BA_ "GenSigCycleTime" SG_ 284 FR_OBJ24_Height 70;
BA_ "GenSigCycleTime" SG_ 284 FR_OBJ24_Width 70;
BA_ "GenSigCycleTime" SG_ 284 FR_OBJ24_Class 70;
BA_ "GenSigCycleTime" SG_ 284 FR_OBJ23_HeightGround 70;
BA_ "GenSigCycleTime" SG_ 284 FR_OBJ23_MotionStatusConf 70;
BA_ "GenSigCycleTime" SG_ 284 FR_OBJ23_ClassConf 70;
BA_ "GenSigCycleTime" SG_ 284 FR_OBJ23_MotionStatus 70;
BA_ "GenSigCycleTime" SG_ 284 FR_OBJ23_Location 70;
BA_ "GenSigCycleTime" SG_ 284 FR_OBJ23_Measured 70;
BA_ "GenSigCycleTime" SG_ 284 FR_OBJ23_valid 70;
BA_ "GenSigCycleTime" SG_ 284 FR_OBJ23_Track_Age 70;
BA_ "GenSigCycleTime" SG_ 284 FR_OBJ23_Track_ID 70;
BA_ "GenSigInvalidValue" SG_ 284 FR_OBJ23_Track_ID "0";
BA_ "GenSigCycleTime" SG_ 284 FR_OBJ23_ObstacleProb 70;
BA_ "GenSigCycleTime" SG_ 284 FR_OBJ23_ExistProb 70;
BA_ "GenSigCycleTime" SG_ 284 FR_OBJ23_RelAx 70;
BA_ "GenSigCycleTime" SG_ 284 FR_OBJ23_RelAy 70;
BA_ "GenSigCycleTime" SG_ 284 FR_OBJ23_RelVx_std 70;
BA_ "GenSigInvalidValue" SG_ 284 FR_OBJ23_RelVx_std "4095";
BA_ "GenSigCycleTime" SG_ 284 FR_OBJ23_RelVx 70;
BA_ "GenSigCycleTime" SG_ 284 FR_OBJ23_RelVy_std 70;
BA_ "GenSigInvalidValue" SG_ 284 FR_OBJ23_RelVy_std "1023";
BA_ "GenSigCycleTime" SG_ 284 FR_OBJ23_RelVy 70;
BA_ "GenSigCycleTime" SG_ 284 FR_OBJ23_Dx_Vnce 70;
BA_ "GenSigInvalidValue" SG_ 284 FR_OBJ23_Dx_Vnce "16383";
BA_ "GenSigCycleTime" SG_ 284 FR_OBJ23_Dx 70;
BA_ "GenSigCycleTime" SG_ 284 FR_OBJ23_Dy_Vnce 70;
BA_ "GenSigInvalidValue" SG_ 284 FR_OBJ23_Dy_Vnce "1023";
BA_ "GenSigCycleTime" SG_ 284 FR_OBJ23_Dy 70;
BA_ "GenSigCycleTime" SG_ 284 FR_OBJ23_HeadingAngle 70;
BA_ "GenSigCycleTime" SG_ 284 FR_OBJ23_Length 70;
BA_ "GenSigCycleTime" SG_ 284 FR_OBJ23_Height 70;
BA_ "GenSigCycleTime" SG_ 284 FR_OBJ23_Width 70;
BA_ "GenSigCycleTime" SG_ 284 FR_OBJ23_Class 70;

BA_ "GenSigCycleTime" SG_ 285 FR_OBJ26_Ax 70;
BA_ "GenSigCycleTime" SG_ 285 FR_OBJ26_Ay 70;
BA_ "GenSigCycleTime" SG_ 285 FR_OBJ26_Vx 70;
BA_ "GenSigCycleTime" SG_ 285 FR_OBJ26_Vy 70;
BA_ "GenSigCycleTime" SG_ 285 FR_OBJ25_Ax 70;
BA_ "GenSigCycleTime" SG_ 285 FR_OBJ25_Ay 70;
BA_ "GenSigCycleTime" SG_ 285 FR_OBJ25_Vx 70;
BA_ "GenSigCycleTime" SG_ 285 FR_OBJ25_Vy 70;
BA_ "GenSigCycleTime" SG_ 285 FR_OBJ26_FeaturePoint 70;
BA_ "GenSigCycleTime" SG_ 285 FR_OBJ25_FeaturePoint 70;
BA_ "GenSigCycleTime" SG_ 285 FR_CRCCheck_11D 70;
BA_ "GenSigCycleTime" SG_ 285 FR_RollingCounter_11D 70;
BA_ "GenSigCycleTime" SG_ 285 FR_OBJ26_HeightGround 70;
BA_ "GenSigCycleTime" SG_ 285 FR_OBJ26_MotionStatusConf 70;
BA_ "GenSigCycleTime" SG_ 285 FR_OBJ26_ClassConf 70;
BA_ "GenSigCycleTime" SG_ 285 FR_OBJ26_MotionStatus 70;
BA_ "GenSigCycleTime" SG_ 285 FR_OBJ26_Location 70;
BA_ "GenSigCycleTime" SG_ 285 FR_OBJ26_Measured 70;
BA_ "GenSigCycleTime" SG_ 285 FR_OBJ26_valid 70;
BA_ "GenSigCycleTime" SG_ 285 FR_OBJ26_Track_Age 70;
BA_ "GenSigCycleTime" SG_ 285 FR_OBJ26_Track_ID 70;
BA_ "GenSigInvalidValue" SG_ 285 FR_OBJ26_Track_ID "0";
BA_ "GenSigCycleTime" SG_ 285 FR_OBJ26_ObstacleProb 70;
BA_ "GenSigCycleTime" SG_ 285 FR_OBJ26_ExistProb 70;
BA_ "GenSigCycleTime" SG_ 285 FR_OBJ26_RelAx 70;
BA_ "GenSigCycleTime" SG_ 285 FR_OBJ26_RelAy 70;
BA_ "GenSigCycleTime" SG_ 285 FR_OBJ26_RelVx_std 70;
BA_ "GenSigInvalidValue" SG_ 285 FR_OBJ26_RelVx_std "4095";
BA_ "GenSigCycleTime" SG_ 285 FR_OBJ26_RelVx 70;
BA_ "GenSigCycleTime" SG_ 285 FR_OBJ26_RelVy_std 70;
BA_ "GenSigInvalidValue" SG_ 285 FR_OBJ26_RelVy_std "1023";
BA_ "GenSigCycleTime" SG_ 285 FR_OBJ26_RelVy 70;
BA_ "GenSigCycleTime" SG_ 285 FR_OBJ26_Dx_Vnce 70;
BA_ "GenSigInvalidValue" SG_ 285 FR_OBJ26_Dx_Vnce "16383";
BA_ "GenSigCycleTime" SG_ 285 FR_OBJ26_Dx 70;
BA_ "GenSigCycleTime" SG_ 285 FR_OBJ26_Dy_Vnce 70;
BA_ "GenSigInvalidValue" SG_ 285 FR_OBJ26_Dy_Vnce "1023";
BA_ "GenSigCycleTime" SG_ 285 FR_OBJ26_Dy 70;
BA_ "GenSigCycleTime" SG_ 285 FR_OBJ26_HeadingAngle 70;
BA_ "GenSigCycleTime" SG_ 285 FR_OBJ26_Length 70;
BA_ "GenSigCycleTime" SG_ 285 FR_OBJ26_Height 70;
BA_ "GenSigCycleTime" SG_ 285 FR_OBJ26_Width 70;
BA_ "GenSigCycleTime" SG_ 285 FR_OBJ26_Class 70;
BA_ "GenSigCycleTime" SG_ 285 FR_OBJ25_HeightGround 70;
BA_ "GenSigCycleTime" SG_ 285 FR_OBJ25_MotionStatusConf 70;
BA_ "GenSigCycleTime" SG_ 285 FR_OBJ25_ClassConf 70;
BA_ "GenSigCycleTime" SG_ 285 FR_OBJ25_MotionStatus 70;
BA_ "GenSigCycleTime" SG_ 285 FR_OBJ25_Location 70;
BA_ "GenSigCycleTime" SG_ 285 FR_OBJ25_Measured 70;
BA_ "GenSigCycleTime" SG_ 285 FR_OBJ25_valid 70;
BA_ "GenSigCycleTime" SG_ 285 FR_OBJ25_Track_Age 70;
BA_ "GenSigCycleTime" SG_ 285 FR_OBJ25_Track_ID 70;
BA_ "GenSigInvalidValue" SG_ 285 FR_OBJ25_Track_ID "0";
BA_ "GenSigCycleTime" SG_ 285 FR_OBJ25_ObstacleProb 70;
BA_ "GenSigCycleTime" SG_ 285 FR_OBJ25_ExistProb 70;
BA_ "GenSigCycleTime" SG_ 285 FR_OBJ25_RelAx 70;
BA_ "GenSigCycleTime" SG_ 285 FR_OBJ25_RelAy 70;
BA_ "GenSigCycleTime" SG_ 285 FR_OBJ25_RelVx_std 70;
BA_ "GenSigInvalidValue" SG_ 285 FR_OBJ25_RelVx_std "4095";
BA_ "GenSigCycleTime" SG_ 285 FR_OBJ25_RelVx 70;
BA_ "GenSigCycleTime" SG_ 285 FR_OBJ25_RelVy_std 70;
BA_ "GenSigInvalidValue" SG_ 285 FR_OBJ25_RelVy_std "1023";
BA_ "GenSigCycleTime" SG_ 285 FR_OBJ25_RelVy 70;
BA_ "GenSigCycleTime" SG_ 285 FR_OBJ25_Dx_Vnce 70;
BA_ "GenSigInvalidValue" SG_ 285 FR_OBJ25_Dx_Vnce "16383";
BA_ "GenSigCycleTime" SG_ 285 FR_OBJ25_Dx 70;
BA_ "GenSigCycleTime" SG_ 285 FR_OBJ25_Dy_Vnce 70;
BA_ "GenSigInvalidValue" SG_ 285 FR_OBJ25_Dy_Vnce "1023";
BA_ "GenSigCycleTime" SG_ 285 FR_OBJ25_Dy 70;
BA_ "GenSigCycleTime" SG_ 285 FR_OBJ25_HeadingAngle 70;
BA_ "GenSigCycleTime" SG_ 285 FR_OBJ25_Length 70;
BA_ "GenSigCycleTime" SG_ 285 FR_OBJ25_Height 70;
BA_ "GenSigCycleTime" SG_ 285 FR_OBJ25_Width 70;
BA_ "GenSigCycleTime" SG_ 285 FR_OBJ25_Class 70;

BA_ "GenSigCycleTime" SG_ 286 FR_OBJ28_Ax 70;
BA_ "GenSigCycleTime" SG_ 286 FR_OBJ28_Ay 70;
BA_ "GenSigCycleTime" SG_ 286 FR_OBJ28_Vx 70;
BA_ "GenSigCycleTime" SG_ 286 FR_OBJ28_Vy 70;
BA_ "GenSigCycleTime" SG_ 286 FR_OBJ27_Ax 70;
BA_ "GenSigCycleTime" SG_ 286 FR_OBJ27_Ay 70;
BA_ "GenSigCycleTime" SG_ 286 FR_OBJ27_Vx 70;
BA_ "GenSigCycleTime" SG_ 286 FR_OBJ27_Vy 70;
BA_ "GenSigCycleTime" SG_ 286 FR_OBJ28_FeaturePoint 70;
BA_ "GenSigCycleTime" SG_ 286 FR_OBJ27_FeaturePoint 70;
BA_ "GenSigCycleTime" SG_ 286 ER_CRCCheck_11E 70;
BA_ "GenSigCycleTime" SG_ 286 ER_RollingCounter_11E 70;
BA_ "GenSigCycleTime" SG_ 286 FR_OBJ28_HeightGround 70;
BA_ "GenSigCycleTime" SG_ 286 FR_OBJ28_MotionStatusConf 70;
BA_ "GenSigCycleTime" SG_ 286 FR_OBJ28_ClassConf 70;
BA_ "GenSigCycleTime" SG_ 286 FR_OBJ28_MotionStatus 70;
BA_ "GenSigCycleTime" SG_ 286 FR_OBJ28_Location 70;
BA_ "GenSigCycleTime" SG_ 286 FR_OBJ28_Measured 70;
BA_ "GenSigCycleTime" SG_ 286 FR_OBJ28_valid 70;
BA_ "GenSigCycleTime" SG_ 286 FR_OBJ28_Track_Age 70;
BA_ "GenSigCycleTime" SG_ 286 FR_OBJ28_Track_ID 70;
BA_ "GenSigInvalidValue" SG_ 286 FR_OBJ28_Track_ID "0";
BA_ "GenSigCycleTime" SG_ 286 FR_OBJ28_ObstacleProb 70;
BA_ "GenSigCycleTime" SG_ 286 FR_OBJ28_ExistProb 70;
BA_ "GenSigCycleTime" SG_ 286 FR_OBJ28_RelAx 70;
BA_ "GenSigCycleTime" SG_ 286 FR_OBJ28_RelAy 70;
BA_ "GenSigCycleTime" SG_ 286 FR_OBJ28_RelVx_std 70;
BA_ "GenSigInvalidValue" SG_ 286 FR_OBJ28_RelVx_std "4095";
BA_ "GenSigCycleTime" SG_ 286 FR_OBJ28_RelVx 70;
BA_ "GenSigCycleTime" SG_ 286 FR_OBJ28_RelVy_std 70;
BA_ "GenSigInvalidValue" SG_ 286 FR_OBJ28_RelVy_std "1023";
BA_ "GenSigCycleTime" SG_ 286 FR_OBJ28_RelVy 70;
BA_ "GenSigCycleTime" SG_ 286 FR_OBJ28_Dx_Vnce 70;
BA_ "GenSigInvalidValue" SG_ 286 FR_OBJ28_Dx_Vnce "16383";
BA_ "GenSigCycleTime" SG_ 286 FR_OBJ28_Dx 70;
BA_ "GenSigCycleTime" SG_ 286 FR_OBJ28_Dy_Vnce 70;
BA_ "GenSigInvalidValue" SG_ 286 FR_OBJ28_Dy_Vnce "1023";
BA_ "GenSigCycleTime" SG_ 286 FR_OBJ28_Dy 70;
BA_ "GenSigCycleTime" SG_ 286 FR_OBJ28_HeadingAngle 70;
BA_ "GenSigCycleTime" SG_ 286 FR_OBJ28_Length 70;
BA_ "GenSigCycleTime" SG_ 286 FR_OBJ28_Height 70;
BA_ "GenSigCycleTime" SG_ 286 FR_OBJ28_Width 70;
BA_ "GenSigCycleTime" SG_ 286 FR_OBJ28_Class 70;
BA_ "GenSigCycleTime" SG_ 286 FR_OBJ27_HeightGround 70;
BA_ "GenSigCycleTime" SG_ 286 FR_OBJ27_MotionStatusConf 70;
BA_ "GenSigCycleTime" SG_ 286 FR_OBJ27_ClassConf 70;
BA_ "GenSigCycleTime" SG_ 286 FR_OBJ27_MotionStatus 70;
BA_ "GenSigCycleTime" SG_ 286 FR_OBJ27_Location 70;
BA_ "GenSigCycleTime" SG_ 286 FR_OBJ27_Measured 70;
BA_ "GenSigCycleTime" SG_ 286 FR_OBJ27_valid 70;
BA_ "GenSigCycleTime" SG_ 286 FR_OBJ27_Track_Age 70;
BA_ "GenSigCycleTime" SG_ 286 FR_OBJ27_Track_ID 70;
BA_ "GenSigInvalidValue" SG_ 286 FR_OBJ27_Track_ID "0";
BA_ "GenSigCycleTime" SG_ 286 FR_OBJ27_ObstacleProb 70;
BA_ "GenSigCycleTime" SG_ 286 FR_OBJ27_ExistProb 70;
BA_ "GenSigCycleTime" SG_ 286 FR_OBJ27_RelAx 70;
BA_ "GenSigCycleTime" SG_ 286 FR_OBJ27_RelAy 70;
BA_ "GenSigCycleTime" SG_ 286 FR_OBJ27_RelVx_std 70;
BA_ "GenSigInvalidValue" SG_ 286 FR_OBJ27_RelVx_std "4095";
BA_ "GenSigCycleTime" SG_ 286 FR_OBJ27_RelVx 70;
BA_ "GenSigCycleTime" SG_ 286 FR_OBJ27_RelVy_std 70;
BA_ "GenSigInvalidValue" SG_ 286 FR_OBJ27_RelVy_std "1023";
BA_ "GenSigCycleTime" SG_ 286 FR_OBJ27_RelVy 70;
BA_ "GenSigCycleTime" SG_ 286 FR_OBJ27_Dx_Vnce 70;
BA_ "GenSigInvalidValue" SG_ 286 FR_OBJ27_Dx_Vnce "16383";
BA_ "GenSigCycleTime" SG_ 286 FR_OBJ27_Dx 70;
BA_ "GenSigCycleTime" SG_ 286 FR_OBJ27_Dy_Vnce 70;
BA_ "GenSigInvalidValue" SG_ 286 FR_OBJ27_Dy_Vnce "1023";
BA_ "GenSigCycleTime" SG_ 286 FR_OBJ27_Dy 70;
BA_ "GenSigCycleTime" SG_ 286 FR_OBJ27_HeadingAngle 70;
BA_ "GenSigCycleTime" SG_ 286 FR_OBJ27_Length 70;
BA_ "GenSigCycleTime" SG_ 286 FR_OBJ27_Height 70;
BA_ "GenSigCycleTime" SG_ 286 FR_OBJ27_Width 70;
BA_ "GenSigCycleTime" SG_ 286 FR_OBJ27_Class 70;

BA_ "GenSigCycleTime" SG_ 287 FR_OBJ30_Ax 70;
BA_ "GenSigCycleTime" SG_ 287 FR_OBJ30_Ay 70;
BA_ "GenSigCycleTime" SG_ 287 FR_OBJ30_Vx 70;
BA_ "GenSigCycleTime" SG_ 287 FR_OBJ30_Vy 70;
BA_ "GenSigCycleTime" SG_ 287 FR_OBJ29_Ax 70;
BA_ "GenSigCycleTime" SG_ 287 FR_OBJ29_Ay 70;
BA_ "GenSigCycleTime" SG_ 287 FR_OBJ29_Vx 70;
BA_ "GenSigCycleTime" SG_ 287 FR_OBJ29_Vy 70;
BA_ "GenSigCycleTime" SG_ 287 FR_OBJ30_FeaturePoint 70;
BA_ "GenSigCycleTime" SG_ 287 FR_OBJ29_FeaturePoint 70;
BA_ "GenSigCycleTime" SG_ 287 FR_CRCCheck_11F 70;
BA_ "GenSigCycleTime" SG_ 287 FR_RollingCounter_11F 70;
BA_ "GenSigCycleTime" SG_ 287 FR_OBJ30_HeightGround 70;
BA_ "GenSigCycleTime" SG_ 287 FR_OBJ30_MotionStatusConf 70;
BA_ "GenSigCycleTime" SG_ 287 FR_OBJ30_ClassConf 70;
BA_ "GenSigCycleTime" SG_ 287 FR_OBJ30_MotionStatus 70;
BA_ "GenSigCycleTime" SG_ 287 FR_OBJ30_Location 70;
BA_ "GenSigCycleTime" SG_ 287 FR_OBJ30_Measured 70;
BA_ "GenSigCycleTime" SG_ 287 FR_OBJ30_valid 70;
BA_ "GenSigCycleTime" SG_ 287 FR_OBJ30_Track_Age 70;
BA_ "GenSigCycleTime" SG_ 287 FR_OBJ30_Track_ID 70;
BA_ "GenSigInvalidValue" SG_ 287 FR_OBJ30_Track_ID "0";
BA_ "GenSigCycleTime" SG_ 287 FR_OBJ30_ObstacleProb 70;
BA_ "GenSigCycleTime" SG_ 287 FR_OBJ30_ExistProb 70;
BA_ "GenSigCycleTime" SG_ 287 FR_OBJ30_RelAx 70;
BA_ "GenSigCycleTime" SG_ 287 FR_OBJ30_RelAy 70;
BA_ "GenSigCycleTime" SG_ 287 FR_OBJ30_RelVx_std 70;
BA_ "GenSigInvalidValue" SG_ 287 FR_OBJ30_RelVx_std "4095";
BA_ "GenSigCycleTime" SG_ 287 FR_OBJ30_RelVx 70;
BA_ "GenSigCycleTime" SG_ 287 FR_OBJ30_RelVy_std 70;
BA_ "GenSigInvalidValue" SG_ 287 FR_OBJ30_RelVy_std "1023";
BA_ "GenSigCycleTime" SG_ 287 FR_OBJ30_RelVy 70;
BA_ "GenSigCycleTime" SG_ 287 FR_OBJ30_Dx_Vnce 70;
BA_ "GenSigInvalidValue" SG_ 287 FR_OBJ30_Dx_Vnce "16383";
BA_ "GenSigCycleTime" SG_ 287 FR_OBJ30_Dx 70;
BA_ "GenSigCycleTime" SG_ 287 FR_OBJ30_Dy_Vnce 70;
BA_ "GenSigInvalidValue" SG_ 287 FR_OBJ30_Dy_Vnce "1023";
BA_ "GenSigCycleTime" SG_ 287 FR_OBJ30_Dy 70;
BA_ "GenSigCycleTime" SG_ 287 FR_OBJ30_HeadingAngle 70;
BA_ "GenSigCycleTime" SG_ 287 FR_OBJ30_Length 70;
BA_ "GenSigCycleTime" SG_ 287 FR_OBJ30_Height 70;
BA_ "GenSigCycleTime" SG_ 287 FR_OBJ30_Width 70;
BA_ "GenSigCycleTime" SG_ 287 FR_OBJ30_Class 70;
BA_ "GenSigCycleTime" SG_ 287 FR_OBJ29_HeightGround 70;
BA_ "GenSigCycleTime" SG_ 287 FR_OBJ29_MotionStatusConf 70;
BA_ "GenSigCycleTime" SG_ 287 FR_OBJ29_ClassConf 70;
BA_ "GenSigCycleTime" SG_ 287 FR_OBJ29_MotionStatus 70;
BA_ "GenSigCycleTime" SG_ 287 FR_OBJ29_Location 70;
BA_ "GenSigCycleTime" SG_ 287 FR_OBJ29_Measured 70;
BA_ "GenSigCycleTime" SG_ 287 FR_OBJ29_valid 70;
BA_ "GenSigCycleTime" SG_ 287 FR_OBJ29_Track_Age 70;
BA_ "GenSigCycleTime" SG_ 287 FR_OBJ29_Track_ID 70;
BA_ "GenSigInvalidValue" SG_ 287 FR_OBJ29_Track_ID "0";
BA_ "GenSigCycleTime" SG_ 287 FR_OBJ29_ObstacleProb 70;
BA_ "GenSigCycleTime" SG_ 287 FR_OBJ29_ExistProb 70;
BA_ "GenSigCycleTime" SG_ 287 FR_OBJ29_RelAx 70;
BA_ "GenSigCycleTime" SG_ 287 FR_OBJ29_RelAy 70;
BA_ "GenSigCycleTime" SG_ 287 FR_OBJ29_RelVx_std 70;
BA_ "GenSigInvalidValue" SG_ 287 FR_OBJ29_RelVx_std "4095";
BA_ "GenSigCycleTime" SG_ 287 FR_OBJ29_RelVx 70;
BA_ "GenSigCycleTime" SG_ 287 FR_OBJ29_RelVy_std 70;
BA_ "GenSigInvalidValue" SG_ 287 FR_OBJ29_RelVy_std "1023";
BA_ "GenSigCycleTime" SG_ 287 FR_OBJ29_RelVy 70;
BA_ "GenSigCycleTime" SG_ 287 FR_OBJ29_Dx_Vnce 70;
BA_ "GenSigInvalidValue" SG_ 287 FR_OBJ29_Dx_Vnce "16383";
BA_ "GenSigCycleTime" SG_ 287 FR_OBJ29_Dx 70;
BA_ "GenSigCycleTime" SG_ 287 FR_OBJ29_Dy_Vnce 70;
BA_ "GenSigInvalidValue" SG_ 287 FR_OBJ29_Dy_Vnce "1023";
BA_ "GenSigCycleTime" SG_ 287 FR_OBJ29_Dy 70;
BA_ "GenSigCycleTime" SG_ 287 FR_OBJ29_HeadingAngle 70;
BA_ "GenSigCycleTime" SG_ 287 FR_OBJ29_Length 70;
BA_ "GenSigCycleTime" SG_ 287 FR_OBJ29_Height 70;
BA_ "GenSigCycleTime" SG_ 287 FR_OBJ29_Width 70;
BA_ "GenSigCycleTime" SG_ 287 FR_OBJ29_Class 70;

BA_ "GenSigCycleTime" SG_ 288 FR_OBJ32_Ax 70;
BA_ "GenSigCycleTime" SG_ 288 FR_OBJ32_Ay 70;
BA_ "GenSigCycleTime" SG_ 288 FR_OBJ32_Vx 70;
BA_ "GenSigCycleTime" SG_ 288 FR_OBJ32_Vy 70;
BA_ "GenSigCycleTime" SG_ 288 FR_OBJ31_Ax 70;
BA_ "GenSigCycleTime" SG_ 288 FR_OBJ31_Ay 70;
BA_ "GenSigCycleTime" SG_ 288 FR_OBJ31_Vx 70;
BA_ "GenSigCycleTime" SG_ 288 FR_OBJ31_Vy 70;
BA_ "GenSigCycleTime" SG_ 288 FR_OBJ32_FeaturePoint 70;
BA_ "GenSigCycleTime" SG_ 288 FR_OBJ31_FeaturePoint 70;
BA_ "GenSigCycleTime" SG_ 288 FR_CRCCheck_120 70;
BA_ "GenSigCycleTime" SG_ 288 FR_RollingCounter_120 70;
BA_ "GenSigCycleTime" SG_ 288 FR_OBJ32_HeightGround 70;
BA_ "GenSigCycleTime" SG_ 288 FR_OBJ32_MotionStatusConf 70;
BA_ "GenSigCycleTime" SG_ 288 FR_OBJ32_ClassConf 70;
BA_ "GenSigCycleTime" SG_ 288 FR_OBJ32_MotionStatus 70;
BA_ "GenSigCycleTime" SG_ 288 FR_OBJ32_Location 70;
BA_ "GenSigCycleTime" SG_ 288 FR_OBJ32_Measured 70;
BA_ "GenSigCycleTime" SG_ 288 FR_OBJ32_valid 70;
BA_ "GenSigCycleTime" SG_ 288 FR_OBJ32_Track_Age 70;
BA_ "GenSigCycleTime" SG_ 288 FR_OBJ32_Track_ID 70;
BA_ "GenSigInvalidValue" SG_ 288 FR_OBJ32_Track_ID "0";
BA_ "GenSigCycleTime" SG_ 288 FR_OBJ32_ObstacleProb 70;
BA_ "GenSigCycleTime" SG_ 288 FR_OBJ32_ExistProb 70;
BA_ "GenSigCycleTime" SG_ 288 FR_OBJ32_RelAx 70;
BA_ "GenSigCycleTime" SG_ 288 FR_OBJ32_RelAy 70;
BA_ "GenSigCycleTime" SG_ 288 FR_OBJ32_RelVx_std 70;
BA_ "GenSigInvalidValue" SG_ 288 FR_OBJ32_RelVx_std "4095";
BA_ "GenSigCycleTime" SG_ 288 FR_OBJ32_RelVx 70;
BA_ "GenSigCycleTime" SG_ 288 FR_OBJ32_RelVy_std 70;
BA_ "GenSigInvalidValue" SG_ 288 FR_OBJ32_RelVy_std "1023";
BA_ "GenSigCycleTime" SG_ 288 FR_OBJ32_RelVy 70;
BA_ "GenSigCycleTime" SG_ 288 FR_OBJ32_Dx_Vnce 70;
BA_ "GenSigInvalidValue" SG_ 288 FR_OBJ32_Dx_Vnce "16383";
BA_ "GenSigCycleTime" SG_ 288 FR_OBJ32_Dx 70;
BA_ "GenSigCycleTime" SG_ 288 FR_OBJ32_Dy_Vnce 70;
BA_ "GenSigInvalidValue" SG_ 288 FR_OBJ32_Dy_Vnce "1023";
BA_ "GenSigCycleTime" SG_ 288 FR_OBJ32_Dy 70;
BA_ "GenSigCycleTime" SG_ 288 FR_OBJ32_HeadingAngle 70;
BA_ "GenSigCycleTime" SG_ 288 FR_OBJ32_Length 70;
BA_ "GenSigCycleTime" SG_ 288 FR_OBJ32_Height 70;
BA_ "GenSigCycleTime" SG_ 288 FR_OBJ32_Width 70;
BA_ "GenSigCycleTime" SG_ 288 FR_OBJ32_Class 70;
BA_ "GenSigCycleTime" SG_ 288 FR_OBJ31_HeightGround 70;
BA_ "GenSigCycleTime" SG_ 288 FR_OBJ31_MotionStatusConf 70;
BA_ "GenSigCycleTime" SG_ 288 FR_OBJ31_ClassConf 70;
BA_ "GenSigCycleTime" SG_ 288 FR_OBJ31_MotionStatus 70;
BA_ "GenSigCycleTime" SG_ 288 FR_OBJ31_Location 70;
BA_ "GenSigCycleTime" SG_ 288 FR_OBJ31_Measured 70;
BA_ "GenSigCycleTime" SG_ 288 FR_Obj31_valid 70;
BA_ "GenSigCycleTime" SG_ 288 FR_OBJ31_Track_Age 70;
BA_ "GenSigCycleTime" SG_ 288 FR_OBJ31_Track_ID 70;
BA_ "GenSigInvalidValue" SG_ 288 FR_OBJ31_Track_ID "0";
BA_ "GenSigCycleTime" SG_ 288 FR_OBJ31_ObstacleProb 70;
BA_ "GenSigCycleTime" SG_ 288 FR_OBJ31_ExistProb 70;
BA_ "GenSigCycleTime" SG_ 288 FR_OBJ31_RelAx 70;
BA_ "GenSigCycleTime" SG_ 288 FR_OBJ31_RelAy 70;
BA_ "GenSigCycleTime" SG_ 288 FR_OBJ31_RelVx_std 70;
BA_ "GenSigInvalidValue" SG_ 288 FR_OBJ31_RelVx_std "4095";
BA_ "GenSigCycleTime" SG_ 288 FR_OBJ31_RelVx 70;
BA_ "GenSigCycleTime" SG_ 288 FR_OBJ31_RelVy_std 70;
BA_ "GenSigInvalidValue" SG_ 288 FR_OBJ31_RelVy_std "1023";
BA_ "GenSigCycleTime" SG_ 288 FR_OBJ31_RelVy 70;
BA_ "GenSigCycleTime" SG_ 288 FR_OBJ31_Dx_Vnce 70;
BA_ "GenSigInvalidValue" SG_ 288 FR_OBJ31_Dx_Vnce "16383";
BA_ "GenSigCycleTime" SG_ 288 FR_OBJ31_Dx 70;
BA_ "GenSigCycleTime" SG_ 288 FR_OBJ31_Dy_Vnce 70;
BA_ "GenSigInvalidValue" SG_ 288 FR_OBJ31_Dy_Vnce "1023";
BA_ "GenSigCycleTime" SG_ 288 FR_OBJ31_Dy 70;
BA_ "GenSigCycleTime" SG_ 288 FR_OBJ31_HeadingAngle 70;
BA_ "GenSigCycleTime" SG_ 288 FR_OBJ31_Length 70;
BA_ "GenSigCycleTime" SG_ 288 FR_OBJ31_Height 70;
BA_ "GenSigCycleTime" SG_ 288 FR_OBJ31_Width 70;
BA_ "GenSigCycleTime" SG_ 288 FR_OBJ31_Class 70;

BA_ "GenSigCycleTime" SG_ 310 FR_KidRushoutFlag 50;
BA_ "GenSigCycleTime" SG_ 310 FR_CRCCheck_136 50;
BA_ "GenSigCycleTime" SG_ 310 FR_RollingCounter_136 50;
BA_ "GenSigCycleTime" SG_ 310 FR_FrameCount 50;
BA_ "GenSigCycleTime" SG_ 310 FR_MisAlignment 50;
BA_ "GenSigCycleTime" SG_ 310 FR_WorkMode 50;
BA_ "GenSigCycleTime" SG_ 310 FR_RadarFailureStatus 50;
BA_ "GenSigInvalidValue" SG_ 310 FR_RadarFailureStatus "7";
BA_ "GenSigCycleTime" SG_ 310 FR_FRadarCalibrationStatus 50;
BA_ "GenSigInvalidValue" SG_ 310 FR_FRadarCalibrationStatus "3";
BA_ "GenSigCycleTime" SG_ 310 FR_Frametime 50;
BA_ "GenSigCycleTime" SG_ 310 FR_ObjCount 50;

BA_ "GenSigCycleTime" SG_ 312 ADC_CRCCheck_138 70;
BA_ "GenSigCycleTime" SG_ 312 ADC_RollingCounter_138 70;
BA_ "GenSigCycleTime" SG_ 312 DiffTime_Time_uS 70;
BA_ "GenSigCycleTime" SG_ 312 FR_TiOut 70;
BA_ "GenSigCycleTime" SG_ 312 FR_TiLeap 70;
BA_ "GenSigCycleTime" SG_ 312 FR_TiBas 70;
BA_ "GenSigCycleTime" SG_ 312 FR_TiStamp 70;

BA_ "GenSigCycleTime" SG_ 320 FR_DTC2_Status 500;
BA_ "GenSigCycleTime" SG_ 320 FR_DTC2_LowByte 500;
BA_ "GenSigCycleTime" SG_ 320 FR_DTC2_MiddByte 500;
BA_ "GenSigCycleTime" SG_ 320 FR_DTC2_HighByte 500;
BA_ "GenSigCycleTime" SG_ 320 FR_DTC1_Status 500;
BA_ "GenSigCycleTime" SG_ 320 FR_DTC1_LowByte 500;
BA_ "GenSigCycleTime" SG_ 320 FR_DTC1_MiddByte 500;
BA_ "GenSigCycleTime" SG_ 320 FR_DTC1_HighByte 500;

BA_ "GenSigCycleTime" SG_ 336 FC_CRCCheck_150 30;
BA_ "GenSigCycleTime" SG_ 336 FC_RollingCounter_150 30;
BA_ "GenSigCycleTime" SG_ 336 FC_Line_2_exist_prob 30;
BA_ "GenSigCycleTime" SG_ 336 FC_Line_2_RMSE 30;
BA_ "GenSigCycleTime" SG_ 336 FC_Line_2_ParseConf 30;
BA_ "GenSigCycleTime" SG_ 336 FC_Line_2_MeasureType 30;
BA_ "GenSigCycleTime" SG_ 336 FC_Line_2_ModelC3 30;
BA_ "GenSigStartValue" SG_ 336 FC_Line_2_ModelC3 2048.000000;
BA_ "GenSigCycleTime" SG_ 336 FC_Line_2_ModelC2 30;
BA_ "GenSigStartValue" SG_ 336 FC_Line_2_ModelC2 12288.000000;
BA_ "GenSigCycleTime" SG_ 336 FC_Line_2_ModelC1 30;
BA_ "GenSigStartValue" SG_ 336 FC_Line_2_ModelC1 3277.000000;
BA_ "GenSigCycleTime" SG_ 336 FC_Line_2_ModelC0 30;
BA_ "GenSigCycleTime" SG_ 336 FC_Line_2_dx_End 30;
BA_ "GenSigCycleTime" SG_ 336 FC_Line_2_dx_Start 30;
BA_ "GenSigCycleTime" SG_ 336 FC_Line_2_Width 30;
BA_ "GenSigCycleTime" SG_ 336 FC_Line_2_color 30;
BA_ "GenSigCycleTime" SG_ 336 FC_Line_2_Id 30;
BA_ "GenSigStartValue" SG_ 336 FC_Line_2_Id 1.000000;
BA_ "GenSigCycleTime" SG_ 336 FC_Line_2_TypeConfidence 30;
BA_ "GenSigCycleTime" SG_ 336 FC_Line_2_Type 30;
BA_ "GenSigCycleTime" SG_ 336 FC_Line_1_exist_prob 30;
BA_ "GenSigCycleTime" SG_ 336 FC_Line_1_RMSE 30;
BA_ "GenSigCycleTime" SG_ 336 FC_Line_1_ParseConf 30;
BA_ "GenSigCycleTime" SG_ 336 FC_Line_1_MeasureType 30;
BA_ "GenSigCycleTime" SG_ 336 FC_Line_1_ModelC3 30;
BA_ "GenSigStartValue" SG_ 336 FC_Line_1_ModelC3 2048.000000;
BA_ "GenSigCycleTime" SG_ 336 FC_Line_1_ModelC2 30;
BA_ "GenSigStartValue" SG_ 336 FC_Line_1_ModelC2 12288.000000;
BA_ "GenSigCycleTime" SG_ 336 FC_Line_1_ModelC1 30;
BA_ "GenSigStartValue" SG_ 336 FC_Line_1_ModelC1 3277.000000;
BA_ "GenSigCycleTime" SG_ 336 FC_Line_1_ModelC0 30;
BA_ "GenSigCycleTime" SG_ 336 FC_Line_1_dx_End 30;
BA_ "GenSigCycleTime" SG_ 336 FC_Line_1_dx_Start 30;
BA_ "GenSigCycleTime" SG_ 336 FC_Line_1_Width 30;
BA_ "GenSigCycleTime" SG_ 336 FC_Line_1_color 30;
BA_ "GenSigCycleTime" SG_ 336 FC_Line_1_Id 30;
BA_ "GenSigStartValue" SG_ 336 FC_Line_1_Id 1.000000;
BA_ "GenSigCycleTime" SG_ 336 FC_Line_1_TypeConfidence 30;
BA_ "GenSigCycleTime" SG_ 336 FC_Line_1_Type 30;

BA_ "GenSigCycleTime" SG_ 337 FC_CRCCheck_151 30;
BA_ "GenSigCycleTime" SG_ 337 FC_RollingCounter_151 30;
BA_ "GenSigCycleTime" SG_ 337 FC_Line_4_exist_prob 30;
BA_ "GenSigCycleTime" SG_ 337 FC_Line_4_RMSE 30;
BA_ "GenSigCycleTime" SG_ 337 FC_Line_4_ParseConf 30;
BA_ "GenSigCycleTime" SG_ 337 FC_Line_4_MeasureType 30;
BA_ "GenSigCycleTime" SG_ 337 FC_Line_4_ModelC3 30;
BA_ "GenSigStartValue" SG_ 337 FC_Line_4_ModelC3 2048.000000;
BA_ "GenSigCycleTime" SG_ 337 FC_Line_4_ModelC2 30;
BA_ "GenSigStartValue" SG_ 337 FC_Line_4_ModelC2 12288.000000;
BA_ "GenSigCycleTime" SG_ 337 FC_Line_4_ModelC1 30;
BA_ "GenSigStartValue" SG_ 337 FC_Line_4_ModelC1 3277.000000;
BA_ "GenSigCycleTime" SG_ 337 FC_Line_4_ModelC0 30;
BA_ "GenSigCycleTime" SG_ 337 FC_Line_4_dx_End 30;
BA_ "GenSigCycleTime" SG_ 337 FC_Line_4_dx_Start 30;
BA_ "GenSigCycleTime" SG_ 337 FC_Line_4_Width 30;
BA_ "GenSigCycleTime" SG_ 337 FC_Line_4_color 30;
BA_ "GenSigCycleTime" SG_ 337 FC_Line_4_Id 30;
BA_ "GenSigStartValue" SG_ 337 FC_Line_4_Id 1.000000;
BA_ "GenSigCycleTime" SG_ 337 FC_Line_4_TypeConfidence 30;
BA_ "GenSigCycleTime" SG_ 337 FC_Line_4_Type 30;
BA_ "GenSigCycleTime" SG_ 337 FC_Line_3_exist_prob 30;
BA_ "GenSigCycleTime" SG_ 337 FC_Line_3_RMSE 30;
BA_ "GenSigCycleTime" SG_ 337 FC_Line_3_ParseConf 30;
BA_ "GenSigCycleTime" SG_ 337 FC_Line_3_MeasureType 30;
BA_ "GenSigCycleTime" SG_ 337 FC_Line_3_ModelC3 30;
BA_ "GenSigStartValue" SG_ 337 FC_Line_3_ModelC3 2048.000000;
BA_ "GenSigCycleTime" SG_ 337 FC_Line_3_ModelC2 30;
BA_ "GenSigStartValue" SG_ 337 FC_Line_3_ModelC2 12288.000000;
BA_ "GenSigCycleTime" SG_ 337 FC_Line_3_ModelC1 30;
BA_ "GenSigStartValue" SG_ 337 FC_Line_3_ModelC1 3277.000000;
BA_ "GenSigCycleTime" SG_ 337 FC_Line_3_ModelC0 30;
BA_ "GenSigCycleTime" SG_ 337 FC_Line_3_dx_End 30;
BA_ "GenSigCycleTime" SG_ 337 FC_Line_3_dx_Start 30;
BA_ "GenSigCycleTime" SG_ 337 FC_Line_3_Width 30;
BA_ "GenSigCycleTime" SG_ 337 FC_Line_3_color 30;
BA_ "GenSigCycleTime" SG_ 337 FC_Line_3_Id 30;
BA_ "GenSigStartValue" SG_ 337 FC_Line_3_Id 1.000000;
BA_ "GenSigCycleTime" SG_ 337 FC_Line_3_TypeConfidence 30;
BA_ "GenSigCycleTime" SG_ 337 FC_Line_3_Type 30;

BA_ "GenSigCycleTime" SG_ 338 FC_CRCCheck_152 30;
BA_ "GenSigCycleTime" SG_ 338 FC_RollingCounter_152 30;
BA_ "GenSigCycleTime" SG_ 338 FC_Line_6_exist_prob 30;
BA_ "GenSigCycleTime" SG_ 338 FC_Line_6_RMSE 30;
BA_ "GenSigCycleTime" SG_ 338 FC_Line_6_ParseConf 30;
BA_ "GenSigCycleTime" SG_ 338 FC_Line_6_MeasureType 30;
BA_ "GenSigCycleTime" SG_ 338 FC_Line_6_ModelC3 30;
BA_ "GenSigStartValue" SG_ 338 FC_Line_6_ModelC3 2048.000000;
BA_ "GenSigCycleTime" SG_ 338 FC_Line_6_ModelC2 30;
BA_ "GenSigStartValue" SG_ 338 FC_Line_6_ModelC2 12288.000000;
BA_ "GenSigCycleTime" SG_ 338 FC_Line_6_ModelC1 30;
BA_ "GenSigStartValue" SG_ 338 FC_Line_6_ModelC1 3277.000000;
BA_ "GenSigCycleTime" SG_ 338 FC_Line_6_ModelC0 30;
BA_ "GenSigCycleTime" SG_ 338 FC_Line_6_dx_End 30;
BA_ "GenSigCycleTime" SG_ 338 FC_Line_6_dx_Start 30;
BA_ "GenSigCycleTime" SG_ 338 FC_Line_6_Width 30;
BA_ "GenSigCycleTime" SG_ 338 FC_Line_6_color 30;
BA_ "GenSigCycleTime" SG_ 338 FC_Line_6_Id 30;
BA_ "GenSigStartValue" SG_ 338 FC_Line_6_Id 1.000000;
BA_ "GenSigCycleTime" SG_ 338 FC_Line_6_TypeConfidence 30;
BA_ "GenSigCycleTime" SG_ 338 FC_Line_6_Type 30;
BA_ "GenSigCycleTime" SG_ 338 FC_Line_5_exist_prob 30;
BA_ "GenSigCycleTime" SG_ 338 FC_Line_5_RMSE 30;
BA_ "GenSigCycleTime" SG_ 338 FC_Line_5_ParseConf 30;
BA_ "GenSigCycleTime" SG_ 338 FC_Line_5_MeasureType 30;
BA_ "GenSigCycleTime" SG_ 338 FC_Line_5_ModelC3 30;
BA_ "GenSigStartValue" SG_ 338 FC_Line_5_ModelC3 2048.000000;
BA_ "GenSigCycleTime" SG_ 338 FC_Line_5_ModelC2 30;
BA_ "GenSigStartValue" SG_ 338 FC_Line_5_ModelC2 12288.000000;
BA_ "GenSigCycleTime" SG_ 338 FC_Line_5_ModelC1 30;
BA_ "GenSigStartValue" SG_ 338 FC_Line_5_ModelC1 3277.000000;
BA_ "GenSigCycleTime" SG_ 338 FC_Line_5_ModelC0 30;
BA_ "GenSigCycleTime" SG_ 338 FC_Line_5_dx_End 30;
BA_ "GenSigCycleTime" SG_ 338 FC_Line_5_dx_Start 30;
BA_ "GenSigCycleTime" SG_ 338 FC_Line_5_Width 30;
BA_ "GenSigCycleTime" SG_ 338 FC_Line_5_color 30;
BA_ "GenSigCycleTime" SG_ 338 FC_Line_5_Id 30;
BA_ "GenSigStartValue" SG_ 338 FC_Line_5_Id 1.000000;
BA_ "GenSigCycleTime" SG_ 338 FC_Line_5_TypeConfidence 30;
BA_ "GenSigCycleTime" SG_ 338 FC_Line_5_Type 30;

BA_ "GenSigCycleTime" SG_ 339 FC_CRCCheck_153 30;
BA_ "GenSigCycleTime" SG_ 339 FC_RollingCounter_153 30;
BA_ "GenSigCycleTime" SG_ 339 FC_Line_8_exist_prob 30;
BA_ "GenSigCycleTime" SG_ 339 FC_Line_8_RMSE 30;
BA_ "GenSigCycleTime" SG_ 339 FC_Line_8_ParseConf 30;
BA_ "GenSigCycleTime" SG_ 339 FC_Line_8_MeasureType 30;
BA_ "GenSigCycleTime" SG_ 339 FC_Line_8_ModelC3 30;
BA_ "GenSigStartValue" SG_ 339 FC_Line_8_ModelC3 2048.000000;
BA_ "GenSigCycleTime" SG_ 339 FC_Line_8_ModelC2 30;
BA_ "GenSigStartValue" SG_ 339 FC_Line_8_ModelC2 12288.000000;
BA_ "GenSigCycleTime" SG_ 339 FC_Line_8_ModelC1 30;
BA_ "GenSigStartValue" SG_ 339 FC_Line_8_ModelC1 3277.000000;
BA_ "GenSigCycleTime" SG_ 339 FC_Line_8_ModelC0 30;
BA_ "GenSigCycleTime" SG_ 339 FC_Line_8_dx_End 30;
BA_ "GenSigCycleTime" SG_ 339 FC_Line_8_dx_Start 30;
BA_ "GenSigCycleTime" SG_ 339 FC_Line_8_Width 30;
BA_ "GenSigCycleTime" SG_ 339 FC_Line_8_color 30;
BA_ "GenSigCycleTime" SG_ 339 FC_Line_8_Id 30;
BA_ "GenSigStartValue" SG_ 339 FC_Line_8_Id 1.000000;
BA_ "GenSigCycleTime" SG_ 339 FC_Line_8_TypeConfidence 30;
BA_ "GenSigCycleTime" SG_ 339 FC_Line_8_Type 30;
BA_ "GenSigCycleTime" SG_ 339 FC_Line_7_exist_prob 30;
BA_ "GenSigCycleTime" SG_ 339 FC_Line_7_RMSE 30;
BA_ "GenSigCycleTime" SG_ 339 FC_Line_7_ParseConf 30;
BA_ "GenSigCycleTime" SG_ 339 FC_Line_7_MeasureType 30;
BA_ "GenSigCycleTime" SG_ 339 FC_Line_7_ModelC3 30;
BA_ "GenSigStartValue" SG_ 339 FC_Line_7_ModelC3 2048.000000;
BA_ "GenSigCycleTime" SG_ 339 FC_Line_7_ModelC2 30;
BA_ "GenSigStartValue" SG_ 339 FC_Line_7_ModelC2 12288.000000;
BA_ "GenSigCycleTime" SG_ 339 FC_Line_7_ModelC1 30;
BA_ "GenSigStartValue" SG_ 339 FC_Line_7_ModelC1 3277.000000;
BA_ "GenSigCycleTime" SG_ 339 FC_Line_7_ModelC0 30;
BA_ "GenSigCycleTime" SG_ 339 FC_Line_7_dx_End 30;
BA_ "GenSigCycleTime" SG_ 339 FC_Line_7_dx_Start 30;
BA_ "GenSigCycleTime" SG_ 339 FC_Line_7_Width 30;
BA_ "GenSigCycleTime" SG_ 339 FC_Line_7_color 30;
BA_ "GenSigCycleTime" SG_ 339 FC_Line_7_Id 30;
BA_ "GenSigStartValue" SG_ 339 FC_Line_7_Id 1.000000;
BA_ "GenSigCycleTime" SG_ 339 FC_Line_7_TypeConfidence 30;
BA_ "GenSigCycleTime" SG_ 339 FC_Line_7_Type 30;

BA_ "GenSigCycleTime" SG_ 340 FC_CRCCheck_154 30;
BA_ "GenSigCycleTime" SG_ 340 FC_RollingCounter_154 30;
BA_ "GenSigCycleTime" SG_ 340 FC_LineMCUTiStamp 30;
BA_ "GenSigCycleTime" SG_ 340 FC_LineTiOut 30;
BA_ "GenSigCycleTime" SG_ 340 FC_LineTiLeap 30;
BA_ "GenSigCycleTime" SG_ 340 FC_LineTiBas 30;
BA_ "GenSigCycleTime" SG_ 340 FC_LineTiStamp 30;
BA_ "GenSigCycleTime" SG_ 340 FC_WeatherType 30;
BA_ "GenSigInvalidValue" SG_ 340 FC_WeatherType "15";
BA_ "GenSigCycleTime" SG_ 340 FC_RCrossPiont_StartEnd 30;
BA_ "GenSigCycleTime" SG_ 340 FC_RCrossPiont_DivMer 30;
BA_ "GenSigCycleTime" SG_ 340 FC_RCrossPiont_ExistProb 30;
BA_ "GenSigCycleTime" SG_ 340 FC_RCrossPiont_Dy 30;
BA_ "GenSigStartValue" SG_ 340 FC_RCrossPiont_Dy 500.000000;
BA_ "GenSigCycleTime" SG_ 340 FC_RCrossPoint_DX 30;
BA_ "GenSigCycleTime" SG_ 340 FC_LCrossPiont_StartEnd 30;
BA_ "GenSigCycleTime" SG_ 340 FC_LCrossPiont_DivMer 30;
BA_ "GenSigCycleTime" SG_ 340 FC_LCrossPiont_ExistProb 30;
BA_ "GenSigCycleTime" SG_ 340 FC_LCrossPiont_Dy 30;
BA_ "GenSigStartValue" SG_ 340 FC_LCrossPiont_Dy 500.000000;
BA_ "GenSigCycleTime" SG_ 340 FC_LCrossPoint_DX 30;

BA_ "GenSigCycleTime" SG_ 352 FC_Obj1_VehicleDir 60;
BA_ "GenSigCycleTime" SG_ 352 FC_Obj1ReDoorSts 60;
BA_ "GenSigCycleTime" SG_ 352 FC_Obj1RiDoorSts 60;
BA_ "GenSigCycleTime" SG_ 352 FC_Obj1LeDoorSts 60;
BA_ "GenSigCycleTime" SG_ 352 FC_Obj1WSInfoPosType 60;
BA_ "GenSigCycleTime" SG_ 352 FC_CRCCheck_160 60;
BA_ "GenSigCycleTime" SG_ 352 FC_RollingCounter_160 60;
BA_ "GenSigCycleTime" SG_ 352 FC_Obj1_Img2dBox_RightDown_V 60;
BA_ "GenSigCycleTime" SG_ 352 FC_Obj1_Img2dBox_LeftTop_V 60;
BA_ "GenSigCycleTime" SG_ 352 FC_Obj1_Img2dBox_RightDown_U 60;
BA_ "GenSigCycleTime" SG_ 352 FC_Obj1_Img2dBox_LeftTop_U 60;
BA_ "GenSigCycleTime" SG_ 352 FC_Obj1_TurnLight 60;
BA_ "GenSigCycleTime" SG_ 352 FC_Obj1_valid 60;
BA_ "GenSigCycleTime" SG_ 352 FC_Obj1_Vy_Vnce 60;
BA_ "GenSigCycleTime" SG_ 352 FC_Obj1_Vx_Vnce 60;
BA_ "GenSigCycleTime" SG_ 352 FC_Obj1_CenterAngle 60;
BA_ "GenSigCycleTime" SG_ 352 FC_Obj1_DistInLane 60;
BA_ "GenSigCycleTime" SG_ 352 FC_Obj1_objCutInLane 60;
BA_ "GenSigCycleTime" SG_ 352 FC_Obj1_objCutInFlag 60;
BA_ "GenSigCycleTime" SG_ 352 FC_Obj1_CornerPoint_y 60;
BA_ "GenSigCycleTime" SG_ 352 FC_Obj1_CornerPoint_x 60;
BA_ "GenSigCycleTime" SG_ 352 FC_Obj1_LaneAssignment 60;
BA_ "GenSigCycleTime" SG_ 352 FC_Obj1_MotionType 60;
BA_ "GenSigCycleTime" SG_ 352 FC_obj1_Brakelight_Info 60;
BA_ "GenSigCycleTime" SG_ 352 FC_Obj1_Width 60;
BA_ "GenSigCycleTime" SG_ 352 FC_Obj1_Length 60;
BA_ "GenSigCycleTime" SG_ 352 FC_Obj1_Height 60;
BA_ "GenSigCycleTime" SG_ 352 FC_Obj1_HeadOrientation 60;
BA_ "GenSigCycleTime" SG_ 352 FC_Obj1_HeadingAngle 60;
BA_ "GenSigCycleTime" SG_ 352 FC_Obj1_ExistProb 60;
BA_ "GenSigCycleTime" SG_ 352 FC_Obj1_Dy_Vnce 60;
BA_ "GenSigCycleTime" SG_ 352 FC_Obj1_Dy 60;
BA_ "GenSigCycleTime" SG_ 352 FC_Obj1_Dx_Vnce 60;
BA_ "GenSigCycleTime" SG_ 352 FC_Obj1_Dx 60;
BA_ "GenSigCycleTime" SG_ 352 FC_Obj1_RelVy 60;
BA_ "GenSigCycleTime" SG_ 352 FC_Obj1_RelVx 60;
BA_ "GenSigCycleTime" SG_ 352 FC_Obj1_RelAy 60;
BA_ "GenSigCycleTime" SG_ 352 FC_Obj1_RelAx 60;
BA_ "GenSigCycleTime" SG_ 352 FC_Obj1_TypeProb 60;
BA_ "GenSigCycleTime" SG_ 352 FC_Obj1_Type 60;
BA_ "GenSigCycleTime" SG_ 352 FC_Obj1_Track_Age 60;
BA_ "GenSigCycleTime" SG_ 352 FC_Obj1_Track_ID 60;

BA_ "GenSigCycleTime" SG_ 353 FC_Obj2_VehicleDir 60;
BA_ "GenSigCycleTime" SG_ 353 FC_Obj2ReDoorSts 60;
BA_ "GenSigCycleTime" SG_ 353 FC_Obj2RiDoorSts 60;
BA_ "GenSigCycleTime" SG_ 353 FC_Obj2LeDoorSts 60;
BA_ "GenSigCycleTime" SG_ 353 FC_Obj2WSInfoPosType 60;
BA_ "GenSigCycleTime" SG_ 353 FC_CRCCheck_161 60;
BA_ "GenSigCycleTime" SG_ 353 FC_RollingCounter_161 60;
BA_ "GenSigCycleTime" SG_ 353 FC_Obj2_Img2dBox_RightDown_V 60;
BA_ "GenSigCycleTime" SG_ 353 FC_Obj2_Img2dBox_LeftTop_V 60;
BA_ "GenSigCycleTime" SG_ 353 FC_Obj2_Img2dBox_RightDown_U 60;
BA_ "GenSigCycleTime" SG_ 353 FC_Obj2_Img2dBox_LeftTop_U 60;
BA_ "GenSigCycleTime" SG_ 353 FC_Obj2_TurnLight 60;
BA_ "GenSigCycleTime" SG_ 353 FC_Obj2_valid 60;
BA_ "GenSigCycleTime" SG_ 353 FC_Obj2_Vy_Vnce 60;
BA_ "GenSigCycleTime" SG_ 353 FC_Obj2_Vx_Vnce 60;
BA_ "GenSigCycleTime" SG_ 353 FC_Obj2_CenterAngle 60;
BA_ "GenSigCycleTime" SG_ 353 FC_Obj2_DistInLane 60;
BA_ "GenSigCycleTime" SG_ 353 FC_Obj2_objCutInLane 60;
BA_ "GenSigCycleTime" SG_ 353 FC_Obj2_objCutInFlag 60;
BA_ "GenSigCycleTime" SG_ 353 FC_Obj2_CornerPoint_y 60;
BA_ "GenSigCycleTime" SG_ 353 FC_Obj2_CornerPoint_x 60;
BA_ "GenSigCycleTime" SG_ 353 FC_Obj2_LaneAssignment 60;
BA_ "GenSigCycleTime" SG_ 353 FC_Obj2_MotionType 60;
BA_ "GenSigCycleTime" SG_ 353 FC_obj2_Brakelight_Info 60;
BA_ "GenSigCycleTime" SG_ 353 FC_Obj2_Width 60;
BA_ "GenSigCycleTime" SG_ 353 FC_Obj2_Length 60;
BA_ "GenSigCycleTime" SG_ 353 FC_Obj2_Height 60;
BA_ "GenSigCycleTime" SG_ 353 FC_Obj2_HeadOrientation 60;
BA_ "GenSigCycleTime" SG_ 353 FC_Obj2_HeadingAngle 60;
BA_ "GenSigCycleTime" SG_ 353 FC_Obj2_ExistProb 60;
BA_ "GenSigCycleTime" SG_ 353 FC_Obj2_Dy_Vnce 60;
BA_ "GenSigCycleTime" SG_ 353 FC_Obj2_Dy 60;
BA_ "GenSigCycleTime" SG_ 353 FC_Obj2_Dx_Vnce 60;
BA_ "GenSigCycleTime" SG_ 353 FC_Obj2_Dx 60;
BA_ "GenSigCycleTime" SG_ 353 FC_Obj2_RelVy 60;
BA_ "GenSigCycleTime" SG_ 353 FC_Obj2_RelVx 60;
BA_ "GenSigCycleTime" SG_ 353 FC_Obj2_RelAy 60;
BA_ "GenSigCycleTime" SG_ 353 FC_Obj2_RelAx 60;
BA_ "GenSigCycleTime" SG_ 353 FC_Obj2_TypeProb 60;
BA_ "GenSigCycleTime" SG_ 353 FC_Obj2_Type 60;
BA_ "GenSigCycleTime" SG_ 353 FC_Obj2_Track_Age 60;
BA_ "GenSigCycleTime" SG_ 353 FC_Obj2_Track_ID 60;

VAL_ 283 FR_OBJ22_FeaturePoint 0 " UNDETERMINED
0x1 = POINT_REAR_LEFT 
0x2 = POINT_REAR_CENTER 
0x3 = POINT_REAR_RIGHT 
0x4 = POINT_CENTER_LEFT 
0x5 = POINT_CENTER_CENTER 
0x6 = POINT_CENTER_RIGHT
0x7 = POINT_FRONT_LEFT
0x8 = POINT_FRONT_CENTER 
0x9 = POINT_FRONT_RIGHT ";
VAL_ 283 FR_OBJ21_FeaturePoint 0 " UNDETERMINED
0x1 = POINT_REAR_LEFT 
0x2 = POINT_REAR_CENTER 
0x3 = POINT_REAR_RIGHT 
0x4 = POINT_CENTER_LEFT 
0x5 = POINT_CENTER_CENTER 
0x6 = POINT_CENTER_RIGHT
0x7 = POINT_FRONT_LEFT
0x8 = POINT_FRONT_CENTER 
0x9 = POINT_FRONT_RIGHT ";
VAL_ 283 FR_OBJ22_MotionStatus 0 "unknown" 1 "moving " 2 "stopped" 3 "stationary" 4 "crossing" 5 "reserve;";
VAL_ 283 FR_OBJ22_Location 0 "unknown" 1 "Left Lane" 2 "Right  Lane" 3 "Ego Lane";
VAL_ 283 FR_OBJ22_Measured 0 "unknown" 1 "Measured" 2 "Predicted" 3 "Reserved";
VAL_ 283 FR_OBJ22_valid 0 "";
VAL_ 283 FR_OBJ22_Class 0 "Not Detected" 1 "car" 2 "truck" 3 "bicycle/motorbike" 4 "pedestrian" 5 "general" 6 "animal" 7 "uncertain";
VAL_ 283 FR_OBJ21_MotionStatus 0 "unknown" 1 "moving " 2 "stopped" 3 "stationary" 4 "crossing" 5 "reserve;";
VAL_ 283 FR_OBJ21_Location 0 "unknown" 1 "Left Lane" 2 "Right  Lane" 3 "Ego Lane";
VAL_ 283 FR_OBJ21_Measured 0 "unknown" 1 "Measured" 2 "Predicted" 3 "Reserved";
VAL_ 283 FR_OBJ21_valid 0 "";
VAL_ 283 FR_OBJ21_Class 0 "Not Detected" 1 "car" 2 "truck" 3 "bicycle/motorbike" 4 "pedestrian" 5 "general" 6 "animal" 7 "uncertain";

VAL_ 284 FR_OBJ24_FeaturePoint 0 " UNDETERMINED
0x1 = POINT_REAR_LEFT 
0x2 = POINT_REAR_CENTER 
0x3 = POINT_REAR_RIGHT 
0x4 = POINT_CENTER_LEFT 
0x5 = POINT_CENTER_CENTER 
0x6 = POINT_CENTER_RIGHT
0x7 = POINT_FRONT_LEFT
0x8 = POINT_FRONT_CENTER 
0x9 = POINT_FRONT_RIGHT ";
VAL_ 284 FR_OBJ23_FeaturePoint 0 " UNDETERMINED
0x1 = POINT_REAR_LEFT 
0x2 = POINT_REAR_CENTER 
0x3 = POINT_REAR_RIGHT 
0x4 = POINT_CENTER_LEFT 
0x5 = POINT_CENTER_CENTER 
0x6 = POINT_CENTER_RIGHT
0x7 = POINT_FRONT_LEFT
0x8 = POINT_FRONT_CENTER 
0x9 = POINT_FRONT_RIGHT ";
VAL_ 284 FR_OBJ24_MotionStatus 0 "unknown" 1 "moving " 2 "stopped" 3 "stationary" 4 "crossing" 5 "reserve;";
VAL_ 284 FR_OBJ24_Location 0 "unknown" 1 "Left Lane" 2 "Right  Lane" 3 "Ego Lane";
VAL_ 284 FR_OBJ24_Measured 0 "unknown" 1 "Measured" 2 "Predicted" 3 "Reserved";
VAL_ 284 FR_OBJ24_valid 0 "";
VAL_ 284 FR_OBJ24_Class 0 "Not Detected" 1 "car" 2 "truck" 3 "bicycle/motorbike" 4 "pedestrian" 5 "general" 6 "animal" 7 "uncertain";
VAL_ 284 FR_OBJ23_MotionStatus 0 "unknown" 1 "moving " 2 "stopped" 3 "stationary" 4 "crossing" 5 "reserve;";
VAL_ 284 FR_OBJ23_Location 0 "unknown" 1 "Left Lane" 2 "Right  Lane" 3 "Ego Lane";
VAL_ 284 FR_OBJ23_Measured 0 "unknown" 1 "Measured" 2 "Predicted" 3 "Reserved";
VAL_ 284 FR_OBJ23_valid 0 "";
VAL_ 284 FR_OBJ23_Class 0 "Not Detected" 1 "car" 2 "truck" 3 "bicycle/motorbike" 4 "pedestrian" 5 "general" 6 "animal" 7 "uncertain";

VAL_ 285 FR_OBJ26_FeaturePoint 0 " UNDETERMINED
0x1 = POINT_REAR_LEFT 
0x2 = POINT_REAR_CENTER 
0x3 = POINT_REAR_RIGHT 
0x4 = POINT_CENTER_LEFT 
0x5 = POINT_CENTER_CENTER 
0x6 = POINT_CENTER_RIGHT
0x7 = POINT_FRONT_LEFT
0x8 = POINT_FRONT_CENTER 
0x9 = POINT_FRONT_RIGHT ";
VAL_ 285 FR_OBJ25_FeaturePoint 0 " UNDETERMINED
0x1 = POINT_REAR_LEFT 
0x2 = POINT_REAR_CENTER 
0x3 = POINT_REAR_RIGHT 
0x4 = POINT_CENTER_LEFT 
0x5 = POINT_CENTER_CENTER 
0x6 = POINT_CENTER_RIGHT
0x7 = POINT_FRONT_LEFT
0x8 = POINT_FRONT_CENTER 
0x9 = POINT_FRONT_RIGHT ";
VAL_ 285 FR_OBJ26_MotionStatus 0 "unknown" 1 "moving " 2 "stopped" 3 "stationary" 4 "crossing" 5 "reserve;";
VAL_ 285 FR_OBJ26_Location 0 "unknown" 1 "Left Lane" 2 "Right  Lane" 3 "Ego Lane";
VAL_ 285 FR_OBJ26_Measured 0 "unknown" 1 "Measured" 2 "Predicted" 3 "Reserved";
VAL_ 285 FR_OBJ26_valid 0 "";
VAL_ 285 FR_OBJ26_Class 0 "Not Detected" 1 "car" 2 "truck" 3 "bicycle/motorbike" 4 "pedestrian" 5 "general" 6 "animal" 7 "uncertain";
VAL_ 285 FR_OBJ25_MotionStatus 0 "unknown" 1 "moving " 2 "stopped" 3 "stationary" 4 "crossing" 5 "reserve;";
VAL_ 285 FR_OBJ25_Location 0 "unknown" 1 "Left Lane" 2 "Right  Lane" 3 "Ego Lane";
VAL_ 285 FR_OBJ25_Measured 0 "unknown" 1 "Measured" 2 "Predicted" 3 "Reserved";
VAL_ 285 FR_OBJ25_valid 0 "";
VAL_ 285 FR_OBJ25_Class 0 "Not Detected" 1 "car" 2 "truck" 3 "bicycle/motorbike" 4 "pedestrian" 5 "general" 6 "animal" 7 "uncertain";

VAL_ 286 FR_OBJ28_FeaturePoint 0 " UNDETERMINED
0x1 = POINT_REAR_LEFT 
0x2 = POINT_REAR_CENTER 
0x3 = POINT_REAR_RIGHT 
0x4 = POINT_CENTER_LEFT 
0x5 = POINT_CENTER_CENTER 
0x6 = POINT_CENTER_RIGHT
0x7 = POINT_FRONT_LEFT
0x8 = POINT_FRONT_CENTER 
0x9 = POINT_FRONT_RIGHT ";
VAL_ 286 FR_OBJ27_FeaturePoint 0 " UNDETERMINED
0x1 = POINT_REAR_LEFT 
0x2 = POINT_REAR_CENTER 
0x3 = POINT_REAR_RIGHT 
0x4 = POINT_CENTER_LEFT 
0x5 = POINT_CENTER_CENTER 
0x6 = POINT_CENTER_RIGHT
0x7 = POINT_FRONT_LEFT
0x8 = POINT_FRONT_CENTER 
0x9 = POINT_FRONT_RIGHT ";
VAL_ 286 FR_OBJ28_MotionStatus 0 "unknown" 1 "moving " 2 "stopped" 3 "stationary" 4 "crossing" 5 "reserve;";
VAL_ 286 FR_OBJ28_Location 0 "unknown" 1 "Left Lane" 2 "Right  Lane" 3 "Ego Lane";
VAL_ 286 FR_OBJ28_Measured 0 "unknown" 1 "Measured" 2 "Predicted" 3 "Reserved";
VAL_ 286 FR_OBJ28_valid 0 "";
VAL_ 286 FR_OBJ28_Class 0 "Not Detected" 1 "car" 2 "truck" 3 "bicycle/motorbike" 4 "pedestrian" 5 "general" 6 "animal" 7 "uncertain";
VAL_ 286 FR_OBJ27_MotionStatus 0 "unknown" 1 "moving " 2 "stopped" 3 "stationary" 4 "crossing" 5 "reserve;";
VAL_ 286 FR_OBJ27_Location 0 "unknown" 1 "Left Lane" 2 "Right  Lane" 3 "Ego Lane";
VAL_ 286 FR_OBJ27_Measured 0 "unknown" 1 "Measured" 2 "Predicted" 3 "Reserved";
VAL_ 286 FR_OBJ27_valid 0 "";
VAL_ 286 FR_OBJ27_Class 0 "Not Detected" 1 "car" 2 "truck" 3 "bicycle/motorbike" 4 "pedestrian" 5 "general" 6 "animal" 7 "uncertain";

VAL_ 287 FR_OBJ30_FeaturePoint 0 " UNDETERMINED
0x1 = POINT_REAR_LEFT 
0x2 = POINT_REAR_CENTER 
0x3 = POINT_REAR_RIGHT 
0x4 = POINT_CENTER_LEFT 
0x5 = POINT_CENTER_CENTER 
0x6 = POINT_CENTER_RIGHT
0x7 = POINT_FRONT_LEFT
0x8 = POINT_FRONT_CENTER 
0x9 = POINT_FRONT_RIGHT ";
VAL_ 287 FR_OBJ29_FeaturePoint 0 " UNDETERMINED
0x1 = POINT_REAR_LEFT 
0x2 = POINT_REAR_CENTER 
0x3 = POINT_REAR_RIGHT 
0x4 = POINT_CENTER_LEFT 
0x5 = POINT_CENTER_CENTER 
0x6 = POINT_CENTER_RIGHT
0x7 = POINT_FRONT_LEFT
0x8 = POINT_FRONT_CENTER 
0x9 = POINT_FRONT_RIGHT ";
VAL_ 287 FR_OBJ30_MotionStatus 0 "unknown" 1 "moving " 2 "stopped" 3 "stationary" 4 "crossing" 5 "reserve;";
VAL_ 287 FR_OBJ30_Location 0 "unknown" 1 "Left Lane" 2 "Right  Lane" 3 "Ego Lane";
VAL_ 287 FR_OBJ30_Measured 0 "unknown" 1 "Measured" 2 "Predicted" 3 "Reserved";
VAL_ 287 FR_OBJ30_valid 0 "";
VAL_ 287 FR_OBJ30_Class 0 "Not Detected" 1 "car" 2 "truck" 3 "bicycle/motorbike" 4 "pedestrian" 5 "general" 6 "animal" 7 "uncertain";
VAL_ 287 FR_OBJ29_MotionStatus 0 "unknown" 1 "moving " 2 "stopped" 3 "stationary" 4 "crossing" 5 "reserve;";
VAL_ 287 FR_OBJ29_Location 0 "unknown" 1 "Left Lane" 2 "Right  Lane" 3 "Ego Lane";
VAL_ 287 FR_OBJ29_Measured 0 "unknown" 1 "Measured" 2 "Predicted" 3 "Reserved";
VAL_ 287 FR_OBJ29_valid 0 "";
VAL_ 287 FR_OBJ29_Class 0 "Not Detected" 1 "car" 2 "truck" 3 "bicycle/motorbike" 4 "pedestrian" 5 "general" 6 "animal" 7 "uncertain";

VAL_ 288 FR_OBJ32_FeaturePoint 0 " UNDETERMINED
0x1 = POINT_REAR_LEFT 
0x2 = POINT_REAR_CENTER 
0x3 = POINT_REAR_RIGHT 
0x4 = POINT_CENTER_LEFT 
0x5 = POINT_CENTER_CENTER 
0x6 = POINT_CENTER_RIGHT
0x7 = POINT_FRONT_LEFT
0x8 = POINT_FRONT_CENTER 
0x9 = POINT_FRONT_RIGHT ";
VAL_ 288 FR_OBJ31_FeaturePoint 0 " UNDETERMINED
0x1 = POINT_REAR_LEFT 
0x2 = POINT_REAR_CENTER 
0x3 = POINT_REAR_RIGHT 
0x4 = POINT_CENTER_LEFT 
0x5 = POINT_CENTER_CENTER 
0x6 = POINT_CENTER_RIGHT
0x7 = POINT_FRONT_LEFT
0x8 = POINT_FRONT_CENTER 
0x9 = POINT_FRONT_RIGHT ";
VAL_ 288 FR_OBJ32_MotionStatus 0 "unknown" 1 "moving " 2 "stopped" 3 "stationary" 4 "crossing" 5 "reserve;";
VAL_ 288 FR_OBJ32_Location 0 "unknown" 1 "Left Lane" 2 "Right  Lane" 3 "Ego Lane";
VAL_ 288 FR_OBJ32_Measured 0 "unknown" 1 "Measured" 2 "Predicted" 3 "Reserved";
VAL_ 288 FR_OBJ32_valid 0 "";
VAL_ 288 FR_OBJ32_Class 0 "Not Detected" 1 "car" 2 "truck" 3 "bicycle/motorbike" 4 "pedestrian" 5 "general" 6 "animal" 7 "uncertain";
VAL_ 288 FR_OBJ31_MotionStatus 0 "unknown" 1 "moving " 2 "stopped" 3 "stationary" 4 "crossing" 5 "reserve;";
VAL_ 288 FR_OBJ31_Location 0 "unknown" 1 "Left Lane" 2 "Right  Lane" 3 "Ego Lane";
VAL_ 288 FR_OBJ31_Measured 0 "unknown" 1 "Measured" 2 "Predicted" 3 "Reserved";
VAL_ 288 FR_Obj31_valid 0 "";
VAL_ 288 FR_OBJ31_Class 0 "Not Detected" 1 "car" 2 "truck" 3 "bicycle/motorbike" 4 "pedestrian" 5 "general" 6 "animal" 7 "uncertain";

VAL_ 310 FR_KidRushoutFlag 0 "";
VAL_ 310 FR_MisAlignment 0 "";
VAL_ 310 FR_WorkMode 0 "";
VAL_ 310 FR_RadarFailureStatus 0 " no failure" 1 "fullBlind" 2 "" 3 "reversible failure" 4 " irrversible failure" 5 "vehicle information failure
0x6-0x7=Reserevd";
VAL_ 310 FR_FRadarCalibrationStatus 0 " Calibration is ok" 1 " Calibration In Process" 2 " Calibration never done" 3 "  Calibration Failed";

VAL_ 312 FR_TiOut 0 "no timeout" 1 "timeout";

VAL_ 336 FC_Line_2_MeasureType 0 "unknow" 1 "virtual_paral" 2 "measured_paral" 3 "virtual" 4 "measured";
VAL_ 336 FC_Line_2_color 0 "Not Detected" 1 "white" 2 "yellow" 3 "white plus yellow" 4 "unknown" 5 "reserved" 6 "reserved" 7 "Invalid";
VAL_ 336 FC_Line_2_Type 0 " solid" 1 "dashed" 2 "double_dashed_dashed" 3 "double_dashed_solid" 4 "double_ solid_ dashed" 5 "double_ solid_ solid" 6 " multiple（Eu&USA）" 7 "multiple_warning（Eu&USA）" 8 "car_pool" 9 "asphalt_joint（USA）" 10 "Bot-Dott（USA）" 11 " road_edge" 12 "guardrail" 13 "curbstone" 14 "wall" 15 "traffic_cone" 16 "delineator_post" 17 "parking_car" 18 "unknown_raised" 19 "fishbone_solid" 20 "unknown" 21 "line_diversion_inside" 22 "line_diversion_outside" 23 "line-ramp" 24 "fishbone_ dashed" 25 "reserved";
VAL_ 336 FC_Line_1_MeasureType 0 "unknow" 1 "virtual_paral" 2 "measured_paral" 3 "virtual" 4 "measured";
VAL_ 336 FC_Line_1_color 0 "Not Detected" 1 "white" 2 "yellow" 3 "white plus yellow" 4 "unknown" 5 "reserved" 6 "reserved" 7 "Invalid";
VAL_ 336 FC_Line_1_Type 0 " solid" 1 "dashed" 2 "double_dashed_dashed" 3 "double_dashed_solid" 4 "double_ solid_ dashed" 5 "double_ solid_ solid" 6 " multiple（Eu&USA）" 7 "multiple_warning（Eu&USA）" 8 "car_pool" 9 "asphalt_joint（USA）" 10 "Bot-Dott（USA）" 11 " road_edge" 12 "guardrail" 13 "curbstone" 14 "wall" 15 "traffic_cone" 16 "delineator_post" 17 "parking_car" 18 "unknown_raised" 19 "fishbone_solid" 20 "unknown" 21 "line_diversion_inside" 22 "line_diversion_outside" 23 "line-ramp" 24 "fishbone_ dashed" 25 "reserved";

VAL_ 337 FC_Line_4_MeasureType 0 "unknow" 1 "virtual_paral" 2 "measured_paral" 3 "virtual" 4 "measured";
VAL_ 337 FC_Line_4_color 0 "Not Detected" 1 "white" 2 "yellow" 3 "white plus yellow" 4 "unknown" 5 "reserved" 6 "reserved" 7 "Invalid";
VAL_ 337 FC_Line_4_Type 0 " solid" 1 "dashed" 2 "double_dashed_dashed" 3 "double_dashed_solid" 4 "double_ solid_ dashed" 5 "double_ solid_ solid" 6 " multiple（Eu&USA）" 7 "multiple_warning（Eu&USA）" 8 "car_pool" 9 "asphalt_joint（USA）" 10 "Bot-Dott（USA）" 11 " road_edge" 12 "guardrail" 13 "curbstone" 14 "wall" 15 "traffic_cone" 16 "delineator_post" 17 "parking_car" 18 "unknown_raised" 19 "fishbone_solid" 20 "unknown" 21 "line_diversion_inside" 22 "line_diversion_outside" 23 "line-ramp" 24 "fishbone_ dashed" 25 "reserved";
VAL_ 337 FC_Line_3_MeasureType 0 "unknow" 1 "virtual_paral" 2 "measured_paral" 3 "virtual" 4 "measured";
VAL_ 337 FC_Line_3_color 0 "Not Detected" 1 "white" 2 "yellow" 3 "white plus yellow" 4 "unknown" 5 "reserved" 6 "reserved" 7 "Invalid";
VAL_ 337 FC_Line_3_Type 0 " solid" 1 "dashed" 2 "double_dashed_dashed" 3 "double_dashed_solid" 4 "double_ solid_ dashed" 5 "double_ solid_ solid" 6 " multiple（Eu&USA）" 7 "multiple_warning（Eu&USA）" 8 "car_pool" 9 "asphalt_joint（USA）" 10 "Bot-Dott（USA）" 11 " road_edge" 12 "guardrail" 13 "curbstone" 14 "wall" 15 "traffic_cone" 16 "delineator_post" 17 "parking_car" 18 "unknown_raised" 19 "fishbone_solid" 20 "unknown" 21 "line_diversion_inside" 22 "line_diversion_outside" 23 "line-ramp" 24 "fishbone_ dashed" 25 "reserved";

VAL_ 338 FC_Line_6_MeasureType 0 "unknow" 1 "virtual_paral" 2 "measured_paral" 3 "virtual" 4 "measured";
VAL_ 338 FC_Line_6_color 0 "Not Detected" 1 "white" 2 "yellow" 3 "white plus yellow" 4 "unknown" 5 "reserved" 6 "reserved" 7 "Invalid";
VAL_ 338 FC_Line_6_Type 0 " solid" 1 "dashed" 2 "double_dashed_dashed" 3 "double_dashed_solid" 4 "double_ solid_ dashed" 5 "double_ solid_ solid" 6 " multiple（Eu&USA）" 7 "multiple_warning（Eu&USA）" 8 "car_pool" 9 "asphalt_joint（USA）" 10 "Bot-Dott（USA）" 11 " road_edge" 12 "guardrail" 13 "curbstone" 14 "wall" 15 "traffic_cone" 16 "delineator_post" 17 "parking_car" 18 "unknown_raised" 19 "fishbone_solid" 20 "unknown" 21 "line_diversion_inside" 22 "line_diversion_outside" 23 "line-ramp" 24 "fishbone_ dashed" 25 "reserved";
VAL_ 338 FC_Line_5_MeasureType 0 "unknow" 1 "virtual_paral" 2 "measured_paral" 3 "virtual" 4 "measured";
VAL_ 338 FC_Line_5_color 0 "Not Detected" 1 "white" 2 "yellow" 3 "white plus yellow" 4 "unknown" 5 "reserved" 6 "reserved" 7 "Invalid";
VAL_ 338 FC_Line_5_Type 0 " solid" 1 "dashed" 2 "double_dashed_dashed" 3 "double_dashed_solid" 4 "double_ solid_ dashed" 5 "double_ solid_ solid" 6 " multiple（Eu&USA）" 7 "multiple_warning（Eu&USA）" 8 "car_pool" 9 "asphalt_joint（USA）" 10 "Bot-Dott（USA）" 11 " road_edge" 12 "guardrail" 13 "curbstone" 14 "wall" 15 "traffic_cone" 16 "delineator_post" 17 "parking_car" 18 "unknown_raised" 19 "fishbone_solid" 20 "unknown" 21 "line_diversion_inside" 22 "line_diversion_outside" 23 "line-ramp" 24 "fishbone_ dashed" 25 "reserved";

VAL_ 339 FC_Line_8_MeasureType 0 "unknow" 1 "virtual_paral" 2 "measured_paral" 3 "virtual" 4 "measured";
VAL_ 339 FC_Line_8_color 0 "Not Detected" 1 "white" 2 "yellow" 3 "white plus yellow" 4 "unknown" 5 "reserved" 6 "reserved" 7 "Invalid";
VAL_ 339 FC_Line_8_Type 0 " solid" 1 "dashed" 2 "double_dashed_dashed" 3 "double_dashed_solid" 4 "double_ solid_ dashed" 5 "double_ solid_ solid" 6 " multiple（Eu&USA）" 7 "multiple_warning（Eu&USA）" 8 "car_pool" 9 "asphalt_joint（USA）" 10 "Bot-Dott（USA）" 11 " road_edge" 12 "guardrail" 13 "curbstone" 14 "wall" 15 "traffic_cone" 16 "delineator_post" 17 "parking_car" 18 "unknown_raised" 19 "fishbone_solid" 20 "unknown" 21 "line_diversion_inside" 22 "line_diversion_outside" 23 "line-ramp" 24 "fishbone_ dashed" 25 "reserved";
VAL_ 339 FC_Line_7_MeasureType 0 "unknow" 1 "virtual_paral" 2 "measured_paral" 3 "virtual" 4 "measured";
VAL_ 339 FC_Line_7_color 0 "Not Detected" 1 "white" 2 "yellow" 3 "white plus yellow" 4 "unknown" 5 "reserved" 6 "reserved" 7 "Invalid";
VAL_ 339 FC_Line_7_Type 0 " solid" 1 "dashed" 2 "double_dashed_dashed" 3 "double_dashed_solid" 4 "double_ solid_ dashed" 5 "double_ solid_ solid" 6 " multiple（Eu&USA）" 7 "multiple_warning（Eu&USA）" 8 "car_pool" 9 "asphalt_joint（USA）" 10 "Bot-Dott（USA）" 11 " road_edge" 12 "guardrail" 13 "curbstone" 14 "wall" 15 "traffic_cone" 16 "delineator_post" 17 "parking_car" 18 "unknown_raised" 19 "fishbone_solid" 20 "unknown" 21 "line_diversion_inside" 22 "line_diversion_outside" 23 "line-ramp" 24 "fishbone_ dashed" 25 "reserved";

VAL_ 340 FC_LineTiOut 0 "no timeout" 1 "timeout";
VAL_ 340 FC_WeatherType 0 "Sunny" 1 "Cloudy" 2 "Rainy" 3 "Snowy" 4 "HeavyRain" 5 "Other" 15 "Invalid" 7 " Reserved;";
VAL_ 340 FC_RCrossPiont_StartEnd 0 "默认;
0x1=起始点;
0x2=终止点;
0x3=reserved;";
VAL_ 340 FC_RCrossPiont_DivMer 0 "默认;
0x1=分裂;
0x2=合并;
0x3=reserved;";
VAL_ 340 FC_LCrossPiont_StartEnd 0 "默认;
0x1=起始点;
0x2=终止点;
0x3=reserved;";
VAL_ 340 FC_LCrossPiont_DivMer 0 "默认;
0x1=分裂;
0x2=合并;
0x3=reserved;";

VAL_ 352 FC_Obj1_VehicleDir 0 "Unknown" 1 "同向车辆" 2 "对向来车
0x3-0x7=预留";
VAL_ 352 FC_Obj1ReDoorSts 0 "关闭" 1 "全开" 2 "半开（预留）";
VAL_ 352 FC_Obj1RiDoorSts 0 "关闭" 1 "全开" 2 "半开（预留）";
VAL_ 352 FC_Obj1LeDoorSts 0 "关闭" 1 "全开" 2 "半开（预留）";
VAL_ 352 FC_Obj1WSInfoPosType 0 "Unknown" 1 "RearLeft" 2 "RearCenter" 3 "RearRgiht" 4 "FrontLeft" 5 "FrontCenter" 6 "FrontRgiht" 7 "LeftCenter" 8 "RgihtCenter" 9 "Center" 10 "预留;";
VAL_ 352 FC_Obj1_TurnLight 0 "";
VAL_ 352 FC_Obj1_valid 0 "";
VAL_ 352 FC_Obj1_objCutInLane 0 "invalid" 1 "measured;
0x2=predicted;";
VAL_ 352 FC_Obj1_objCutInFlag 0 "invalid" 1 "cutin_hostLane" 2 "cutin_fov";
VAL_ 352 FC_Obj1_LaneAssignment 0 "UNKNOWN    
1=LEFT_LEFT    
2=LEFT    
3=HOST    
4=RIGHT     
5=RIGHT_RIGHT
0x6-0x7=Reserved";
VAL_ 352 FC_Obj1_MotionType 0 "Unknown" 1 "Moving" 2 "Stationary" 3 "Stopped" 4 "Moving Slowly";
VAL_ 352 FC_obj1_Brakelight_Info 0 "off" 1 "on ";
VAL_ 352 FC_Obj1_HeadOrientation 0 "Unknown" 1 "Head Front" 2 "Head Left Front" 3 "Head Left" 4 "Head Left Back" 5 "Head Back" 6 "Head Right Back" 7 "Head Right" 8 "Head right front" 9 "Reserved";
VAL_ 352 FC_Obj1_Type 0 "Not Detected;
0x1=car" 2 "truck" 3 "cyclist/tricycle" 4 "pedestrian" 5 "bicycle/motorbike（无人）" 6 "animal" 7 "uncertain" 8 " bus; 
 0x9~0xF = Reserved;";

VAL_ 353 FC_Obj2_VehicleDir 0 "Unknown" 1 "同向车辆" 2 "对向来车
0x3-0x7=预留";
VAL_ 353 FC_Obj2ReDoorSts 0 "关闭" 1 "全开" 2 "半开（预留）";
VAL_ 353 FC_Obj2RiDoorSts 0 "关闭" 1 "全开" 2 "半开（预留）";
VAL_ 353 FC_Obj2LeDoorSts 0 "关闭" 1 "全开" 2 "半开（预留）";
VAL_ 353 FC_Obj2WSInfoPosType 0 "Unknown" 1 "RearLeft" 2 "RearCenter" 3 "RearRgiht" 4 "FrontLeft" 5 "FrontCenter" 6 "FrontRgiht" 7 "LeftCenter" 8 "RgihtCenter" 9 "Center" 10 "预留;";
VAL_ 353 FC_Obj2_TurnLight 0 "";
VAL_ 353 FC_Obj2_valid 0 "";
VAL_ 353 FC_Obj2_objCutInLane 0 "invalid" 1 "measured;
0x2=predicted;";
VAL_ 353 FC_Obj2_objCutInFlag 0 "invalid" 1 "cutin_hostLane" 2 "cutin_fov";
VAL_ 353 FC_Obj2_LaneAssignment 0 "UNKNOWN    
1=LEFT_LEFT    
2=LEFT    
3=HOST    
4=RIGHT     
5=RIGHT_RIGHT
0x6-0x7=Reserved";
VAL_ 353 FC_Obj2_MotionType 0 "Unknown" 1 "Moving" 2 "Stationary" 3 "Stopped" 4 "Moving Slowly";
VAL_ 353 FC_obj2_Brakelight_Info 0 "off" 1 "on ";
VAL_ 353 FC_Obj2_HeadOrientation 0 "Unknown" 1 "Head Front" 2 "Head Left Front" 3 "Head Left" 4 "Head Left Back" 5 "Head Back" 6 "Head Right Back" 7 "Head Right" 8 "Head right front" 9 "Reserved";
VAL_ 353 FC_Obj2_Type 0 "Not Detected;
0x1=car" 2 "truck" 3 "cyclist/tricycle" 4 "pedestrian" 5 "bicycle/motorbike（无人）" 6 "animal" 7 "uncertain" 8 " bus; 
 0x9~0xF = Reserved;";
