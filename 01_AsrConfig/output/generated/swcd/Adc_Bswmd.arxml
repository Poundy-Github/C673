AUTOSAR XML (schema 4-0-3)
package /AUTOSAR_Adc/BswModuleDescriptions
  bsw module description Adc: module-id=123, provided-entrys=Adc_Init
    bsw internal behavior InternalBehavior_0
      exclusive area KernelData
      exclusive area SrcRegAccess
      bsw called entity Adc_Init: can-enter-exclusive-area=[KernelData, SrcRegAccess], implemented-entry=Adc_Init
package /AUTOSAR_Adc/BswModuleEntrys
  bsw module entry Adc_Init: service-id=0, is-reentrant=false, is-synchronous=true, call-type=REGULAR, execution-context=UNSPECIFIED, sw-service-impl-policy=STANDARD
package /Adc_Aurix2GAS422/Implementations
  bsw implementation BswImplementation_0: programming-language=C, sw-version=20.0.2, vendor-id=17, ar-release-version=4.2.2, behavior=InternalBehavior_0, vendor-specific-module-def=Adc
    code-descriptors:
      code Files: artifact-descriptors=[{short-label=make::Adc_defs.mak, category=SWMAKE}, {short-label=make::Adc_rules.mak, category=SWMAKE}]
    resource consumption ResourceConsumption
      13 x memory section, all with options=safetyAsilB:
        CONFIG_DATA_ASIL_B_CORE0_UNSPECIFIED: alignment=UNSPECIFIED, sw-addrmethod=CONFIG_DATA_ASIL_B
        VAR_CLEARED_ASIL_B_CORE0_UNSPECIFIED: alignment=UNSPECIFIED, sw-addrmethod=VAR_CLEARED_ASIL_B
        CONFIG_DATA_ASIL_B_CORE1_UNSPECIFIED: alignment=UNSPECIFIED, sw-addrmethod=CONFIG_DATA_ASIL_B
        VAR_CLEARED_ASIL_B_CORE1_UNSPECIFIED: alignment=UNSPECIFIED, sw-addrmethod=VAR_CLEARED_ASIL_B
        CONFIG_DATA_ASIL_B_CORE2_UNSPECIFIED: alignment=UNSPECIFIED, sw-addrmethod=CONFIG_DATA_ASIL_B
        VAR_CLEARED_ASIL_B_CORE2_UNSPECIFIED: alignment=UNSPECIFIED, sw-addrmethod=VAR_CLEARED_ASIL_B
        CONFIG_DATA_ASIL_B_CORE3_UNSPECIFIED: alignment=UNSPECIFIED, sw-addrmethod=CONFIG_DATA_ASIL_B
        VAR_CLEARED_ASIL_B_CORE3_UNSPECIFIED: alignment=UNSPECIFIED, sw-addrmethod=VAR_CLEARED_ASIL_B
        CONFIG_DATA_ASIL_B_GLOBAL_UNSPECIFIED: alignment=UNSPECIFIED, sw-addrmethod=CONFIG_DATA_ASIL_B
        CODE_ASIL_B_GLOBAL: alignment=UNSPECIFIED, sw-addrmethod=CODE_ASIL_B
        VAR_CLEARED_ASIL_B_GLOBAL_32: alignment=32, sw-addrmethod=VAR_CLEARED_ASIL_B
        CONST_ASIL_B_GLOBAL_8: alignment=8, sw-addrmethod=CONST_ASIL_B
        CONST_ASIL_B_GLOBAL_UNSPECIFIED: alignment=UNSPECIFIED, sw-addrmethod=CONST_ASIL_B
      section name prefix ADC
