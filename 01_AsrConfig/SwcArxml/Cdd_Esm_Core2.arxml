AUTOSAR XML (schema 00045)
package /Esm_Core2
  swc implementation EsmImpl_Core2: programming-language=C, sw-version=1.0.0, vendor-id=0, behavior=Esm_Core2_IB
    code-descriptors:
      code CodeGen: artifact-descriptors=[{short-label=SWSRC, category=SWSRC}, {short-label=SWHDR, category=SWHDR}]
    resource consumption Core2_Resource
      memory section CODE: sw-addrmethod=CODE
      memory section VAR_UNSPECIFIED: sw-addrmethod=VAR
  complex device driver sw component type Esm_Core2  # Ecu State Management
    behavior Esm_Core2_IB: handle-termination-and-restart=NO-SUPPORT
      init event InitEvent_Esm_Core2_InitFunction: start-on-event=Esm_Core2_InitFunction
      timing event TimingEvent_Esm_Core2_MainFunction: start-on-event=Esm_Core2_MainFunction, period=0.02
      runnable Esm_Core2_InitFunction
      runnable Esm_Core2_MainFunction
