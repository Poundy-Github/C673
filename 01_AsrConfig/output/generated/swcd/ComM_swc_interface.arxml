AUTOSAR XML (schema 4-0-3)
package /AUTOSAR_ComM/ImplementationDataTypes
  5 x impl type:
    ComM_ModeType: compu {0=COMM_NO_COMMUNICATION, 1=COMM_SILENT_COMMUNICATION, 2=COMM_FULL_COMMUNICATION}, implementation-data-type=uint8
    ComM_UserHandleType: implementation-data-type=uint8
    ComM_InhibitionStatusType: implementation-data-type=uint8
    ComM_UserHandleArrayType: category=STRUCTURE
      element numberOfRequesters: implementation-data-type=uint8
      element handleArray: implementation-data-type=ComM_InternalHandleArrayType
    ComM_InternalHandleArrayType: category=ARRAY
      element handleArrayElement: array-size=1, array-size-semantics=FIXED-SIZE, implementation-data-type=ComM_UserHandleType
package /AUTOSAR_ComM/ConstantSpecifications
  constant specification ComM_InitConst_UserHandleArray: value-spec=fields=[0, [0]]
package /AUTOSAR_ComM/ModeDeclarationGroups
  mode declaration group ComMMode: category=EXPLICIT_ORDER, initial-mode=COMM_NO_COMMUNICATION, on-transition-value=3
    mode COMM_NO_COMMUNICATION: value=0
    mode COMM_SILENT_COMMUNICATION: value=1
    mode COMM_FULL_COMMUNICATION: value=2
package /AUTOSAR_ComM/DataTypeMappingSets
  data type mapping set DataTypeMappingSet_0: mode-request-type-map{implementation-data-type=uint8, mode-group=ComMMode}
package /AUTOSAR_ComM/PortInterfaces
  mode switch interface ComM_CurrentMode: is-service=true
    mode group currentMode: type=ComMMode
  client server interface ComM_UserRequest: is-service=true
    5 x operation:
      RequestComMode: possible-error=[ComM_UserRequest/E_NOT_OK, E_MODE_LIMITATION]
        arg ComMode: type=ComM_ModeType, direction=IN
      GetCurrentComMode: possible-error=ComM_UserRequest/E_NOT_OK
        arg ComMode: type=ComM_ModeType, direction=OUT
      GetCurrentPNCComMode: possible-error=[ComM_UserRequest/E_NOT_OK, E_MULTIPLE_PNC_ASSIGNED, E_NO_PNC_ASSIGNED]
        arg ComMode: type=ComM_ModeType, direction=OUT
      GetMaxComMode: possible-error=ComM_UserRequest/E_NOT_OK
        arg ComMode: type=ComM_ModeType, direction=OUT
      GetRequestedComMode: possible-error=ComM_UserRequest/E_NOT_OK
        arg ComMode: type=ComM_ModeType, direction=OUT
    4 x error:
      E_NOT_OK: error-code=1
      E_MODE_LIMITATION: error-code=2
      E_MULTIPLE_PNC_ASSIGNED: error-code=3
      E_NO_PNC_ASSIGNED: error-code=4
  sender receiver interface ComM_CurrentChannelRequest: is-service=true
    data fullComRequestors: type=ComM_UserHandleArrayType
  client server interface ComM_ECUModeLimitation: is-service=true
    4 x operation, all with possible-error=ComM_ECUModeLimitation/E_NOT_OK:
      LimitECUToNoComMode
        arg Status: type=boolean, direction=IN
      ReadInhibitCounter
        arg CounterValue: type=uint16, direction=OUT
      ResetInhibitCounter
      SetECUGroupClassification
        arg Status: type=ComM_InhibitionStatusType, direction=IN
    error E_NOT_OK: error-code=1
  client server interface ComM_ChannelLimitation: is-service=true
    operation LimitChannelToNoComMode: possible-error=ComM_ChannelLimitation/E_NOT_OK
      arg Status: type=boolean, direction=IN
    operation GetInhibitionStatus: possible-error=ComM_ChannelLimitation/E_NOT_OK
      arg Status: type=ComM_InhibitionStatusType, direction=OUT
    error E_NOT_OK: error-code=1
  client server interface ComM_ChannelWakeup: is-service=true
    operation PreventWakeUp: possible-error=ComM_ChannelWakeup/E_NOT_OK
      arg Status: type=boolean, direction=IN
    operation GetInhibitionStatus: possible-error=ComM_ChannelWakeup/E_NOT_OK
      arg Status: type=ComM_InhibitionStatusType, direction=OUT
    error E_NOT_OK: error-code=1
