[part 2 of 2]
[!IF "../CanGeneral/CanPublicIcomSupport = 'true'"!][!//
          <IMPLEMENTATION-DATA-TYPE>
            <SHORT-NAME>Can_17_McmCan_IcomConfigType</SHORT-NAME>
            <CATEGORY>STRUCTURE</CATEGORY>
            <SUB-ELEMENTS>
              <IMPLEMENTATION-DATA-TYPE-ELEMENT>
                <SHORT-NAME>CanIcomFirstMsgIndx</SHORT-NAME>
                <CATEGORY>TYPE_REFERENCE</CATEGORY>
                <SW-DATA-DEF-PROPS>
                  <SW-DATA-DEF-PROPS-VARIANTS>
                    <SW-DATA-DEF-PROPS-CONDITIONAL>
                      <IMPLEMENTATION-DATA-TYPE-REF DEST="IMPLEMENTATION-DATA-TYPE">/AUTOSAR_Platform/ImplementationDataTypes/uint16</IMPLEMENTATION-DATA-TYPE-REF>
                    </SW-DATA-DEF-PROPS-CONDITIONAL>
                  </SW-DATA-DEF-PROPS-VARIANTS>
                </SW-DATA-DEF-PROPS>
              </IMPLEMENTATION-DATA-TYPE-ELEMENT>
              <IMPLEMENTATION-DATA-TYPE-ELEMENT>
                <SHORT-NAME>CanIcomNoOfMsgIndx</SHORT-NAME>
                <CATEGORY>TYPE_REFERENCE</CATEGORY>
                <SW-DATA-DEF-PROPS>
                  <SW-DATA-DEF-PROPS-VARIANTS>
                    <SW-DATA-DEF-PROPS-CONDITIONAL>
                      <IMPLEMENTATION-DATA-TYPE-REF DEST="IMPLEMENTATION-DATA-TYPE">/AUTOSAR_Platform/ImplementationDataTypes/uint16</IMPLEMENTATION-DATA-TYPE-REF>
                    </SW-DATA-DEF-PROPS-CONDITIONAL>
                  </SW-DATA-DEF-PROPS-VARIANTS>
                </SW-DATA-DEF-PROPS>
              </IMPLEMENTATION-DATA-TYPE-ELEMENT>
              <IMPLEMENTATION-DATA-TYPE-ELEMENT>
                <SHORT-NAME>CanIcomWakeOnBusOff</SHORT-NAME>
                <CATEGORY>TYPE_REFERENCE</CATEGORY>
                <SW-DATA-DEF-PROPS>
                  <SW-DATA-DEF-PROPS-VARIANTS>
                    <SW-DATA-DEF-PROPS-CONDITIONAL>
                      <IMPLEMENTATION-DATA-TYPE-REF DEST="IMPLEMENTATION-DATA-TYPE">/AUTOSAR_Platform/ImplementationDataTypes/boolean</IMPLEMENTATION-DATA-TYPE-REF>
                    </SW-DATA-DEF-PROPS-CONDITIONAL>
                  </SW-DATA-DEF-PROPS-VARIANTS>
                </SW-DATA-DEF-PROPS>
              </IMPLEMENTATION-DATA-TYPE-ELEMENT>
            </SUB-ELEMENTS>
            <TYPE-EMITTER>BSW</TYPE-EMITTER>
          </IMPLEMENTATION-DATA-TYPE>
          <IMPLEMENTATION-DATA-TYPE>
            <SHORT-NAME>Can_17_McmCan_IcomRxMsgConfigType</SHORT-NAME>
            <CATEGORY>STRUCTURE</CATEGORY>
            <SUB-ELEMENTS>
              <IMPLEMENTATION-DATA-TYPE-ELEMENT>
                <SHORT-NAME>CanIcomMsgId</SHORT-NAME>
                <CATEGORY>TYPE_REFERENCE</CATEGORY>
                <SW-DATA-DEF-PROPS>
                  <SW-DATA-DEF-PROPS-VARIANTS>
                    <SW-DATA-DEF-PROPS-CONDITIONAL>
                      <IMPLEMENTATION-DATA-TYPE-REF DEST="IMPLEMENTATION-DATA-TYPE">/AUTOSAR_Can_GeneralTypes/ImplementationDataTypes/Can_IdType</IMPLEMENTATION-DATA-TYPE-REF>
                    </SW-DATA-DEF-PROPS-CONDITIONAL>
                  </SW-DATA-DEF-PROPS-VARIANTS>
                </SW-DATA-DEF-PROPS>
              </IMPLEMENTATION-DATA-TYPE-ELEMENT>
              <IMPLEMENTATION-DATA-TYPE-ELEMENT>
                <SHORT-NAME>CanIcomMaskRef</SHORT-NAME>
                <CATEGORY>TYPE_REFERENCE</CATEGORY>
                <SW-DATA-DEF-PROPS>
                  <SW-DATA-DEF-PROPS-VARIANTS>
                    <SW-DATA-DEF-PROPS-CONDITIONAL>
                      <IMPLEMENTATION-DATA-TYPE-REF DEST="IMPLEMENTATION-DATA-TYPE">/AUTOSAR_Can_GeneralTypes/ImplementationDataTypes/Can_IdType</IMPLEMENTATION-DATA-TYPE-REF>
                    </SW-DATA-DEF-PROPS-CONDITIONAL>
                  </SW-DATA-DEF-PROPS-VARIANTS>
                </SW-DATA-DEF-PROPS>
              </IMPLEMENTATION-DATA-TYPE-ELEMENT>
              <IMPLEMENTATION-DATA-TYPE-ELEMENT>
                <SHORT-NAME>CanIcomCntrVal</SHORT-NAME>
                <CATEGORY>TYPE_REFERENCE</CATEGORY>
                <SW-DATA-DEF-PROPS>
                  <SW-DATA-DEF-PROPS-VARIANTS>
                    <SW-DATA-DEF-PROPS-CONDITIONAL>
                      <IMPLEMENTATION-DATA-TYPE-REF DEST="IMPLEMENTATION-DATA-TYPE">/AUTOSAR_Platform/ImplementationDataTypes/uint16</IMPLEMENTATION-DATA-TYPE-REF>
                    </SW-DATA-DEF-PROPS-CONDITIONAL>
                  </SW-DATA-DEF-PROPS-VARIANTS>
                </SW-DATA-DEF-PROPS>
              </IMPLEMENTATION-DATA-TYPE-ELEMENT>
              <IMPLEMENTATION-DATA-TYPE-ELEMENT>
                <SHORT-NAME>CanIcomDLC</SHORT-NAME>
                <CATEGORY>TYPE_REFERENCE</CATEGORY>
                <SW-DATA-DEF-PROPS>
                  <SW-DATA-DEF-PROPS-VARIANTS>
                    <SW-DATA-DEF-PROPS-CONDITIONAL>
                      <IMPLEMENTATION-DATA-TYPE-REF DEST="IMPLEMENTATION-DATA-TYPE">/AUTOSAR_Platform/ImplementationDataTypes/uint8</IMPLEMENTATION-DATA-TYPE-REF>
                    </SW-DATA-DEF-PROPS-CONDITIONAL>
                  </SW-DATA-DEF-PROPS-VARIANTS>
                </SW-DATA-DEF-PROPS>
              </IMPLEMENTATION-DATA-TYPE-ELEMENT>
              <IMPLEMENTATION-DATA-TYPE-ELEMENT>
                <SHORT-NAME>CanIcomFirstSignalIndx</SHORT-NAME>
                <CATEGORY>TYPE_REFERENCE</CATEGORY>
                <SW-DATA-DEF-PROPS>
                  <SW-DATA-DEF-PROPS-VARIANTS>
                    <SW-DATA-DEF-PROPS-CONDITIONAL>
                      <IMPLEMENTATION-DATA-TYPE-REF DEST="IMPLEMENTATION-DATA-TYPE">/AUTOSAR_Platform/ImplementationDataTypes/uint8</IMPLEMENTATION-DATA-TYPE-REF>
                    </SW-DATA-DEF-PROPS-CONDITIONAL>
                  </SW-DATA-DEF-PROPS-VARIANTS>
                </SW-DATA-DEF-PROPS>
              </IMPLEMENTATION-DATA-TYPE-ELEMENT>
              <IMPLEMENTATION-DATA-TYPE-ELEMENT>
                <SHORT-NAME>CanIcomNoOfSignalIndx</SHORT-NAME>
                <CATEGORY>TYPE_REFERENCE</CATEGORY>
                <SW-DATA-DEF-PROPS>
                  <SW-DATA-DEF-PROPS-VARIANTS>
                    <SW-DATA-DEF-PROPS-CONDITIONAL>
                      <IMPLEMENTATION-DATA-TYPE-REF DEST="IMPLEMENTATION-DATA-TYPE">/AUTOSAR_Platform/ImplementationDataTypes/uint8</IMPLEMENTATION-DATA-TYPE-REF>
                    </SW-DATA-DEF-PROPS-CONDITIONAL>
                  </SW-DATA-DEF-PROPS-VARIANTS>
                </SW-DATA-DEF-PROPS>
              </IMPLEMENTATION-DATA-TYPE-ELEMENT>
              <IMPLEMENTATION-DATA-TYPE-ELEMENT>
                <SHORT-NAME>CanIcomLengthErr</SHORT-NAME>
                <CATEGORY>TYPE_REFERENCE</CATEGORY>
                <SW-DATA-DEF-PROPS>
                  <SW-DATA-DEF-PROPS-VARIANTS>
                    <SW-DATA-DEF-PROPS-CONDITIONAL>
                      <IMPLEMENTATION-DATA-TYPE-REF DEST="IMPLEMENTATION-DATA-TYPE">/AUTOSAR_Platform/ImplementationDataTypes/boolean</IMPLEMENTATION-DATA-TYPE-REF>
                    </SW-DATA-DEF-PROPS-CONDITIONAL>
                  </SW-DATA-DEF-PROPS-VARIANTS>
                </SW-DATA-DEF-PROPS>
              </IMPLEMENTATION-DATA-TYPE-ELEMENT>
            </SUB-ELEMENTS>
            <TYPE-EMITTER>BSW</TYPE-EMITTER>
          </IMPLEMENTATION-DATA-TYPE>
      <IMPLEMENTATION-DATA-TYPE>
      <SHORT-NAME>Can_17_McmCan_IcomRxMsgSignalConfigType</SHORT-NAME>
      <CATEGORY>STRUCTURE</CATEGORY>
      <SUB-ELEMENTS>
        <IMPLEMENTATION-DATA-TYPE-ELEMENT>
          <SHORT-NAME>CanIcomSignalMask</SHORT-NAME>
          <CATEGORY>TYPE_REFERENCE</CATEGORY>
          <ARRAY-SIZE>8</ARRAY-SIZE>
          <ARRAY-SIZE-SEMANTICS>FIXED-SIZE</ARRAY-SIZE-SEMANTICS>
          <SW-DATA-DEF-PROPS>
            <SW-DATA-DEF-PROPS-VARIANTS>
              <SW-DATA-DEF-PROPS-CONDITIONAL>
                <IMPLEMENTATION-DATA-TYPE-REF DEST="IMPLEMENTATION-DATA-TYPE">/AUTOSAR_Platform/ImplementationDataTypes/uint8</IMPLEMENTATION-DATA-TYPE-REF>
              </SW-DATA-DEF-PROPS-CONDITIONAL>
            </SW-DATA-DEF-PROPS-VARIANTS>
          </SW-DATA-DEF-PROPS>
        </IMPLEMENTATION-DATA-TYPE-ELEMENT>
        <IMPLEMENTATION-DATA-TYPE-ELEMENT>
          <SHORT-NAME>CanIcomSignalValue</SHORT-NAME>
          <CATEGORY>TYPE_REFERENCE</CATEGORY>
          <ARRAY-SIZE>8</ARRAY-SIZE>
          <ARRAY-SIZE-SEMANTICS>FIXED-SIZE</ARRAY-SIZE-SEMANTICS>
          <SW-DATA-DEF-PROPS>
            <SW-DATA-DEF-PROPS-VARIANTS>
              <SW-DATA-DEF-PROPS-CONDITIONAL>
                <IMPLEMENTATION-DATA-TYPE-REF DEST="IMPLEMENTATION-DATA-TYPE">/AUTOSAR_Platform/ImplementationDataTypes/uint8</IMPLEMENTATION-DATA-TYPE-REF>
              </SW-DATA-DEF-PROPS-CONDITIONAL>
            </SW-DATA-DEF-PROPS-VARIANTS>
          </SW-DATA-DEF-PROPS>
        </IMPLEMENTATION-DATA-TYPE-ELEMENT>
        <IMPLEMENTATION-DATA-TYPE-ELEMENT>
          <SHORT-NAME>CanIcomSignalOper</SHORT-NAME>
          <CATEGORY>TYPE_REFERENCE</CATEGORY>
          <SW-DATA-DEF-PROPS>
            <SW-DATA-DEF-PROPS-VARIANTS>
              <SW-DATA-DEF-PROPS-CONDITIONAL>
                <IMPLEMENTATION-DATA-TYPE-REF DEST="IMPLEMENTATION-DATA-TYPE">/AUTOSAR_Can_17_McmCan/ImplementationDataTypes/Can_17_McmCan_IcomSignalOperType</IMPLEMENTATION-DATA-TYPE-REF>
              </SW-DATA-DEF-PROPS-CONDITIONAL>
            </SW-DATA-DEF-PROPS-VARIANTS>
          </SW-DATA-DEF-PROPS>
        </IMPLEMENTATION-DATA-TYPE-ELEMENT>
      </SUB-ELEMENTS>
      <TYPE-EMITTER>BSW</TYPE-EMITTER>
    </IMPLEMENTATION-DATA-TYPE>
[!ENDIF!][!//
          <IMPLEMENTATION-DATA-TYPE>
              <SHORT-NAME>Can_17_McmCan_McmModuleConfigType</SHORT-NAME>
              <CATEGORY>STRUCTURE</CATEGORY>
              <SUB-ELEMENTS>
                <IMPLEMENTATION-DATA-TYPE-ELEMENT>
                <SHORT-NAME>CanBaseAddressPtr</SHORT-NAME>
                <CATEGORY>TYPE_REFERENCE</CATEGORY>
                <SW-DATA-DEF-PROPS>
                  <SW-DATA-DEF-PROPS-VARIANTS>
                    <SW-DATA-DEF-PROPS-CONDITIONAL>
                      <IMPLEMENTATION-DATA-TYPE-REF DEST="IMPLEMENTATION-DATA-TYPE">/AUTOSAR_Platform/ImplementationDataTypes/uint32</IMPLEMENTATION-DATA-TYPE-REF>
                    </SW-DATA-DEF-PROPS-CONDITIONAL>
                  </SW-DATA-DEF-PROPS-VARIANTS>
                </SW-DATA-DEF-PROPS>
              </IMPLEMENTATION-DATA-TYPE-ELEMENT>
                <IMPLEMENTATION-DATA-TYPE-ELEMENT>
                  <SHORT-NAME>CanUsedHwCfgIndx</SHORT-NAME>
                  <CATEGORY>TYPE_REFERENCE</CATEGORY>
                  <ARRAY-SIZE> [!"$MaxController"!]</ARRAY-SIZE>
                  <ARRAY-SIZE-SEMANTICS>FIXED-SIZE</ARRAY-SIZE-SEMANTICS>
                  <SW-DATA-DEF-PROPS>
                    <SW-DATA-DEF-PROPS-VARIANTS>
                      <SW-DATA-DEF-PROPS-CONDITIONAL>
                        <IMPLEMENTATION-DATA-TYPE-REF DEST="IMPLEMENTATION-DATA-TYPE">/AUTOSAR_Platform/ImplementationDataTypes/boolean</IMPLEMENTATION-DATA-TYPE-REF>
                      </SW-DATA-DEF-PROPS-CONDITIONAL>
                    </SW-DATA-DEF-PROPS-VARIANTS>
                  </SW-DATA-DEF-PROPS>
                </IMPLEMENTATION-DATA-TYPE-ELEMENT>
              </SUB-ELEMENTS>
              <TYPE-EMITTER>BSW</TYPE-EMITTER>
          </IMPLEMENTATION-DATA-TYPE>
          <IMPLEMENTATION-DATA-TYPE>
            <SHORT-NAME>Can_17_McmCan_ControllerMsgRAMConfigType</SHORT-NAME>
            <CATEGORY>STRUCTURE</CATEGORY>
            <SUB-ELEMENTS>
              <IMPLEMENTATION-DATA-TYPE-ELEMENT>
                <SHORT-NAME>CanControllerMsgRAMMap</SHORT-NAME>
                <CATEGORY>TYPE_REFERENCE</CATEGORY>
                <ARRAY-SIZE>7</ARRAY-SIZE>
                <ARRAY-SIZE-SEMANTICS>FIXED-SIZE</ARRAY-SIZE-SEMANTICS>
                <SW-DATA-DEF-PROPS>
                  <SW-DATA-DEF-PROPS-VARIANTS>
                    <SW-DATA-DEF-PROPS-CONDITIONAL>
                      <IMPLEMENTATION-DATA-TYPE-REF DEST="IMPLEMENTATION-DATA-TYPE">/AUTOSAR_Platform/ImplementationDataTypes/uint32</IMPLEMENTATION-DATA-TYPE-REF>
                    </SW-DATA-DEF-PROPS-CONDITIONAL>
                  </SW-DATA-DEF-PROPS-VARIANTS>
                </SW-DATA-DEF-PROPS>
              </IMPLEMENTATION-DATA-TYPE-ELEMENT>
              <IMPLEMENTATION-DATA-TYPE-ELEMENT>
                <SHORT-NAME>CanTxDedBuffCount</SHORT-NAME>
                <CATEGORY>TYPE_REFERENCE</CATEGORY>
                <SW-DATA-DEF-PROPS>
                  <SW-DATA-DEF-PROPS-VARIANTS>
                    <SW-DATA-DEF-PROPS-CONDITIONAL>
                      <IMPLEMENTATION-DATA-TYPE-REF DEST="IMPLEMENTATION-DATA-TYPE">/AUTOSAR_Platform/ImplementationDataTypes/uint8</IMPLEMENTATION-DATA-TYPE-REF>
                    </SW-DATA-DEF-PROPS-CONDITIONAL>
                  </SW-DATA-DEF-PROPS-VARIANTS>
                </SW-DATA-DEF-PROPS>
              </IMPLEMENTATION-DATA-TYPE-ELEMENT>
              <IMPLEMENTATION-DATA-TYPE-ELEMENT>
                <SHORT-NAME>CanTxEvntFIFOSize</SHORT-NAME>
                <CATEGORY>TYPE_REFERENCE</CATEGORY>
                <SW-DATA-DEF-PROPS>
                  <SW-DATA-DEF-PROPS-VARIANTS>
                    <SW-DATA-DEF-PROPS-CONDITIONAL>
                      <IMPLEMENTATION-DATA-TYPE-REF DEST="IMPLEMENTATION-DATA-TYPE">/AUTOSAR_Platform/ImplementationDataTypes/uint8</IMPLEMENTATION-DATA-TYPE-REF>
                    </SW-DATA-DEF-PROPS-CONDITIONAL>
                  </SW-DATA-DEF-PROPS-VARIANTS>
                </SW-DATA-DEF-PROPS>
              </IMPLEMENTATION-DATA-TYPE-ELEMENT>
              <IMPLEMENTATION-DATA-TYPE-ELEMENT>
                <SHORT-NAME>CanRxFIFO0Size</SHORT-NAME>
                <CATEGORY>TYPE_REFERENCE</CATEGORY>
                <SW-DATA-DEF-PROPS>
                  <SW-DATA-DEF-PROPS-VARIANTS>
                    <SW-DATA-DEF-PROPS-CONDITIONAL>
                      <IMPLEMENTATION-DATA-TYPE-REF DEST="IMPLEMENTATION-DATA-TYPE">/AUTOSAR_Platform/ImplementationDataTypes/uint8</IMPLEMENTATION-DATA-TYPE-REF>
                    </SW-DATA-DEF-PROPS-CONDITIONAL>
                  </SW-DATA-DEF-PROPS-VARIANTS>
                </SW-DATA-DEF-PROPS>
              </IMPLEMENTATION-DATA-TYPE-ELEMENT>
              <IMPLEMENTATION-DATA-TYPE-ELEMENT>
                <SHORT-NAME>CanRxFIFO0Threshold</SHORT-NAME>
                <CATEGORY>TYPE_REFERENCE</CATEGORY>
                <SW-DATA-DEF-PROPS>
                  <SW-DATA-DEF-PROPS-VARIANTS>
                    <SW-DATA-DEF-PROPS-CONDITIONAL>
                      <IMPLEMENTATION-DATA-TYPE-REF DEST="IMPLEMENTATION-DATA-TYPE">/AUTOSAR_Platform/ImplementationDataTypes/uint8</IMPLEMENTATION-DATA-TYPE-REF>
                    </SW-DATA-DEF-PROPS-CONDITIONAL>
                  </SW-DATA-DEF-PROPS-VARIANTS>
                </SW-DATA-DEF-PROPS>
              </IMPLEMENTATION-DATA-TYPE-ELEMENT>
              <IMPLEMENTATION-DATA-TYPE-ELEMENT>
                <SHORT-NAME>CanRxFIFO1Size</SHORT-NAME>
                <CATEGORY>TYPE_REFERENCE</CATEGORY>
                <SW-DATA-DEF-PROPS>
                  <SW-DATA-DEF-PROPS-VARIANTS>
                    <SW-DATA-DEF-PROPS-CONDITIONAL>
                      <IMPLEMENTATION-DATA-TYPE-REF DEST="IMPLEMENTATION-DATA-TYPE">/AUTOSAR_Platform/ImplementationDataTypes/uint8</IMPLEMENTATION-DATA-TYPE-REF>
                    </SW-DATA-DEF-PROPS-CONDITIONAL>
                  </SW-DATA-DEF-PROPS-VARIANTS>
                </SW-DATA-DEF-PROPS>
              </IMPLEMENTATION-DATA-TYPE-ELEMENT>
              <IMPLEMENTATION-DATA-TYPE-ELEMENT>
                <SHORT-NAME>CanRxFIFO1Threshold</SHORT-NAME>
                <CATEGORY>TYPE_REFERENCE</CATEGORY>
                <SW-DATA-DEF-PROPS>
                  <SW-DATA-DEF-PROPS-VARIANTS>
                    <SW-DATA-DEF-PROPS-CONDITIONAL>
                      <IMPLEMENTATION-DATA-TYPE-REF DEST="IMPLEMENTATION-DATA-TYPE">/AUTOSAR_Platform/ImplementationDataTypes/uint8</IMPLEMENTATION-DATA-TYPE-REF>
                    </SW-DATA-DEF-PROPS-CONDITIONAL>
                  </SW-DATA-DEF-PROPS-VARIANTS>
                </SW-DATA-DEF-PROPS>
              </IMPLEMENTATION-DATA-TYPE-ELEMENT>
[!IF "../CanGeneral/CanMultiplexedTransmission = 'true'"!][!//
              <IMPLEMENTATION-DATA-TYPE-ELEMENT>
                <SHORT-NAME>CanTxQueueSize</SHORT-NAME>
                <CATEGORY>TYPE_REFERENCE</CATEGORY>
                <SW-DATA-DEF-PROPS>
                  <SW-DATA-DEF-PROPS-VARIANTS>
                    <SW-DATA-DEF-PROPS-CONDITIONAL>
                      <IMPLEMENTATION-DATA-TYPE-REF DEST="IMPLEMENTATION-DATA-TYPE">/AUTOSAR_Platform/ImplementationDataTypes/uint8</IMPLEMENTATION-DATA-TYPE-REF>
                    </SW-DATA-DEF-PROPS-CONDITIONAL>
                  </SW-DATA-DEF-PROPS-VARIANTS>
                </SW-DATA-DEF-PROPS>
              </IMPLEMENTATION-DATA-TYPE-ELEMENT>
              <IMPLEMENTATION-DATA-TYPE-ELEMENT>
                <SHORT-NAME>CanTxQueueStatus</SHORT-NAME>
                <CATEGORY>TYPE_REFERENCE</CATEGORY>
                <SW-DATA-DEF-PROPS>
                  <SW-DATA-DEF-PROPS-VARIANTS>
                    <SW-DATA-DEF-PROPS-CONDITIONAL>
                      <IMPLEMENTATION-DATA-TYPE-REF DEST="IMPLEMENTATION-DATA-TYPE">/AUTOSAR_Platform/ImplementationDataTypes/boolean</IMPLEMENTATION-DATA-TYPE-REF>
                    </SW-DATA-DEF-PROPS-CONDITIONAL>
                  </SW-DATA-DEF-PROPS-VARIANTS>
                </SW-DATA-DEF-PROPS>
              </IMPLEMENTATION-DATA-TYPE-ELEMENT>
[!ENDIF!][!//
            </SUB-ELEMENTS>
            <TYPE-EMITTER>BSW</TYPE-EMITTER>
          </IMPLEMENTATION-DATA-TYPE>
          [!IF "$FDNodesPresentVal = 0"!][!//
          <IMPLEMENTATION-DATA-TYPE>
             <SHORT-NAME>Can_17_McmCan_ControllerFDBaudrateConfigType</SHORT-NAME>
             <CATEGORY>STRUCTURE</CATEGORY>
             <SUB-ELEMENTS>
              <IMPLEMENTATION-DATA-TYPE-ELEMENT>
                <SHORT-NAME>CanControllerFDBaudrate</SHORT-NAME>
                <CATEGORY>TYPE_REFERENCE</CATEGORY>
                <SW-DATA-DEF-PROPS>
                  <SW-DATA-DEF-PROPS-VARIANTS>
                    <SW-DATA-DEF-PROPS-CONDITIONAL>
                      <IMPLEMENTATION-DATA-TYPE-REF DEST="IMPLEMENTATION-DATA-TYPE">/AUTOSAR_Platform/ImplementationDataTypes/uint32</IMPLEMENTATION-DATA-TYPE-REF>
                    </SW-DATA-DEF-PROPS-CONDITIONAL>
                  </SW-DATA-DEF-PROPS-VARIANTS>
                </SW-DATA-DEF-PROPS>
              </IMPLEMENTATION-DATA-TYPE-ELEMENT>
              <IMPLEMENTATION-DATA-TYPE-ELEMENT>
                <SHORT-NAME>CanTrcvDelyComp</SHORT-NAME>
                <CATEGORY>TYPE_REFERENCE</CATEGORY>
                <SW-DATA-DEF-PROPS>
                  <SW-DATA-DEF-PROPS-VARIANTS>
                    <SW-DATA-DEF-PROPS-CONDITIONAL>
                      <IMPLEMENTATION-DATA-TYPE-REF DEST="IMPLEMENTATION-DATA-TYPE">/AUTOSAR_Platform/ImplementationDataTypes/uint32</IMPLEMENTATION-DATA-TYPE-REF>
                    </SW-DATA-DEF-PROPS-CONDITIONAL>
                  </SW-DATA-DEF-PROPS-VARIANTS>
                </SW-DATA-DEF-PROPS>
              </IMPLEMENTATION-DATA-TYPE-ELEMENT>
              <IMPLEMENTATION-DATA-TYPE-ELEMENT>
                <SHORT-NAME>CanTxBRSEnable</SHORT-NAME>
                <CATEGORY>TYPE_REFERENCE</CATEGORY>
                <SW-DATA-DEF-PROPS>
                  <SW-DATA-DEF-PROPS-VARIANTS>
                    <SW-DATA-DEF-PROPS-CONDITIONAL>
                      <IMPLEMENTATION-DATA-TYPE-REF DEST="IMPLEMENTATION-DATA-TYPE">/AUTOSAR_Platform/ImplementationDataTypes/boolean</IMPLEMENTATION-DATA-TYPE-REF>
                    </SW-DATA-DEF-PROPS-CONDITIONAL>
                  </SW-DATA-DEF-PROPS-VARIANTS>
                </SW-DATA-DEF-PROPS>
              </IMPLEMENTATION-DATA-TYPE-ELEMENT>
             </SUB-ELEMENTS>
             <TYPE-EMITTER>BSW</TYPE-EMITTER>
            </IMPLEMENTATION-DATA-TYPE>
            [!ENDIF!][!//
          <IMPLEMENTATION-DATA-TYPE>
      <SHORT-NAME>Can_17_McmCan_SIDFilterConfigType</SHORT-NAME>
      <CATEGORY>STRUCTURE</CATEGORY>
      <SUB-ELEMENTS>
        <IMPLEMENTATION-DATA-TYPE-ELEMENT>
          <SHORT-NAME>CanSIDFiltEleS0</SHORT-NAME>
          <CATEGORY>TYPE_REFERENCE</CATEGORY>
          <SW-DATA-DEF-PROPS>
            <SW-DATA-DEF-PROPS-VARIANTS>
              <SW-DATA-DEF-PROPS-CONDITIONAL>
                <IMPLEMENTATION-DATA-TYPE-REF DEST="IMPLEMENTATION-DATA-TYPE">/AUTOSAR_Platform/ImplementationDataTypes/uint32</IMPLEMENTATION-DATA-TYPE-REF>
              </SW-DATA-DEF-PROPS-CONDITIONAL>
            </SW-DATA-DEF-PROPS-VARIANTS>
          </SW-DATA-DEF-PROPS>
        </IMPLEMENTATION-DATA-TYPE-ELEMENT>
        <IMPLEMENTATION-DATA-TYPE-ELEMENT>
          <SHORT-NAME>CanSidHwObjId</SHORT-NAME>
          <CATEGORY>TYPE_REFERENCE</CATEGORY>
          <SW-DATA-DEF-PROPS>
            <SW-DATA-DEF-PROPS-VARIANTS>
              <SW-DATA-DEF-PROPS-CONDITIONAL>
                <IMPLEMENTATION-DATA-TYPE-REF DEST="IMPLEMENTATION-DATA-TYPE">/AUTOSAR_Can_GeneralTypes/ImplementationDataTypes/Can_HwHandleType</IMPLEMENTATION-DATA-TYPE-REF>
              </SW-DATA-DEF-PROPS-CONDITIONAL>
            </SW-DATA-DEF-PROPS-VARIANTS>
          </SW-DATA-DEF-PROPS>
        </IMPLEMENTATION-DATA-TYPE-ELEMENT>
        <IMPLEMENTATION-DATA-TYPE-ELEMENT>
              <SHORT-NAME>HwControllerId</SHORT-NAME>
              <CATEGORY>TYPE_REFERENCE</CATEGORY>
              <SW-DATA-DEF-PROPS>
                <SW-DATA-DEF-PROPS-VARIANTS>
                  <SW-DATA-DEF-PROPS-CONDITIONAL>
                    <IMPLEMENTATION-DATA-TYPE-REF DEST="IMPLEMENTATION-DATA-TYPE">/AUTOSAR_Platform/ImplementationDataTypes/uint8</IMPLEMENTATION-DATA-TYPE-REF>
                  </SW-DATA-DEF-PROPS-CONDITIONAL>
                </SW-DATA-DEF-PROPS-VARIANTS>
              </SW-DATA-DEF-PROPS>
            </IMPLEMENTATION-DATA-TYPE-ELEMENT>
            <IMPLEMENTATION-DATA-TYPE-ELEMENT>
              <SHORT-NAME>CanSidBufferType</SHORT-NAME>
              <CATEGORY>TYPE_REFERENCE</CATEGORY>
              <SW-DATA-DEF-PROPS>
                <SW-DATA-DEF-PROPS-VARIANTS>
                  <SW-DATA-DEF-PROPS-CONDITIONAL>
                    <IMPLEMENTATION-DATA-TYPE-REF DEST="IMPLEMENTATION-DATA-TYPE">/AUTOSAR_Can_17_McmCan/ImplementationDataTypes/Can_17_McmCan_RxBufferType</IMPLEMENTATION-DATA-TYPE-REF>
                  </SW-DATA-DEF-PROPS-CONDITIONAL>
                </SW-DATA-DEF-PROPS-VARIANTS>
              </SW-DATA-DEF-PROPS>
            </IMPLEMENTATION-DATA-TYPE-ELEMENT>
[!IF "../CanGeneral/CanPublicIcomSupport = 'true'"!][!//
            <IMPLEMENTATION-DATA-TYPE-ELEMENT>
              <SHORT-NAME>CanSidPNSupport</SHORT-NAME>
              <CATEGORY>TYPE_REFERENCE</CATEGORY>
              <SW-DATA-DEF-PROPS>
                <SW-DATA-DEF-PROPS-VARIANTS>
                  <SW-DATA-DEF-PROPS-CONDITIONAL>
                    <IMPLEMENTATION-DATA-TYPE-REF DEST="IMPLEMENTATION-DATA-TYPE">/AUTOSAR_Platform/ImplementationDataTypes/boolean</IMPLEMENTATION-DATA-TYPE-REF>
                  </SW-DATA-DEF-PROPS-CONDITIONAL>
                </SW-DATA-DEF-PROPS-VARIANTS>
              </SW-DATA-DEF-PROPS>
            </IMPLEMENTATION-DATA-TYPE-ELEMENT>
[!ENDIF!][!//
            </SUB-ELEMENTS>
        <TYPE-EMITTER>BSW</TYPE-EMITTER>
        </IMPLEMENTATION-DATA-TYPE>
            <IMPLEMENTATION-DATA-TYPE>
      <SHORT-NAME>Can_17_McmCan_XIDFilterConfigType</SHORT-NAME>
      <CATEGORY>STRUCTURE</CATEGORY>
      <SUB-ELEMENTS>
        <IMPLEMENTATION-DATA-TYPE-ELEMENT>
          <SHORT-NAME>CanXIDFiltEleF0</SHORT-NAME>
          <CATEGORY>TYPE_REFERENCE</CATEGORY>
          <SW-DATA-DEF-PROPS>
            <SW-DATA-DEF-PROPS-VARIANTS>
              <SW-DATA-DEF-PROPS-CONDITIONAL>
                <IMPLEMENTATION-DATA-TYPE-REF DEST="IMPLEMENTATION-DATA-TYPE">/AUTOSAR_Platform/ImplementationDataTypes/uint32</IMPLEMENTATION-DATA-TYPE-REF>
              </SW-DATA-DEF-PROPS-CONDITIONAL>
            </SW-DATA-DEF-PROPS-VARIANTS>
          </SW-DATA-DEF-PROPS>
        </IMPLEMENTATION-DATA-TYPE-ELEMENT>
        <IMPLEMENTATION-DATA-TYPE-ELEMENT>
          <SHORT-NAME>CanXIDFiltEleF1</SHORT-NAME>
          <CATEGORY>TYPE_REFERENCE</CATEGORY>
          <SW-DATA-DEF-PROPS>
            <SW-DATA-DEF-PROPS-VARIANTS>
              <SW-DATA-DEF-PROPS-CONDITIONAL>
                <IMPLEMENTATION-DATA-TYPE-REF DEST="IMPLEMENTATION-DATA-TYPE">/AUTOSAR_Platform/ImplementationDataTypes/uint32</IMPLEMENTATION-DATA-TYPE-REF>
              </SW-DATA-DEF-PROPS-CONDITIONAL>
            </SW-DATA-DEF-PROPS-VARIANTS>
          </SW-DATA-DEF-PROPS>
        </IMPLEMENTATION-DATA-TYPE-ELEMENT>
        <IMPLEMENTATION-DATA-TYPE-ELEMENT>
          <SHORT-NAME>CanXidHwObjId</SHORT-NAME>
          <CATEGORY>TYPE_REFERENCE</CATEGORY>
          <SW-DATA-DEF-PROPS>
            <SW-DATA-DEF-PROPS-VARIANTS>
              <SW-DATA-DEF-PROPS-CONDITIONAL>
                <IMPLEMENTATION-DATA-TYPE-REF DEST="IMPLEMENTATION-DATA-TYPE">/AUTOSAR_Can_GeneralTypes/ImplementationDataTypes/Can_HwHandleType</IMPLEMENTATION-DATA-TYPE-REF>
              </SW-DATA-DEF-PROPS-CONDITIONAL>
            </SW-DATA-DEF-PROPS-VARIANTS>
          </SW-DATA-DEF-PROPS>
        </IMPLEMENTATION-DATA-TYPE-ELEMENT>
        <IMPLEMENTATION-DATA-TYPE-ELEMENT>
          <SHORT-NAME>HwControllerId</SHORT-NAME>
          <CATEGORY>TYPE_REFERENCE</CATEGORY>
          <SW-DATA-DEF-PROPS>
            <SW-DATA-DEF-PROPS-VARIANTS>
              <SW-DATA-DEF-PROPS-CONDITIONAL>
                <IMPLEMENTATION-DATA-TYPE-REF DEST="IMPLEMENTATION-DATA-TYPE">/AUTOSAR_Platform/ImplementationDataTypes/uint8</IMPLEMENTATION-DATA-TYPE-REF>
              </SW-DATA-DEF-PROPS-CONDITIONAL>
            </SW-DATA-DEF-PROPS-VARIANTS>
          </SW-DATA-DEF-PROPS>
        </IMPLEMENTATION-DATA-TYPE-ELEMENT>
        <IMPLEMENTATION-DATA-TYPE-ELEMENT>
          <SHORT-NAME>CanXidBufferType</SHORT-NAME>
          <CATEGORY>TYPE_REFERENCE</CATEGORY>
          <SW-DATA-DEF-PROPS>
            <SW-DATA-DEF-PROPS-VARIANTS>
              <SW-DATA-DEF-PROPS-CONDITIONAL>
                <IMPLEMENTATION-DATA-TYPE-REF DEST="IMPLEMENTATION-DATA-TYPE">/AUTOSAR_Can_17_McmCan/ImplementationDataTypes/Can_17_McmCan_RxBufferType</IMPLEMENTATION-DATA-TYPE-REF>
              </SW-DATA-DEF-PROPS-CONDITIONAL>
            </SW-DATA-DEF-PROPS-VARIANTS>
          </SW-DATA-DEF-PROPS>
        </IMPLEMENTATION-DATA-TYPE-ELEMENT>
[!IF "../CanGeneral/CanPublicIcomSupport = 'true'"!][!//
        <IMPLEMENTATION-DATA-TYPE-ELEMENT>
          <SHORT-NAME>CanXidPNSupport</SHORT-NAME>
          <CATEGORY>TYPE_REFERENCE</CATEGORY>
          <SW-DATA-DEF-PROPS>
            <SW-DATA-DEF-PROPS-VARIANTS>
              <SW-DATA-DEF-PROPS-CONDITIONAL>
                <IMPLEMENTATION-DATA-TYPE-REF DEST="IMPLEMENTATION-DATA-TYPE">/AUTOSAR_Platform/ImplementationDataTypes/boolean</IMPLEMENTATION-DATA-TYPE-REF>
              </SW-DATA-DEF-PROPS-CONDITIONAL>
            </SW-DATA-DEF-PROPS-VARIANTS>
          </SW-DATA-DEF-PROPS>
        </IMPLEMENTATION-DATA-TYPE-ELEMENT>
[!ENDIF!][!//
      </SUB-ELEMENTS>
      <TYPE-EMITTER>BSW</TYPE-EMITTER>
    </IMPLEMENTATION-DATA-TYPE>
         <IMPLEMENTATION-DATA-TYPE>
          <SHORT-NAME>Can_17_McmCan_TxHwObjectConfigType</SHORT-NAME>
          <CATEGORY>STRUCTURE</CATEGORY>
          <SUB-ELEMENTS>
            <IMPLEMENTATION-DATA-TYPE-ELEMENT>
              <SHORT-NAME>CanTxHwObjId</SHORT-NAME>
              <CATEGORY>TYPE_REFERENCE</CATEGORY>
              <SW-DATA-DEF-PROPS>
                <SW-DATA-DEF-PROPS-VARIANTS>
                  <SW-DATA-DEF-PROPS-CONDITIONAL>
                    <IMPLEMENTATION-DATA-TYPE-REF DEST="IMPLEMENTATION-DATA-TYPE">/AUTOSAR_Can_GeneralTypes/ImplementationDataTypes/Can_HwHandleType</IMPLEMENTATION-DATA-TYPE-REF>
                  </SW-DATA-DEF-PROPS-CONDITIONAL>
                </SW-DATA-DEF-PROPS-VARIANTS>
              </SW-DATA-DEF-PROPS>
            </IMPLEMENTATION-DATA-TYPE-ELEMENT>
            <IMPLEMENTATION-DATA-TYPE-ELEMENT>
              <SHORT-NAME>CanTxBuffIndx</SHORT-NAME>
              <CATEGORY>TYPE_REFERENCE</CATEGORY>
              <SW-DATA-DEF-PROPS>
                <SW-DATA-DEF-PROPS-VARIANTS>
                  <SW-DATA-DEF-PROPS-CONDITIONAL>
                    <IMPLEMENTATION-DATA-TYPE-REF DEST="IMPLEMENTATION-DATA-TYPE">/AUTOSAR_Platform/ImplementationDataTypes/uint8</IMPLEMENTATION-DATA-TYPE-REF>
                  </SW-DATA-DEF-PROPS-CONDITIONAL>
                </SW-DATA-DEF-PROPS-VARIANTS>
              </SW-DATA-DEF-PROPS>
            </IMPLEMENTATION-DATA-TYPE-ELEMENT>
            <IMPLEMENTATION-DATA-TYPE-ELEMENT>
              <SHORT-NAME>HwControllerId</SHORT-NAME>
              <CATEGORY>TYPE_REFERENCE</CATEGORY>
              <SW-DATA-DEF-PROPS>
                <SW-DATA-DEF-PROPS-VARIANTS>
                  <SW-DATA-DEF-PROPS-CONDITIONAL>
                    <IMPLEMENTATION-DATA-TYPE-REF DEST="IMPLEMENTATION-DATA-TYPE">/AUTOSAR_Platform/ImplementationDataTypes/uint8</IMPLEMENTATION-DATA-TYPE-REF>
                  </SW-DATA-DEF-PROPS-CONDITIONAL>
                </SW-DATA-DEF-PROPS-VARIANTS>
              </SW-DATA-DEF-PROPS>
            </IMPLEMENTATION-DATA-TYPE-ELEMENT>
[!IF "$FDNodesPresentVal = 0"!][!//
            <IMPLEMENTATION-DATA-TYPE-ELEMENT>
              <SHORT-NAME>CanFdPaddValue</SHORT-NAME>
              <CATEGORY>TYPE_REFERENCE</CATEGORY>
              <SW-DATA-DEF-PROPS>
                <SW-DATA-DEF-PROPS-VARIANTS>
                  <SW-DATA-DEF-PROPS-CONDITIONAL>
                    <IMPLEMENTATION-DATA-TYPE-REF DEST="IMPLEMENTATION-DATA-TYPE">/AUTOSAR_Platform/ImplementationDataTypes/uint8</IMPLEMENTATION-DATA-TYPE-REF>
                  </SW-DATA-DEF-PROPS-CONDITIONAL>
                </SW-DATA-DEF-PROPS-VARIANTS>
              </SW-DATA-DEF-PROPS>
            </IMPLEMENTATION-DATA-TYPE-ELEMENT>
[!ENDIF!][!//
            <IMPLEMENTATION-DATA-TYPE-ELEMENT>
              <SHORT-NAME>CanTxHwObjIdType</SHORT-NAME>
              <CATEGORY>TYPE_REFERENCE</CATEGORY>
              <SW-DATA-DEF-PROPS>
                <SW-DATA-DEF-PROPS-VARIANTS>
                  <SW-DATA-DEF-PROPS-CONDITIONAL>
                    <IMPLEMENTATION-DATA-TYPE-REF DEST="IMPLEMENTATION-DATA-TYPE">/AUTOSAR_Platform/ImplementationDataTypes/uint8</IMPLEMENTATION-DATA-TYPE-REF>
                  </SW-DATA-DEF-PROPS-CONDITIONAL>
                </SW-DATA-DEF-PROPS-VARIANTS>
              </SW-DATA-DEF-PROPS>
            </IMPLEMENTATION-DATA-TYPE-ELEMENT>
            <IMPLEMENTATION-DATA-TYPE-ELEMENT>
              <SHORT-NAME>CanTxBufferType</SHORT-NAME>
              <CATEGORY>TYPE_REFERENCE</CATEGORY>
              <SW-DATA-DEF-PROPS>
                <SW-DATA-DEF-PROPS-VARIANTS>
                  <SW-DATA-DEF-PROPS-CONDITIONAL>
                    <IMPLEMENTATION-DATA-TYPE-REF DEST="IMPLEMENTATION-DATA-TYPE">/AUTOSAR_Can_17_McmCan/ImplementationDataTypes/Can_17_McmCan_TxBufferType</IMPLEMENTATION-DATA-TYPE-REF>
                  </SW-DATA-DEF-PROPS-CONDITIONAL>
                </SW-DATA-DEF-PROPS-VARIANTS>
              </SW-DATA-DEF-PROPS>
            </IMPLEMENTATION-DATA-TYPE-ELEMENT>
            <IMPLEMENTATION-DATA-TYPE-ELEMENT>
              <SHORT-NAME>CanTrigTxStatus</SHORT-NAME>
              <CATEGORY>TYPE_REFERENCE</CATEGORY>
              <SW-DATA-DEF-PROPS>
                <SW-DATA-DEF-PROPS-VARIANTS>
                  <SW-DATA-DEF-PROPS-CONDITIONAL>
                    <IMPLEMENTATION-DATA-TYPE-REF DEST="IMPLEMENTATION-DATA-TYPE">/AUTOSAR_Platform/ImplementationDataTypes/boolean</IMPLEMENTATION-DATA-TYPE-REF>
                  </SW-DATA-DEF-PROPS-CONDITIONAL>
                </SW-DATA-DEF-PROPS-VARIANTS>
              </SW-DATA-DEF-PROPS>
            </IMPLEMENTATION-DATA-TYPE-ELEMENT>
          </SUB-ELEMENTS>
          <TYPE-EMITTER>BSW</TYPE-EMITTER>
         </IMPLEMENTATION-DATA-TYPE>
        <IMPLEMENTATION-DATA-TYPE>
      <SHORT-NAME>Can_17_McmCan_EventHandlingType</SHORT-NAME>
      <CATEGORY>STRUCTURE</CATEGORY>
      <SUB-ELEMENTS>
        <IMPLEMENTATION-DATA-TYPE-ELEMENT>
          <SHORT-NAME>CanTxProcessing</SHORT-NAME>
          <CATEGORY>TYPE_REFERENCE</CATEGORY>
          <SW-DATA-DEF-PROPS>
            <SW-DATA-DEF-PROPS-VARIANTS>
              <SW-DATA-DEF-PROPS-CONDITIONAL>
                <IMPLEMENTATION-DATA-TYPE-REF DEST="IMPLEMENTATION-DATA-TYPE">/AUTOSAR_Can_17_McmCan/ImplementationDataTypes/Can_17_McmCan_ProcessingType</IMPLEMENTATION-DATA-TYPE-REF>
              </SW-DATA-DEF-PROPS-CONDITIONAL>
            </SW-DATA-DEF-PROPS-VARIANTS>
          </SW-DATA-DEF-PROPS>
        </IMPLEMENTATION-DATA-TYPE-ELEMENT>
        <IMPLEMENTATION-DATA-TYPE-ELEMENT>
          <SHORT-NAME>CanRxProcessing</SHORT-NAME>
          <CATEGORY>TYPE_REFERENCE</CATEGORY>
          <SW-DATA-DEF-PROPS>
            <SW-DATA-DEF-PROPS-VARIANTS>
              <SW-DATA-DEF-PROPS-CONDITIONAL>
                <IMPLEMENTATION-DATA-TYPE-REF DEST="IMPLEMENTATION-DATA-TYPE">/AUTOSAR_Can_17_McmCan/ImplementationDataTypes/Can_17_McmCan_ProcessingType</IMPLEMENTATION-DATA-TYPE-REF>
              </SW-DATA-DEF-PROPS-CONDITIONAL>
            </SW-DATA-DEF-PROPS-VARIANTS>
          </SW-DATA-DEF-PROPS>
        </IMPLEMENTATION-DATA-TYPE-ELEMENT>
        <IMPLEMENTATION-DATA-TYPE-ELEMENT>
          <SHORT-NAME>CanBusoffProcessing</SHORT-NAME>
          <CATEGORY>TYPE_REFERENCE</CATEGORY>
          <SW-DATA-DEF-PROPS>
            <SW-DATA-DEF-PROPS-VARIANTS>
              <SW-DATA-DEF-PROPS-CONDITIONAL>
                <IMPLEMENTATION-DATA-TYPE-REF DEST="IMPLEMENTATION-DATA-TYPE">/AUTOSAR_Can_17_McmCan/ImplementationDataTypes/Can_17_McmCan_ProcessingType</IMPLEMENTATION-DATA-TYPE-REF>
              </SW-DATA-DEF-PROPS-CONDITIONAL>
            </SW-DATA-DEF-PROPS-VARIANTS>
          </SW-DATA-DEF-PROPS>
        </IMPLEMENTATION-DATA-TYPE-ELEMENT>
        <IMPLEMENTATION-DATA-TYPE-ELEMENT>
          <SHORT-NAME>CanWakeupProcessing</SHORT-NAME>
          <CATEGORY>TYPE_REFERENCE</CATEGORY>
          <SW-DATA-DEF-PROPS>
            <SW-DATA-DEF-PROPS-VARIANTS>
              <SW-DATA-DEF-PROPS-CONDITIONAL>
                <IMPLEMENTATION-DATA-TYPE-REF DEST="IMPLEMENTATION-DATA-TYPE">/AUTOSAR_Can_17_McmCan/ImplementationDataTypes/Can_17_McmCan_ProcessingType</IMPLEMENTATION-DATA-TYPE-REF>
              </SW-DATA-DEF-PROPS-CONDITIONAL>
            </SW-DATA-DEF-PROPS-VARIANTS>
          </SW-DATA-DEF-PROPS>
        </IMPLEMENTATION-DATA-TYPE-ELEMENT>
      </SUB-ELEMENTS>
      <TYPE-EMITTER>BSW</TYPE-EMITTER>
    </IMPLEMENTATION-DATA-TYPE>
        <IMPLEMENTATION-DATA-TYPE>
      <SHORT-NAME>Can_17_McmCan_HthMaskObjectConfigType</SHORT-NAME>
      <CATEGORY>STRUCTURE</CATEGORY>
      <SUB-ELEMENTS>
        <IMPLEMENTATION-DATA-TYPE-ELEMENT>
          <SHORT-NAME>CanTxBufferMaskvalue</SHORT-NAME>
          <CATEGORY>TYPE_REFERENCE</CATEGORY>
          <SW-DATA-DEF-PROPS>
            <SW-DATA-DEF-PROPS-VARIANTS>
              <SW-DATA-DEF-PROPS-CONDITIONAL>
                <IMPLEMENTATION-DATA-TYPE-REF DEST="IMPLEMENTATION-DATA-TYPE">/AUTOSAR_Platform/ImplementationDataTypes/uint32</IMPLEMENTATION-DATA-TYPE-REF>
              </SW-DATA-DEF-PROPS-CONDITIONAL>
            </SW-DATA-DEF-PROPS-VARIANTS>
          </SW-DATA-DEF-PROPS>
        </IMPLEMENTATION-DATA-TYPE-ELEMENT>
        <IMPLEMENTATION-DATA-TYPE-ELEMENT>
          <SHORT-NAME>CanPerHthHwObjId</SHORT-NAME>
          <CATEGORY>TYPE_REFERENCE</CATEGORY>
          <SW-DATA-DEF-PROPS>
            <SW-DATA-DEF-PROPS-VARIANTS>
              <SW-DATA-DEF-PROPS-CONDITIONAL>
                <IMPLEMENTATION-DATA-TYPE-REF DEST="IMPLEMENTATION-DATA-TYPE">/AUTOSAR_Can_GeneralTypes/ImplementationDataTypes/Can_HwHandleType</IMPLEMENTATION-DATA-TYPE-REF>
              </SW-DATA-DEF-PROPS-CONDITIONAL>
            </SW-DATA-DEF-PROPS-VARIANTS>
          </SW-DATA-DEF-PROPS>
        </IMPLEMENTATION-DATA-TYPE-ELEMENT>
        <IMPLEMENTATION-DATA-TYPE-ELEMENT>
          <SHORT-NAME>HwControllerId</SHORT-NAME>
          <CATEGORY>TYPE_REFERENCE</CATEGORY>
          <SW-DATA-DEF-PROPS>
            <SW-DATA-DEF-PROPS-VARIANTS>
              <SW-DATA-DEF-PROPS-CONDITIONAL>
                <IMPLEMENTATION-DATA-TYPE-REF DEST="IMPLEMENTATION-DATA-TYPE">/AUTOSAR_Platform/ImplementationDataTypes/uint8</IMPLEMENTATION-DATA-TYPE-REF>
              </SW-DATA-DEF-PROPS-CONDITIONAL>
            </SW-DATA-DEF-PROPS-VARIANTS>
          </SW-DATA-DEF-PROPS>
        </IMPLEMENTATION-DATA-TYPE-ELEMENT>
      </SUB-ELEMENTS>
      <TYPE-EMITTER>BSW</TYPE-EMITTER>
    </IMPLEMENTATION-DATA-TYPE>
[!IF "$MultiTxPeriod = num:i(0)"!][!//
        <IMPLEMENTATION-DATA-TYPE>
      <SHORT-NAME>Can_17_McmCan_PeriodHthMaskConfigType</SHORT-NAME>
      <CATEGORY>STRUCTURE</CATEGORY>
      <SUB-ELEMENTS>
        <IMPLEMENTATION-DATA-TYPE-ELEMENT>
          <SHORT-NAME>CanPerHthStartIndx</SHORT-NAME>
          <CATEGORY>TYPE_REFERENCE</CATEGORY>
          <SW-DATA-DEF-PROPS>
            <SW-DATA-DEF-PROPS-VARIANTS>
              <SW-DATA-DEF-PROPS-CONDITIONAL>
                <IMPLEMENTATION-DATA-TYPE-REF DEST="IMPLEMENTATION-DATA-TYPE">/AUTOSAR_Can_GeneralTypes/ImplementationDataTypes/Can_HwHandleType</IMPLEMENTATION-DATA-TYPE-REF>
              </SW-DATA-DEF-PROPS-CONDITIONAL>
            </SW-DATA-DEF-PROPS-VARIANTS>
          </SW-DATA-DEF-PROPS>
        </IMPLEMENTATION-DATA-TYPE-ELEMENT>
        <IMPLEMENTATION-DATA-TYPE-ELEMENT>
          <SHORT-NAME>CanPerHthEndIndx</SHORT-NAME>
          <CATEGORY>TYPE_REFERENCE</CATEGORY>
          <SW-DATA-DEF-PROPS>
            <SW-DATA-DEF-PROPS-VARIANTS>
              <SW-DATA-DEF-PROPS-CONDITIONAL>
                <IMPLEMENTATION-DATA-TYPE-REF DEST="IMPLEMENTATION-DATA-TYPE">/AUTOSAR_Can_GeneralTypes/ImplementationDataTypes/Can_HwHandleType</IMPLEMENTATION-DATA-TYPE-REF>
              </SW-DATA-DEF-PROPS-CONDITIONAL>
            </SW-DATA-DEF-PROPS-VARIANTS>
          </SW-DATA-DEF-PROPS>
        </IMPLEMENTATION-DATA-TYPE-ELEMENT>
      </SUB-ELEMENTS>
      <TYPE-EMITTER>BSW</TYPE-EMITTER>
    </IMPLEMENTATION-DATA-TYPE>
[!ENDIF!][!//
     <IMPLEMENTATION-DATA-TYPE>
      <SHORT-NAME>Can_17_McmCan_HrhMaskObjectConfigType</SHORT-NAME>
      <CATEGORY>STRUCTURE</CATEGORY>
      <SUB-ELEMENTS>
        <IMPLEMENTATION-DATA-TYPE-ELEMENT>
          <SHORT-NAME>CanPerRxbufferMaskvalue0</SHORT-NAME>
          <CATEGORY>TYPE_REFERENCE</CATEGORY>
          <SW-DATA-DEF-PROPS>
            <SW-DATA-DEF-PROPS-VARIANTS>
              <SW-DATA-DEF-PROPS-CONDITIONAL>
                <IMPLEMENTATION-DATA-TYPE-REF DEST="IMPLEMENTATION-DATA-TYPE">/AUTOSAR_Platform/ImplementationDataTypes/uint32</IMPLEMENTATION-DATA-TYPE-REF>
              </SW-DATA-DEF-PROPS-CONDITIONAL>
            </SW-DATA-DEF-PROPS-VARIANTS>
          </SW-DATA-DEF-PROPS>
        </IMPLEMENTATION-DATA-TYPE-ELEMENT>
        <IMPLEMENTATION-DATA-TYPE-ELEMENT>
          <SHORT-NAME>CanPerRxbufferMaskvalue1</SHORT-NAME>
          <CATEGORY>TYPE_REFERENCE</CATEGORY>
          <SW-DATA-DEF-PROPS>
            <SW-DATA-DEF-PROPS-VARIANTS>
              <SW-DATA-DEF-PROPS-CONDITIONAL>
                <IMPLEMENTATION-DATA-TYPE-REF DEST="IMPLEMENTATION-DATA-TYPE">/AUTOSAR_Platform/ImplementationDataTypes/uint32</IMPLEMENTATION-DATA-TYPE-REF>
              </SW-DATA-DEF-PROPS-CONDITIONAL>
            </SW-DATA-DEF-PROPS-VARIANTS>
          </SW-DATA-DEF-PROPS>
        </IMPLEMENTATION-DATA-TYPE-ELEMENT>
        <IMPLEMENTATION-DATA-TYPE-ELEMENT>
          <SHORT-NAME>CanPerHrhHwObjId</SHORT-NAME>
          <CATEGORY>TYPE_REFERENCE</CATEGORY>
          <SW-DATA-DEF-PROPS>
            <SW-DATA-DEF-PROPS-VARIANTS>
              <SW-DATA-DEF-PROPS-CONDITIONAL>
                <IMPLEMENTATION-DATA-TYPE-REF DEST="IMPLEMENTATION-DATA-TYPE">/AUTOSAR_Can_GeneralTypes/ImplementationDataTypes/Can_HwHandleType</IMPLEMENTATION-DATA-TYPE-REF>
              </SW-DATA-DEF-PROPS-CONDITIONAL>
            </SW-DATA-DEF-PROPS-VARIANTS>
          </SW-DATA-DEF-PROPS>
        </IMPLEMENTATION-DATA-TYPE-ELEMENT>
        <IMPLEMENTATION-DATA-TYPE-ELEMENT>
          <SHORT-NAME>HwControllerId</SHORT-NAME>
          <CATEGORY>TYPE_REFERENCE</CATEGORY>
          <SW-DATA-DEF-PROPS>
            <SW-DATA-DEF-PROPS-VARIANTS>
              <SW-DATA-DEF-PROPS-CONDITIONAL>
                <IMPLEMENTATION-DATA-TYPE-REF DEST="IMPLEMENTATION-DATA-TYPE">/AUTOSAR_Platform/ImplementationDataTypes/uint8</IMPLEMENTATION-DATA-TYPE-REF>
              </SW-DATA-DEF-PROPS-CONDITIONAL>
            </SW-DATA-DEF-PROPS-VARIANTS>
          </SW-DATA-DEF-PROPS>
        </IMPLEMENTATION-DATA-TYPE-ELEMENT>
        <IMPLEMENTATION-DATA-TYPE-ELEMENT>
          <SHORT-NAME>CanPerHrhBufferType</SHORT-NAME>
          <CATEGORY>TYPE_REFERENCE</CATEGORY>
          <SW-DATA-DEF-PROPS>
            <SW-DATA-DEF-PROPS-VARIANTS>
              <SW-DATA-DEF-PROPS-CONDITIONAL>
                <IMPLEMENTATION-DATA-TYPE-REF DEST="IMPLEMENTATION-DATA-TYPE">/AUTOSAR_Can_17_McmCan/ImplementationDataTypes/Can_17_McmCan_RxBufferType</IMPLEMENTATION-DATA-TYPE-REF>
              </SW-DATA-DEF-PROPS-CONDITIONAL>
            </SW-DATA-DEF-PROPS-VARIANTS>
          </SW-DATA-DEF-PROPS>
        </IMPLEMENTATION-DATA-TYPE-ELEMENT>
      </SUB-ELEMENTS>
      <TYPE-EMITTER>BSW</TYPE-EMITTER>
    </IMPLEMENTATION-DATA-TYPE>
[!IF "$MultiRxPeriod = num:i(0)"!][!//
        <IMPLEMENTATION-DATA-TYPE>
      <SHORT-NAME>Can_17_McmCan_PeriodHrhMaskConfigType</SHORT-NAME>
      <CATEGORY>STRUCTURE</CATEGORY>
      <SUB-ELEMENTS>
        <IMPLEMENTATION-DATA-TYPE-ELEMENT>
          <SHORT-NAME>CanPerHrhStartIndx</SHORT-NAME>
          <CATEGORY>TYPE_REFERENCE</CATEGORY>
          <SW-DATA-DEF-PROPS>
            <SW-DATA-DEF-PROPS-VARIANTS>
              <SW-DATA-DEF-PROPS-CONDITIONAL>
                <IMPLEMENTATION-DATA-TYPE-REF DEST="IMPLEMENTATION-DATA-TYPE">/AUTOSAR_Can_GeneralTypes/ImplementationDataTypes/Can_HwHandleType</IMPLEMENTATION-DATA-TYPE-REF>
              </SW-DATA-DEF-PROPS-CONDITIONAL>
            </SW-DATA-DEF-PROPS-VARIANTS>
          </SW-DATA-DEF-PROPS>
        </IMPLEMENTATION-DATA-TYPE-ELEMENT>
        <IMPLEMENTATION-DATA-TYPE-ELEMENT>
          <SHORT-NAME>CanPerHrhEndIndx</SHORT-NAME>
          <CATEGORY>TYPE_REFERENCE</CATEGORY>
          <SW-DATA-DEF-PROPS>
            <SW-DATA-DEF-PROPS-VARIANTS>
              <SW-DATA-DEF-PROPS-CONDITIONAL>
                <IMPLEMENTATION-DATA-TYPE-REF DEST="IMPLEMENTATION-DATA-TYPE">/AUTOSAR_Can_GeneralTypes/ImplementationDataTypes/Can_HwHandleType</IMPLEMENTATION-DATA-TYPE-REF>
              </SW-DATA-DEF-PROPS-CONDITIONAL>
            </SW-DATA-DEF-PROPS-VARIANTS>
          </SW-DATA-DEF-PROPS>
        </IMPLEMENTATION-DATA-TYPE-ELEMENT>
      </SUB-ELEMENTS>
      <TYPE-EMITTER>BSW</TYPE-EMITTER>
    </IMPLEMENTATION-DATA-TYPE>
 [!ENDIF!][!//


    <IMPLEMENTATION-DATA-TYPE>
      <SHORT-NAME>Can_17_McmCan_ControllerConfigType</SHORT-NAME>
      <CATEGORY>STRUCTURE</CATEGORY>
      <SUB-ELEMENTS>
      <IMPLEMENTATION-DATA-TYPE-ELEMENT>
                <SHORT-NAME>CanNodeAddressPtr</SHORT-NAME>
                <CATEGORY>TYPE_REFERENCE</CATEGORY>
                <SW-DATA-DEF-PROPS>
                  <SW-DATA-DEF-PROPS-VARIANTS>
                    <SW-DATA-DEF-PROPS-CONDITIONAL>
                      <IMPLEMENTATION-DATA-TYPE-REF DEST="IMPLEMENTATION-DATA-TYPE">/AUTOSAR_Platform/ImplementationDataTypes/uint32</IMPLEMENTATION-DATA-TYPE-REF>
                    </SW-DATA-DEF-PROPS-CONDITIONAL>
                  </SW-DATA-DEF-PROPS-VARIANTS>
                </SW-DATA-DEF-PROPS>
              </IMPLEMENTATION-DATA-TYPE-ELEMENT>
        <IMPLEMENTATION-DATA-TYPE-ELEMENT>
          <SHORT-NAME>CanNPCRValue</SHORT-NAME>
          <CATEGORY>TYPE_REFERENCE</CATEGORY>
          <SW-DATA-DEF-PROPS>
            <SW-DATA-DEF-PROPS-VARIANTS>
              <SW-DATA-DEF-PROPS-CONDITIONAL>
                <IMPLEMENTATION-DATA-TYPE-REF DEST="IMPLEMENTATION-DATA-TYPE">/AUTOSAR_Platform/ImplementationDataTypes/uint32</IMPLEMENTATION-DATA-TYPE-REF>
              </SW-DATA-DEF-PROPS-CONDITIONAL>
            </SW-DATA-DEF-PROPS-VARIANTS>
          </SW-DATA-DEF-PROPS>
        </IMPLEMENTATION-DATA-TYPE-ELEMENT>
        <IMPLEMENTATION-DATA-TYPE-ELEMENT>
          <SHORT-NAME>CanControllerMOMap</SHORT-NAME>
          <CATEGORY>TYPE_REFERENCE</CATEGORY>
          <ARRAY-SIZE>6</ARRAY-SIZE>
          <ARRAY-SIZE-SEMANTICS>FIXED-SIZE</ARRAY-SIZE-SEMANTICS>
          <SW-DATA-DEF-PROPS>
            <SW-DATA-DEF-PROPS-VARIANTS>
              <SW-DATA-DEF-PROPS-CONDITIONAL>
                <IMPLEMENTATION-DATA-TYPE-REF DEST="IMPLEMENTATION-DATA-TYPE">/AUTOSAR_Platform/ImplementationDataTypes/uint16</IMPLEMENTATION-DATA-TYPE-REF>
              </SW-DATA-DEF-PROPS-CONDITIONAL>
            </SW-DATA-DEF-PROPS-VARIANTS>
          </SW-DATA-DEF-PROPS>
        </IMPLEMENTATION-DATA-TYPE-ELEMENT>
        <IMPLEMENTATION-DATA-TYPE-ELEMENT>
          <SHORT-NAME>CanDefaultBRCfgIndx</SHORT-NAME>
          <CATEGORY>TYPE_REFERENCE</CATEGORY>
          <SW-DATA-DEF-PROPS>
            <SW-DATA-DEF-PROPS-VARIANTS>
              <SW-DATA-DEF-PROPS-CONDITIONAL>
                <IMPLEMENTATION-DATA-TYPE-REF DEST="IMPLEMENTATION-DATA-TYPE">/AUTOSAR_Platform/ImplementationDataTypes/uint16</IMPLEMENTATION-DATA-TYPE-REF>
              </SW-DATA-DEF-PROPS-CONDITIONAL>
            </SW-DATA-DEF-PROPS-VARIANTS>
          </SW-DATA-DEF-PROPS>
        </IMPLEMENTATION-DATA-TYPE-ELEMENT>
        <IMPLEMENTATION-DATA-TYPE-ELEMENT>
          <SHORT-NAME>CanBaudrateCfgIndx</SHORT-NAME>
          <CATEGORY>TYPE_REFERENCE</CATEGORY>
          <SW-DATA-DEF-PROPS>
            <SW-DATA-DEF-PROPS-VARIANTS>
              <SW-DATA-DEF-PROPS-CONDITIONAL>
                <IMPLEMENTATION-DATA-TYPE-REF DEST="IMPLEMENTATION-DATA-TYPE">/AUTOSAR_Platform/ImplementationDataTypes/uint16</IMPLEMENTATION-DATA-TYPE-REF>
              </SW-DATA-DEF-PROPS-CONDITIONAL>
            </SW-DATA-DEF-PROPS-VARIANTS>
          </SW-DATA-DEF-PROPS>
        </IMPLEMENTATION-DATA-TYPE-ELEMENT>
        <IMPLEMENTATION-DATA-TYPE-ELEMENT>
          <SHORT-NAME>CanNoOfBaudrateCfg</SHORT-NAME>
          <CATEGORY>TYPE_REFERENCE</CATEGORY>
          <SW-DATA-DEF-PROPS>
            <SW-DATA-DEF-PROPS-VARIANTS>
              <SW-DATA-DEF-PROPS-CONDITIONAL>
                <IMPLEMENTATION-DATA-TYPE-REF DEST="IMPLEMENTATION-DATA-TYPE">/AUTOSAR_Platform/ImplementationDataTypes/uint16</IMPLEMENTATION-DATA-TYPE-REF>
              </SW-DATA-DEF-PROPS-CONDITIONAL>
            </SW-DATA-DEF-PROPS-VARIANTS>
          </SW-DATA-DEF-PROPS>
        </IMPLEMENTATION-DATA-TYPE-ELEMENT>
        <IMPLEMENTATION-DATA-TYPE-ELEMENT>
          <SHORT-NAME>CanKernelHwId</SHORT-NAME>
          <CATEGORY>TYPE_REFERENCE</CATEGORY>
          <SW-DATA-DEF-PROPS>
            <SW-DATA-DEF-PROPS-VARIANTS>
              <SW-DATA-DEF-PROPS-CONDITIONAL>
                <IMPLEMENTATION-DATA-TYPE-REF DEST="IMPLEMENTATION-DATA-TYPE">/AUTOSAR_Platform/ImplementationDataTypes/uint8</IMPLEMENTATION-DATA-TYPE-REF>
              </SW-DATA-DEF-PROPS-CONDITIONAL>
            </SW-DATA-DEF-PROPS-VARIANTS>
          </SW-DATA-DEF-PROPS>
        </IMPLEMENTATION-DATA-TYPE-ELEMENT>
        <IMPLEMENTATION-DATA-TYPE-ELEMENT>
          <SHORT-NAME>CanControllerHwId</SHORT-NAME>
          <CATEGORY>TYPE_REFERENCE</CATEGORY>
          <SW-DATA-DEF-PROPS>
            <SW-DATA-DEF-PROPS-VARIANTS>
              <SW-DATA-DEF-PROPS-CONDITIONAL>
                <IMPLEMENTATION-DATA-TYPE-REF DEST="IMPLEMENTATION-DATA-TYPE">/AUTOSAR_Platform/ImplementationDataTypes/uint8</IMPLEMENTATION-DATA-TYPE-REF>
              </SW-DATA-DEF-PROPS-CONDITIONAL>
            </SW-DATA-DEF-PROPS-VARIANTS>
          </SW-DATA-DEF-PROPS>
        </IMPLEMENTATION-DATA-TYPE-ELEMENT>
        <IMPLEMENTATION-DATA-TYPE-ELEMENT>
          <SHORT-NAME>CanControllerLogicalId</SHORT-NAME>
          <CATEGORY>TYPE_REFERENCE</CATEGORY>
          <SW-DATA-DEF-PROPS>
            <SW-DATA-DEF-PROPS-VARIANTS>
              <SW-DATA-DEF-PROPS-CONDITIONAL>
                <IMPLEMENTATION-DATA-TYPE-REF DEST="IMPLEMENTATION-DATA-TYPE">/AUTOSAR_Platform/ImplementationDataTypes/uint8</IMPLEMENTATION-DATA-TYPE-REF>
              </SW-DATA-DEF-PROPS-CONDITIONAL>
            </SW-DATA-DEF-PROPS-VARIANTS>
          </SW-DATA-DEF-PROPS>
        </IMPLEMENTATION-DATA-TYPE-ELEMENT>
[!IF "$FDNodesPresentVal = 0"!][!//
        <IMPLEMENTATION-DATA-TYPE-ELEMENT>
          <SHORT-NAME>CanFDSupport</SHORT-NAME>
          <CATEGORY>TYPE_REFERENCE</CATEGORY>
          <SW-DATA-DEF-PROPS>
            <SW-DATA-DEF-PROPS-VARIANTS>
              <SW-DATA-DEF-PROPS-CONDITIONAL>
                <IMPLEMENTATION-DATA-TYPE-REF DEST="IMPLEMENTATION-DATA-TYPE">/AUTOSAR_Platform/ImplementationDataTypes/boolean</IMPLEMENTATION-DATA-TYPE-REF>
              </SW-DATA-DEF-PROPS-CONDITIONAL>
            </SW-DATA-DEF-PROPS-VARIANTS>
          </SW-DATA-DEF-PROPS>
        </IMPLEMENTATION-DATA-TYPE-ELEMENT>
[!ENDIF!][!//
        <IMPLEMENTATION-DATA-TYPE-ELEMENT>
          <SHORT-NAME>CanRxFIFO0ProcessingConfig</SHORT-NAME>
          <CATEGORY>TYPE_REFERENCE</CATEGORY>
          <SW-DATA-DEF-PROPS>
            <SW-DATA-DEF-PROPS-VARIANTS>
              <SW-DATA-DEF-PROPS-CONDITIONAL>
                <IMPLEMENTATION-DATA-TYPE-REF DEST="IMPLEMENTATION-DATA-TYPE">/AUTOSAR_Can_17_McmCan/ImplementationDataTypes/Can_17_McmCan_RxFIFOProcessingType</IMPLEMENTATION-DATA-TYPE-REF>
              </SW-DATA-DEF-PROPS-CONDITIONAL>
            </SW-DATA-DEF-PROPS-VARIANTS>
          </SW-DATA-DEF-PROPS>
        </IMPLEMENTATION-DATA-TYPE-ELEMENT>
        <IMPLEMENTATION-DATA-TYPE-ELEMENT>
          <SHORT-NAME>CanRxFIFO1ProcessingConfig</SHORT-NAME>
          <CATEGORY>TYPE_REFERENCE</CATEGORY>
          <SW-DATA-DEF-PROPS>
            <SW-DATA-DEF-PROPS-VARIANTS>
              <SW-DATA-DEF-PROPS-CONDITIONAL>
                <IMPLEMENTATION-DATA-TYPE-REF DEST="IMPLEMENTATION-DATA-TYPE">/AUTOSAR_Can_17_McmCan/ImplementationDataTypes/Can_17_McmCan_RxFIFOProcessingType</IMPLEMENTATION-DATA-TYPE-REF>
              </SW-DATA-DEF-PROPS-CONDITIONAL>
            </SW-DATA-DEF-PROPS-VARIANTS>
          </SW-DATA-DEF-PROPS>
        </IMPLEMENTATION-DATA-TYPE-ELEMENT>
        <IMPLEMENTATION-DATA-TYPE-ELEMENT>
          <SHORT-NAME>CanHrhNDAT1PollingMask</SHORT-NAME>
          <CATEGORY>TYPE_REFERENCE</CATEGORY>
          <SW-DATA-DEF-PROPS>
            <SW-DATA-DEF-PROPS-VARIANTS>
              <SW-DATA-DEF-PROPS-CONDITIONAL>
                <IMPLEMENTATION-DATA-TYPE-REF DEST="IMPLEMENTATION-DATA-TYPE">/AUTOSAR_Platform/ImplementationDataTypes/uint32</IMPLEMENTATION-DATA-TYPE-REF>
              </SW-DATA-DEF-PROPS-CONDITIONAL>
            </SW-DATA-DEF-PROPS-VARIANTS>
          </SW-DATA-DEF-PROPS>
        </IMPLEMENTATION-DATA-TYPE-ELEMENT>
        <IMPLEMENTATION-DATA-TYPE-ELEMENT>
          <SHORT-NAME>CanHrhNDAT2PollingMask</SHORT-NAME>
          <CATEGORY>TYPE_REFERENCE</CATEGORY>
          <SW-DATA-DEF-PROPS>
            <SW-DATA-DEF-PROPS-VARIANTS>
              <SW-DATA-DEF-PROPS-CONDITIONAL>
                <IMPLEMENTATION-DATA-TYPE-REF DEST="IMPLEMENTATION-DATA-TYPE">/AUTOSAR_Platform/ImplementationDataTypes/uint32</IMPLEMENTATION-DATA-TYPE-REF>
              </SW-DATA-DEF-PROPS-CONDITIONAL>
            </SW-DATA-DEF-PROPS-VARIANTS>
          </SW-DATA-DEF-PROPS>
        </IMPLEMENTATION-DATA-TYPE-ELEMENT>
        <IMPLEMENTATION-DATA-TYPE-ELEMENT>
          <SHORT-NAME>CanTxPollingObjectMask</SHORT-NAME>
          <CATEGORY>TYPE_REFERENCE</CATEGORY>
          <SW-DATA-DEF-PROPS>
            <SW-DATA-DEF-PROPS-VARIANTS>
              <SW-DATA-DEF-PROPS-CONDITIONAL>
                <IMPLEMENTATION-DATA-TYPE-REF DEST="IMPLEMENTATION-DATA-TYPE">/AUTOSAR_Platform/ImplementationDataTypes/uint32</IMPLEMENTATION-DATA-TYPE-REF>
              </SW-DATA-DEF-PROPS-CONDITIONAL>
            </SW-DATA-DEF-PROPS-VARIANTS>
          </SW-DATA-DEF-PROPS>
        </IMPLEMENTATION-DATA-TYPE-ELEMENT>
        <IMPLEMENTATION-DATA-TYPE-ELEMENT>
          <SHORT-NAME>CanEnableInterruptMask</SHORT-NAME>
          <CATEGORY>TYPE_REFERENCE</CATEGORY>
          <SW-DATA-DEF-PROPS>
            <SW-DATA-DEF-PROPS-VARIANTS>
              <SW-DATA-DEF-PROPS-CONDITIONAL>
                <IMPLEMENTATION-DATA-TYPE-REF DEST="IMPLEMENTATION-DATA-TYPE">/AUTOSAR_Platform/ImplementationDataTypes/uint32</IMPLEMENTATION-DATA-TYPE-REF>
              </SW-DATA-DEF-PROPS-CONDITIONAL>
            </SW-DATA-DEF-PROPS-VARIANTS>
          </SW-DATA-DEF-PROPS>
        </IMPLEMENTATION-DATA-TYPE-ELEMENT>
      </SUB-ELEMENTS>
      <TYPE-EMITTER>BSW</TYPE-EMITTER>
    </IMPLEMENTATION-DATA-TYPE>
    <IMPLEMENTATION-DATA-TYPE>
      <SHORT-NAME>Can_17_McmCan_ControllerIndexType</SHORT-NAME>
      <CATEGORY>TYPE_REFERENCE</CATEGORY>
      <SW-DATA-DEF-PROPS>
        <SW-DATA-DEF-PROPS-VARIANTS>
          <SW-DATA-DEF-PROPS-CONDITIONAL>
            <IMPLEMENTATION-DATA-TYPE-REF DEST="IMPLEMENTATION-DATA-TYPE">/AUTOSAR_Platform/ImplementationDataTypes/uint8</IMPLEMENTATION-DATA-TYPE-REF>
            <SW-IMPL-POLICY>STANDARD</SW-IMPL-POLICY>
          </SW-DATA-DEF-PROPS-CONDITIONAL>
        </SW-DATA-DEF-PROPS-VARIANTS>
      </SW-DATA-DEF-PROPS>
      <TYPE-EMITTER>BSW</TYPE-EMITTER>
    </IMPLEMENTATION-DATA-TYPE>
        <IMPLEMENTATION-DATA-TYPE>
      <SHORT-NAME>Can_17_McmCan_HthPeriodIndexType</SHORT-NAME>
      <CATEGORY>TYPE_REFERENCE</CATEGORY>
      <SW-DATA-DEF-PROPS>
        <SW-DATA-DEF-PROPS-VARIANTS>
          <SW-DATA-DEF-PROPS-CONDITIONAL>
            <IMPLEMENTATION-DATA-TYPE-REF DEST="IMPLEMENTATION-DATA-TYPE">/AUTOSAR_Platform/ImplementationDataTypes/uint8</IMPLEMENTATION-DATA-TYPE-REF>
            <SW-IMPL-POLICY>STANDARD</SW-IMPL-POLICY>
          </SW-DATA-DEF-PROPS-CONDITIONAL>
        </SW-DATA-DEF-PROPS-VARIANTS>
      </SW-DATA-DEF-PROPS>
      <TYPE-EMITTER>BSW</TYPE-EMITTER>
    </IMPLEMENTATION-DATA-TYPE>
          <IMPLEMENTATION-DATA-TYPE>
      <SHORT-NAME>Can_17_McmCan_HrhPeriodIndexType</SHORT-NAME>
      <CATEGORY>TYPE_REFERENCE</CATEGORY>
      <SW-DATA-DEF-PROPS>
        <SW-DATA-DEF-PROPS-VARIANTS>
          <SW-DATA-DEF-PROPS-CONDITIONAL>
            <IMPLEMENTATION-DATA-TYPE-REF DEST="IMPLEMENTATION-DATA-TYPE">/AUTOSAR_Platform/ImplementationDataTypes/uint8</IMPLEMENTATION-DATA-TYPE-REF>
            <SW-IMPL-POLICY>STANDARD</SW-IMPL-POLICY>
          </SW-DATA-DEF-PROPS-CONDITIONAL>
        </SW-DATA-DEF-PROPS-VARIANTS>
      </SW-DATA-DEF-PROPS>
      <TYPE-EMITTER>BSW</TYPE-EMITTER>
    </IMPLEMENTATION-DATA-TYPE>
            <IMPLEMENTATION-DATA-TYPE>
      <SHORT-NAME>Can_17_McmCan_HthIndexType</SHORT-NAME>
      <CATEGORY>STRUCTURE</CATEGORY>
      <SUB-ELEMENTS>
        <IMPLEMENTATION-DATA-TYPE-ELEMENT>
          <SHORT-NAME>CanHthCoreAssigned</SHORT-NAME>
          <CATEGORY>TYPE_REFERENCE</CATEGORY>
          <SW-DATA-DEF-PROPS>
            <SW-DATA-DEF-PROPS-VARIANTS>
              <SW-DATA-DEF-PROPS-CONDITIONAL>
                <IMPLEMENTATION-DATA-TYPE-REF DEST="IMPLEMENTATION-DATA-TYPE">/AUTOSAR_Platform/ImplementationDataTypes/uint8</IMPLEMENTATION-DATA-TYPE-REF>
              </SW-DATA-DEF-PROPS-CONDITIONAL>
            </SW-DATA-DEF-PROPS-VARIANTS>
          </SW-DATA-DEF-PROPS>
        </IMPLEMENTATION-DATA-TYPE-ELEMENT>
        <IMPLEMENTATION-DATA-TYPE-ELEMENT>
          <SHORT-NAME>CanHthLogicContIndex</SHORT-NAME>
          <CATEGORY>TYPE_REFERENCE</CATEGORY>
          <SW-DATA-DEF-PROPS>
            <SW-DATA-DEF-PROPS-VARIANTS>
              <SW-DATA-DEF-PROPS-CONDITIONAL>
                <IMPLEMENTATION-DATA-TYPE-REF DEST="IMPLEMENTATION-DATA-TYPE">/AUTOSAR_Platform/ImplementationDataTypes/uint8</IMPLEMENTATION-DATA-TYPE-REF>
              </SW-DATA-DEF-PROPS-CONDITIONAL>
            </SW-DATA-DEF-PROPS-VARIANTS>
          </SW-DATA-DEF-PROPS>
        </IMPLEMENTATION-DATA-TYPE-ELEMENT>
        <IMPLEMENTATION-DATA-TYPE-ELEMENT>
          <SHORT-NAME>CanHthCoreSpecIndex</SHORT-NAME>
          <CATEGORY>TYPE_REFERENCE</CATEGORY>
          <SW-DATA-DEF-PROPS>
            <SW-DATA-DEF-PROPS-VARIANTS>
              <SW-DATA-DEF-PROPS-CONDITIONAL>
                <IMPLEMENTATION-DATA-TYPE-REF DEST="IMPLEMENTATION-DATA-TYPE">/AUTOSAR_Platform/ImplementationDataTypes/uint16</IMPLEMENTATION-DATA-TYPE-REF>
              </SW-DATA-DEF-PROPS-CONDITIONAL>
            </SW-DATA-DEF-PROPS-VARIANTS>
          </SW-DATA-DEF-PROPS>
        </IMPLEMENTATION-DATA-TYPE-ELEMENT>
      </SUB-ELEMENTS>
      <TYPE-EMITTER>BSW</TYPE-EMITTER>
        </IMPLEMENTATION-DATA-TYPE>
    <IMPLEMENTATION-DATA-TYPE>
      <SHORT-NAME>Can_17_McmCan_LogicalControllerIndexType</SHORT-NAME>
      <CATEGORY>STRUCTURE</CATEGORY>
      <SUB-ELEMENTS>
        <IMPLEMENTATION-DATA-TYPE-ELEMENT>
          <SHORT-NAME>CanLCoreAssigned</SHORT-NAME>
          <CATEGORY>TYPE_REFERENCE</CATEGORY>
          <SW-DATA-DEF-PROPS>
            <SW-DATA-DEF-PROPS-VARIANTS>
              <SW-DATA-DEF-PROPS-CONDITIONAL>
                <IMPLEMENTATION-DATA-TYPE-REF DEST="IMPLEMENTATION-DATA-TYPE">/AUTOSAR_Platform/ImplementationDataTypes/uint8</IMPLEMENTATION-DATA-TYPE-REF>
              </SW-DATA-DEF-PROPS-CONDITIONAL>
            </SW-DATA-DEF-PROPS-VARIANTS>
          </SW-DATA-DEF-PROPS>
        </IMPLEMENTATION-DATA-TYPE-ELEMENT>
        <IMPLEMENTATION-DATA-TYPE-ELEMENT>
          <SHORT-NAME>CanLCoreSpecContIndex</SHORT-NAME>
          <CATEGORY>TYPE_REFERENCE</CATEGORY>
          <SW-DATA-DEF-PROPS>
            <SW-DATA-DEF-PROPS-VARIANTS>
              <SW-DATA-DEF-PROPS-CONDITIONAL>
                <IMPLEMENTATION-DATA-TYPE-REF DEST="IMPLEMENTATION-DATA-TYPE">/AUTOSAR_Platform/ImplementationDataTypes/uint8</IMPLEMENTATION-DATA-TYPE-REF>
              </SW-DATA-DEF-PROPS-CONDITIONAL>
            </SW-DATA-DEF-PROPS-VARIANTS>
          </SW-DATA-DEF-PROPS>
        </IMPLEMENTATION-DATA-TYPE-ELEMENT>
        <IMPLEMENTATION-DATA-TYPE-ELEMENT>
          <SHORT-NAME>CanLContPhyIndex</SHORT-NAME>
          <CATEGORY>TYPE_REFERENCE</CATEGORY>
          <SW-DATA-DEF-PROPS>
            <SW-DATA-DEF-PROPS-VARIANTS>
              <SW-DATA-DEF-PROPS-CONDITIONAL>
                <IMPLEMENTATION-DATA-TYPE-REF DEST="IMPLEMENTATION-DATA-TYPE">/AUTOSAR_Platform/ImplementationDataTypes/uint8</IMPLEMENTATION-DATA-TYPE-REF>
              </SW-DATA-DEF-PROPS-CONDITIONAL>
            </SW-DATA-DEF-PROPS-VARIANTS>
          </SW-DATA-DEF-PROPS>
        </IMPLEMENTATION-DATA-TYPE-ELEMENT>
        <IMPLEMENTATION-DATA-TYPE-ELEMENT>
          <SHORT-NAME>CanLKerPhyIndex</SHORT-NAME>
          <CATEGORY>TYPE_REFERENCE</CATEGORY>
          <SW-DATA-DEF-PROPS>
            <SW-DATA-DEF-PROPS-VARIANTS>
              <SW-DATA-DEF-PROPS-CONDITIONAL>
                <IMPLEMENTATION-DATA-TYPE-REF DEST="IMPLEMENTATION-DATA-TYPE">/AUTOSAR_Platform/ImplementationDataTypes/uint8</IMPLEMENTATION-DATA-TYPE-REF>
              </SW-DATA-DEF-PROPS-CONDITIONAL>
            </SW-DATA-DEF-PROPS-VARIANTS>
          </SW-DATA-DEF-PROPS>
        </IMPLEMENTATION-DATA-TYPE-ELEMENT>
      </SUB-ELEMENTS>
      <TYPE-EMITTER>BSW</TYPE-EMITTER>
    </IMPLEMENTATION-DATA-TYPE>
          <IMPLEMENTATION-DATA-TYPE>
      <SHORT-NAME>Can_17_McmCan_PhyControllerIndexType</SHORT-NAME>
      <CATEGORY>STRUCTURE</CATEGORY>
      <SUB-ELEMENTS>
        <IMPLEMENTATION-DATA-TYPE-ELEMENT>
          <SHORT-NAME>CanPLogicContIndex</SHORT-NAME>
          <CATEGORY>TYPE_REFERENCE</CATEGORY>
          <SW-DATA-DEF-PROPS>
            <SW-DATA-DEF-PROPS-VARIANTS>
              <SW-DATA-DEF-PROPS-CONDITIONAL>
                <IMPLEMENTATION-DATA-TYPE-REF DEST="IMPLEMENTATION-DATA-TYPE">/AUTOSAR_Platform/ImplementationDataTypes/uint8</IMPLEMENTATION-DATA-TYPE-REF>
              </SW-DATA-DEF-PROPS-CONDITIONAL>
            </SW-DATA-DEF-PROPS-VARIANTS>
          </SW-DATA-DEF-PROPS>
        </IMPLEMENTATION-DATA-TYPE-ELEMENT>
        <IMPLEMENTATION-DATA-TYPE-ELEMENT>
          <SHORT-NAME>CanPCoreSpecContIndex</SHORT-NAME>
          <CATEGORY>TYPE_REFERENCE</CATEGORY>
          <SW-DATA-DEF-PROPS>
            <SW-DATA-DEF-PROPS-VARIANTS>
              <SW-DATA-DEF-PROPS-CONDITIONAL>
                <IMPLEMENTATION-DATA-TYPE-REF DEST="IMPLEMENTATION-DATA-TYPE">/AUTOSAR_Platform/ImplementationDataTypes/uint8</IMPLEMENTATION-DATA-TYPE-REF>
              </SW-DATA-DEF-PROPS-CONDITIONAL>
            </SW-DATA-DEF-PROPS-VARIANTS>
          </SW-DATA-DEF-PROPS>
        </IMPLEMENTATION-DATA-TYPE-ELEMENT>
        <IMPLEMENTATION-DATA-TYPE-ELEMENT>
          <SHORT-NAME>CanPCoreAssigned</SHORT-NAME>
          <CATEGORY>TYPE_REFERENCE</CATEGORY>
          <SW-DATA-DEF-PROPS>
            <SW-DATA-DEF-PROPS-VARIANTS>
              <SW-DATA-DEF-PROPS-CONDITIONAL>
                <IMPLEMENTATION-DATA-TYPE-REF DEST="IMPLEMENTATION-DATA-TYPE">/AUTOSAR_Platform/ImplementationDataTypes/uint8</IMPLEMENTATION-DATA-TYPE-REF>
              </SW-DATA-DEF-PROPS-CONDITIONAL>
            </SW-DATA-DEF-PROPS-VARIANTS>
          </SW-DATA-DEF-PROPS>
        </IMPLEMENTATION-DATA-TYPE-ELEMENT>
      </SUB-ELEMENTS>
      <TYPE-EMITTER>BSW</TYPE-EMITTER>
    </IMPLEMENTATION-DATA-TYPE>
    <IMPLEMENTATION-DATA-TYPE>
      <SHORT-NAME>Can_17_McmCan_CoreConfigType</SHORT-NAME>
      <CATEGORY>STRUCTURE</CATEGORY>
      <SUB-ELEMENTS>
        <IMPLEMENTATION-DATA-TYPE-ELEMENT>
          <SHORT-NAME>CanCoreContCnt</SHORT-NAME>
          <CATEGORY>TYPE_REFERENCE</CATEGORY>
          <SW-DATA-DEF-PROPS>
            <SW-DATA-DEF-PROPS-VARIANTS>
              <SW-DATA-DEF-PROPS-CONDITIONAL>
                <IMPLEMENTATION-DATA-TYPE-REF DEST="IMPLEMENTATION-DATA-TYPE">/AUTOSAR_Platform/ImplementationDataTypes/uint8</IMPLEMENTATION-DATA-TYPE-REF>
              </SW-DATA-DEF-PROPS-CONDITIONAL>
            </SW-DATA-DEF-PROPS-VARIANTS>
          </SW-DATA-DEF-PROPS>
        </IMPLEMENTATION-DATA-TYPE-ELEMENT>
        <IMPLEMENTATION-DATA-TYPE-ELEMENT>
          <SHORT-NAME>CanControllerIndexingPtr</SHORT-NAME>
          <CATEGORY>DATA_REFERENCE</CATEGORY>
          <SW-DATA-DEF-PROPS>
            <SW-DATA-DEF-PROPS-VARIANTS>
              <SW-DATA-DEF-PROPS-CONDITIONAL>
                <SW-POINTER-TARGET-PROPS>
                  <TARGET-CATEGORY>TYPE_REFERENCE</TARGET-CATEGORY>
                  <SW-DATA-DEF-PROPS>
                    <SW-DATA-DEF-PROPS-VARIANTS>
                      <SW-DATA-DEF-PROPS-CONDITIONAL>
                        <IMPLEMENTATION-DATA-TYPE-REF DEST="IMPLEMENTATION-DATA-TYPE">/AUTOSAR_Can_17_McmCan/ImplementationDataTypes/Can_17_McmCan_ControllerIndexType</IMPLEMENTATION-DATA-TYPE-REF>
                      </SW-DATA-DEF-PROPS-CONDITIONAL>
                    </SW-DATA-DEF-PROPS-VARIANTS>
                  </SW-DATA-DEF-PROPS>
                </SW-POINTER-TARGET-PROPS>
              </SW-DATA-DEF-PROPS-CONDITIONAL>
            </SW-DATA-DEF-PROPS-VARIANTS>
          </SW-DATA-DEF-PROPS>
        </IMPLEMENTATION-DATA-TYPE-ELEMENT>
        <IMPLEMENTATION-DATA-TYPE-ELEMENT>
          <SHORT-NAME>CanControllerConfigPtr</SHORT-NAME>
          <CATEGORY>DATA_REFERENCE</CATEGORY>
          <SW-DATA-DEF-PROPS>
            <SW-DATA-DEF-PROPS-VARIANTS>
              <SW-DATA-DEF-PROPS-CONDITIONAL>
                <SW-POINTER-TARGET-PROPS>
                  <TARGET-CATEGORY>TYPE_REFERENCE</TARGET-CATEGORY>
                  <SW-DATA-DEF-PROPS>
                    <SW-DATA-DEF-PROPS-VARIANTS>
                      <SW-DATA-DEF-PROPS-CONDITIONAL>
                        <IMPLEMENTATION-DATA-TYPE-REF DEST="IMPLEMENTATION-DATA-TYPE">/AUTOSAR_Can_17_McmCan/ImplementationDataTypes/Can_17_McmCan_ControllerConfigType</IMPLEMENTATION-DATA-TYPE-REF>
                      </SW-DATA-DEF-PROPS-CONDITIONAL>
                    </SW-DATA-DEF-PROPS-VARIANTS>
                  </SW-DATA-DEF-PROPS>
                </SW-POINTER-TARGET-PROPS>
              </SW-DATA-DEF-PROPS-CONDITIONAL>
            </SW-DATA-DEF-PROPS-VARIANTS>
          </SW-DATA-DEF-PROPS>
        </IMPLEMENTATION-DATA-TYPE-ELEMENT>
        <IMPLEMENTATION-DATA-TYPE-ELEMENT>
          <SHORT-NAME>CanControllerMsgRAMMapConfigPtr</SHORT-NAME>
          <CATEGORY>DATA_REFERENCE</CATEGORY>
          <SW-DATA-DEF-PROPS>
            <SW-DATA-DEF-PROPS-VARIANTS>
              <SW-DATA-DEF-PROPS-CONDITIONAL>
                <SW-POINTER-TARGET-PROPS>
                  <TARGET-CATEGORY>TYPE_REFERENCE</TARGET-CATEGORY>
                  <SW-DATA-DEF-PROPS>
                    <SW-DATA-DEF-PROPS-VARIANTS>
                      <SW-DATA-DEF-PROPS-CONDITIONAL>
                        <IMPLEMENTATION-DATA-TYPE-REF DEST="IMPLEMENTATION-DATA-TYPE">/AUTOSAR_Can_17_McmCan/ImplementationDataTypes/Can_17_McmCan_ControllerMsgRAMConfigType</IMPLEMENTATION-DATA-TYPE-REF>
                      </SW-DATA-DEF-PROPS-CONDITIONAL>
                    </SW-DATA-DEF-PROPS-VARIANTS>
                  </SW-DATA-DEF-PROPS>
                </SW-POINTER-TARGET-PROPS>
              </SW-DATA-DEF-PROPS-CONDITIONAL>
            </SW-DATA-DEF-PROPS-VARIANTS>
          </SW-DATA-DEF-PROPS>
        </IMPLEMENTATION-DATA-TYPE-ELEMENT>
        <IMPLEMENTATION-DATA-TYPE-ELEMENT>
          <SHORT-NAME>CanEventHandlingConfigPtr</SHORT-NAME>
          <CATEGORY>DATA_REFERENCE</CATEGORY>
          <SW-DATA-DEF-PROPS>
            <SW-DATA-DEF-PROPS-VARIANTS>
              <SW-DATA-DEF-PROPS-CONDITIONAL>
                <SW-POINTER-TARGET-PROPS>
                  <TARGET-CATEGORY>TYPE_REFERENCE</TARGET-CATEGORY>
                  <SW-DATA-DEF-PROPS>
                    <SW-DATA-DEF-PROPS-VARIANTS>
                      <SW-DATA-DEF-PROPS-CONDITIONAL>
                        <IMPLEMENTATION-DATA-TYPE-REF DEST="IMPLEMENTATION-DATA-TYPE">/AUTOSAR_Can_17_McmCan/ImplementationDataTypes/Can_17_McmCan_EventHandlingType</IMPLEMENTATION-DATA-TYPE-REF>
                      </SW-DATA-DEF-PROPS-CONDITIONAL>
                    </SW-DATA-DEF-PROPS-VARIANTS>
                  </SW-DATA-DEF-PROPS>
                </SW-POINTER-TARGET-PROPS>
              </SW-DATA-DEF-PROPS-CONDITIONAL>
            </SW-DATA-DEF-PROPS-VARIANTS>
          </SW-DATA-DEF-PROPS>
        </IMPLEMENTATION-DATA-TYPE-ELEMENT>
        <IMPLEMENTATION-DATA-TYPE-ELEMENT>
          <SHORT-NAME>CanBaudrateConfigPtr</SHORT-NAME>
          <CATEGORY>DATA_REFERENCE</CATEGORY>
          <SW-DATA-DEF-PROPS>
            <SW-DATA-DEF-PROPS-VARIANTS>
              <SW-DATA-DEF-PROPS-CONDITIONAL>
                <SW-POINTER-TARGET-PROPS>
                  <TARGET-CATEGORY>TYPE_REFERENCE</TARGET-CATEGORY>
                  <SW-DATA-DEF-PROPS>
                    <SW-DATA-DEF-PROPS-VARIANTS>
                      <SW-DATA-DEF-PROPS-CONDITIONAL>
                        <IMPLEMENTATION-DATA-TYPE-REF DEST="IMPLEMENTATION-DATA-TYPE">/AUTOSAR_Can_17_McmCan/ImplementationDataTypes/Can_17_McmCan_ControllerBaudrateConfigType</IMPLEMENTATION-DATA-TYPE-REF>
                      </SW-DATA-DEF-PROPS-CONDITIONAL>
                    </SW-DATA-DEF-PROPS-VARIANTS>
                  </SW-DATA-DEF-PROPS>
                </SW-POINTER-TARGET-PROPS>
              </SW-DATA-DEF-PROPS-CONDITIONAL>
            </SW-DATA-DEF-PROPS-VARIANTS>
          </SW-DATA-DEF-PROPS>
        </IMPLEMENTATION-DATA-TYPE-ELEMENT>
[!IF "$FDNodesPresentVal = 0"!][!//
        <IMPLEMENTATION-DATA-TYPE-ELEMENT>
          <SHORT-NAME>CanFDConfigParamPtr</SHORT-NAME>
          <CATEGORY>DATA_REFERENCE</CATEGORY>
          <SW-DATA-DEF-PROPS>
            <SW-DATA-DEF-PROPS-VARIANTS>
              <SW-DATA-DEF-PROPS-CONDITIONAL>
                <SW-POINTER-TARGET-PROPS>
                  <TARGET-CATEGORY>TYPE_REFERENCE</TARGET-CATEGORY>
                  <SW-DATA-DEF-PROPS>
                    <SW-DATA-DEF-PROPS-VARIANTS>
                      <SW-DATA-DEF-PROPS-CONDITIONAL>
                        <IMPLEMENTATION-DATA-TYPE-REF DEST="IMPLEMENTATION-DATA-TYPE">/AUTOSAR_Can_17_McmCan/ImplementationDataTypes/Can_17_McmCan_ControllerFDBaudrateConfigType</IMPLEMENTATION-DATA-TYPE-REF>
                      </SW-DATA-DEF-PROPS-CONDITIONAL>
                    </SW-DATA-DEF-PROPS-VARIANTS>
                  </SW-DATA-DEF-PROPS>
                </SW-POINTER-TARGET-PROPS>
              </SW-DATA-DEF-PROPS-CONDITIONAL>
            </SW-DATA-DEF-PROPS-VARIANTS>
          </SW-DATA-DEF-PROPS>
        </IMPLEMENTATION-DATA-TYPE-ELEMENT>
[!ENDIF!][!//
        <IMPLEMENTATION-DATA-TYPE-ELEMENT>
          <SHORT-NAME>CanTxHwObjectConfigPtr</SHORT-NAME>
          <CATEGORY>DATA_REFERENCE</CATEGORY>
          <SW-DATA-DEF-PROPS>
            <SW-DATA-DEF-PROPS-VARIANTS>
              <SW-DATA-DEF-PROPS-CONDITIONAL>
                <SW-POINTER-TARGET-PROPS>
                  <TARGET-CATEGORY>TYPE_REFERENCE</TARGET-CATEGORY>
                  <SW-DATA-DEF-PROPS>
                    <SW-DATA-DEF-PROPS-VARIANTS>
                      <SW-DATA-DEF-PROPS-CONDITIONAL>
                        <IMPLEMENTATION-DATA-TYPE-REF DEST="IMPLEMENTATION-DATA-TYPE">/AUTOSAR_Can_17_McmCan/ImplementationDataTypes/Can_17_McmCan_TxHwObjectConfigType</IMPLEMENTATION-DATA-TYPE-REF>
                      </SW-DATA-DEF-PROPS-CONDITIONAL>
                    </SW-DATA-DEF-PROPS-VARIANTS>
                  </SW-DATA-DEF-PROPS>
                </SW-POINTER-TARGET-PROPS>
              </SW-DATA-DEF-PROPS-CONDITIONAL>
            </SW-DATA-DEF-PROPS-VARIANTS>
          </SW-DATA-DEF-PROPS>
        </IMPLEMENTATION-DATA-TYPE-ELEMENT>
        <IMPLEMENTATION-DATA-TYPE-ELEMENT>
          <SHORT-NAME>CanSIDFilterConfigPtr</SHORT-NAME>
          <CATEGORY>DATA_REFERENCE</CATEGORY>
          <SW-DATA-DEF-PROPS>
            <SW-DATA-DEF-PROPS-VARIANTS>
              <SW-DATA-DEF-PROPS-CONDITIONAL>
                <SW-POINTER-TARGET-PROPS>
                  <TARGET-CATEGORY>TYPE_REFERENCE</TARGET-CATEGORY>
                  <SW-DATA-DEF-PROPS>
                    <SW-DATA-DEF-PROPS-VARIANTS>
                      <SW-DATA-DEF-PROPS-CONDITIONAL>
                        <IMPLEMENTATION-DATA-TYPE-REF DEST="IMPLEMENTATION-DATA-TYPE">/AUTOSAR_Can_17_McmCan/ImplementationDataTypes/Can_17_McmCan_SIDFilterConfigType</IMPLEMENTATION-DATA-TYPE-REF>
                      </SW-DATA-DEF-PROPS-CONDITIONAL>
                    </SW-DATA-DEF-PROPS-VARIANTS>
                  </SW-DATA-DEF-PROPS>
                </SW-POINTER-TARGET-PROPS>
              </SW-DATA-DEF-PROPS-CONDITIONAL>
            </SW-DATA-DEF-PROPS-VARIANTS>
          </SW-DATA-DEF-PROPS>
        </IMPLEMENTATION-DATA-TYPE-ELEMENT>
        <IMPLEMENTATION-DATA-TYPE-ELEMENT>
          <SHORT-NAME>CanXIDFilterConfigPtr</SHORT-NAME>
          <CATEGORY>DATA_REFERENCE</CATEGORY>
          <SW-DATA-DEF-PROPS>
            <SW-DATA-DEF-PROPS-VARIANTS>
              <SW-DATA-DEF-PROPS-CONDITIONAL>
                <SW-POINTER-TARGET-PROPS>
                  <TARGET-CATEGORY>TYPE_REFERENCE</TARGET-CATEGORY>
                  <SW-DATA-DEF-PROPS>
                    <SW-DATA-DEF-PROPS-VARIANTS>
                      <SW-DATA-DEF-PROPS-CONDITIONAL>
                        <IMPLEMENTATION-DATA-TYPE-REF DEST="IMPLEMENTATION-DATA-TYPE">/AUTOSAR_Can_17_McmCan/ImplementationDataTypes/Can_17_McmCan_XIDFilterConfigType</IMPLEMENTATION-DATA-TYPE-REF>
                      </SW-DATA-DEF-PROPS-CONDITIONAL>
                    </SW-DATA-DEF-PROPS-VARIANTS>
                  </SW-DATA-DEF-PROPS>
                </SW-POINTER-TARGET-PROPS>
              </SW-DATA-DEF-PROPS-CONDITIONAL>
            </SW-DATA-DEF-PROPS-VARIANTS>
          </SW-DATA-DEF-PROPS>
        </IMPLEMENTATION-DATA-TYPE-ELEMENT>
[!IF "$MultiTxPeriod = num:i(0)"!][!//
        <IMPLEMENTATION-DATA-TYPE-ELEMENT>
          <SHORT-NAME>CanHthPeriodIndexPtr</SHORT-NAME>
          <CATEGORY>DATA_REFERENCE</CATEGORY>
          <SW-DATA-DEF-PROPS>
            <SW-DATA-DEF-PROPS-VARIANTS>
              <SW-DATA-DEF-PROPS-CONDITIONAL>
                <SW-POINTER-TARGET-PROPS>
                  <TARGET-CATEGORY>TYPE_REFERENCE</TARGET-CATEGORY>
                  <SW-DATA-DEF-PROPS>
                    <SW-DATA-DEF-PROPS-VARIANTS>
                      <SW-DATA-DEF-PROPS-CONDITIONAL>
                        <IMPLEMENTATION-DATA-TYPE-REF DEST="IMPLEMENTATION-DATA-TYPE">/AUTOSAR_Can_17_McmCan/ImplementationDataTypes/Can_17_McmCan_HthPeriodIndexType</IMPLEMENTATION-DATA-TYPE-REF>
                      </SW-DATA-DEF-PROPS-CONDITIONAL>
                    </SW-DATA-DEF-PROPS-VARIANTS>
                  </SW-DATA-DEF-PROPS>
                </SW-POINTER-TARGET-PROPS>
              </SW-DATA-DEF-PROPS-CONDITIONAL>
            </SW-DATA-DEF-PROPS-VARIANTS>
          </SW-DATA-DEF-PROPS>
        </IMPLEMENTATION-DATA-TYPE-ELEMENT>
        <IMPLEMENTATION-DATA-TYPE-ELEMENT>
          <SHORT-NAME>CanHthMaskObjectConfigPtr</SHORT-NAME>
          <CATEGORY>DATA_REFERENCE</CATEGORY>
          <SW-DATA-DEF-PROPS>
            <SW-DATA-DEF-PROPS-VARIANTS>
              <SW-DATA-DEF-PROPS-CONDITIONAL>
                <SW-POINTER-TARGET-PROPS>
                  <TARGET-CATEGORY>TYPE_REFERENCE</TARGET-CATEGORY>
                  <SW-DATA-DEF-PROPS>
                    <SW-DATA-DEF-PROPS-VARIANTS>
                      <SW-DATA-DEF-PROPS-CONDITIONAL>
                        <IMPLEMENTATION-DATA-TYPE-REF DEST="IMPLEMENTATION-DATA-TYPE">/AUTOSAR_Can_17_McmCan/ImplementationDataTypes/Can_17_McmCan_HthMaskObjectConfigType</IMPLEMENTATION-DATA-TYPE-REF>
                      </SW-DATA-DEF-PROPS-CONDITIONAL>
                    </SW-DATA-DEF-PROPS-VARIANTS>
                  </SW-DATA-DEF-PROPS>
                </SW-POINTER-TARGET-PROPS>
              </SW-DATA-DEF-PROPS-CONDITIONAL>
            </SW-DATA-DEF-PROPS-VARIANTS>
          </SW-DATA-DEF-PROPS>
        </IMPLEMENTATION-DATA-TYPE-ELEMENT>
        <IMPLEMENTATION-DATA-TYPE-ELEMENT>
          <SHORT-NAME>CanPeriodHthMaskConfigPtr</SHORT-NAME>
          <CATEGORY>DATA_REFERENCE</CATEGORY>
          <SW-DATA-DEF-PROPS>
            <SW-DATA-DEF-PROPS-VARIANTS>
              <SW-DATA-DEF-PROPS-CONDITIONAL>
                <SW-POINTER-TARGET-PROPS>
                  <TARGET-CATEGORY>TYPE_REFERENCE</TARGET-CATEGORY>
                  <SW-DATA-DEF-PROPS>
                    <SW-DATA-DEF-PROPS-VARIANTS>
                      <SW-DATA-DEF-PROPS-CONDITIONAL>
                        <IMPLEMENTATION-DATA-TYPE-REF DEST="IMPLEMENTATION-DATA-TYPE">/AUTOSAR_Can_17_McmCan/ImplementationDataTypes/Can_17_McmCan_PeriodHthMaskConfigType</IMPLEMENTATION-DATA-TYPE-REF>
                      </SW-DATA-DEF-PROPS-CONDITIONAL>
                    </SW-DATA-DEF-PROPS-VARIANTS>
                  </SW-DATA-DEF-PROPS>
                </SW-POINTER-TARGET-PROPS>
              </SW-DATA-DEF-PROPS-CONDITIONAL>
            </SW-DATA-DEF-PROPS-VARIANTS>
          </SW-DATA-DEF-PROPS>
        </IMPLEMENTATION-DATA-TYPE-ELEMENT>
[!ENDIF!][!//
[!IF "$MultiRxPeriod = num:i(0)"!][!//
        <IMPLEMENTATION-DATA-TYPE-ELEMENT>
          <SHORT-NAME>CanHrhPeriodIndexPtr</SHORT-NAME>
          <CATEGORY>DATA_REFERENCE</CATEGORY>
          <SW-DATA-DEF-PROPS>
            <SW-DATA-DEF-PROPS-VARIANTS>
              <SW-DATA-DEF-PROPS-CONDITIONAL>
                <SW-POINTER-TARGET-PROPS>
                  <TARGET-CATEGORY>TYPE_REFERENCE</TARGET-CATEGORY>
                  <SW-DATA-DEF-PROPS>
                    <SW-DATA-DEF-PROPS-VARIANTS>
                      <SW-DATA-DEF-PROPS-CONDITIONAL>
                        <IMPLEMENTATION-DATA-TYPE-REF DEST="IMPLEMENTATION-DATA-TYPE">/AUTOSAR_Can_17_McmCan/ImplementationDataTypes/Can_17_McmCan_HrhPeriodIndexType</IMPLEMENTATION-DATA-TYPE-REF>
                      </SW-DATA-DEF-PROPS-CONDITIONAL>
                    </SW-DATA-DEF-PROPS-VARIANTS>
                  </SW-DATA-DEF-PROPS>
                </SW-POINTER-TARGET-PROPS>
              </SW-DATA-DEF-PROPS-CONDITIONAL>
            </SW-DATA-DEF-PROPS-VARIANTS>
          </SW-DATA-DEF-PROPS>
        </IMPLEMENTATION-DATA-TYPE-ELEMENT>
        <IMPLEMENTATION-DATA-TYPE-ELEMENT>
          <SHORT-NAME>CanHrhMaskObjectConfigPtr</SHORT-NAME>
          <CATEGORY>DATA_REFERENCE</CATEGORY>
          <SW-DATA-DEF-PROPS>
            <SW-DATA-DEF-PROPS-VARIANTS>
              <SW-DATA-DEF-PROPS-CONDITIONAL>
                <SW-POINTER-TARGET-PROPS>
                  <TARGET-CATEGORY>TYPE_REFERENCE</TARGET-CATEGORY>
                  <SW-DATA-DEF-PROPS>
                    <SW-DATA-DEF-PROPS-VARIANTS>
                      <SW-DATA-DEF-PROPS-CONDITIONAL>
                        <IMPLEMENTATION-DATA-TYPE-REF DEST="IMPLEMENTATION-DATA-TYPE">/AUTOSAR_Can_17_McmCan/ImplementationDataTypes/Can_17_McmCan_HrhMaskObjectConfigType</IMPLEMENTATION-DATA-TYPE-REF>
                      </SW-DATA-DEF-PROPS-CONDITIONAL>
                    </SW-DATA-DEF-PROPS-VARIANTS>
                  </SW-DATA-DEF-PROPS>
                </SW-POINTER-TARGET-PROPS>
              </SW-DATA-DEF-PROPS-CONDITIONAL>
            </SW-DATA-DEF-PROPS-VARIANTS>
          </SW-DATA-DEF-PROPS>
        </IMPLEMENTATION-DATA-TYPE-ELEMENT>
        <IMPLEMENTATION-DATA-TYPE-ELEMENT>
          <SHORT-NAME>CanPeriodHrhMaskConfigPtr</SHORT-NAME>
          <CATEGORY>DATA_REFERENCE</CATEGORY>
          <SW-DATA-DEF-PROPS>
            <SW-DATA-DEF-PROPS-VARIANTS>
              <SW-DATA-DEF-PROPS-CONDITIONAL>
                <SW-POINTER-TARGET-PROPS>
                  <TARGET-CATEGORY>TYPE_REFERENCE</TARGET-CATEGORY>
                  <SW-DATA-DEF-PROPS>
                    <SW-DATA-DEF-PROPS-VARIANTS>
                      <SW-DATA-DEF-PROPS-CONDITIONAL>
                        <IMPLEMENTATION-DATA-TYPE-REF DEST="IMPLEMENTATION-DATA-TYPE">/AUTOSAR_Can_17_McmCan/ImplementationDataTypes/Can_17_McmCan_PeriodHrhMaskConfigType</IMPLEMENTATION-DATA-TYPE-REF>
                      </SW-DATA-DEF-PROPS-CONDITIONAL>
                    </SW-DATA-DEF-PROPS-VARIANTS>
                  </SW-DATA-DEF-PROPS>
                </SW-POINTER-TARGET-PROPS>
              </SW-DATA-DEF-PROPS-CONDITIONAL>
            </SW-DATA-DEF-PROPS-VARIANTS>
          </SW-DATA-DEF-PROPS>
        </IMPLEMENTATION-DATA-TYPE-ELEMENT>
[!ENDIF!][!//
      </SUB-ELEMENTS>
      <TYPE-EMITTER>BSW</TYPE-EMITTER>
    </IMPLEMENTATION-DATA-TYPE>
              <IMPLEMENTATION-DATA-TYPE>
      <SHORT-NAME>Can_17_McmCan_ConfigType</SHORT-NAME>
      <CATEGORY>STRUCTURE</CATEGORY>
      <SUB-ELEMENTS>
        <IMPLEMENTATION-DATA-TYPE-ELEMENT>
          <SHORT-NAME>CanCoreConfigPtr</SHORT-NAME>
          <CATEGORY>DATA_REFERENCE</CATEGORY>
          <ARRAY-SIZE>[!"$MaxCore"!]</ARRAY-SIZE>
          <ARRAY-SIZE-SEMANTICS>FIXED-SIZE</ARRAY-SIZE-SEMANTICS>
          <SW-DATA-DEF-PROPS>
            <SW-DATA-DEF-PROPS-VARIANTS>
              <SW-DATA-DEF-PROPS-CONDITIONAL>
                <SW-POINTER-TARGET-PROPS>
                  <TARGET-CATEGORY>TYPE_REFERENCE</TARGET-CATEGORY>
                  <SW-DATA-DEF-PROPS>
                    <SW-DATA-DEF-PROPS-VARIANTS>
                      <SW-DATA-DEF-PROPS-CONDITIONAL>
                        <IMPLEMENTATION-DATA-TYPE-REF DEST="IMPLEMENTATION-DATA-TYPE">/AUTOSAR_Can_17_McmCan/ImplementationDataTypes/Can_17_McmCan_CoreConfigType</IMPLEMENTATION-DATA-TYPE-REF>
                      </SW-DATA-DEF-PROPS-CONDITIONAL>
                    </SW-DATA-DEF-PROPS-VARIANTS>
                  </SW-DATA-DEF-PROPS>
                </SW-POINTER-TARGET-PROPS>
              </SW-DATA-DEF-PROPS-CONDITIONAL>
            </SW-DATA-DEF-PROPS-VARIANTS>
          </SW-DATA-DEF-PROPS>
        </IMPLEMENTATION-DATA-TYPE-ELEMENT>
        <IMPLEMENTATION-DATA-TYPE-ELEMENT>
          <SHORT-NAME>CanNoOfKernel</SHORT-NAME>
          <CATEGORY>TYPE_REFERENCE</CATEGORY>
          <SW-DATA-DEF-PROPS>
            <SW-DATA-DEF-PROPS-VARIANTS>
              <SW-DATA-DEF-PROPS-CONDITIONAL>
                <IMPLEMENTATION-DATA-TYPE-REF DEST="IMPLEMENTATION-DATA-TYPE">/AUTOSAR_Platform/ImplementationDataTypes/uint8</IMPLEMENTATION-DATA-TYPE-REF>
              </SW-DATA-DEF-PROPS-CONDITIONAL>
            </SW-DATA-DEF-PROPS-VARIANTS>
          </SW-DATA-DEF-PROPS>
        </IMPLEMENTATION-DATA-TYPE-ELEMENT>
        <IMPLEMENTATION-DATA-TYPE-ELEMENT>
          <SHORT-NAME>CanNoOfHrh</SHORT-NAME>
          <CATEGORY>TYPE_REFERENCE</CATEGORY>
          <SW-DATA-DEF-PROPS>
            <SW-DATA-DEF-PROPS-VARIANTS>
              <SW-DATA-DEF-PROPS-CONDITIONAL>
                <IMPLEMENTATION-DATA-TYPE-REF DEST="IMPLEMENTATION-DATA-TYPE">/AUTOSAR_Can_GeneralTypes/ImplementationDataTypes/Can_HwHandleType</IMPLEMENTATION-DATA-TYPE-REF>
              </SW-DATA-DEF-PROPS-CONDITIONAL>
            </SW-DATA-DEF-PROPS-VARIANTS>
          </SW-DATA-DEF-PROPS>
        </IMPLEMENTATION-DATA-TYPE-ELEMENT>
        <IMPLEMENTATION-DATA-TYPE-ELEMENT>
          <SHORT-NAME>CanTotalHwObj</SHORT-NAME>
          <CATEGORY>TYPE_REFERENCE</CATEGORY>
          <SW-DATA-DEF-PROPS>
            <SW-DATA-DEF-PROPS-VARIANTS>
              <SW-DATA-DEF-PROPS-CONDITIONAL>
                <IMPLEMENTATION-DATA-TYPE-REF DEST="IMPLEMENTATION-DATA-TYPE">/AUTOSAR_Can_GeneralTypes/ImplementationDataTypes/Can_HwHandleType</IMPLEMENTATION-DATA-TYPE-REF>
              </SW-DATA-DEF-PROPS-CONDITIONAL>
            </SW-DATA-DEF-PROPS-VARIANTS>
          </SW-DATA-DEF-PROPS>
        </IMPLEMENTATION-DATA-TYPE-ELEMENT>
        <IMPLEMENTATION-DATA-TYPE-ELEMENT>
          <SHORT-NAME>CanTriggerTransmitEnable</SHORT-NAME>
          <CATEGORY>TYPE_REFERENCE</CATEGORY>
          <SW-DATA-DEF-PROPS>
            <SW-DATA-DEF-PROPS-VARIANTS>
              <SW-DATA-DEF-PROPS-CONDITIONAL>
                <IMPLEMENTATION-DATA-TYPE-REF DEST="IMPLEMENTATION-DATA-TYPE">/AUTOSAR_Platform/ImplementationDataTypes/boolean</IMPLEMENTATION-DATA-TYPE-REF>
              </SW-DATA-DEF-PROPS-CONDITIONAL>
            </SW-DATA-DEF-PROPS-VARIANTS>
          </SW-DATA-DEF-PROPS>
        </IMPLEMENTATION-DATA-TYPE-ELEMENT>
        <IMPLEMENTATION-DATA-TYPE-ELEMENT>
          <SHORT-NAME>CanMCMModuleConfigPtr</SHORT-NAME>
          <CATEGORY>DATA_REFERENCE</CATEGORY>
          <SW-DATA-DEF-PROPS>
            <SW-DATA-DEF-PROPS-VARIANTS>
              <SW-DATA-DEF-PROPS-CONDITIONAL>
                <SW-POINTER-TARGET-PROPS>
                  <TARGET-CATEGORY>TYPE_REFERENCE</TARGET-CATEGORY>
                  <SW-DATA-DEF-PROPS>
                    <SW-DATA-DEF-PROPS-VARIANTS>
                      <SW-DATA-DEF-PROPS-CONDITIONAL>
                        <IMPLEMENTATION-DATA-TYPE-REF DEST="IMPLEMENTATION-DATA-TYPE">/AUTOSAR_Can_17_McmCan/ImplementationDataTypes/Can_17_McmCan_McmModuleConfigType</IMPLEMENTATION-DATA-TYPE-REF>
                      </SW-DATA-DEF-PROPS-CONDITIONAL>
                    </SW-DATA-DEF-PROPS-VARIANTS>
                  </SW-DATA-DEF-PROPS>
                </SW-POINTER-TARGET-PROPS>
              </SW-DATA-DEF-PROPS-CONDITIONAL>
            </SW-DATA-DEF-PROPS-VARIANTS>
          </SW-DATA-DEF-PROPS>
        </IMPLEMENTATION-DATA-TYPE-ELEMENT>
        <IMPLEMENTATION-DATA-TYPE-ELEMENT>
          <SHORT-NAME>CanPhyControllerIndexPtr</SHORT-NAME>
          <CATEGORY>DATA_REFERENCE</CATEGORY>
          <SW-DATA-DEF-PROPS>
            <SW-DATA-DEF-PROPS-VARIANTS>
              <SW-DATA-DEF-PROPS-CONDITIONAL>
                <SW-POINTER-TARGET-PROPS>
                  <TARGET-CATEGORY>TYPE_REFERENCE</TARGET-CATEGORY>
                  <SW-DATA-DEF-PROPS>
                    <SW-DATA-DEF-PROPS-VARIANTS>
                      <SW-DATA-DEF-PROPS-CONDITIONAL>
                        <IMPLEMENTATION-DATA-TYPE-REF DEST="IMPLEMENTATION-DATA-TYPE">/AUTOSAR_Can_17_McmCan/ImplementationDataTypes/Can_17_McmCan_PhyControllerIndexType</IMPLEMENTATION-DATA-TYPE-REF>
                      </SW-DATA-DEF-PROPS-CONDITIONAL>
                    </SW-DATA-DEF-PROPS-VARIANTS>
                  </SW-DATA-DEF-PROPS>
                </SW-POINTER-TARGET-PROPS>
              </SW-DATA-DEF-PROPS-CONDITIONAL>
            </SW-DATA-DEF-PROPS-VARIANTS>
          </SW-DATA-DEF-PROPS>
        </IMPLEMENTATION-DATA-TYPE-ELEMENT>
        <IMPLEMENTATION-DATA-TYPE-ELEMENT>
          <SHORT-NAME>CanLogicalControllerIndexPtr</SHORT-NAME>
          <CATEGORY>DATA_REFERENCE</CATEGORY>
          <SW-DATA-DEF-PROPS>
            <SW-DATA-DEF-PROPS-VARIANTS>
              <SW-DATA-DEF-PROPS-CONDITIONAL>
                <SW-POINTER-TARGET-PROPS>
                  <TARGET-CATEGORY>TYPE_REFERENCE</TARGET-CATEGORY>
                  <SW-DATA-DEF-PROPS>
                    <SW-DATA-DEF-PROPS-VARIANTS>
                      <SW-DATA-DEF-PROPS-CONDITIONAL>
                        <IMPLEMENTATION-DATA-TYPE-REF DEST="IMPLEMENTATION-DATA-TYPE">/AUTOSAR_Can_17_McmCan/ImplementationDataTypes/Can_17_McmCan_LogicalControllerIndexType</IMPLEMENTATION-DATA-TYPE-REF>
                      </SW-DATA-DEF-PROPS-CONDITIONAL>
                    </SW-DATA-DEF-PROPS-VARIANTS>
                  </SW-DATA-DEF-PROPS>
                </SW-POINTER-TARGET-PROPS>
              </SW-DATA-DEF-PROPS-CONDITIONAL>
            </SW-DATA-DEF-PROPS-VARIANTS>
          </SW-DATA-DEF-PROPS>
        </IMPLEMENTATION-DATA-TYPE-ELEMENT>
        <IMPLEMENTATION-DATA-TYPE-ELEMENT>
          <SHORT-NAME>CanHthIndexPtr</SHORT-NAME>
          <CATEGORY>DATA_REFERENCE</CATEGORY>
          <SW-DATA-DEF-PROPS>
            <SW-DATA-DEF-PROPS-VARIANTS>
              <SW-DATA-DEF-PROPS-CONDITIONAL>
                <SW-POINTER-TARGET-PROPS>
                  <TARGET-CATEGORY>TYPE_REFERENCE</TARGET-CATEGORY>
                  <SW-DATA-DEF-PROPS>
                    <SW-DATA-DEF-PROPS-VARIANTS>
                      <SW-DATA-DEF-PROPS-CONDITIONAL>
                        <IMPLEMENTATION-DATA-TYPE-REF DEST="IMPLEMENTATION-DATA-TYPE">/AUTOSAR_Can_17_McmCan/ImplementationDataTypes/Can_17_McmCan_HthIndexType</IMPLEMENTATION-DATA-TYPE-REF>
                      </SW-DATA-DEF-PROPS-CONDITIONAL>
                    </SW-DATA-DEF-PROPS-VARIANTS>
                  </SW-DATA-DEF-PROPS>
                </SW-POINTER-TARGET-PROPS>
              </SW-DATA-DEF-PROPS-CONDITIONAL>
            </SW-DATA-DEF-PROPS-VARIANTS>
          </SW-DATA-DEF-PROPS>
        </IMPLEMENTATION-DATA-TYPE-ELEMENT>
[!IF "../CanGeneral/CanPublicIcomSupport = 'true'"!][!//
        <IMPLEMENTATION-DATA-TYPE-ELEMENT>
          <SHORT-NAME>CanIcomConfigPtr</SHORT-NAME>
          <CATEGORY>DATA_REFERENCE</CATEGORY>
          <SW-DATA-DEF-PROPS>
            <SW-DATA-DEF-PROPS-VARIANTS>
              <SW-DATA-DEF-PROPS-CONDITIONAL>
                <SW-POINTER-TARGET-PROPS>
                  <TARGET-CATEGORY>TYPE_REFERENCE</TARGET-CATEGORY>
                  <SW-DATA-DEF-PROPS>
                    <SW-DATA-DEF-PROPS-VARIANTS>
                      <SW-DATA-DEF-PROPS-CONDITIONAL>
                        <IMPLEMENTATION-DATA-TYPE-REF DEST="IMPLEMENTATION-DATA-TYPE">/AUTOSAR_Can_17_McmCan/ImplementationDataTypes/Can_17_McmCan_IcomConfigType</IMPLEMENTATION-DATA-TYPE-REF>
                      </SW-DATA-DEF-PROPS-CONDITIONAL>
                    </SW-DATA-DEF-PROPS-VARIANTS>
                  </SW-DATA-DEF-PROPS>
                </SW-POINTER-TARGET-PROPS>
              </SW-DATA-DEF-PROPS-CONDITIONAL>
            </SW-DATA-DEF-PROPS-VARIANTS>
          </SW-DATA-DEF-PROPS>
        </IMPLEMENTATION-DATA-TYPE-ELEMENT>
        <IMPLEMENTATION-DATA-TYPE-ELEMENT>
          <SHORT-NAME>CanIcomMsgConfigPtr</SHORT-NAME>
          <CATEGORY>DATA_REFERENCE</CATEGORY>
          <SW-DATA-DEF-PROPS>
            <SW-DATA-DEF-PROPS-VARIANTS>
              <SW-DATA-DEF-PROPS-CONDITIONAL>
                <SW-POINTER-TARGET-PROPS>
                  <TARGET-CATEGORY>TYPE_REFERENCE</TARGET-CATEGORY>
                  <SW-DATA-DEF-PROPS>
                    <SW-DATA-DEF-PROPS-VARIANTS>
                      <SW-DATA-DEF-PROPS-CONDITIONAL>
                        <IMPLEMENTATION-DATA-TYPE-REF DEST="IMPLEMENTATION-DATA-TYPE">/AUTOSAR_Can_17_McmCan/ImplementationDataTypes/Can_17_McmCan_IcomRxMsgConfigType</IMPLEMENTATION-DATA-TYPE-REF>
                      </SW-DATA-DEF-PROPS-CONDITIONAL>
                    </SW-DATA-DEF-PROPS-VARIANTS>
                  </SW-DATA-DEF-PROPS>
                </SW-POINTER-TARGET-PROPS>
              </SW-DATA-DEF-PROPS-CONDITIONAL>
            </SW-DATA-DEF-PROPS-VARIANTS>
          </SW-DATA-DEF-PROPS>
        </IMPLEMENTATION-DATA-TYPE-ELEMENT>
        <IMPLEMENTATION-DATA-TYPE-ELEMENT>
          <SHORT-NAME>CanIcomRxSignalConfigPtr</SHORT-NAME>
          <CATEGORY>DATA_REFERENCE</CATEGORY>
          <SW-DATA-DEF-PROPS>
            <SW-DATA-DEF-PROPS-VARIANTS>
              <SW-DATA-DEF-PROPS-CONDITIONAL>
                <SW-POINTER-TARGET-PROPS>
                  <TARGET-CATEGORY>TYPE_REFERENCE</TARGET-CATEGORY>
                  <SW-DATA-DEF-PROPS>
                    <SW-DATA-DEF-PROPS-VARIANTS>
                      <SW-DATA-DEF-PROPS-CONDITIONAL>
                        <IMPLEMENTATION-DATA-TYPE-REF DEST="IMPLEMENTATION-DATA-TYPE">/AUTOSAR_Can_17_McmCan/ImplementationDataTypes/Can_17_McmCan_IcomRxMsgSignalConfigType</IMPLEMENTATION-DATA-TYPE-REF>
                      </SW-DATA-DEF-PROPS-CONDITIONAL>
                    </SW-DATA-DEF-PROPS-VARIANTS>
                  </SW-DATA-DEF-PROPS>
                </SW-POINTER-TARGET-PROPS>
              </SW-DATA-DEF-PROPS-CONDITIONAL>
            </SW-DATA-DEF-PROPS-VARIANTS>
          </SW-DATA-DEF-PROPS>
        </IMPLEMENTATION-DATA-TYPE-ELEMENT>
[!ENDIF!][!//
        <IMPLEMENTATION-DATA-TYPE-ELEMENT>
          <SHORT-NAME>CanLPduRxCalloutFuncPtr</SHORT-NAME>
          <CATEGORY>TYPE_REFERENCE</CATEGORY>
          <SW-DATA-DEF-PROPS>
            <SW-DATA-DEF-PROPS-VARIANTS>
              <SW-DATA-DEF-PROPS-CONDITIONAL>
                <IMPLEMENTATION-DATA-TYPE-REF DEST="IMPLEMENTATION-DATA-TYPE">/AUTOSAR_Can_17_McmCan/ImplementationDataTypes/Can_17_McmCan_LPduRxCalloutFnPtrType</IMPLEMENTATION-DATA-TYPE-REF>
              </SW-DATA-DEF-PROPS-CONDITIONAL>
            </SW-DATA-DEF-PROPS-VARIANTS>
          </SW-DATA-DEF-PROPS>
        </IMPLEMENTATION-DATA-TYPE-ELEMENT>
      </SUB-ELEMENTS>
      <TYPE-EMITTER>BSW</TYPE-EMITTER>
    </IMPLEMENTATION-DATA-TYPE>
        </ELEMENTS>
      </AR-PACKAGE>
      <AR-PACKAGE>
        <SHORT-NAME>CompuMethods</SHORT-NAME>
        <CATEGORY>STANDARD</CATEGORY>
        <ELEMENTS>
          <COMPU-METHOD>
            <SHORT-NAME>Can_17_McmCan_IcomSignalOperType</SHORT-NAME>
            <CATEGORY>TEXTTABLE</CATEGORY>
            <COMPU-INTERNAL-TO-PHYS>
              <COMPU-SCALES>
                <COMPU-SCALE>
                  <LOWER-LIMIT INTERVAL-TYPE="CLOSED">0</LOWER-LIMIT>
                  <UPPER-LIMIT INTERVAL-TYPE="CLOSED">0</UPPER-LIMIT>
                  <COMPU-CONST>
                    <VT>CAN_17_MCMCAN_ICOM_OPER_AND</VT>
                  </COMPU-CONST>
                </COMPU-SCALE>
                <COMPU-SCALE>
                  <LOWER-LIMIT INTERVAL-TYPE="CLOSED">1</LOWER-LIMIT>
                  <UPPER-LIMIT INTERVAL-TYPE="CLOSED">1</UPPER-LIMIT>
                  <COMPU-CONST>
                    <VT>CAN_17_MCMCAN_ICOM_OPER_EQUAL</VT>
                  </COMPU-CONST>
                </COMPU-SCALE>
                <COMPU-SCALE>
                  <LOWER-LIMIT INTERVAL-TYPE="CLOSED">2</LOWER-LIMIT>
                  <UPPER-LIMIT INTERVAL-TYPE="CLOSED">2</UPPER-LIMIT>
                  <COMPU-CONST>
                    <VT>CAN_17_MCMCAN_ICOM_OPER_GREATER</VT>
                  </COMPU-CONST>
                </COMPU-SCALE>
                <COMPU-SCALE>
                  <LOWER-LIMIT INTERVAL-TYPE="CLOSED">3</LOWER-LIMIT>
                  <UPPER-LIMIT INTERVAL-TYPE="CLOSED">3</UPPER-LIMIT>
                  <COMPU-CONST>
                    <VT>CAN_17_MCMCAN_ICOM_OPER_SMALLER</VT>
                  </COMPU-CONST>
                </COMPU-SCALE>
                <COMPU-SCALE>
                  <LOWER-LIMIT INTERVAL-TYPE="CLOSED">4</LOWER-LIMIT>
                  <UPPER-LIMIT INTERVAL-TYPE="CLOSED">4</UPPER-LIMIT>
                  <COMPU-CONST>
                    <VT>CAN_17_MCMCAN_ICOM_OPER_XOR</VT>
                  </COMPU-CONST>
                </COMPU-SCALE>
              </COMPU-SCALES>
            </COMPU-INTERNAL-TO-PHYS>
          </COMPU-METHOD>
          <COMPU-METHOD>
            <SHORT-NAME>Can_17_McmCan_TxBufferType</SHORT-NAME>
            <CATEGORY>TEXTTABLE</CATEGORY>
            <COMPU-INTERNAL-TO-PHYS>
              <COMPU-SCALES>
                <COMPU-SCALE>
                  <LOWER-LIMIT INTERVAL-TYPE="CLOSED">0</LOWER-LIMIT>
                  <UPPER-LIMIT INTERVAL-TYPE="CLOSED">0</UPPER-LIMIT>
                  <COMPU-CONST>
                    <VT>CAN_17_MCMCAN_TX_DED_BUFFER</VT>
                  </COMPU-CONST>
                </COMPU-SCALE>
                <COMPU-SCALE>
                  <LOWER-LIMIT INTERVAL-TYPE="CLOSED">1</LOWER-LIMIT>
                  <UPPER-LIMIT INTERVAL-TYPE="CLOSED">1</UPPER-LIMIT>
                  <COMPU-CONST>
                    <VT>CAN_17_MCMCAN_TX_QUEUE</VT>
                  </COMPU-CONST>
                </COMPU-SCALE>
              </COMPU-SCALES>
            </COMPU-INTERNAL-TO-PHYS>
          </COMPU-METHOD>
          <COMPU-METHOD>
      <SHORT-NAME>Can_17_Mcmcan_DrvStateMachine</SHORT-NAME>
      <CATEGORY>TEXTTABLE</CATEGORY>
      <COMPU-INTERNAL-TO-PHYS>
        <COMPU-SCALES>
          <COMPU-SCALE>
            <LOWER-LIMIT INTERVAL-TYPE="CLOSED">0</LOWER-LIMIT>
            <UPPER-LIMIT INTERVAL-TYPE="CLOSED">0</UPPER-LIMIT>
            <COMPU-CONST>
              <VT>CAN_17_MCMCA_UNINIT</VT>
            </COMPU-CONST>
          </COMPU-SCALE>
          <COMPU-SCALE>
            <LOWER-LIMIT INTERVAL-TYPE="CLOSED">1</LOWER-LIMIT>
            <UPPER-LIMIT INTERVAL-TYPE="CLOSED">1</UPPER-LIMIT>
            <COMPU-CONST>
              <VT>CAN_17_MCMCAN_READY</VT>
            </COMPU-CONST>
          </COMPU-SCALE>
        </COMPU-SCALES>
      </COMPU-INTERNAL-TO-PHYS>
    </COMPU-METHOD>
    <COMPU-METHOD>
      <SHORT-NAME>Can_17_McmCan_EventIndicesType</SHORT-NAME>
      <CATEGORY>TEXTTABLE</CATEGORY>
      <COMPU-INTERNAL-TO-PHYS>
        <COMPU-SCALES>
          <COMPU-SCALE>
            <LOWER-LIMIT INTERVAL-TYPE="CLOSED">0</LOWER-LIMIT>
            <UPPER-LIMIT INTERVAL-TYPE="CLOSED">0</UPPER-LIMIT>
            <COMPU-CONST>
              <VT>CAN_17_MCMCAN_TX_PROCESSING_MODE</VT>
            </COMPU-CONST>
          </COMPU-SCALE>
          <COMPU-SCALE>
            <LOWER-LIMIT INTERVAL-TYPE="CLOSED">1</LOWER-LIMIT>
            <UPPER-LIMIT INTERVAL-TYPE="CLOSED">1</UPPER-LIMIT>
            <COMPU-CONST>
              <VT>CAN_17_MCMCAN_RX_PROCESSING_MODE</VT>
            </COMPU-CONST>
          </COMPU-SCALE>
          <COMPU-SCALE>
            <LOWER-LIMIT INTERVAL-TYPE="CLOSED">2</LOWER-LIMIT>
            <UPPER-LIMIT INTERVAL-TYPE="CLOSED">2</UPPER-LIMIT>
            <COMPU-CONST>
              <VT>CAN_17_MCMCAN_BO_PROCESSING_MODE</VT>
            </COMPU-CONST>
          </COMPU-SCALE>
          <COMPU-SCALE>
            <LOWER-LIMIT INTERVAL-TYPE="CLOSED">3</LOWER-LIMIT>
            <UPPER-LIMIT INTERVAL-TYPE="CLOSED">3</UPPER-LIMIT>
            <COMPU-CONST>
              <VT>CAN_17_MCMCAN_WU_PROCESSING_MODE</VT>
            </COMPU-CONST>
          </COMPU-SCALE>
        </COMPU-SCALES>
      </COMPU-INTERNAL-TO-PHYS>
    </COMPU-METHOD>
    <COMPU-METHOD>
      <SHORT-NAME>Can_17_McmCan_IDType</SHORT-NAME>
      <CATEGORY>TEXTTABLE</CATEGORY>
      <COMPU-INTERNAL-TO-PHYS>
        <COMPU-SCALES>
          <COMPU-SCALE>
            <LOWER-LIMIT INTERVAL-TYPE="CLOSED">0</LOWER-LIMIT>
            <UPPER-LIMIT INTERVAL-TYPE="CLOSED">0</UPPER-LIMIT>
            <COMPU-CONST>
              <VT>CAN_17_MCMCAN_ID_STANDARD</VT>
            </COMPU-CONST>
          </COMPU-SCALE>
          <COMPU-SCALE>
            <LOWER-LIMIT INTERVAL-TYPE="CLOSED">1</LOWER-LIMIT>
            <UPPER-LIMIT INTERVAL-TYPE="CLOSED">1</UPPER-LIMIT>
            <COMPU-CONST>
              <VT>CAN_17_MCMCAN_ID_MIXED</VT>
            </COMPU-CONST>
          </COMPU-SCALE>
          <COMPU-SCALE>
            <LOWER-LIMIT INTERVAL-TYPE="CLOSED">2</LOWER-LIMIT>
            <UPPER-LIMIT INTERVAL-TYPE="CLOSED">2</UPPER-LIMIT>
            <COMPU-CONST>
              <VT>CAN_17_MCMCAN_ID_EXTENDED</VT>
            </COMPU-CONST>
          </COMPU-SCALE>
        </COMPU-SCALES>
      </COMPU-INTERNAL-TO-PHYS>
    </COMPU-METHOD>
    <COMPU-METHOD>
      <SHORT-NAME>Can_17_McmCan_MOMapType</SHORT-NAME>
      <CATEGORY>TEXTTABLE</CATEGORY>
      <COMPU-INTERNAL-TO-PHYS>
        <COMPU-SCALES>
          <COMPU-SCALE>
            <LOWER-LIMIT INTERVAL-TYPE="CLOSED">0</LOWER-LIMIT>
            <UPPER-LIMIT INTERVAL-TYPE="CLOSED">0</UPPER-LIMIT>
            <COMPU-CONST>
              <VT>CAN_17_MCMCAN_TX_STARTINDEX</VT>
            </COMPU-CONST>
          </COMPU-SCALE>
          <COMPU-SCALE>
            <LOWER-LIMIT INTERVAL-TYPE="CLOSED">1</LOWER-LIMIT>
            <UPPER-LIMIT INTERVAL-TYPE="CLOSED">1</UPPER-LIMIT>
            <COMPU-CONST>
              <VT>CAN_17_MCMCAN_TX_TOTAL_MSGCFG</VT>
            </COMPU-CONST>
          </COMPU-SCALE>
          <COMPU-SCALE>
            <LOWER-LIMIT INTERVAL-TYPE="CLOSED">2</LOWER-LIMIT>
            <UPPER-LIMIT INTERVAL-TYPE="CLOSED">2</UPPER-LIMIT>
            <COMPU-CONST>
              <VT>CAN_17_MCMCAN_RX_SID_STARTINDEX</VT>
            </COMPU-CONST>
          </COMPU-SCALE>
          <COMPU-SCALE>
            <LOWER-LIMIT INTERVAL-TYPE="CLOSED">3</LOWER-LIMIT>
            <UPPER-LIMIT INTERVAL-TYPE="CLOSED">3</UPPER-LIMIT>
            <COMPU-CONST>
              <VT>CAN_17_MCMCAN_TOTAL_SIDCFG</VT>
            </COMPU-CONST>
          </COMPU-SCALE>
          <COMPU-SCALE>
            <LOWER-LIMIT INTERVAL-TYPE="CLOSED">4</LOWER-LIMIT>
            <UPPER-LIMIT INTERVAL-TYPE="CLOSED">4</UPPER-LIMIT>
            <COMPU-CONST>
              <VT>CAN_17_MCMCAN_RX_XID_STARTINDEX</VT>
            </COMPU-CONST>
          </COMPU-SCALE>
          <COMPU-SCALE>
            <LOWER-LIMIT INTERVAL-TYPE="CLOSED">5</LOWER-LIMIT>
            <UPPER-LIMIT INTERVAL-TYPE="CLOSED">5</UPPER-LIMIT>
            <COMPU-CONST>
              <VT>CAN_17_MCMCAN_TOTAL_XIDCFG</VT>
            </COMPU-CONST>
          </COMPU-SCALE>
        </COMPU-SCALES>
      </COMPU-INTERNAL-TO-PHYS>
    </COMPU-METHOD>
    <COMPU-METHOD>
      <SHORT-NAME>Can_17_McmCan_MsgRamMapType</SHORT-NAME>
      <CATEGORY>TEXTTABLE</CATEGORY>
      <COMPU-INTERNAL-TO-PHYS>
        <COMPU-SCALES>
          <COMPU-SCALE>
            <LOWER-LIMIT INTERVAL-TYPE="CLOSED">0</LOWER-LIMIT>
            <UPPER-LIMIT INTERVAL-TYPE="CLOSED">0</UPPER-LIMIT>
            <COMPU-CONST>
              <VT>CAN_17_MCMCAN_FLSSA</VT>
            </COMPU-CONST>
          </COMPU-SCALE>
          <COMPU-SCALE>
            <LOWER-LIMIT INTERVAL-TYPE="CLOSED">1</LOWER-LIMIT>
            <UPPER-LIMIT INTERVAL-TYPE="CLOSED">1</UPPER-LIMIT>
            <COMPU-CONST>
              <VT>CAN_17_MCMCAN_FLSEA</VT>
            </COMPU-CONST>
          </COMPU-SCALE>
          <COMPU-SCALE>
            <LOWER-LIMIT INTERVAL-TYPE="CLOSED">2</LOWER-LIMIT>
            <UPPER-LIMIT INTERVAL-TYPE="CLOSED">2</UPPER-LIMIT>
            <COMPU-CONST>
              <VT>CAN_17_MCMCAN_F0SA</VT>
            </COMPU-CONST>
          </COMPU-SCALE>
          <COMPU-SCALE>
            <LOWER-LIMIT INTERVAL-TYPE="CLOSED">3</LOWER-LIMIT>
            <UPPER-LIMIT INTERVAL-TYPE="CLOSED">3</UPPER-LIMIT>
            <COMPU-CONST>
              <VT>CAN_17_MCMCAN_F1SA</VT>
            </COMPU-CONST>
          </COMPU-SCALE>
          <COMPU-SCALE>
            <LOWER-LIMIT INTERVAL-TYPE="CLOSED">4</LOWER-LIMIT>
            <UPPER-LIMIT INTERVAL-TYPE="CLOSED">4</UPPER-LIMIT>
            <COMPU-CONST>
              <VT>CAN_17_MCMCAN_RBSA</VT>
            </COMPU-CONST>
          </COMPU-SCALE>
          <COMPU-SCALE>
            <LOWER-LIMIT INTERVAL-TYPE="CLOSED">5</LOWER-LIMIT>
            <UPPER-LIMIT INTERVAL-TYPE="CLOSED">5</UPPER-LIMIT>
            <COMPU-CONST>
              <VT>CAN_17_MCMCAN_EFSA</VT>
            </COMPU-CONST>
          </COMPU-SCALE>
          <COMPU-SCALE>
            <LOWER-LIMIT INTERVAL-TYPE="CLOSED">6</LOWER-LIMIT>
            <UPPER-LIMIT INTERVAL-TYPE="CLOSED">6</UPPER-LIMIT>
            <COMPU-CONST>
              <VT>CAN_17_MCMCAN_TBSA</VT>
            </COMPU-CONST>
          </COMPU-SCALE>
        </COMPU-SCALES>
      </COMPU-INTERNAL-TO-PHYS>
    </COMPU-METHOD>
    <COMPU-METHOD>
      <SHORT-NAME>Can_17_McmCan_ProcessingType</SHORT-NAME>
      <CATEGORY>TEXTTABLE</CATEGORY>
      <COMPU-INTERNAL-TO-PHYS>
        <COMPU-SCALES>
          <COMPU-SCALE>
            <LOWER-LIMIT INTERVAL-TYPE="CLOSED">0</LOWER-LIMIT>
            <UPPER-LIMIT INTERVAL-TYPE="CLOSED">0</UPPER-LIMIT>
            <COMPU-CONST>
              <VT>CAN_17_MCMCAN_POLLING</VT>
            </COMPU-CONST>
          </COMPU-SCALE>
          <COMPU-SCALE>
            <LOWER-LIMIT INTERVAL-TYPE="CLOSED">1</LOWER-LIMIT>
            <UPPER-LIMIT INTERVAL-TYPE="CLOSED">1</UPPER-LIMIT>
            <COMPU-CONST>
              <VT>CAN_17_MCMCAN_INTERRUPT</VT>
            </COMPU-CONST>
          </COMPU-SCALE>
          <COMPU-SCALE>
            <LOWER-LIMIT INTERVAL-TYPE="CLOSED">2</LOWER-LIMIT>
            <UPPER-LIMIT INTERVAL-TYPE="CLOSED">2</UPPER-LIMIT>
            <COMPU-CONST>
              <VT>CAN_17_MCMCAN_MIXED</VT>
            </COMPU-CONST>
          </COMPU-SCALE>
        </COMPU-SCALES>
      </COMPU-INTERNAL-TO-PHYS>
    </COMPU-METHOD>
    <COMPU-METHOD>
      <SHORT-NAME>Can_17_McmCan_RxFIFOProcessingType</SHORT-NAME>
      <CATEGORY>TEXTTABLE</CATEGORY>
      <COMPU-INTERNAL-TO-PHYS>
        <COMPU-SCALES>
          <COMPU-SCALE>
            <LOWER-LIMIT INTERVAL-TYPE="CLOSED">0</LOWER-LIMIT>
            <UPPER-LIMIT INTERVAL-TYPE="CLOSED">0</UPPER-LIMIT>
            <COMPU-CONST>
              <VT>CAN_17_MCMCAN_RX_FIFO_POLLING</VT>
            </COMPU-CONST>
          </COMPU-SCALE>
          <COMPU-SCALE>
            <LOWER-LIMIT INTERVAL-TYPE="CLOSED">1</LOWER-LIMIT>
            <UPPER-LIMIT INTERVAL-TYPE="CLOSED">1</UPPER-LIMIT>
            <COMPU-CONST>
              <VT>CAN_17_MCMCAN_RX_FIFO_INTERRUPT</VT>
            </COMPU-CONST>
          </COMPU-SCALE>
          <COMPU-SCALE>
            <LOWER-LIMIT INTERVAL-TYPE="CLOSED">2</LOWER-LIMIT>
            <UPPER-LIMIT INTERVAL-TYPE="CLOSED">2</UPPER-LIMIT>
            <COMPU-CONST>
              <VT>CAN_17_MCMCAN_RX_FIFO_NOT_CONFIGURED</VT>
            </COMPU-CONST>
          </COMPU-SCALE>
        </COMPU-SCALES>
      </COMPU-INTERNAL-TO-PHYS>
    </COMPU-METHOD>
    <COMPU-METHOD>
      <SHORT-NAME>Can_17_McmCan_RxBufferType</SHORT-NAME>
      <CATEGORY>TEXTTABLE</CATEGORY>
      <COMPU-INTERNAL-TO-PHYS>
        <COMPU-SCALES>
          <COMPU-SCALE>
            <LOWER-LIMIT INTERVAL-TYPE="CLOSED">0</LOWER-LIMIT>
            <UPPER-LIMIT INTERVAL-TYPE="CLOSED">0</UPPER-LIMIT>
            <COMPU-CONST>
              <VT>CAN_17_MCMCAN_RX_DED_BUFFER</VT>
            </COMPU-CONST>
          </COMPU-SCALE>
          <COMPU-SCALE>
            <LOWER-LIMIT INTERVAL-TYPE="CLOSED">1</LOWER-LIMIT>
            <UPPER-LIMIT INTERVAL-TYPE="CLOSED">1</UPPER-LIMIT>
            <COMPU-CONST>
              <VT>CAN_17_MCMCAN_RX_FIFO0</VT>
            </COMPU-CONST>
          </COMPU-SCALE>
          <COMPU-SCALE>
            <LOWER-LIMIT INTERVAL-TYPE="CLOSED">2</LOWER-LIMIT>
            <UPPER-LIMIT INTERVAL-TYPE="CLOSED">2</UPPER-LIMIT>
            <COMPU-CONST>
              <VT>CAN_17_MCMCAN_RX_FIFO1</VT>
            </COMPU-CONST>
          </COMPU-SCALE>
          <COMPU-SCALE>
            <LOWER-LIMIT INTERVAL-TYPE="CLOSED">3</LOWER-LIMIT>
            <UPPER-LIMIT INTERVAL-TYPE="CLOSED">3</UPPER-LIMIT>
            <COMPU-CONST>
              <VT>CAN_17_MCMCAN_RX_ALL</VT>
            </COMPU-CONST>
          </COMPU-SCALE>
        </COMPU-SCALES>
      </COMPU-INTERNAL-TO-PHYS>
    </COMPU-METHOD>
        </ELEMENTS>
      </AR-PACKAGE>
    </AR-PACKAGES>
  </AR-PACKAGE>
</AR-PACKAGES>
[!ENDSELECT!][!//
</AUTOSAR>
