[part 3 of 4: package /EcuExtract]
AUTOSAR XML (schema 00046)
package /EcuExtract  (continued)
  flat map FlatMap  (continued)
    2430 x flat instance descriptor:  (continued)
      EPS_APA_EpasFAILED_Status_1174: upstream-reference=TopLevelComposition.FSMonitor_Prototype.RP_Fs_Chassis_Data_EspVehSpd_Status.EPS_APA_EpasFAILED_Status, ecu-extract-reference=TopLevelCompositionPrototype.FSMonitor_Prototype.RP_Fs_Chassis_Data_EspVehSpd_Status.EPS_APA_EpasFAILED_Status
      EPS_ActualMotorTorq_1175: upstream-reference=TopLevelComposition.FSMonitor_Prototype.RP_Fs_Chassis_Data_EspVehSpd_Status.EPS_ActualMotorTorq, ecu-extract-reference=TopLevelCompositionPrototype.FSMonitor_Prototype.RP_Fs_Chassis_Data_EspVehSpd_Status.EPS_ActualMotorTorq
      EPS_ActualMotorTorq_Status_1176: upstream-reference=TopLevelComposition.FSMonitor_Prototype.RP_Fs_Chassis_Data_EspVehSpd_Status.EPS_ActualMotorTorq_Status, ecu-extract-reference=TopLevelCompositionPrototype.FSMonitor_Prototype.RP_Fs_Chassis_Data_EspVehSpd_Status.EPS_ActualMotorTorq_Status
      EPS_ActualTorsionBarTorq_1177: upstream-reference=TopLevelComposition.FSMonitor_Prototype.RP_Fs_Chassis_Data_EspVehSpd_Status.EPS_ActualTorsionBarTorq, ecu-extract-reference=TopLevelCompositionPrototype.FSMonitor_Prototype.RP_Fs_Chassis_Data_EspVehSpd_Status.EPS_ActualTorsionBarTorq
      EPS_ActualTorsionBarTorq_Status_1178: upstream-reference=TopLevelComposition.FSMonitor_Prototype.RP_Fs_Chassis_Data_EspVehSpd_Status.EPS_ActualTorsionBarTorq_Status, ecu-extract-reference=TopLevelCompositionPrototype.FSMonitor_Prototype.RP_Fs_Chassis_Data_EspVehSpd_Status.EPS_ActualTorsionBarTorq_Status
      EPS_MeasuredTorsionBarTorqValid_1179: upstream-reference=TopLevelComposition.FSMonitor_Prototype.RP_Fs_Chassis_Data_EspVehSpd_Status.EPS_MeasuredTorsionBarTorqValid, ecu-extract-reference=TopLevelCompositionPrototype.FSMonitor_Prototype.RP_Fs_Chassis_Data_EspVehSpd_Status.EPS_MeasuredTorsionBarTorqValid
      EPS_Pinionang_Valid_1180: upstream-reference=TopLevelComposition.FSMonitor_Prototype.RP_Fs_Chassis_Data_EspVehSpd_Status.EPS_Pinionang_Valid, ecu-extract-reference=TopLevelCompositionPrototype.FSMonitor_Prototype.RP_Fs_Chassis_Data_EspVehSpd_Status.EPS_Pinionang_Valid
      EPS_fault_state_1181: upstream-reference=TopLevelComposition.FSMonitor_Prototype.RP_Fs_Chassis_Data_EspVehSpd_Status.EPS_fault_state, ecu-extract-reference=TopLevelCompositionPrototype.FSMonitor_Prototype.RP_Fs_Chassis_Data_EspVehSpd_Status.EPS_fault_state
      EPS_fault_state_Status_1182: upstream-reference=TopLevelComposition.FSMonitor_Prototype.RP_Fs_Chassis_Data_EspVehSpd_Status.EPS_fault_state_Status, ecu-extract-reference=TopLevelCompositionPrototype.FSMonitor_Prototype.RP_Fs_Chassis_Data_EspVehSpd_Status.EPS_fault_state_Status
      ESP_LatAccelValid_1183: upstream-reference=TopLevelComposition.FSMonitor_Prototype.RP_Fs_Chassis_Data_EspVehSpd_Status.ESP_LatAccelValid, ecu-extract-reference=TopLevelCompositionPrototype.FSMonitor_Prototype.RP_Fs_Chassis_Data_EspVehSpd_Status.ESP_LatAccelValid
      ESP_LongAccelValid_1184: upstream-reference=TopLevelComposition.FSMonitor_Prototype.RP_Fs_Chassis_Data_EspVehSpd_Status.ESP_LongAccelValid, ecu-extract-reference=TopLevelCompositionPrototype.FSMonitor_Prototype.RP_Fs_Chassis_Data_EspVehSpd_Status.ESP_LongAccelValid
      ESP_YawRateValid_1185: upstream-reference=TopLevelComposition.FSMonitor_Prototype.RP_Fs_Chassis_Data_EspVehSpd_Status.ESP_YawRateValid, ecu-extract-reference=TopLevelCompositionPrototype.FSMonitor_Prototype.RP_Fs_Chassis_Data_EspVehSpd_Status.ESP_YawRateValid
      EpsConcussAvailabilityStatus_1186: upstream-reference=TopLevelComposition.FSMonitor_Prototype.RP_Fs_Chassis_Data_EspVehSpd_Status.EpsConcussAvailabilityStatus, ecu-extract-reference=TopLevelCompositionPrototype.FSMonitor_Prototype.RP_Fs_Chassis_Data_EspVehSpd_Status.EpsConcussAvailabilityStatus
      EpsConcussAvailabilityStatus_Status_1187: upstream-reference=TopLevelComposition.FSMonitor_Prototype.RP_Fs_Chassis_Data_EspVehSpd_Status.EpsConcussAvailabilityStatus_Status, ecu-extract-reference=TopLevelCompositionPrototype.FSMonitor_Prototype.RP_Fs_Chassis_Data_EspVehSpd_Status.EpsConcussAvailabilityStatus_Status
      EpsFaild_1188: upstream-reference=TopLevelComposition.FSMonitor_Prototype.RP_Fs_Chassis_Data_EspVehSpd_Status.EpsFaild, ecu-extract-reference=TopLevelCompositionPrototype.FSMonitor_Prototype.RP_Fs_Chassis_Data_EspVehSpd_Status.EpsFaild
      EpsFaild_Status_1189: upstream-reference=TopLevelComposition.FSMonitor_Prototype.RP_Fs_Chassis_Data_EspVehSpd_Status.EpsFaild_Status, ecu-extract-reference=TopLevelCompositionPrototype.FSMonitor_Prototype.RP_Fs_Chassis_Data_EspVehSpd_Status.EpsFaild_Status
      EpsIACCabortreason_1190: upstream-reference=TopLevelComposition.FSMonitor_Prototype.RP_Fs_Chassis_Data_EspVehSpd_Status.EpsIACCabortreason, ecu-extract-reference=TopLevelCompositionPrototype.FSMonitor_Prototype.RP_Fs_Chassis_Data_EspVehSpd_Status.EpsIACCabortreason
      EpsIACCabortreason_Status_1191: upstream-reference=TopLevelComposition.FSMonitor_Prototype.RP_Fs_Chassis_Data_EspVehSpd_Status.EpsIACCabortreason_Status, ecu-extract-reference=TopLevelCompositionPrototype.FSMonitor_Prototype.RP_Fs_Chassis_Data_EspVehSpd_Status.EpsIACCabortreason_Status
      EpsLatCtrlActive_1192: upstream-reference=TopLevelComposition.FSMonitor_Prototype.RP_Fs_Chassis_Data_EspVehSpd_Status.EpsLatCtrlActive, ecu-extract-reference=TopLevelCompositionPrototype.FSMonitor_Prototype.RP_Fs_Chassis_Data_EspVehSpd_Status.EpsLatCtrlActive
      EpsLatCtrlActive_Status_1193: upstream-reference=TopLevelComposition.FSMonitor_Prototype.RP_Fs_Chassis_Data_EspVehSpd_Status.EpsLatCtrlActive_Status, ecu-extract-reference=TopLevelCompositionPrototype.FSMonitor_Prototype.RP_Fs_Chassis_Data_EspVehSpd_Status.EpsLatCtrlActive_Status
      EpsLatCtrlAvailabilityStatus_1194: upstream-reference=TopLevelComposition.FSMonitor_Prototype.RP_Fs_Chassis_Data_EspVehSpd_Status.EpsLatCtrlAvailabilityStatus, ecu-extract-reference=TopLevelCompositionPrototype.FSMonitor_Prototype.RP_Fs_Chassis_Data_EspVehSpd_Status.EpsLatCtrlAvailabilityStatus
      EpsLatCtrlAvailabilityStatus_Status_1195: upstream-reference=TopLevelComposition.FSMonitor_Prototype.RP_Fs_Chassis_Data_EspVehSpd_Status.EpsLatCtrlAvailabilityStatus_Status, ecu-extract-reference=TopLevelCompositionPrototype.FSMonitor_Prototype.RP_Fs_Chassis_Data_EspVehSpd_Status.EpsLatCtrlAvailabilityStatus_Status
      EpsMeasuredTorsionBarTorq_Status_1196: upstream-reference=TopLevelComposition.FSMonitor_Prototype.RP_Fs_Chassis_Data_EspVehSpd_Status.EpsMeasuredTorsionBarTorq_Status, ecu-extract-reference=TopLevelCompositionPrototype.FSMonitor_Prototype.RP_Fs_Chassis_Data_EspVehSpd_Status.EpsMeasuredTorsionBarTorq_Status
      EpsMeasuredTorsionBarTorque_1197: upstream-reference=TopLevelComposition.FSMonitor_Prototype.RP_Fs_Chassis_Data_EspVehSpd_Status.EpsMeasuredTorsionBarTorque, ecu-extract-reference=TopLevelCompositionPrototype.FSMonitor_Prototype.RP_Fs_Chassis_Data_EspVehSpd_Status.EpsMeasuredTorsionBarTorque
      EpsMeasuredTorsionBarTorque_Status_1198: upstream-reference=TopLevelComposition.FSMonitor_Prototype.RP_Fs_Chassis_Data_EspVehSpd_Status.EpsMeasuredTorsionBarTorque_Status, ecu-extract-reference=TopLevelCompositionPrototype.FSMonitor_Prototype.RP_Fs_Chassis_Data_EspVehSpd_Status.EpsMeasuredTorsionBarTorque_Status
      EpsPinionang_1199: upstream-reference=TopLevelComposition.FSMonitor_Prototype.RP_Fs_Chassis_Data_EspVehSpd_Status.EpsPinionang, ecu-extract-reference=TopLevelCompositionPrototype.FSMonitor_Prototype.RP_Fs_Chassis_Data_EspVehSpd_Status.EpsPinionang
      EpsPinionang_Status_1200: upstream-reference=TopLevelComposition.FSMonitor_Prototype.RP_Fs_Chassis_Data_EspVehSpd_Status.EpsPinionang_Status, ecu-extract-reference=TopLevelCompositionPrototype.FSMonitor_Prototype.RP_Fs_Chassis_Data_EspVehSpd_Status.EpsPinionang_Status
      EpsSasCalSts_1201: upstream-reference=TopLevelComposition.FSMonitor_Prototype.RP_Fs_Chassis_Data_EspVehSpd_Status.EpsSasCalSts, ecu-extract-reference=TopLevelCompositionPrototype.FSMonitor_Prototype.RP_Fs_Chassis_Data_EspVehSpd_Status.EpsSasCalSts
      EpsSasCalSts_Status_1202: upstream-reference=TopLevelComposition.FSMonitor_Prototype.RP_Fs_Chassis_Data_EspVehSpd_Status.EpsSasCalSts_Status, ecu-extract-reference=TopLevelCompositionPrototype.FSMonitor_Prototype.RP_Fs_Chassis_Data_EspVehSpd_Status.EpsSasCalSts_Status
      EpsSasSteerAg_1203: upstream-reference=TopLevelComposition.FSMonitor_Prototype.RP_Fs_Chassis_Data_EspVehSpd_Status.EpsSasSteerAg, ecu-extract-reference=TopLevelCompositionPrototype.FSMonitor_Prototype.RP_Fs_Chassis_Data_EspVehSpd_Status.EpsSasSteerAg
      EpsSasSteerAgVld_1204: upstream-reference=TopLevelComposition.FSMonitor_Prototype.RP_Fs_Chassis_Data_EspVehSpd_Status.EpsSasSteerAgVld, ecu-extract-reference=TopLevelCompositionPrototype.FSMonitor_Prototype.RP_Fs_Chassis_Data_EspVehSpd_Status.EpsSasSteerAgVld
      EpsSasSteerAg_Status_1205: upstream-reference=TopLevelComposition.FSMonitor_Prototype.RP_Fs_Chassis_Data_EspVehSpd_Status.EpsSasSteerAg_Status, ecu-extract-reference=TopLevelCompositionPrototype.FSMonitor_Prototype.RP_Fs_Chassis_Data_EspVehSpd_Status.EpsSasSteerAg_Status
      EpsSteerAgRate_1206: upstream-reference=TopLevelComposition.FSMonitor_Prototype.RP_Fs_Chassis_Data_EspVehSpd_Status.EpsSteerAgRate, ecu-extract-reference=TopLevelCompositionPrototype.FSMonitor_Prototype.RP_Fs_Chassis_Data_EspVehSpd_Status.EpsSteerAgRate
      EpsSteerAgRate_Status_1207: upstream-reference=TopLevelComposition.FSMonitor_Prototype.RP_Fs_Chassis_Data_EspVehSpd_Status.EpsSteerAgRate_Status, ecu-extract-reference=TopLevelCompositionPrototype.FSMonitor_Prototype.RP_Fs_Chassis_Data_EspVehSpd_Status.EpsSteerAgRate_Status
      EpsSteerAgSensFilr_1208: upstream-reference=TopLevelComposition.FSMonitor_Prototype.RP_Fs_Chassis_Data_EspVehSpd_Status.EpsSteerAgSensFilr, ecu-extract-reference=TopLevelCompositionPrototype.FSMonitor_Prototype.RP_Fs_Chassis_Data_EspVehSpd_Status.EpsSteerAgSensFilr
      EpsSteerAgSensFilr_Status_1209: upstream-reference=TopLevelComposition.FSMonitor_Prototype.RP_Fs_Chassis_Data_EspVehSpd_Status.EpsSteerAgSensFilr_Status, ecu-extract-reference=TopLevelCompositionPrototype.FSMonitor_Prototype.RP_Fs_Chassis_Data_EspVehSpd_Status.EpsSteerAgSensFilr_Status
      EspABAactive_1210: upstream-reference=TopLevelComposition.FSMonitor_Prototype.RP_Fs_Chassis_Data_EspVehSpd_Status.EspABAactive, ecu-extract-reference=TopLevelCompositionPrototype.FSMonitor_Prototype.RP_Fs_Chassis_Data_EspVehSpd_Status.EspABAactive
      EspABAactive_Status_1211: upstream-reference=TopLevelComposition.FSMonitor_Prototype.RP_Fs_Chassis_Data_EspVehSpd_Status.EspABAactive_Status, ecu-extract-reference=TopLevelCompositionPrototype.FSMonitor_Prototype.RP_Fs_Chassis_Data_EspVehSpd_Status.EspABAactive_Status
      EspABAavailable_1212: upstream-reference=TopLevelComposition.FSMonitor_Prototype.RP_Fs_Chassis_Data_EspVehSpd_Status.EspABAavailable, ecu-extract-reference=TopLevelCompositionPrototype.FSMonitor_Prototype.RP_Fs_Chassis_Data_EspVehSpd_Status.EspABAavailable
      EspABAavailable_Status_1213: upstream-reference=TopLevelComposition.FSMonitor_Prototype.RP_Fs_Chassis_Data_EspVehSpd_Status.EspABAavailable_Status, ecu-extract-reference=TopLevelCompositionPrototype.FSMonitor_Prototype.RP_Fs_Chassis_Data_EspVehSpd_Status.EspABAavailable_Status
      EspAEBAvailable_1214: upstream-reference=TopLevelComposition.FSMonitor_Prototype.RP_Fs_Chassis_Data_EspVehSpd_Status.EspAEBAvailable, ecu-extract-reference=TopLevelCompositionPrototype.FSMonitor_Prototype.RP_Fs_Chassis_Data_EspVehSpd_Status.EspAEBAvailable
      EspAEBAvailable_Status_1215: upstream-reference=TopLevelComposition.FSMonitor_Prototype.RP_Fs_Chassis_Data_EspVehSpd_Status.EspAEBAvailable_Status, ecu-extract-reference=TopLevelCompositionPrototype.FSMonitor_Prototype.RP_Fs_Chassis_Data_EspVehSpd_Status.EspAEBAvailable_Status
      EspAEBdecActive_1216: upstream-reference=TopLevelComposition.FSMonitor_Prototype.RP_Fs_Chassis_Data_EspVehSpd_Status.EspAEBdecActive, ecu-extract-reference=TopLevelCompositionPrototype.FSMonitor_Prototype.RP_Fs_Chassis_Data_EspVehSpd_Status.EspAEBdecActive
      EspAEBdecActive_Status_1217: upstream-reference=TopLevelComposition.FSMonitor_Prototype.RP_Fs_Chassis_Data_EspVehSpd_Status.EspAEBdecActive_Status, ecu-extract-reference=TopLevelCompositionPrototype.FSMonitor_Prototype.RP_Fs_Chassis_Data_EspVehSpd_Status.EspAEBdecActive_Status
      EspAWBactive_1218: upstream-reference=TopLevelComposition.FSMonitor_Prototype.RP_Fs_Chassis_Data_EspVehSpd_Status.EspAWBactive, ecu-extract-reference=TopLevelCompositionPrototype.FSMonitor_Prototype.RP_Fs_Chassis_Data_EspVehSpd_Status.EspAWBactive
      EspAWBactive_Status_1219: upstream-reference=TopLevelComposition.FSMonitor_Prototype.RP_Fs_Chassis_Data_EspVehSpd_Status.EspAWBactive_Status, ecu-extract-reference=TopLevelCompositionPrototype.FSMonitor_Prototype.RP_Fs_Chassis_Data_EspVehSpd_Status.EspAWBactive_Status
      EspAWBavailable_1220: upstream-reference=TopLevelComposition.FSMonitor_Prototype.RP_Fs_Chassis_Data_EspVehSpd_Status.EspAWBavailable, ecu-extract-reference=TopLevelCompositionPrototype.FSMonitor_Prototype.RP_Fs_Chassis_Data_EspVehSpd_Status.EspAWBavailable
      EspAWBavailable_Status_1221: upstream-reference=TopLevelComposition.FSMonitor_Prototype.RP_Fs_Chassis_Data_EspVehSpd_Status.EspAWBavailable_Status, ecu-extract-reference=TopLevelCompositionPrototype.FSMonitor_Prototype.RP_Fs_Chassis_Data_EspVehSpd_Status.EspAWBavailable_Status
      EspAbsActv_1222: upstream-reference=TopLevelComposition.FSMonitor_Prototype.RP_Fs_Chassis_Data_EspVehSpd_Status.EspAbsActv, ecu-extract-reference=TopLevelCompositionPrototype.FSMonitor_Prototype.RP_Fs_Chassis_Data_EspVehSpd_Status.EspAbsActv
      EspAbsActv_Status_1223: upstream-reference=TopLevelComposition.FSMonitor_Prototype.RP_Fs_Chassis_Data_EspVehSpd_Status.EspAbsActv_Status, ecu-extract-reference=TopLevelCompositionPrototype.FSMonitor_Prototype.RP_Fs_Chassis_Data_EspVehSpd_Status.EspAbsActv_Status
      EspAbsFailr_1224: upstream-reference=TopLevelComposition.FSMonitor_Prototype.RP_Fs_Chassis_Data_EspVehSpd_Status.EspAbsFailr, ecu-extract-reference=TopLevelCompositionPrototype.FSMonitor_Prototype.RP_Fs_Chassis_Data_EspVehSpd_Status.EspAbsFailr
      EspAbsFailr_Status_1225: upstream-reference=TopLevelComposition.FSMonitor_Prototype.RP_Fs_Chassis_Data_EspVehSpd_Status.EspAbsFailr_Status, ecu-extract-reference=TopLevelCompositionPrototype.FSMonitor_Prototype.RP_Fs_Chassis_Data_EspVehSpd_Status.EspAbsFailr_Status
      EspActvSts_1226: upstream-reference=TopLevelComposition.FSMonitor_Prototype.RP_Fs_Chassis_Data_EspVehSpd_Status.EspActvSts, ecu-extract-reference=TopLevelCompositionPrototype.FSMonitor_Prototype.RP_Fs_Chassis_Data_EspVehSpd_Status.EspActvSts
      EspActvSts_Status_1227: upstream-reference=TopLevelComposition.FSMonitor_Prototype.RP_Fs_Chassis_Data_EspVehSpd_Status.EspActvSts_Status, ecu-extract-reference=TopLevelCompositionPrototype.FSMonitor_Prototype.RP_Fs_Chassis_Data_EspVehSpd_Status.EspActvSts_Status
      EspEbdFailr_1228: upstream-reference=TopLevelComposition.FSMonitor_Prototype.RP_Fs_Chassis_Data_EspVehSpd_Status.EspEbdFailr, ecu-extract-reference=TopLevelCompositionPrototype.FSMonitor_Prototype.RP_Fs_Chassis_Data_EspVehSpd_Status.EspEbdFailr
      EspEbdFailr_Status_1229: upstream-reference=TopLevelComposition.FSMonitor_Prototype.RP_Fs_Chassis_Data_EspVehSpd_Status.EspEbdFailr_Status, ecu-extract-reference=TopLevelCompositionPrototype.FSMonitor_Prototype.RP_Fs_Chassis_Data_EspVehSpd_Status.EspEbdFailr_Status
      EspLatAccel_1230: upstream-reference=TopLevelComposition.FSMonitor_Prototype.RP_Fs_Chassis_Data_EspVehSpd_Status.EspLatAccel, ecu-extract-reference=TopLevelCompositionPrototype.FSMonitor_Prototype.RP_Fs_Chassis_Data_EspVehSpd_Status.EspLatAccel
      EspLatAccel_Status_1231: upstream-reference=TopLevelComposition.FSMonitor_Prototype.RP_Fs_Chassis_Data_EspVehSpd_Status.EspLatAccel_Status, ecu-extract-reference=TopLevelCompositionPrototype.FSMonitor_Prototype.RP_Fs_Chassis_Data_EspVehSpd_Status.EspLatAccel_Status
      EspLongAccel_1232: upstream-reference=TopLevelComposition.FSMonitor_Prototype.RP_Fs_Chassis_Data_EspVehSpd_Status.EspLongAccel, ecu-extract-reference=TopLevelCompositionPrototype.FSMonitor_Prototype.RP_Fs_Chassis_Data_EspVehSpd_Status.EspLongAccel
      EspLongAccel_Status_1233: upstream-reference=TopLevelComposition.FSMonitor_Prototype.RP_Fs_Chassis_Data_EspVehSpd_Status.EspLongAccel_Status, ecu-extract-reference=TopLevelCompositionPrototype.FSMonitor_Prototype.RP_Fs_Chassis_Data_EspVehSpd_Status.EspLongAccel_Status
      EspPrefillActive_1234: upstream-reference=TopLevelComposition.FSMonitor_Prototype.RP_Fs_Chassis_Data_EspVehSpd_Status.EspPrefillActive, ecu-extract-reference=TopLevelCompositionPrototype.FSMonitor_Prototype.RP_Fs_Chassis_Data_EspVehSpd_Status.EspPrefillActive
      EspPrefillActive_Status_1235: upstream-reference=TopLevelComposition.FSMonitor_Prototype.RP_Fs_Chassis_Data_EspVehSpd_Status.EspPrefillActive_Status, ecu-extract-reference=TopLevelCompositionPrototype.FSMonitor_Prototype.RP_Fs_Chassis_Data_EspVehSpd_Status.EspPrefillActive_Status
      EspPrefillAvailable_1236: upstream-reference=TopLevelComposition.FSMonitor_Prototype.RP_Fs_Chassis_Data_EspVehSpd_Status.EspPrefillAvailable, ecu-extract-reference=TopLevelCompositionPrototype.FSMonitor_Prototype.RP_Fs_Chassis_Data_EspVehSpd_Status.EspPrefillAvailable
      EspPrefillAvailable_Status_1237: upstream-reference=TopLevelComposition.FSMonitor_Prototype.RP_Fs_Chassis_Data_EspVehSpd_Status.EspPrefillAvailable_Status, ecu-extract-reference=TopLevelCompositionPrototype.FSMonitor_Prototype.RP_Fs_Chassis_Data_EspVehSpd_Status.EspPrefillAvailable_Status
      EspTcsActvSts_1238: upstream-reference=TopLevelComposition.FSMonitor_Prototype.RP_Fs_Chassis_Data_EspVehSpd_Status.EspTcsActvSts, ecu-extract-reference=TopLevelCompositionPrototype.FSMonitor_Prototype.RP_Fs_Chassis_Data_EspVehSpd_Status.EspTcsActvSts
      EspTcsActvSts_Status_1239: upstream-reference=TopLevelComposition.FSMonitor_Prototype.RP_Fs_Chassis_Data_EspVehSpd_Status.EspTcsActvSts_Status, ecu-extract-reference=TopLevelCompositionPrototype.FSMonitor_Prototype.RP_Fs_Chassis_Data_EspVehSpd_Status.EspTcsActvSts_Status
      EspTcsFailr_1240: upstream-reference=TopLevelComposition.FSMonitor_Prototype.RP_Fs_Chassis_Data_EspVehSpd_Status.EspTcsFailr, ecu-extract-reference=TopLevelCompositionPrototype.FSMonitor_Prototype.RP_Fs_Chassis_Data_EspVehSpd_Status.EspTcsFailr
      EspTcsFailr_Status_1241: upstream-reference=TopLevelComposition.FSMonitor_Prototype.RP_Fs_Chassis_Data_EspVehSpd_Status.EspTcsFailr_Status, ecu-extract-reference=TopLevelCompositionPrototype.FSMonitor_Prototype.RP_Fs_Chassis_Data_EspVehSpd_Status.EspTcsFailr_Status
      EspVdcActvSts_1242: upstream-reference=TopLevelComposition.FSMonitor_Prototype.RP_Fs_Chassis_Data_EspVehSpd_Status.EspVdcActvSts, ecu-extract-reference=TopLevelCompositionPrototype.FSMonitor_Prototype.RP_Fs_Chassis_Data_EspVehSpd_Status.EspVdcActvSts
      EspVdcActvSts_Status_1243: upstream-reference=TopLevelComposition.FSMonitor_Prototype.RP_Fs_Chassis_Data_EspVehSpd_Status.EspVdcActvSts_Status, ecu-extract-reference=TopLevelCompositionPrototype.FSMonitor_Prototype.RP_Fs_Chassis_Data_EspVehSpd_Status.EspVdcActvSts_Status
      EspVehSpd_1244: upstream-reference=TopLevelComposition.FSMonitor_Prototype.RP_Fs_Chassis_Data_EspVehSpd_Status.EspVehSpd, ecu-extract-reference=TopLevelCompositionPrototype.FSMonitor_Prototype.RP_Fs_Chassis_Data_EspVehSpd_Status.EspVehSpd
      EspVehSpdVld_1245: upstream-reference=TopLevelComposition.FSMonitor_Prototype.RP_Fs_Chassis_Data_EspVehSpd_Status.EspVehSpdVld, ecu-extract-reference=TopLevelCompositionPrototype.FSMonitor_Prototype.RP_Fs_Chassis_Data_EspVehSpd_Status.EspVehSpdVld
      EspVehSpd_Status_1246: upstream-reference=TopLevelComposition.FSMonitor_Prototype.RP_Fs_Chassis_Data_EspVehSpd_Status.EspVehSpd_Status, ecu-extract-reference=TopLevelCompositionPrototype.FSMonitor_Prototype.RP_Fs_Chassis_Data_EspVehSpd_Status.EspVehSpd_Status
      EspYawRate_1247: upstream-reference=TopLevelComposition.FSMonitor_Prototype.RP_Fs_Chassis_Data_EspVehSpd_Status.EspYawRate, ecu-extract-reference=TopLevelCompositionPrototype.FSMonitor_Prototype.RP_Fs_Chassis_Data_EspVehSpd_Status.EspYawRate
      EspYawRate_Status_1248: upstream-reference=TopLevelComposition.FSMonitor_Prototype.RP_Fs_Chassis_Data_EspVehSpd_Status.EspYawRate_Status, ecu-extract-reference=TopLevelCompositionPrototype.FSMonitor_Prototype.RP_Fs_Chassis_Data_EspVehSpd_Status.EspYawRate_Status
      IBCU_PFSBrakePressureValid_1249: upstream-reference=TopLevelComposition.FSMonitor_Prototype.RP_Fs_Chassis_Data_EspVehSpd_Status.IBCU_PFSBrakePressureValid, ecu-extract-reference=TopLevelCompositionPrototype.FSMonitor_Prototype.RP_Fs_Chassis_Data_EspVehSpd_Status.IBCU_PFSBrakePressureValid
      IbBrkPedlStsGb_1250: upstream-reference=TopLevelComposition.FSMonitor_Prototype.RP_Fs_Chassis_Data_EspVehSpd_Status.IbBrkPedlStsGb, ecu-extract-reference=TopLevelCompositionPrototype.FSMonitor_Prototype.RP_Fs_Chassis_Data_EspVehSpd_Status.IbBrkPedlStsGb
      IbBrkPedlStsGbVld_1251: upstream-reference=TopLevelComposition.FSMonitor_Prototype.RP_Fs_Chassis_Data_EspVehSpd_Status.IbBrkPedlStsGbVld, ecu-extract-reference=TopLevelCompositionPrototype.FSMonitor_Prototype.RP_Fs_Chassis_Data_EspVehSpd_Status.IbBrkPedlStsGbVld
      IbBrkPedlStsGb_Status_1252: upstream-reference=TopLevelComposition.FSMonitor_Prototype.RP_Fs_Chassis_Data_EspVehSpd_Status.IbBrkPedlStsGb_Status, ecu-extract-reference=TopLevelCompositionPrototype.FSMonitor_Prototype.RP_Fs_Chassis_Data_EspVehSpd_Status.IbBrkPedlStsGb_Status
      IbBrkPedlTrvlDrvr_1253: upstream-reference=TopLevelComposition.FSMonitor_Prototype.RP_Fs_Chassis_Data_EspVehSpd_Status.IbBrkPedlTrvlDrvr, ecu-extract-reference=TopLevelCompositionPrototype.FSMonitor_Prototype.RP_Fs_Chassis_Data_EspVehSpd_Status.IbBrkPedlTrvlDrvr
      IbBrkPedlTrvlDrvrVld_1254: upstream-reference=TopLevelComposition.FSMonitor_Prototype.RP_Fs_Chassis_Data_EspVehSpd_Status.IbBrkPedlTrvlDrvrVld, ecu-extract-reference=TopLevelCompositionPrototype.FSMonitor_Prototype.RP_Fs_Chassis_Data_EspVehSpd_Status.IbBrkPedlTrvlDrvrVld
      PlungerBrakePressure_1255: upstream-reference=TopLevelComposition.FSMonitor_Prototype.RP_Fs_Chassis_Data_EspVehSpd_Status.PlungerBrakePressure, ecu-extract-reference=TopLevelCompositionPrototype.FSMonitor_Prototype.RP_Fs_Chassis_Data_EspVehSpd_Status.PlungerBrakePressure
      PlungerBrakePressure_Status_1256: upstream-reference=TopLevelComposition.FSMonitor_Prototype.RP_Fs_Chassis_Data_EspVehSpd_Status.PlungerBrakePressure_Status, ecu-extract-reference=TopLevelCompositionPrototype.FSMonitor_Prototype.RP_Fs_Chassis_Data_EspVehSpd_Status.PlungerBrakePressure_Status
      VcuAccrPedlPosn_1257: upstream-reference=TopLevelComposition.FSMonitor_Prototype.RP_Fs_Chassis_Data_EspVehSpd_Status.VcuAccrPedlPosn, ecu-extract-reference=TopLevelCompositionPrototype.FSMonitor_Prototype.RP_Fs_Chassis_Data_EspVehSpd_Status.VcuAccrPedlPosn
      VcuAccrPedlPosnVld_1258: upstream-reference=TopLevelComposition.FSMonitor_Prototype.RP_Fs_Chassis_Data_EspVehSpd_Status.VcuAccrPedlPosnVld, ecu-extract-reference=TopLevelCompositionPrototype.FSMonitor_Prototype.RP_Fs_Chassis_Data_EspVehSpd_Status.VcuAccrPedlPosnVld
      VcuAccrPedlPosn_Status_1259: upstream-reference=TopLevelComposition.FSMonitor_Prototype.RP_Fs_Chassis_Data_EspVehSpd_Status.VcuAccrPedlPosn_Status, ecu-extract-reference=TopLevelCompositionPrototype.FSMonitor_Prototype.RP_Fs_Chassis_Data_EspVehSpd_Status.VcuAccrPedlPosn_Status
      VcuGearPosn_1260: upstream-reference=TopLevelComposition.FSMonitor_Prototype.RP_Fs_Chassis_Data_EspVehSpd_Status.VcuGearPosn, ecu-extract-reference=TopLevelCompositionPrototype.FSMonitor_Prototype.RP_Fs_Chassis_Data_EspVehSpd_Status.VcuGearPosn
      VcuGearPosn_Status_1261: upstream-reference=TopLevelComposition.FSMonitor_Prototype.RP_Fs_Chassis_Data_EspVehSpd_Status.VcuGearPosn_Status, ecu-extract-reference=TopLevelCompositionPrototype.FSMonitor_Prototype.RP_Fs_Chassis_Data_EspVehSpd_Status.VcuGearPosn_Status
      VcuVehGearPosnVld_1262: upstream-reference=TopLevelComposition.FSMonitor_Prototype.RP_Fs_Chassis_Data_EspVehSpd_Status.VcuVehGearPosnVld, ecu-extract-reference=TopLevelCompositionPrototype.FSMonitor_Prototype.RP_Fs_Chassis_Data_EspVehSpd_Status.VcuVehGearPosnVld
      RP_Fs_EvAdc_GetValue_VMON_BATT_1263: upstream-reference=TopLevelComposition.FSMonitor_Prototype.RP_Fs_EvAdc_GetValue_VMON_BATT, ecu-extract-reference=TopLevelCompositionPrototype.FSMonitor_Prototype.RP_Fs_EvAdc_GetValue_VMON_BATT
      RP_Fs_EvAdc_GetValue_VMON_IGN_1264: upstream-reference=TopLevelComposition.FSMonitor_Prototype.RP_Fs_EvAdc_GetValue_VMON_IGN, ecu-extract-reference=TopLevelCompositionPrototype.FSMonitor_Prototype.RP_Fs_EvAdc_GetValue_VMON_IGN
      RP_Fs_EvAdc_GetValue_VMON_McuExtTemp_1265: upstream-reference=TopLevelComposition.FSMonitor_Prototype.RP_Fs_EvAdc_GetValue_VMON_McuExtTemp, ecu-extract-reference=TopLevelCompositionPrototype.FSMonitor_Prototype.RP_Fs_EvAdc_GetValue_VMON_McuExtTemp
      RP_Fs_EvAdc_GetValue_VMON_SocExtTemp_1266: upstream-reference=TopLevelComposition.FSMonitor_Prototype.RP_Fs_EvAdc_GetValue_VMON_SocExtTemp, ecu-extract-reference=TopLevelCompositionPrototype.FSMonitor_Prototype.RP_Fs_EvAdc_GetValue_VMON_SocExtTemp
      FctAdapter_Prototype_1267: upstream-reference=TopLevelComposition.FctAdapter_Prototype, ecu-extract-reference=TopLevelCompositionPrototype.FctAdapter_Prototype
      PP_FctAdapter_HeadOutputCustomData_1268: upstream-reference=TopLevelComposition.FctAdapter_Prototype.PP_FctAdapter_HeadOutputCustomData, ecu-extract-reference=TopLevelCompositionPrototype.FctAdapter_Prototype.PP_FctAdapter_HeadOutputCustomData
      HeadOutputCustomData_1269: upstream-reference=TopLevelComposition.FctAdapter_Prototype.PP_FctAdapter_HeadOutputCustomData.HeadOutputCustomData, ecu-extract-reference=TopLevelCompositionPrototype.FctAdapter_Prototype.PP_FctAdapter_HeadOutputCustomData.HeadOutputCustomData
      RP_Fcu_DimInputCustomData_1270: upstream-reference=TopLevelComposition.FctAdapter_Prototype.RP_Fcu_DimInputCustomData, ecu-extract-reference=TopLevelCompositionPrototype.FctAdapter_Prototype.RP_Fcu_DimInputCustomData
      DimInputCustomData_1271: upstream-reference=TopLevelComposition.FctAdapter_Prototype.RP_Fcu_DimInputCustomData.DimInputCustomData, ecu-extract-reference=TopLevelCompositionPrototype.FctAdapter_Prototype.RP_Fcu_DimInputCustomData.DimInputCustomData
      RP_Fcu_DimInputGenericData_1272: upstream-reference=TopLevelComposition.FctAdapter_Prototype.RP_Fcu_DimInputGenericData, ecu-extract-reference=TopLevelCompositionPrototype.FctAdapter_Prototype.RP_Fcu_DimInputGenericData
      DimInputGenericData_1273: upstream-reference=TopLevelComposition.FctAdapter_Prototype.RP_Fcu_DimInputGenericData.DimInputGenericData, ecu-extract-reference=TopLevelCompositionPrototype.FctAdapter_Prototype.RP_Fcu_DimInputGenericData.DimInputGenericData
      RP_Fcu_FctCtrlData_1274: upstream-reference=TopLevelComposition.FctAdapter_Prototype.RP_Fcu_FctCtrlData, ecu-extract-reference=TopLevelCompositionPrototype.FctAdapter_Prototype.RP_Fcu_FctCtrlData
      FctCtrlData_1275: upstream-reference=TopLevelComposition.FctAdapter_Prototype.RP_Fcu_FctCtrlData.FctCtrlData, ecu-extract-reference=TopLevelCompositionPrototype.FctAdapter_Prototype.RP_Fcu_FctCtrlData.FctCtrlData
      RP_Fcu_HeadInputCustomData_1276: upstream-reference=TopLevelComposition.FctAdapter_Prototype.RP_Fcu_HeadInputCustomData, ecu-extract-reference=TopLevelCompositionPrototype.FctAdapter_Prototype.RP_Fcu_HeadInputCustomData
      HeadInputCustomData_1277: upstream-reference=TopLevelComposition.FctAdapter_Prototype.RP_Fcu_HeadInputCustomData.HeadInputCustomData, ecu-extract-reference=TopLevelCompositionPrototype.FctAdapter_Prototype.RP_Fcu_HeadInputCustomData.HeadInputCustomData
      RP_Fcu_HeadInputGenericData_1278: upstream-reference=TopLevelComposition.FctAdapter_Prototype.RP_Fcu_HeadInputGenericData, ecu-extract-reference=TopLevelCompositionPrototype.FctAdapter_Prototype.RP_Fcu_HeadInputGenericData
      HeadInputGenericData_1279: upstream-reference=TopLevelComposition.FctAdapter_Prototype.RP_Fcu_HeadInputGenericData.HeadInputGenericData, ecu-extract-reference=TopLevelCompositionPrototype.FctAdapter_Prototype.RP_Fcu_HeadInputGenericData.HeadInputGenericData
      RP_Fcu_VehPar_1280: upstream-reference=TopLevelComposition.FctAdapter_Prototype.RP_Fcu_VehPar, ecu-extract-reference=TopLevelCompositionPrototype.FctAdapter_Prototype.RP_Fcu_VehPar
      VehPar_1281: upstream-reference=TopLevelComposition.FctAdapter_Prototype.RP_Fcu_VehPar.VehPar, ecu-extract-reference=TopLevelCompositionPrototype.FctAdapter_Prototype.RP_Fcu_VehPar.VehPar
      RP_Fcu_VehSig_1282: upstream-reference=TopLevelComposition.FctAdapter_Prototype.RP_Fcu_VehSig, ecu-extract-reference=TopLevelCompositionPrototype.FctAdapter_Prototype.RP_Fcu_VehSig
      VehSig_1283: upstream-reference=TopLevelComposition.FctAdapter_Prototype.RP_Fcu_VehSig.VehSig, ecu-extract-reference=TopLevelCompositionPrototype.FctAdapter_Prototype.RP_Fcu_VehSig.VehSig
      RP_MtsiAdapter_MeasFreezeData_1284: upstream-reference=TopLevelComposition.FctAdapter_Prototype.RP_MtsiAdapter_MeasFreezeData, ecu-extract-reference=TopLevelCompositionPrototype.FctAdapter_Prototype.RP_MtsiAdapter_MeasFreezeData
      RP_Sdc_Cem_ARSObjectList_1285: upstream-reference=TopLevelComposition.FctAdapter_Prototype.RP_Sdc_Cem_ARSObjectList, ecu-extract-reference=TopLevelCompositionPrototype.FctAdapter_Prototype.RP_Sdc_Cem_ARSObjectList
      ARSObjectList_1286: upstream-reference=TopLevelComposition.FctAdapter_Prototype.RP_Sdc_Cem_ARSObjectList.ARSObjectList, ecu-extract-reference=TopLevelCompositionPrototype.FctAdapter_Prototype.RP_Sdc_Cem_ARSObjectList.ARSObjectList
      RP_Sdc_Cem_FusionObjectList_1287: upstream-reference=TopLevelComposition.FctAdapter_Prototype.RP_Sdc_Cem_FusionObjectList, ecu-extract-reference=TopLevelCompositionPrototype.FctAdapter_Prototype.RP_Sdc_Cem_FusionObjectList
      FusionObjectList_1288: upstream-reference=TopLevelComposition.FctAdapter_Prototype.RP_Sdc_Cem_FusionObjectList.FusionObjectList, ecu-extract-reference=TopLevelCompositionPrototype.FctAdapter_Prototype.RP_Sdc_Cem_FusionObjectList.FusionObjectList
      RP_Sdc_Cem_GenObjectList_1289: upstream-reference=TopLevelComposition.FctAdapter_Prototype.RP_Sdc_Cem_GenObjectList, ecu-extract-reference=TopLevelCompositionPrototype.FctAdapter_Prototype.RP_Sdc_Cem_GenObjectList
      GenObjectList_1290: upstream-reference=TopLevelComposition.FctAdapter_Prototype.RP_Sdc_Cem_GenObjectList.GenObjectList, ecu-extract-reference=TopLevelCompositionPrototype.FctAdapter_Prototype.RP_Sdc_Cem_GenObjectList.GenObjectList
      RP_UpdateTaskCycle_1291: upstream-reference=TopLevelComposition.FctAdapter_Prototype.RP_UpdateTaskCycle, ecu-extract-reference=TopLevelCompositionPrototype.FctAdapter_Prototype.RP_UpdateTaskCycle
      RP_VdyAdapter_VehDyn_1292: upstream-reference=TopLevelComposition.FctAdapter_Prototype.RP_VdyAdapter_VehDyn, ecu-extract-reference=TopLevelCompositionPrototype.FctAdapter_Prototype.RP_VdyAdapter_VehDyn
      VehDyn_1293: upstream-reference=TopLevelComposition.FctAdapter_Prototype.RP_VdyAdapter_VehDyn.VehDyn, ecu-extract-reference=TopLevelCompositionPrototype.FctAdapter_Prototype.RP_VdyAdapter_VehDyn.VehDyn
      Fcu_Prototype_1294: upstream-reference=TopLevelComposition.Fcu_Prototype, ecu-extract-reference=TopLevelCompositionPrototype.Fcu_Prototype
      PP_Fcu_BaseCtrlData_1295: upstream-reference=TopLevelComposition.Fcu_Prototype.PP_Fcu_BaseCtrlData, ecu-extract-reference=TopLevelCompositionPrototype.Fcu_Prototype.PP_Fcu_BaseCtrlData
      BaseCtrlData_1296: upstream-reference=TopLevelComposition.Fcu_Prototype.PP_Fcu_BaseCtrlData.BaseCtrlData, ecu-extract-reference=TopLevelCompositionPrototype.Fcu_Prototype.PP_Fcu_BaseCtrlData.BaseCtrlData
      PP_Fcu_Cps_TxSignal_Acc_1297: upstream-reference=TopLevelComposition.Fcu_Prototype.PP_Fcu_Cps_TxSignal_Acc, ecu-extract-reference=TopLevelCompositionPrototype.Fcu_Prototype.PP_Fcu_Cps_TxSignal_Acc
      Cps_SignalPhyData_FC_ACC_temp_1298: upstream-reference=TopLevelComposition.Fcu_Prototype.PP_Fcu_Cps_TxSignal_Acc.Cps_SignalPhyData_FC_ACC_temp, ecu-extract-reference=TopLevelCompositionPrototype.Fcu_Prototype.PP_Fcu_Cps_TxSignal_Acc.Cps_SignalPhyData_FC_ACC_temp
      PP_Fcu_Cps_TxSignal_Aeb_1299: upstream-reference=TopLevelComposition.Fcu_Prototype.PP_Fcu_Cps_TxSignal_Aeb, ecu-extract-reference=TopLevelCompositionPrototype.Fcu_Prototype.PP_Fcu_Cps_TxSignal_Aeb
      Cps_SignalPhyData_FC_ABAActive_1300: upstream-reference=TopLevelComposition.Fcu_Prototype.PP_Fcu_Cps_TxSignal_Aeb.Cps_SignalPhyData_FC_ABAActive, ecu-extract-reference=TopLevelCompositionPrototype.Fcu_Prototype.PP_Fcu_Cps_TxSignal_Aeb.Cps_SignalPhyData_FC_ABAActive
      Cps_SignalPhyData_FC_ABAlevel_1301: upstream-reference=TopLevelComposition.Fcu_Prototype.PP_Fcu_Cps_TxSignal_Aeb.Cps_SignalPhyData_FC_ABAlevel, ecu-extract-reference=TopLevelCompositionPrototype.Fcu_Prototype.PP_Fcu_Cps_TxSignal_Aeb.Cps_SignalPhyData_FC_ABAlevel
      Cps_SignalPhyData_FC_AEBActive_1302: upstream-reference=TopLevelComposition.Fcu_Prototype.PP_Fcu_Cps_TxSignal_Aeb.Cps_SignalPhyData_FC_AEBActive, ecu-extract-reference=TopLevelCompositionPrototype.Fcu_Prototype.PP_Fcu_Cps_TxSignal_Aeb.Cps_SignalPhyData_FC_AEBActive
      Cps_SignalPhyData_FC_AEBCtrlType_1303: upstream-reference=TopLevelComposition.Fcu_Prototype.PP_Fcu_Cps_TxSignal_Aeb.Cps_SignalPhyData_FC_AEBCtrlType, ecu-extract-reference=TopLevelCompositionPrototype.Fcu_Prototype.PP_Fcu_Cps_TxSignal_Aeb.Cps_SignalPhyData_FC_AEBCtrlType
      Cps_SignalPhyData_FC_AEBEnable_1304: upstream-reference=TopLevelComposition.Fcu_Prototype.PP_Fcu_Cps_TxSignal_Aeb.Cps_SignalPhyData_FC_AEBEnable, ecu-extract-reference=TopLevelCompositionPrototype.Fcu_Prototype.PP_Fcu_Cps_TxSignal_Aeb.Cps_SignalPhyData_FC_AEBEnable
      Cps_SignalPhyData_FC_AEBStatus_1305: upstream-reference=TopLevelComposition.Fcu_Prototype.PP_Fcu_Cps_TxSignal_Aeb.Cps_SignalPhyData_FC_AEBStatus, ecu-extract-reference=TopLevelCompositionPrototype.Fcu_Prototype.PP_Fcu_Cps_TxSignal_Aeb.Cps_SignalPhyData_FC_AEBStatus
      Cps_SignalPhyData_FC_AEBTargetAx_1306: upstream-reference=TopLevelComposition.Fcu_Prototype.PP_Fcu_Cps_TxSignal_Aeb.Cps_SignalPhyData_FC_AEBTargetAx, ecu-extract-reference=TopLevelCompositionPrototype.Fcu_Prototype.PP_Fcu_Cps_TxSignal_Aeb.Cps_SignalPhyData_FC_AEBTargetAx
      Cps_SignalPhyData_FC_AEBTargetAy_1307: upstream-reference=TopLevelComposition.Fcu_Prototype.PP_Fcu_Cps_TxSignal_Aeb.Cps_SignalPhyData_FC_AEBTargetAy, ecu-extract-reference=TopLevelCompositionPrototype.Fcu_Prototype.PP_Fcu_Cps_TxSignal_Aeb.Cps_SignalPhyData_FC_AEBTargetAy
      Cps_SignalPhyData_FC_AEBTargetDeceleration_1308: upstream-reference=TopLevelComposition.Fcu_Prototype.PP_Fcu_Cps_TxSignal_Aeb.Cps_SignalPhyData_FC_AEBTargetDeceleration, ecu-extract-reference=TopLevelCompositionPrototype.Fcu_Prototype.PP_Fcu_Cps_TxSignal_Aeb.Cps_SignalPhyData_FC_AEBTargetDeceleration
      Cps_SignalPhyData_FC_AEBTargetDetection_1309: upstream-reference=TopLevelComposition.Fcu_Prototype.PP_Fcu_Cps_TxSignal_Aeb.Cps_SignalPhyData_FC_AEBTargetDetection, ecu-extract-reference=TopLevelCompositionPrototype.Fcu_Prototype.PP_Fcu_Cps_TxSignal_Aeb.Cps_SignalPhyData_FC_AEBTargetDetection
      Cps_SignalPhyData_FC_AEBTargetLatRange_1310: upstream-reference=TopLevelComposition.Fcu_Prototype.PP_Fcu_Cps_TxSignal_Aeb.Cps_SignalPhyData_FC_AEBTargetLatRange, ecu-extract-reference=TopLevelCompositionPrototype.Fcu_Prototype.PP_Fcu_Cps_TxSignal_Aeb.Cps_SignalPhyData_FC_AEBTargetLatRange
      Cps_SignalPhyData_FC_AEBTargetLatRelSpeed_1311: upstream-reference=TopLevelComposition.Fcu_Prototype.PP_Fcu_Cps_TxSignal_Aeb.Cps_SignalPhyData_FC_AEBTargetLatRelSpeed, ecu-extract-reference=TopLevelCompositionPrototype.Fcu_Prototype.PP_Fcu_Cps_TxSignal_Aeb.Cps_SignalPhyData_FC_AEBTargetLatRelSpeed
      Cps_SignalPhyData_FC_AEBTargetLngRange_1312: upstream-reference=TopLevelComposition.Fcu_Prototype.PP_Fcu_Cps_TxSignal_Aeb.Cps_SignalPhyData_FC_AEBTargetLngRange, ecu-extract-reference=TopLevelCompositionPrototype.Fcu_Prototype.PP_Fcu_Cps_TxSignal_Aeb.Cps_SignalPhyData_FC_AEBTargetLngRange
      Cps_SignalPhyData_FC_AEBTargetProb_1313: upstream-reference=TopLevelComposition.Fcu_Prototype.PP_Fcu_Cps_TxSignal_Aeb.Cps_SignalPhyData_FC_AEBTargetProb, ecu-extract-reference=TopLevelCompositionPrototype.Fcu_Prototype.PP_Fcu_Cps_TxSignal_Aeb.Cps_SignalPhyData_FC_AEBTargetProb
      Cps_SignalPhyData_FC_AEBTargetRelSpeed_1314: upstream-reference=TopLevelComposition.Fcu_Prototype.PP_Fcu_Cps_TxSignal_Aeb.Cps_SignalPhyData_FC_AEBTargetRelSpeed, ecu-extract-reference=TopLevelCompositionPrototype.Fcu_Prototype.PP_Fcu_Cps_TxSignal_Aeb.Cps_SignalPhyData_FC_AEBTargetRelSpeed
      Cps_SignalPhyData_FC_AEBTargetType_1315: upstream-reference=TopLevelComposition.Fcu_Prototype.PP_Fcu_Cps_TxSignal_Aeb.Cps_SignalPhyData_FC_AEBTargetType, ecu-extract-reference=TopLevelCompositionPrototype.Fcu_Prototype.PP_Fcu_Cps_TxSignal_Aeb.Cps_SignalPhyData_FC_AEBTargetType
      Cps_SignalPhyData_FC_AEBTargetmode_1316: upstream-reference=TopLevelComposition.Fcu_Prototype.PP_Fcu_Cps_TxSignal_Aeb.Cps_SignalPhyData_FC_AEBTargetmode, ecu-extract-reference=TopLevelCompositionPrototype.Fcu_Prototype.PP_Fcu_Cps_TxSignal_Aeb.Cps_SignalPhyData_FC_AEBTargetmode
      Cps_SignalPhyData_FC_AEBTextInfo_1317: upstream-reference=TopLevelComposition.Fcu_Prototype.PP_Fcu_Cps_TxSignal_Aeb.Cps_SignalPhyData_FC_AEBTextInfo, ecu-extract-reference=TopLevelCompositionPrototype.Fcu_Prototype.PP_Fcu_Cps_TxSignal_Aeb.Cps_SignalPhyData_FC_AEBTextInfo
      Cps_SignalPhyData_FC_AEBVehilceHoldReq_1318: upstream-reference=TopLevelComposition.Fcu_Prototype.PP_Fcu_Cps_TxSignal_Aeb.Cps_SignalPhyData_FC_AEBVehilceHoldReq, ecu-extract-reference=TopLevelCompositionPrototype.Fcu_Prototype.PP_Fcu_Cps_TxSignal_Aeb.Cps_SignalPhyData_FC_AEBVehilceHoldReq
      Cps_SignalPhyData_FC_AWBActive_1319: upstream-reference=TopLevelComposition.Fcu_Prototype.PP_Fcu_Cps_TxSignal_Aeb.Cps_SignalPhyData_FC_AWBActive, ecu-extract-reference=TopLevelCompositionPrototype.Fcu_Prototype.PP_Fcu_Cps_TxSignal_Aeb.Cps_SignalPhyData_FC_AWBActive
      Cps_SignalPhyData_FC_AWBlevel_1320: upstream-reference=TopLevelComposition.Fcu_Prototype.PP_Fcu_Cps_TxSignal_Aeb.Cps_SignalPhyData_FC_AWBlevel, ecu-extract-reference=TopLevelCompositionPrototype.Fcu_Prototype.PP_Fcu_Cps_TxSignal_Aeb.Cps_SignalPhyData_FC_AWBlevel
      Cps_SignalPhyData_FC_FCWActive_1321: upstream-reference=TopLevelComposition.Fcu_Prototype.PP_Fcu_Cps_TxSignal_Aeb.Cps_SignalPhyData_FC_FCWActive, ecu-extract-reference=TopLevelCompositionPrototype.Fcu_Prototype.PP_Fcu_Cps_TxSignal_Aeb.Cps_SignalPhyData_FC_FCWActive
      Cps_SignalPhyData_FC_FCWLatentWarning_1322: upstream-reference=TopLevelComposition.Fcu_Prototype.PP_Fcu_Cps_TxSignal_Aeb.Cps_SignalPhyData_FC_FCWLatentWarning, ecu-extract-reference=TopLevelCompositionPrototype.Fcu_Prototype.PP_Fcu_Cps_TxSignal_Aeb.Cps_SignalPhyData_FC_FCWLatentWarning
      Cps_SignalPhyData_FC_FCWPreWarning_1323: upstream-reference=TopLevelComposition.Fcu_Prototype.PP_Fcu_Cps_TxSignal_Aeb.Cps_SignalPhyData_FC_FCWPreWarning, ecu-extract-reference=TopLevelCompositionPrototype.Fcu_Prototype.PP_Fcu_Cps_TxSignal_Aeb.Cps_SignalPhyData_FC_FCWPreWarning
      Cps_SignalPhyData_FC_FCWSettingStatus_1324: upstream-reference=TopLevelComposition.Fcu_Prototype.PP_Fcu_Cps_TxSignal_Aeb.Cps_SignalPhyData_FC_FCWSettingStatus, ecu-extract-reference=TopLevelCompositionPrototype.Fcu_Prototype.PP_Fcu_Cps_TxSignal_Aeb.Cps_SignalPhyData_FC_FCWSettingStatus
      Cps_SignalPhyData_FC_FCWStatus_1325: upstream-reference=TopLevelComposition.Fcu_Prototype.PP_Fcu_Cps_TxSignal_Aeb.Cps_SignalPhyData_FC_FCWStatus, ecu-extract-reference=TopLevelCompositionPrototype.Fcu_Prototype.PP_Fcu_Cps_TxSignal_Aeb.Cps_SignalPhyData_FC_FCWStatus
      Cps_SignalPhyData_FC_LLaneDistanceFus_1326: upstream-reference=TopLevelComposition.Fcu_Prototype.PP_Fcu_Cps_TxSignal_Aeb.Cps_SignalPhyData_FC_LLaneDistanceFus, ecu-extract-reference=TopLevelCompositionPrototype.Fcu_Prototype.PP_Fcu_Cps_TxSignal_Aeb.Cps_SignalPhyData_FC_LLaneDistanceFus
      Cps_SignalPhyData_FC_LLaneMarkerType_1327: upstream-reference=TopLevelComposition.Fcu_Prototype.PP_Fcu_Cps_TxSignal_Aeb.Cps_SignalPhyData_FC_LLaneMarkerType, ecu-extract-reference=TopLevelCompositionPrototype.Fcu_Prototype.PP_Fcu_Cps_TxSignal_Aeb.Cps_SignalPhyData_FC_LLaneMarkerType
      Cps_SignalPhyData_FC_OBJ_AEB_ID_1328: upstream-reference=TopLevelComposition.Fcu_Prototype.PP_Fcu_Cps_TxSignal_Aeb.Cps_SignalPhyData_FC_OBJ_AEB_ID, ecu-extract-reference=TopLevelCompositionPrototype.Fcu_Prototype.PP_Fcu_Cps_TxSignal_Aeb.Cps_SignalPhyData_FC_OBJ_AEB_ID
      Cps_SignalPhyData_FC_PrefillActive_1329: upstream-reference=TopLevelComposition.Fcu_Prototype.PP_Fcu_Cps_TxSignal_Aeb.Cps_SignalPhyData_FC_PrefillActive, ecu-extract-reference=TopLevelCompositionPrototype.Fcu_Prototype.PP_Fcu_Cps_TxSignal_Aeb.Cps_SignalPhyData_FC_PrefillActive
      Cps_SignalPhyData_FC_RLaneDistanceFus_1330: upstream-reference=TopLevelComposition.Fcu_Prototype.PP_Fcu_Cps_TxSignal_Aeb.Cps_SignalPhyData_FC_RLaneDistanceFus, ecu-extract-reference=TopLevelCompositionPrototype.Fcu_Prototype.PP_Fcu_Cps_TxSignal_Aeb.Cps_SignalPhyData_FC_RLaneDistanceFus
      Cps_SignalPhyData_FC_RLaneMarkerType_1331: upstream-reference=TopLevelComposition.Fcu_Prototype.PP_Fcu_Cps_TxSignal_Aeb.Cps_SignalPhyData_FC_RLaneMarkerType, ecu-extract-reference=TopLevelCompositionPrototype.Fcu_Prototype.PP_Fcu_Cps_TxSignal_Aeb.Cps_SignalPhyData_FC_RLaneMarkerType
      PP_Fcu_Cps_TxSignal_Hla_1332: upstream-reference=TopLevelComposition.Fcu_Prototype.PP_Fcu_Cps_TxSignal_Hla, ecu-extract-reference=TopLevelCompositionPrototype.Fcu_Prototype.PP_Fcu_Cps_TxSignal_Hla
      Cps_SignalPhyData_FC_HMAEnableStatus_1333: upstream-reference=TopLevelComposition.Fcu_Prototype.PP_Fcu_Cps_TxSignal_Hla.Cps_SignalPhyData_FC_HMAEnableStatus, ecu-extract-reference=TopLevelCompositionPrototype.Fcu_Prototype.PP_Fcu_Cps_TxSignal_Hla.Cps_SignalPhyData_FC_HMAEnableStatus
      Cps_SignalPhyData_FC_HMALightDistribution_1334: upstream-reference=TopLevelComposition.Fcu_Prototype.PP_Fcu_Cps_TxSignal_Hla.Cps_SignalPhyData_FC_HMALightDistribution, ecu-extract-reference=TopLevelCompositionPrototype.Fcu_Prototype.PP_Fcu_Cps_TxSignal_Hla.Cps_SignalPhyData_FC_HMALightDistribution
      Cps_SignalPhyData_FC_HMAStatus_1335: upstream-reference=TopLevelComposition.Fcu_Prototype.PP_Fcu_Cps_TxSignal_Hla.Cps_SignalPhyData_FC_HMAStatus, ecu-extract-reference=TopLevelCompositionPrototype.Fcu_Prototype.PP_Fcu_Cps_TxSignal_Hla.Cps_SignalPhyData_FC_HMAStatus
      PP_Fcu_Cps_TxSignal_Lcf_1336: upstream-reference=TopLevelComposition.Fcu_Prototype.PP_Fcu_Cps_TxSignal_Lcf, ecu-extract-reference=TopLevelCompositionPrototype.Fcu_Prototype.PP_Fcu_Cps_TxSignal_Lcf
      Cps_SignalPhyData_ACC_HostLaneLeftStatus_1337: upstream-reference=TopLevelComposition.Fcu_Prototype.PP_Fcu_Cps_TxSignal_Lcf.Cps_SignalPhyData_ACC_HostLaneLeftStatus, ecu-extract-reference=TopLevelCompositionPrototype.Fcu_Prototype.PP_Fcu_Cps_TxSignal_Lcf.Cps_SignalPhyData_ACC_HostLaneLeftStatus
      Cps_SignalPhyData_ACC_HostLaneRightStatus_1338: upstream-reference=TopLevelComposition.Fcu_Prototype.PP_Fcu_Cps_TxSignal_Lcf.Cps_SignalPhyData_ACC_HostLaneRightStatus, ecu-extract-reference=TopLevelCompositionPrototype.Fcu_Prototype.PP_Fcu_Cps_TxSignal_Lcf.Cps_SignalPhyData_ACC_HostLaneRightStatus
      Cps_SignalPhyData_ACC_LatAngReq_1339: upstream-reference=TopLevelComposition.Fcu_Prototype.PP_Fcu_Cps_TxSignal_Lcf.Cps_SignalPhyData_ACC_LatAngReq, ecu-extract-reference=TopLevelCompositionPrototype.Fcu_Prototype.PP_Fcu_Cps_TxSignal_Lcf.Cps_SignalPhyData_ACC_LatAngReq
      Cps_SignalPhyData_ACC_LatAngReqActive_1340: upstream-reference=TopLevelComposition.Fcu_Prototype.PP_Fcu_Cps_TxSignal_Lcf.Cps_SignalPhyData_ACC_LatAngReqActive, ecu-extract-reference=TopLevelCompositionPrototype.Fcu_Prototype.PP_Fcu_Cps_TxSignal_Lcf.Cps_SignalPhyData_ACC_LatAngReqActive
      Cps_SignalPhyData_FC_ELKEnableStatus_1341: upstream-reference=TopLevelComposition.Fcu_Prototype.PP_Fcu_Cps_TxSignal_Lcf.Cps_SignalPhyData_FC_ELKEnableStatus, ecu-extract-reference=TopLevelCompositionPrototype.Fcu_Prototype.PP_Fcu_Cps_TxSignal_Lcf.Cps_SignalPhyData_FC_ELKEnableStatus
      Cps_SignalPhyData_FC_ELKInterventionMode_1342: upstream-reference=TopLevelComposition.Fcu_Prototype.PP_Fcu_Cps_TxSignal_Lcf.Cps_SignalPhyData_FC_ELKInterventionMode, ecu-extract-reference=TopLevelCompositionPrototype.Fcu_Prototype.PP_Fcu_Cps_TxSignal_Lcf.Cps_SignalPhyData_FC_ELKInterventionMode
      Cps_SignalPhyData_FC_ELKMode_1343: upstream-reference=TopLevelComposition.Fcu_Prototype.PP_Fcu_Cps_TxSignal_Lcf.Cps_SignalPhyData_FC_ELKMode, ecu-extract-reference=TopLevelCompositionPrototype.Fcu_Prototype.PP_Fcu_Cps_TxSignal_Lcf.Cps_SignalPhyData_FC_ELKMode
      Cps_SignalPhyData_FC_HostLaneLeftStatus_1344: upstream-reference=TopLevelComposition.Fcu_Prototype.PP_Fcu_Cps_TxSignal_Lcf.Cps_SignalPhyData_FC_HostLaneLeftStatus, ecu-extract-reference=TopLevelCompositionPrototype.Fcu_Prototype.PP_Fcu_Cps_TxSignal_Lcf.Cps_SignalPhyData_FC_HostLaneLeftStatus
      Cps_SignalPhyData_FC_HostLaneRightStatus_1345: upstream-reference=TopLevelComposition.Fcu_Prototype.PP_Fcu_Cps_TxSignal_Lcf.Cps_SignalPhyData_FC_HostLaneRightStatus, ecu-extract-reference=TopLevelCompositionPrototype.Fcu_Prototype.PP_Fcu_Cps_TxSignal_Lcf.Cps_SignalPhyData_FC_HostLaneRightStatus
      Cps_SignalPhyData_FC_LASModeSelectionStatus_1346: upstream-reference=TopLevelComposition.Fcu_Prototype.PP_Fcu_Cps_TxSignal_Lcf.Cps_SignalPhyData_FC_LASModeSelectionStatus, ecu-extract-reference=TopLevelCompositionPrototype.Fcu_Prototype.PP_Fcu_Cps_TxSignal_Lcf.Cps_SignalPhyData_FC_LASModeSelectionStatus
      Cps_SignalPhyData_FC_LASWarningModeSelectionSts_1347: upstream-reference=TopLevelComposition.Fcu_Prototype.PP_Fcu_Cps_TxSignal_Lcf.Cps_SignalPhyData_FC_LASWarningModeSelectionSts, ecu-extract-reference=TopLevelCompositionPrototype.Fcu_Prototype.PP_Fcu_Cps_TxSignal_Lcf.Cps_SignalPhyData_FC_LASWarningModeSelectionSts
      Cps_SignalPhyData_FC_LDWShakeLevStatus_1348: upstream-reference=TopLevelComposition.Fcu_Prototype.PP_Fcu_Cps_TxSignal_Lcf.Cps_SignalPhyData_FC_LDWShakeLevStatus, ecu-extract-reference=TopLevelCompositionPrototype.Fcu_Prototype.PP_Fcu_Cps_TxSignal_Lcf.Cps_SignalPhyData_FC_LDWShakeLevStatus
      Cps_SignalPhyData_FC_LDWStatus_1349: upstream-reference=TopLevelComposition.Fcu_Prototype.PP_Fcu_Cps_TxSignal_Lcf.Cps_SignalPhyData_FC_LDWStatus, ecu-extract-reference=TopLevelCompositionPrototype.Fcu_Prototype.PP_Fcu_Cps_TxSignal_Lcf.Cps_SignalPhyData_FC_LDWStatus
      Cps_SignalPhyData_FC_LDWVibrationWarningReq_1350: upstream-reference=TopLevelComposition.Fcu_Prototype.PP_Fcu_Cps_TxSignal_Lcf.Cps_SignalPhyData_FC_LDWVibrationWarningReq, ecu-extract-reference=TopLevelCompositionPrototype.Fcu_Prototype.PP_Fcu_Cps_TxSignal_Lcf.Cps_SignalPhyData_FC_LDWVibrationWarningReq
      Cps_SignalPhyData_FC_LKAStatus_1351: upstream-reference=TopLevelComposition.Fcu_Prototype.PP_Fcu_Cps_TxSignal_Lcf.Cps_SignalPhyData_FC_LKAStatus, ecu-extract-reference=TopLevelCompositionPrototype.Fcu_Prototype.PP_Fcu_Cps_TxSignal_Lcf.Cps_SignalPhyData_FC_LKAStatus
      Cps_SignalPhyData_FC_LKATakeoverReq_1352: upstream-reference=TopLevelComposition.Fcu_Prototype.PP_Fcu_Cps_TxSignal_Lcf.Cps_SignalPhyData_FC_LKATakeoverReq, ecu-extract-reference=TopLevelCompositionPrototype.Fcu_Prototype.PP_Fcu_Cps_TxSignal_Lcf.Cps_SignalPhyData_FC_LKATakeoverReq
      Cps_SignalPhyData_FC_LatAngReq_1353: upstream-reference=TopLevelComposition.Fcu_Prototype.PP_Fcu_Cps_TxSignal_Lcf.Cps_SignalPhyData_FC_LatAngReq, ecu-extract-reference=TopLevelCompositionPrototype.Fcu_Prototype.PP_Fcu_Cps_TxSignal_Lcf.Cps_SignalPhyData_FC_LatAngReq
      Cps_SignalPhyData_FC_LatAngReqActive_1354: upstream-reference=TopLevelComposition.Fcu_Prototype.PP_Fcu_Cps_TxSignal_Lcf.Cps_SignalPhyData_FC_LatAngReqActive, ecu-extract-reference=TopLevelCompositionPrototype.Fcu_Prototype.PP_Fcu_Cps_TxSignal_Lcf.Cps_SignalPhyData_FC_LatAngReqActive
      Cps_SignalPhyData_FC_MotorTorqueMaxLimitRequest_1355: upstream-reference=TopLevelComposition.Fcu_Prototype.PP_Fcu_Cps_TxSignal_Lcf.Cps_SignalPhyData_FC_MotorTorqueMaxLimitRequest, ecu-extract-reference=TopLevelCompositionPrototype.Fcu_Prototype.PP_Fcu_Cps_TxSignal_Lcf.Cps_SignalPhyData_FC_MotorTorqueMaxLimitRequest
      Cps_SignalPhyData_FC_MotorTorqueMinLimitRequest_1356: upstream-reference=TopLevelComposition.Fcu_Prototype.PP_Fcu_Cps_TxSignal_Lcf.Cps_SignalPhyData_FC_MotorTorqueMinLimitRequest, ecu-extract-reference=TopLevelCompositionPrototype.Fcu_Prototype.PP_Fcu_Cps_TxSignal_Lcf.Cps_SignalPhyData_FC_MotorTorqueMinLimitRequest
      Cps_SignalPhyData_FC_Voiceinfo_1357: upstream-reference=TopLevelComposition.Fcu_Prototype.PP_Fcu_Cps_TxSignal_Lcf.Cps_SignalPhyData_FC_Voiceinfo, ecu-extract-reference=TopLevelCompositionPrototype.Fcu_Prototype.PP_Fcu_Cps_TxSignal_Lcf.Cps_SignalPhyData_FC_Voiceinfo
      PP_Fcu_DimInputCustomData_1358: upstream-reference=TopLevelComposition.Fcu_Prototype.PP_Fcu_DimInputCustomData, ecu-extract-reference=TopLevelCompositionPrototype.Fcu_Prototype.PP_Fcu_DimInputCustomData
      DimInputCustomData_1359: upstream-reference=TopLevelComposition.Fcu_Prototype.PP_Fcu_DimInputCustomData.DimInputCustomData, ecu-extract-reference=TopLevelCompositionPrototype.Fcu_Prototype.PP_Fcu_DimInputCustomData.DimInputCustomData
      PP_Fcu_DimInputGenericData_1360: upstream-reference=TopLevelComposition.Fcu_Prototype.PP_Fcu_DimInputGenericData, ecu-extract-reference=TopLevelCompositionPrototype.Fcu_Prototype.PP_Fcu_DimInputGenericData
      DimInputGenericData_1361: upstream-reference=TopLevelComposition.Fcu_Prototype.PP_Fcu_DimInputGenericData.DimInputGenericData, ecu-extract-reference=TopLevelCompositionPrototype.Fcu_Prototype.PP_Fcu_DimInputGenericData.DimInputGenericData
      PP_Fcu_FctCtrlData_1362: upstream-reference=TopLevelComposition.Fcu_Prototype.PP_Fcu_FctCtrlData, ecu-extract-reference=TopLevelCompositionPrototype.Fcu_Prototype.PP_Fcu_FctCtrlData
      FctCtrlData_1363: upstream-reference=TopLevelComposition.Fcu_Prototype.PP_Fcu_FctCtrlData.FctCtrlData, ecu-extract-reference=TopLevelCompositionPrototype.Fcu_Prototype.PP_Fcu_FctCtrlData.FctCtrlData
      PP_Fcu_HeadInputCustomData_1364: upstream-reference=TopLevelComposition.Fcu_Prototype.PP_Fcu_HeadInputCustomData, ecu-extract-reference=TopLevelCompositionPrototype.Fcu_Prototype.PP_Fcu_HeadInputCustomData
      HeadInputCustomData_1365: upstream-reference=TopLevelComposition.Fcu_Prototype.PP_Fcu_HeadInputCustomData.HeadInputCustomData, ecu-extract-reference=TopLevelCompositionPrototype.Fcu_Prototype.PP_Fcu_HeadInputCustomData.HeadInputCustomData
      PP_Fcu_HeadInputGenericData_1366: upstream-reference=TopLevelComposition.Fcu_Prototype.PP_Fcu_HeadInputGenericData, ecu-extract-reference=TopLevelCompositionPrototype.Fcu_Prototype.PP_Fcu_HeadInputGenericData
      HeadInputGenericData_1367: upstream-reference=TopLevelComposition.Fcu_Prototype.PP_Fcu_HeadInputGenericData.HeadInputGenericData, ecu-extract-reference=TopLevelCompositionPrototype.Fcu_Prototype.PP_Fcu_HeadInputGenericData.HeadInputGenericData
      PP_Fcu_HlaInputData_1368: upstream-reference=TopLevelComposition.Fcu_Prototype.PP_Fcu_HlaInputData, ecu-extract-reference=TopLevelCompositionPrototype.Fcu_Prototype.PP_Fcu_HlaInputData
      Hla_InputSignals_t_1369: upstream-reference=TopLevelComposition.Fcu_Prototype.PP_Fcu_HlaInputData.Hla_InputSignals_t, ecu-extract-reference=TopLevelCompositionPrototype.Fcu_Prototype.PP_Fcu_HlaInputData.Hla_InputSignals_t
      PP_Fcu_LcfGenericInputData_1370: upstream-reference=TopLevelComposition.Fcu_Prototype.PP_Fcu_LcfGenericInputData, ecu-extract-reference=TopLevelCompositionPrototype.Fcu_Prototype.PP_Fcu_LcfGenericInputData
      LcfGenericInputData_1371: upstream-reference=TopLevelComposition.Fcu_Prototype.PP_Fcu_LcfGenericInputData.LcfGenericInputData, ecu-extract-reference=TopLevelCompositionPrototype.Fcu_Prototype.PP_Fcu_LcfGenericInputData.LcfGenericInputData
      PP_Fcu_SRI_FC_AEBStatus_1372: upstream-reference=TopLevelComposition.Fcu_Prototype.PP_Fcu_SRI_FC_AEBStatus, ecu-extract-reference=TopLevelCompositionPrototype.Fcu_Prototype.PP_Fcu_SRI_FC_AEBStatus
      DE_FC_AEBStatus_1373: upstream-reference=TopLevelComposition.Fcu_Prototype.PP_Fcu_SRI_FC_AEBStatus.DE_FC_AEBStatus, ecu-extract-reference=TopLevelCompositionPrototype.Fcu_Prototype.PP_Fcu_SRI_FC_AEBStatus.DE_FC_AEBStatus
      PP_Fcu_SRI_FC_ELKModeStatus_1374: upstream-reference=TopLevelComposition.Fcu_Prototype.PP_Fcu_SRI_FC_ELKModeStatus, ecu-extract-reference=TopLevelCompositionPrototype.Fcu_Prototype.PP_Fcu_SRI_FC_ELKModeStatus
      DE_FC_ELKMode_1375: upstream-reference=TopLevelComposition.Fcu_Prototype.PP_Fcu_SRI_FC_ELKModeStatus.DE_FC_ELKMode, ecu-extract-reference=TopLevelCompositionPrototype.Fcu_Prototype.PP_Fcu_SRI_FC_ELKModeStatus.DE_FC_ELKMode
      PP_Fcu_SRI_FC_FCWStatus_1376: upstream-reference=TopLevelComposition.Fcu_Prototype.PP_Fcu_SRI_FC_FCWStatus, ecu-extract-reference=TopLevelCompositionPrototype.Fcu_Prototype.PP_Fcu_SRI_FC_FCWStatus
      DE_FC_FCWStatus_1377: upstream-reference=TopLevelComposition.Fcu_Prototype.PP_Fcu_SRI_FC_FCWStatus.DE_FC_FCWStatus, ecu-extract-reference=TopLevelCompositionPrototype.Fcu_Prototype.PP_Fcu_SRI_FC_FCWStatus.DE_FC_FCWStatus
      PP_Fcu_SRI_FC_HMAStatus_1378: upstream-reference=TopLevelComposition.Fcu_Prototype.PP_Fcu_SRI_FC_HMAStatus, ecu-extract-reference=TopLevelCompositionPrototype.Fcu_Prototype.PP_Fcu_SRI_FC_HMAStatus
      DE_FC_HMAStatus_1379: upstream-reference=TopLevelComposition.Fcu_Prototype.PP_Fcu_SRI_FC_HMAStatus.DE_FC_HMAStatus, ecu-extract-reference=TopLevelCompositionPrototype.Fcu_Prototype.PP_Fcu_SRI_FC_HMAStatus.DE_FC_HMAStatus
      PP_Fcu_SRI_FC_LDWStatus_1380: upstream-reference=TopLevelComposition.Fcu_Prototype.PP_Fcu_SRI_FC_LDWStatus, ecu-extract-reference=TopLevelCompositionPrototype.Fcu_Prototype.PP_Fcu_SRI_FC_LDWStatus
      DE_FC_LDWStatus_1381: upstream-reference=TopLevelComposition.Fcu_Prototype.PP_Fcu_SRI_FC_LDWStatus.DE_FC_LDWStatus, ecu-extract-reference=TopLevelCompositionPrototype.Fcu_Prototype.PP_Fcu_SRI_FC_LDWStatus.DE_FC_LDWStatus
      PP_Fcu_SRI_FC_LKAStatus_1382: upstream-reference=TopLevelComposition.Fcu_Prototype.PP_Fcu_SRI_FC_LKAStatus, ecu-extract-reference=TopLevelCompositionPrototype.Fcu_Prototype.PP_Fcu_SRI_FC_LKAStatus
      DE_FC_LKAStatus_1383: upstream-reference=TopLevelComposition.Fcu_Prototype.PP_Fcu_SRI_FC_LKAStatus.DE_FC_LKAStatus, ecu-extract-reference=TopLevelCompositionPrototype.Fcu_Prototype.PP_Fcu_SRI_FC_LKAStatus.DE_FC_LKAStatus
      PP_Fcu_VehPar_1384: upstream-reference=TopLevelComposition.Fcu_Prototype.PP_Fcu_VehPar, ecu-extract-reference=TopLevelCompositionPrototype.Fcu_Prototype.PP_Fcu_VehPar
      VehPar_1385: upstream-reference=TopLevelComposition.Fcu_Prototype.PP_Fcu_VehPar.VehPar, ecu-extract-reference=TopLevelCompositionPrototype.Fcu_Prototype.PP_Fcu_VehPar.VehPar
      PP_Fcu_VehSig_1386: upstream-reference=TopLevelComposition.Fcu_Prototype.PP_Fcu_VehSig, ecu-extract-reference=TopLevelCompositionPrototype.Fcu_Prototype.PP_Fcu_VehSig
      VehSig_1387: upstream-reference=TopLevelComposition.Fcu_Prototype.PP_Fcu_VehSig.VehSig, ecu-extract-reference=TopLevelCompositionPrototype.Fcu_Prototype.PP_Fcu_VehSig.VehSig
      RP_Cdm_FcuBlockOp_1388: upstream-reference=TopLevelComposition.Fcu_Prototype.RP_Cdm_FcuBlockOp, ecu-extract-reference=TopLevelCompositionPrototype.Fcu_Prototype.RP_Cdm_FcuBlockOp
      RP_FctAdapter_HeadOutputCustomData_1389: upstream-reference=TopLevelComposition.Fcu_Prototype.RP_FctAdapter_HeadOutputCustomData, ecu-extract-reference=TopLevelCompositionPrototype.Fcu_Prototype.RP_FctAdapter_HeadOutputCustomData
      HeadOutputCustomData_1390: upstream-reference=TopLevelComposition.Fcu_Prototype.RP_FctAdapter_HeadOutputCustomData.HeadOutputCustomData, ecu-extract-reference=TopLevelCompositionPrototype.Fcu_Prototype.RP_FctAdapter_HeadOutputCustomData.HeadOutputCustomData
      RP_Fcu_Adas_Data_1391: upstream-reference=TopLevelComposition.Fcu_Prototype.RP_Fcu_Adas_Data, ecu-extract-reference=TopLevelCompositionPrototype.Fcu_Prototype.RP_Fcu_Adas_Data
      ACCMode_1392: upstream-reference=TopLevelComposition.Fcu_Prototype.RP_Fcu_Adas_Data.ACCMode, ecu-extract-reference=TopLevelCompositionPrototype.Fcu_Prototype.RP_Fcu_Adas_Data.ACCMode
      ACCMode_Status_1393: upstream-reference=TopLevelComposition.Fcu_Prototype.RP_Fcu_Adas_Data.ACCMode_Status, ecu-extract-reference=TopLevelCompositionPrototype.Fcu_Prototype.RP_Fcu_Adas_Data.ACCMode_Status
      FR_RadarFailureStatus_1394: upstream-reference=TopLevelComposition.Fcu_Prototype.RP_Fcu_Adas_Data.FR_RadarFailureStatus, ecu-extract-reference=TopLevelCompositionPrototype.Fcu_Prototype.RP_Fcu_Adas_Data.FR_RadarFailureStatus
      FR_RadarFailureStatus_Status_1395: upstream-reference=TopLevelComposition.Fcu_Prototype.RP_Fcu_Adas_Data.FR_RadarFailureStatus_Status, ecu-extract-reference=TopLevelCompositionPrototype.Fcu_Prototype.RP_Fcu_Adas_Data.FR_RadarFailureStatus_Status
      FRadarCalibrationStatus_1396: upstream-reference=TopLevelComposition.Fcu_Prototype.RP_Fcu_Adas_Data.FRadarCalibrationStatus, ecu-extract-reference=TopLevelCompositionPrototype.Fcu_Prototype.RP_Fcu_Adas_Data.FRadarCalibrationStatus
      FRadarCalibrationStatus_Status_1397: upstream-reference=TopLevelComposition.Fcu_Prototype.RP_Fcu_Adas_Data.FRadarCalibrationStatus_Status, ecu-extract-reference=TopLevelCompositionPrototype.Fcu_Prototype.RP_Fcu_Adas_Data.FRadarCalibrationStatus_Status
      RadarObj1_Dx_1398: upstream-reference=TopLevelComposition.Fcu_Prototype.RP_Fcu_Adas_Data.RadarObj1_Dx, ecu-extract-reference=TopLevelCompositionPrototype.Fcu_Prototype.RP_Fcu_Adas_Data.RadarObj1_Dx
      RadarObj1_Dx_Status_1399: upstream-reference=TopLevelComposition.Fcu_Prototype.RP_Fcu_Adas_Data.RadarObj1_Dx_Status, ecu-extract-reference=TopLevelCompositionPrototype.Fcu_Prototype.RP_Fcu_Adas_Data.RadarObj1_Dx_Status
      RadarObj1_Dy_1400: upstream-reference=TopLevelComposition.Fcu_Prototype.RP_Fcu_Adas_Data.RadarObj1_Dy, ecu-extract-reference=TopLevelCompositionPrototype.Fcu_Prototype.RP_Fcu_Adas_Data.RadarObj1_Dy
      RadarObj1_Dy_Status_1401: upstream-reference=TopLevelComposition.Fcu_Prototype.RP_Fcu_Adas_Data.RadarObj1_Dy_Status, ecu-extract-reference=TopLevelCompositionPrototype.Fcu_Prototype.RP_Fcu_Adas_Data.RadarObj1_Dy_Status
      RadarObj1_ExistProb_1402: upstream-reference=TopLevelComposition.Fcu_Prototype.RP_Fcu_Adas_Data.RadarObj1_ExistProb, ecu-extract-reference=TopLevelCompositionPrototype.Fcu_Prototype.RP_Fcu_Adas_Data.RadarObj1_ExistProb
      RadarObj1_ExistProb_Status_1403: upstream-reference=TopLevelComposition.Fcu_Prototype.RP_Fcu_Adas_Data.RadarObj1_ExistProb_Status, ecu-extract-reference=TopLevelCompositionPrototype.Fcu_Prototype.RP_Fcu_Adas_Data.RadarObj1_ExistProb_Status
      RadarObj1_Length_1404: upstream-reference=TopLevelComposition.Fcu_Prototype.RP_Fcu_Adas_Data.RadarObj1_Length, ecu-extract-reference=TopLevelCompositionPrototype.Fcu_Prototype.RP_Fcu_Adas_Data.RadarObj1_Length
      RadarObj1_Length_Status_1405: upstream-reference=TopLevelComposition.Fcu_Prototype.RP_Fcu_Adas_Data.RadarObj1_Length_Status, ecu-extract-reference=TopLevelCompositionPrototype.Fcu_Prototype.RP_Fcu_Adas_Data.RadarObj1_Length_Status
      RadarObj1_Location_1406: upstream-reference=TopLevelComposition.Fcu_Prototype.RP_Fcu_Adas_Data.RadarObj1_Location, ecu-extract-reference=TopLevelCompositionPrototype.Fcu_Prototype.RP_Fcu_Adas_Data.RadarObj1_Location
      RadarObj1_Location_Status_1407: upstream-reference=TopLevelComposition.Fcu_Prototype.RP_Fcu_Adas_Data.RadarObj1_Location_Status, ecu-extract-reference=TopLevelCompositionPrototype.Fcu_Prototype.RP_Fcu_Adas_Data.RadarObj1_Location_Status
      RadarObj1_Measured_1408: upstream-reference=TopLevelComposition.Fcu_Prototype.RP_Fcu_Adas_Data.RadarObj1_Measured, ecu-extract-reference=TopLevelCompositionPrototype.Fcu_Prototype.RP_Fcu_Adas_Data.RadarObj1_Measured
      RadarObj1_Measured_Status_1409: upstream-reference=TopLevelComposition.Fcu_Prototype.RP_Fcu_Adas_Data.RadarObj1_Measured_Status, ecu-extract-reference=TopLevelCompositionPrototype.Fcu_Prototype.RP_Fcu_Adas_Data.RadarObj1_Measured_Status
      RadarObj1_RelAx_1410: upstream-reference=TopLevelComposition.Fcu_Prototype.RP_Fcu_Adas_Data.RadarObj1_RelAx, ecu-extract-reference=TopLevelCompositionPrototype.Fcu_Prototype.RP_Fcu_Adas_Data.RadarObj1_RelAx
      RadarObj1_RelAx_Status_1411: upstream-reference=TopLevelComposition.Fcu_Prototype.RP_Fcu_Adas_Data.RadarObj1_RelAx_Status, ecu-extract-reference=TopLevelCompositionPrototype.Fcu_Prototype.RP_Fcu_Adas_Data.RadarObj1_RelAx_Status
      RadarObj1_RelVx_1412: upstream-reference=TopLevelComposition.Fcu_Prototype.RP_Fcu_Adas_Data.RadarObj1_RelVx, ecu-extract-reference=TopLevelCompositionPrototype.Fcu_Prototype.RP_Fcu_Adas_Data.RadarObj1_RelVx
      RadarObj1_RelVx_Status_1413: upstream-reference=TopLevelComposition.Fcu_Prototype.RP_Fcu_Adas_Data.RadarObj1_RelVx_Status, ecu-extract-reference=TopLevelCompositionPrototype.Fcu_Prototype.RP_Fcu_Adas_Data.RadarObj1_RelVx_Status
      RadarObj1_RelVy_1414: upstream-reference=TopLevelComposition.Fcu_Prototype.RP_Fcu_Adas_Data.RadarObj1_RelVy, ecu-extract-reference=TopLevelCompositionPrototype.Fcu_Prototype.RP_Fcu_Adas_Data.RadarObj1_RelVy
      RadarObj1_RelVy_Status_1415: upstream-reference=TopLevelComposition.Fcu_Prototype.RP_Fcu_Adas_Data.RadarObj1_RelVy_Status, ecu-extract-reference=TopLevelCompositionPrototype.Fcu_Prototype.RP_Fcu_Adas_Data.RadarObj1_RelVy_Status
      RadarObj1_Width_1416: upstream-reference=TopLevelComposition.Fcu_Prototype.RP_Fcu_Adas_Data.RadarObj1_Width, ecu-extract-reference=TopLevelCompositionPrototype.Fcu_Prototype.RP_Fcu_Adas_Data.RadarObj1_Width
      RadarObj1_Width_Status_1417: upstream-reference=TopLevelComposition.Fcu_Prototype.RP_Fcu_Adas_Data.RadarObj1_Width_Status, ecu-extract-reference=TopLevelCompositionPrototype.Fcu_Prototype.RP_Fcu_Adas_Data.RadarObj1_Width_Status
      RadarObj2_Dx_1418: upstream-reference=TopLevelComposition.Fcu_Prototype.RP_Fcu_Adas_Data.RadarObj2_Dx, ecu-extract-reference=TopLevelCompositionPrototype.Fcu_Prototype.RP_Fcu_Adas_Data.RadarObj2_Dx
      RadarObj2_Dx_Status_1419: upstream-reference=TopLevelComposition.Fcu_Prototype.RP_Fcu_Adas_Data.RadarObj2_Dx_Status, ecu-extract-reference=TopLevelCompositionPrototype.Fcu_Prototype.RP_Fcu_Adas_Data.RadarObj2_Dx_Status
      RadarObj2_Dy_1420: upstream-reference=TopLevelComposition.Fcu_Prototype.RP_Fcu_Adas_Data.RadarObj2_Dy, ecu-extract-reference=TopLevelCompositionPrototype.Fcu_Prototype.RP_Fcu_Adas_Data.RadarObj2_Dy
      RadarObj2_Dy_Status_1421: upstream-reference=TopLevelComposition.Fcu_Prototype.RP_Fcu_Adas_Data.RadarObj2_Dy_Status, ecu-extract-reference=TopLevelCompositionPrototype.Fcu_Prototype.RP_Fcu_Adas_Data.RadarObj2_Dy_Status
      RadarObj2_ExistProb_1422: upstream-reference=TopLevelComposition.Fcu_Prototype.RP_Fcu_Adas_Data.RadarObj2_ExistProb, ecu-extract-reference=TopLevelCompositionPrototype.Fcu_Prototype.RP_Fcu_Adas_Data.RadarObj2_ExistProb
      RadarObj2_ExistProb_Status_1423: upstream-reference=TopLevelComposition.Fcu_Prototype.RP_Fcu_Adas_Data.RadarObj2_ExistProb_Status, ecu-extract-reference=TopLevelCompositionPrototype.Fcu_Prototype.RP_Fcu_Adas_Data.RadarObj2_ExistProb_Status
      RadarObj2_Length_1424: upstream-reference=TopLevelComposition.Fcu_Prototype.RP_Fcu_Adas_Data.RadarObj2_Length, ecu-extract-reference=TopLevelCompositionPrototype.Fcu_Prototype.RP_Fcu_Adas_Data.RadarObj2_Length
      RadarObj2_Length_Status_1425: upstream-reference=TopLevelComposition.Fcu_Prototype.RP_Fcu_Adas_Data.RadarObj2_Length_Status, ecu-extract-reference=TopLevelCompositionPrototype.Fcu_Prototype.RP_Fcu_Adas_Data.RadarObj2_Length_Status
      RadarObj2_Location_1426: upstream-reference=TopLevelComposition.Fcu_Prototype.RP_Fcu_Adas_Data.RadarObj2_Location, ecu-extract-reference=TopLevelCompositionPrototype.Fcu_Prototype.RP_Fcu_Adas_Data.RadarObj2_Location
      RadarObj2_Location_Status_1427: upstream-reference=TopLevelComposition.Fcu_Prototype.RP_Fcu_Adas_Data.RadarObj2_Location_Status, ecu-extract-reference=TopLevelCompositionPrototype.Fcu_Prototype.RP_Fcu_Adas_Data.RadarObj2_Location_Status
      RadarObj2_Measured_1428: upstream-reference=TopLevelComposition.Fcu_Prototype.RP_Fcu_Adas_Data.RadarObj2_Measured, ecu-extract-reference=TopLevelCompositionPrototype.Fcu_Prototype.RP_Fcu_Adas_Data.RadarObj2_Measured
      RadarObj2_Measured_Status_1429: upstream-reference=TopLevelComposition.Fcu_Prototype.RP_Fcu_Adas_Data.RadarObj2_Measured_Status, ecu-extract-reference=TopLevelCompositionPrototype.Fcu_Prototype.RP_Fcu_Adas_Data.RadarObj2_Measured_Status
      RadarObj2_RelAx_1430: upstream-reference=TopLevelComposition.Fcu_Prototype.RP_Fcu_Adas_Data.RadarObj2_RelAx, ecu-extract-reference=TopLevelCompositionPrototype.Fcu_Prototype.RP_Fcu_Adas_Data.RadarObj2_RelAx
      RadarObj2_RelAx_Status_1431: upstream-reference=TopLevelComposition.Fcu_Prototype.RP_Fcu_Adas_Data.RadarObj2_RelAx_Status, ecu-extract-reference=TopLevelCompositionPrototype.Fcu_Prototype.RP_Fcu_Adas_Data.RadarObj2_RelAx_Status
      RadarObj2_RelVx_1432: upstream-reference=TopLevelComposition.Fcu_Prototype.RP_Fcu_Adas_Data.RadarObj2_RelVx, ecu-extract-reference=TopLevelCompositionPrototype.Fcu_Prototype.RP_Fcu_Adas_Data.RadarObj2_RelVx
      RadarObj2_RelVx_Status_1433: upstream-reference=TopLevelComposition.Fcu_Prototype.RP_Fcu_Adas_Data.RadarObj2_RelVx_Status, ecu-extract-reference=TopLevelCompositionPrototype.Fcu_Prototype.RP_Fcu_Adas_Data.RadarObj2_RelVx_Status
      RadarObj2_RelVy_1434: upstream-reference=TopLevelComposition.Fcu_Prototype.RP_Fcu_Adas_Data.RadarObj2_RelVy, ecu-extract-reference=TopLevelCompositionPrototype.Fcu_Prototype.RP_Fcu_Adas_Data.RadarObj2_RelVy
      RadarObj2_RelVy_Status_1435: upstream-reference=TopLevelComposition.Fcu_Prototype.RP_Fcu_Adas_Data.RadarObj2_RelVy_Status, ecu-extract-reference=TopLevelCompositionPrototype.Fcu_Prototype.RP_Fcu_Adas_Data.RadarObj2_RelVy_Status
      RadarObj2_Width_1436: upstream-reference=TopLevelComposition.Fcu_Prototype.RP_Fcu_Adas_Data.RadarObj2_Width, ecu-extract-reference=TopLevelCompositionPrototype.Fcu_Prototype.RP_Fcu_Adas_Data.RadarObj2_Width
      RadarObj2_Width_Status_1437: upstream-reference=TopLevelComposition.Fcu_Prototype.RP_Fcu_Adas_Data.RadarObj2_Width_Status, ecu-extract-reference=TopLevelCompositionPrototype.Fcu_Prototype.RP_Fcu_Adas_Data.RadarObj2_Width_Status
      RadarObj3_Dx_1438: upstream-reference=TopLevelComposition.Fcu_Prototype.RP_Fcu_Adas_Data.RadarObj3_Dx, ecu-extract-reference=TopLevelCompositionPrototype.Fcu_Prototype.RP_Fcu_Adas_Data.RadarObj3_Dx
      RadarObj3_Dx_Status_1439: upstream-reference=TopLevelComposition.Fcu_Prototype.RP_Fcu_Adas_Data.RadarObj3_Dx_Status, ecu-extract-reference=TopLevelCompositionPrototype.Fcu_Prototype.RP_Fcu_Adas_Data.RadarObj3_Dx_Status
      RadarObj3_Dy_1440: upstream-reference=TopLevelComposition.Fcu_Prototype.RP_Fcu_Adas_Data.RadarObj3_Dy, ecu-extract-reference=TopLevelCompositionPrototype.Fcu_Prototype.RP_Fcu_Adas_Data.RadarObj3_Dy
      RadarObj3_Dy_Status_1441: upstream-reference=TopLevelComposition.Fcu_Prototype.RP_Fcu_Adas_Data.RadarObj3_Dy_Status, ecu-extract-reference=TopLevelCompositionPrototype.Fcu_Prototype.RP_Fcu_Adas_Data.RadarObj3_Dy_Status
      RadarObj3_ExistProb_1442: upstream-reference=TopLevelComposition.Fcu_Prototype.RP_Fcu_Adas_Data.RadarObj3_ExistProb, ecu-extract-reference=TopLevelCompositionPrototype.Fcu_Prototype.RP_Fcu_Adas_Data.RadarObj3_ExistProb
      RadarObj3_ExistProb_Status_1443: upstream-reference=TopLevelComposition.Fcu_Prototype.RP_Fcu_Adas_Data.RadarObj3_ExistProb_Status, ecu-extract-reference=TopLevelCompositionPrototype.Fcu_Prototype.RP_Fcu_Adas_Data.RadarObj3_ExistProb_Status
      RadarObj3_Length_1444: upstream-reference=TopLevelComposition.Fcu_Prototype.RP_Fcu_Adas_Data.RadarObj3_Length, ecu-extract-reference=TopLevelCompositionPrototype.Fcu_Prototype.RP_Fcu_Adas_Data.RadarObj3_Length
      RadarObj3_Length_Status_1445: upstream-reference=TopLevelComposition.Fcu_Prototype.RP_Fcu_Adas_Data.RadarObj3_Length_Status, ecu-extract-reference=TopLevelCompositionPrototype.Fcu_Prototype.RP_Fcu_Adas_Data.RadarObj3_Length_Status
      RadarObj3_Location_1446: upstream-reference=TopLevelComposition.Fcu_Prototype.RP_Fcu_Adas_Data.RadarObj3_Location, ecu-extract-reference=TopLevelCompositionPrototype.Fcu_Prototype.RP_Fcu_Adas_Data.RadarObj3_Location
      RadarObj3_Location_Status_1447: upstream-reference=TopLevelComposition.Fcu_Prototype.RP_Fcu_Adas_Data.RadarObj3_Location_Status, ecu-extract-reference=TopLevelCompositionPrototype.Fcu_Prototype.RP_Fcu_Adas_Data.RadarObj3_Location_Status
      RadarObj3_Measured_1448: upstream-reference=TopLevelComposition.Fcu_Prototype.RP_Fcu_Adas_Data.RadarObj3_Measured, ecu-extract-reference=TopLevelCompositionPrototype.Fcu_Prototype.RP_Fcu_Adas_Data.RadarObj3_Measured
      RadarObj3_Measured_Status_1449: upstream-reference=TopLevelComposition.Fcu_Prototype.RP_Fcu_Adas_Data.RadarObj3_Measured_Status, ecu-extract-reference=TopLevelCompositionPrototype.Fcu_Prototype.RP_Fcu_Adas_Data.RadarObj3_Measured_Status
      RadarObj3_RelAx_1450: upstream-reference=TopLevelComposition.Fcu_Prototype.RP_Fcu_Adas_Data.RadarObj3_RelAx, ecu-extract-reference=TopLevelCompositionPrototype.Fcu_Prototype.RP_Fcu_Adas_Data.RadarObj3_RelAx
      RadarObj3_RelAx_Status_1451: upstream-reference=TopLevelComposition.Fcu_Prototype.RP_Fcu_Adas_Data.RadarObj3_RelAx_Status, ecu-extract-reference=TopLevelCompositionPrototype.Fcu_Prototype.RP_Fcu_Adas_Data.RadarObj3_RelAx_Status
      RadarObj3_RelVx_1452: upstream-reference=TopLevelComposition.Fcu_Prototype.RP_Fcu_Adas_Data.RadarObj3_RelVx, ecu-extract-reference=TopLevelCompositionPrototype.Fcu_Prototype.RP_Fcu_Adas_Data.RadarObj3_RelVx
      RadarObj3_RelVx_Status_1453: upstream-reference=TopLevelComposition.Fcu_Prototype.RP_Fcu_Adas_Data.RadarObj3_RelVx_Status, ecu-extract-reference=TopLevelCompositionPrototype.Fcu_Prototype.RP_Fcu_Adas_Data.RadarObj3_RelVx_Status
      RadarObj3_RelVy_1454: upstream-reference=TopLevelComposition.Fcu_Prototype.RP_Fcu_Adas_Data.RadarObj3_RelVy, ecu-extract-reference=TopLevelCompositionPrototype.Fcu_Prototype.RP_Fcu_Adas_Data.RadarObj3_RelVy
      RadarObj3_RelVy_Status_1455: upstream-reference=TopLevelComposition.Fcu_Prototype.RP_Fcu_Adas_Data.RadarObj3_RelVy_Status, ecu-extract-reference=TopLevelCompositionPrototype.Fcu_Prototype.RP_Fcu_Adas_Data.RadarObj3_RelVy_Status
      RadarObj3_Width_1456: upstream-reference=TopLevelComposition.Fcu_Prototype.RP_Fcu_Adas_Data.RadarObj3_Width, ecu-extract-reference=TopLevelCompositionPrototype.Fcu_Prototype.RP_Fcu_Adas_Data.RadarObj3_Width
      RadarObj3_Width_Status_1457: upstream-reference=TopLevelComposition.Fcu_Prototype.RP_Fcu_Adas_Data.RadarObj3_Width_Status, ecu-extract-reference=TopLevelCompositionPrototype.Fcu_Prototype.RP_Fcu_Adas_Data.RadarObj3_Width_Status
      RadarObj4_Dx_1458: upstream-reference=TopLevelComposition.Fcu_Prototype.RP_Fcu_Adas_Data.RadarObj4_Dx, ecu-extract-reference=TopLevelCompositionPrototype.Fcu_Prototype.RP_Fcu_Adas_Data.RadarObj4_Dx
      RadarObj4_Dx_Status_1459: upstream-reference=TopLevelComposition.Fcu_Prototype.RP_Fcu_Adas_Data.RadarObj4_Dx_Status, ecu-extract-reference=TopLevelCompositionPrototype.Fcu_Prototype.RP_Fcu_Adas_Data.RadarObj4_Dx_Status
      RadarObj4_Dy_1460: upstream-reference=TopLevelComposition.Fcu_Prototype.RP_Fcu_Adas_Data.RadarObj4_Dy, ecu-extract-reference=TopLevelCompositionPrototype.Fcu_Prototype.RP_Fcu_Adas_Data.RadarObj4_Dy
      RadarObj4_Dy_Status_1461: upstream-reference=TopLevelComposition.Fcu_Prototype.RP_Fcu_Adas_Data.RadarObj4_Dy_Status, ecu-extract-reference=TopLevelCompositionPrototype.Fcu_Prototype.RP_Fcu_Adas_Data.RadarObj4_Dy_Status
      RadarObj4_ExistProb_1462: upstream-reference=TopLevelComposition.Fcu_Prototype.RP_Fcu_Adas_Data.RadarObj4_ExistProb, ecu-extract-reference=TopLevelCompositionPrototype.Fcu_Prototype.RP_Fcu_Adas_Data.RadarObj4_ExistProb
      RadarObj4_ExistProb_Status_1463: upstream-reference=TopLevelComposition.Fcu_Prototype.RP_Fcu_Adas_Data.RadarObj4_ExistProb_Status, ecu-extract-reference=TopLevelCompositionPrototype.Fcu_Prototype.RP_Fcu_Adas_Data.RadarObj4_ExistProb_Status
      RadarObj4_Length_1464: upstream-reference=TopLevelComposition.Fcu_Prototype.RP_Fcu_Adas_Data.RadarObj4_Length, ecu-extract-reference=TopLevelCompositionPrototype.Fcu_Prototype.RP_Fcu_Adas_Data.RadarObj4_Length
      RadarObj4_Length_Status_1465: upstream-reference=TopLevelComposition.Fcu_Prototype.RP_Fcu_Adas_Data.RadarObj4_Length_Status, ecu-extract-reference=TopLevelCompositionPrototype.Fcu_Prototype.RP_Fcu_Adas_Data.RadarObj4_Length_Status
      RadarObj4_Location_1466: upstream-reference=TopLevelComposition.Fcu_Prototype.RP_Fcu_Adas_Data.RadarObj4_Location, ecu-extract-reference=TopLevelCompositionPrototype.Fcu_Prototype.RP_Fcu_Adas_Data.RadarObj4_Location
      RadarObj4_Location_Status_1467: upstream-reference=TopLevelComposition.Fcu_Prototype.RP_Fcu_Adas_Data.RadarObj4_Location_Status, ecu-extract-reference=TopLevelCompositionPrototype.Fcu_Prototype.RP_Fcu_Adas_Data.RadarObj4_Location_Status
      RadarObj4_Measured_1468: upstream-reference=TopLevelComposition.Fcu_Prototype.RP_Fcu_Adas_Data.RadarObj4_Measured, ecu-extract-reference=TopLevelCompositionPrototype.Fcu_Prototype.RP_Fcu_Adas_Data.RadarObj4_Measured
      RadarObj4_Measured_Status_1469: upstream-reference=TopLevelComposition.Fcu_Prototype.RP_Fcu_Adas_Data.RadarObj4_Measured_Status, ecu-extract-reference=TopLevelCompositionPrototype.Fcu_Prototype.RP_Fcu_Adas_Data.RadarObj4_Measured_Status
      RadarObj4_RelAx_1470: upstream-reference=TopLevelComposition.Fcu_Prototype.RP_Fcu_Adas_Data.RadarObj4_RelAx, ecu-extract-reference=TopLevelCompositionPrototype.Fcu_Prototype.RP_Fcu_Adas_Data.RadarObj4_RelAx
      RadarObj4_RelAx_Status_1471: upstream-reference=TopLevelComposition.Fcu_Prototype.RP_Fcu_Adas_Data.RadarObj4_RelAx_Status, ecu-extract-reference=TopLevelCompositionPrototype.Fcu_Prototype.RP_Fcu_Adas_Data.RadarObj4_RelAx_Status
      RadarObj4_RelVx_1472: upstream-reference=TopLevelComposition.Fcu_Prototype.RP_Fcu_Adas_Data.RadarObj4_RelVx, ecu-extract-reference=TopLevelCompositionPrototype.Fcu_Prototype.RP_Fcu_Adas_Data.RadarObj4_RelVx
      RadarObj4_RelVx_Status_1473: upstream-reference=TopLevelComposition.Fcu_Prototype.RP_Fcu_Adas_Data.RadarObj4_RelVx_Status, ecu-extract-reference=TopLevelCompositionPrototype.Fcu_Prototype.RP_Fcu_Adas_Data.RadarObj4_RelVx_Status
      RadarObj4_RelVy_1474: upstream-reference=TopLevelComposition.Fcu_Prototype.RP_Fcu_Adas_Data.RadarObj4_RelVy, ecu-extract-reference=TopLevelCompositionPrototype.Fcu_Prototype.RP_Fcu_Adas_Data.RadarObj4_RelVy
      RadarObj4_RelVy_Status_1475: upstream-reference=TopLevelComposition.Fcu_Prototype.RP_Fcu_Adas_Data.RadarObj4_RelVy_Status, ecu-extract-reference=TopLevelCompositionPrototype.Fcu_Prototype.RP_Fcu_Adas_Data.RadarObj4_RelVy_Status
      RadarObj4_Width_1476: upstream-reference=TopLevelComposition.Fcu_Prototype.RP_Fcu_Adas_Data.RadarObj4_Width, ecu-extract-reference=TopLevelCompositionPrototype.Fcu_Prototype.RP_Fcu_Adas_Data.RadarObj4_Width
      RadarObj4_Width_Status_1477: upstream-reference=TopLevelComposition.Fcu_Prototype.RP_Fcu_Adas_Data.RadarObj4_Width_Status, ecu-extract-reference=TopLevelCompositionPrototype.Fcu_Prototype.RP_Fcu_Adas_Data.RadarObj4_Width_Status
      RP_Fcu_Body_Data_1478: upstream-reference=TopLevelComposition.Fcu_Prototype.RP_Fcu_Body_Data, ecu-extract-reference=TopLevelCompositionPrototype.Fcu_Prototype.RP_Fcu_Body_Data
      ACC_HostLaneLeftStatus_1479: upstream-reference=TopLevelComposition.Fcu_Prototype.RP_Fcu_Body_Data.ACC_HostLaneLeftStatus, ecu-extract-reference=TopLevelCompositionPrototype.Fcu_Prototype.RP_Fcu_Body_Data.ACC_HostLaneLeftStatus
      ACC_HostLaneRightStatus_1480: upstream-reference=TopLevelComposition.Fcu_Prototype.RP_Fcu_Body_Data.ACC_HostLaneRightStatus, ecu-extract-reference=TopLevelCompositionPrototype.Fcu_Prototype.RP_Fcu_Body_Data.ACC_HostLaneRightStatus
      AccIaccHWAMode_1481: upstream-reference=TopLevelComposition.Fcu_Prototype.RP_Fcu_Body_Data.AccIaccHWAMode, ecu-extract-reference=TopLevelCompositionPrototype.Fcu_Prototype.RP_Fcu_Body_Data.AccIaccHWAMode
      AccIaccHWAMode_Status_1482: upstream-reference=TopLevelComposition.Fcu_Prototype.RP_Fcu_Body_Data.AccIaccHWAMode_Status, ecu-extract-reference=TopLevelCompositionPrototype.Fcu_Prototype.RP_Fcu_Body_Data.AccIaccHWAMode_Status
      BCM_BrakeLampError_1483: upstream-reference=TopLevelComposition.Fcu_Prototype.RP_Fcu_Body_Data.BCM_BrakeLampError, ecu-extract-reference=TopLevelCompositionPrototype.Fcu_Prototype.RP_Fcu_Body_Data.BCM_BrakeLampError
      BCM_BrakeLampError_Status_1484: upstream-reference=TopLevelComposition.Fcu_Prototype.RP_Fcu_Body_Data.BCM_BrakeLampError_Status, ecu-extract-reference=TopLevelCompositionPrototype.Fcu_Prototype.RP_Fcu_Body_Data.BCM_BrakeLampError_Status
      BCM_TurnLightSwitchSts_1485: upstream-reference=TopLevelComposition.Fcu_Prototype.RP_Fcu_Body_Data.BCM_TurnLightSwitchSts, ecu-extract-reference=TopLevelCompositionPrototype.Fcu_Prototype.RP_Fcu_Body_Data.BCM_TurnLightSwitchSts
      BCM_TurnLightSwitchSts_Status_1486: upstream-reference=TopLevelComposition.Fcu_Prototype.RP_Fcu_Body_Data.BCM_TurnLightSwitchSts_Status, ecu-extract-reference=TopLevelCompositionPrototype.Fcu_Prototype.RP_Fcu_Body_Data.BCM_TurnLightSwitchSts_Status
      BcmAutHeadLiSts_1487: upstream-reference=TopLevelComposition.Fcu_Prototype.RP_Fcu_Body_Data.BcmAutHeadLiSts, ecu-extract-reference=TopLevelCompositionPrototype.Fcu_Prototype.RP_Fcu_Body_Data.BcmAutHeadLiSts
      BcmAutHeadLiSts_Status_1488: upstream-reference=TopLevelComposition.Fcu_Prototype.RP_Fcu_Body_Data.BcmAutHeadLiSts_Status, ecu-extract-reference=TopLevelCompositionPrototype.Fcu_Prototype.RP_Fcu_Body_Data.BcmAutHeadLiSts_Status
      BcmDrvrDoorSts_1489: upstream-reference=TopLevelComposition.Fcu_Prototype.RP_Fcu_Body_Data.BcmDrvrDoorSts, ecu-extract-reference=TopLevelCompositionPrototype.Fcu_Prototype.RP_Fcu_Body_Data.BcmDrvrDoorSts
      BcmDrvrDoorSts_Status_1490: upstream-reference=TopLevelComposition.Fcu_Prototype.RP_Fcu_Body_Data.BcmDrvrDoorSts_Status, ecu-extract-reference=TopLevelCompositionPrototype.Fcu_Prototype.RP_Fcu_Body_Data.BcmDrvrDoorSts_Status
      BcmEmgyLiSts_1491: upstream-reference=TopLevelComposition.Fcu_Prototype.RP_Fcu_Body_Data.BcmEmgyLiSts, ecu-extract-reference=TopLevelCompositionPrototype.Fcu_Prototype.RP_Fcu_Body_Data.BcmEmgyLiSts
      BcmEmgyLiSts_Status_1492: upstream-reference=TopLevelComposition.Fcu_Prototype.RP_Fcu_Body_Data.BcmEmgyLiSts_Status, ecu-extract-reference=TopLevelCompositionPrototype.Fcu_Prototype.RP_Fcu_Body_Data.BcmEmgyLiSts_Status
      BcmFrntFogLmpSts_1493: upstream-reference=TopLevelComposition.Fcu_Prototype.RP_Fcu_Body_Data.BcmFrntFogLmpSts, ecu-extract-reference=TopLevelCompositionPrototype.Fcu_Prototype.RP_Fcu_Body_Data.BcmFrntFogLmpSts
      BcmFrntFogLmpSts_Status_1494: upstream-reference=TopLevelComposition.Fcu_Prototype.RP_Fcu_Body_Data.BcmFrntFogLmpSts_Status, ecu-extract-reference=TopLevelCompositionPrototype.Fcu_Prototype.RP_Fcu_Body_Data.BcmFrntFogLmpSts_Status
      BcmFrntWiperSts_1495: upstream-reference=TopLevelComposition.Fcu_Prototype.RP_Fcu_Body_Data.BcmFrntWiperSts, ecu-extract-reference=TopLevelCompositionPrototype.Fcu_Prototype.RP_Fcu_Body_Data.BcmFrntWiperSts
      BcmFrntWiperSts_Status_1496: upstream-reference=TopLevelComposition.Fcu_Prototype.RP_Fcu_Body_Data.BcmFrntWiperSts_Status, ecu-extract-reference=TopLevelCompositionPrototype.Fcu_Prototype.RP_Fcu_Body_Data.BcmFrntWiperSts_Status
      BcmHiBeamSts_1497: upstream-reference=TopLevelComposition.Fcu_Prototype.RP_Fcu_Body_Data.BcmHiBeamSts, ecu-extract-reference=TopLevelCompositionPrototype.Fcu_Prototype.RP_Fcu_Body_Data.BcmHiBeamSts
      BcmHiBeamSts_Status_1498: upstream-reference=TopLevelComposition.Fcu_Prototype.RP_Fcu_Body_Data.BcmHiBeamSts_Status, ecu-extract-reference=TopLevelCompositionPrototype.Fcu_Prototype.RP_Fcu_Body_Data.BcmHiBeamSts_Status
      BcmLeReDoorSts_1499: upstream-reference=TopLevelComposition.Fcu_Prototype.RP_Fcu_Body_Data.BcmLeReDoorSts, ecu-extract-reference=TopLevelCompositionPrototype.Fcu_Prototype.RP_Fcu_Body_Data.BcmLeReDoorSts
      BcmLeReDoorSts_Status_1500: upstream-reference=TopLevelComposition.Fcu_Prototype.RP_Fcu_Body_Data.BcmLeReDoorSts_Status, ecu-extract-reference=TopLevelCompositionPrototype.Fcu_Prototype.RP_Fcu_Body_Data.BcmLeReDoorSts_Status
      BcmLoBeamSts_1501: upstream-reference=TopLevelComposition.Fcu_Prototype.RP_Fcu_Body_Data.BcmLoBeamSts, ecu-extract-reference=TopLevelCompositionPrototype.Fcu_Prototype.RP_Fcu_Body_Data.BcmLoBeamSts
      BcmLoBeamSts_Status_1502: upstream-reference=TopLevelComposition.Fcu_Prototype.RP_Fcu_Body_Data.BcmLoBeamSts_Status, ecu-extract-reference=TopLevelCompositionPrototype.Fcu_Prototype.RP_Fcu_Body_Data.BcmLoBeamSts_Status
      BcmPassDoorSts_1503: upstream-reference=TopLevelComposition.Fcu_Prototype.RP_Fcu_Body_Data.BcmPassDoorSts, ecu-extract-reference=TopLevelCompositionPrototype.Fcu_Prototype.RP_Fcu_Body_Data.BcmPassDoorSts
      BcmPassDoorSts_Status_1504: upstream-reference=TopLevelComposition.Fcu_Prototype.RP_Fcu_Body_Data.BcmPassDoorSts_Status, ecu-extract-reference=TopLevelCompositionPrototype.Fcu_Prototype.RP_Fcu_Body_Data.BcmPassDoorSts_Status
      BcmReFoglmpSts_1505: upstream-reference=TopLevelComposition.Fcu_Prototype.RP_Fcu_Body_Data.BcmReFoglmpSts, ecu-extract-reference=TopLevelCompositionPrototype.Fcu_Prototype.RP_Fcu_Body_Data.BcmReFoglmpSts
      BcmReFoglmpSts_Status_1506: upstream-reference=TopLevelComposition.Fcu_Prototype.RP_Fcu_Body_Data.BcmReFoglmpSts_Status, ecu-extract-reference=TopLevelCompositionPrototype.Fcu_Prototype.RP_Fcu_Body_Data.BcmReFoglmpSts_Status
      BcmRiReDoorSts_1507: upstream-reference=TopLevelComposition.Fcu_Prototype.RP_Fcu_Body_Data.BcmRiReDoorSts, ecu-extract-reference=TopLevelCompositionPrototype.Fcu_Prototype.RP_Fcu_Body_Data.BcmRiReDoorSts
      BcmRiReDoorSts_Status_1508: upstream-reference=TopLevelComposition.Fcu_Prototype.RP_Fcu_Body_Data.BcmRiReDoorSts_Status, ecu-extract-reference=TopLevelCompositionPrototype.Fcu_Prototype.RP_Fcu_Body_Data.BcmRiReDoorSts_Status
      BcmTurnIndcrLe_1509: upstream-reference=TopLevelComposition.Fcu_Prototype.RP_Fcu_Body_Data.BcmTurnIndcrLe, ecu-extract-reference=TopLevelCompositionPrototype.Fcu_Prototype.RP_Fcu_Body_Data.BcmTurnIndcrLe
      BcmTurnIndcrLe_Status_1510: upstream-reference=TopLevelComposition.Fcu_Prototype.RP_Fcu_Body_Data.BcmTurnIndcrLe_Status, ecu-extract-reference=TopLevelCompositionPrototype.Fcu_Prototype.RP_Fcu_Body_Data.BcmTurnIndcrLe_Status
      BcmTurnIndcrRi_1511: upstream-reference=TopLevelComposition.Fcu_Prototype.RP_Fcu_Body_Data.BcmTurnIndcrRi, ecu-extract-reference=TopLevelCompositionPrototype.Fcu_Prototype.RP_Fcu_Body_Data.BcmTurnIndcrRi
      BcmTurnIndcrRi_Status_1512: upstream-reference=TopLevelComposition.Fcu_Prototype.RP_Fcu_Body_Data.BcmTurnIndcrRi_Status, ecu-extract-reference=TopLevelCompositionPrototype.Fcu_Prototype.RP_Fcu_Body_Data.BcmTurnIndcrRi_Status
      IP_DISFail_1513: upstream-reference=TopLevelComposition.Fcu_Prototype.RP_Fcu_Body_Data.IP_DISFail, ecu-extract-reference=TopLevelCompositionPrototype.Fcu_Prototype.RP_Fcu_Body_Data.IP_DISFail
      IP_DISFail_Status_1514: upstream-reference=TopLevelComposition.Fcu_Prototype.RP_Fcu_Body_Data.IP_DISFail_Status, ecu-extract-reference=TopLevelCompositionPrototype.Fcu_Prototype.RP_Fcu_Body_Data.IP_DISFail_Status
      IP_QDashACCFail_1515: upstream-reference=TopLevelComposition.Fcu_Prototype.RP_Fcu_Body_Data.IP_QDashACCFail, ecu-extract-reference=TopLevelCompositionPrototype.Fcu_Prototype.RP_Fcu_Body_Data.IP_QDashACCFail
      IP_QDashACCFail_Status_1516: upstream-reference=TopLevelComposition.Fcu_Prototype.RP_Fcu_Body_Data.IP_QDashACCFail_Status, ecu-extract-reference=TopLevelCompositionPrototype.Fcu_Prototype.RP_Fcu_Body_Data.IP_QDashACCFail_Status
      SrsDrvrBucSwtSts_1517: upstream-reference=TopLevelComposition.Fcu_Prototype.RP_Fcu_Body_Data.SrsDrvrBucSwtSts, ecu-extract-reference=TopLevelCompositionPrototype.Fcu_Prototype.RP_Fcu_Body_Data.SrsDrvrBucSwtSts
      SrsDrvrBucSwtSts_Status_1518: upstream-reference=TopLevelComposition.Fcu_Prototype.RP_Fcu_Body_Data.SrsDrvrBucSwtSts_Status, ecu-extract-reference=TopLevelCompositionPrototype.Fcu_Prototype.RP_Fcu_Body_Data.SrsDrvrBucSwtSts_Status
      SrsPassBucSwtSts_1519: upstream-reference=TopLevelComposition.Fcu_Prototype.RP_Fcu_Body_Data.SrsPassBucSwtSts, ecu-extract-reference=TopLevelCompositionPrototype.Fcu_Prototype.RP_Fcu_Body_Data.SrsPassBucSwtSts
      SrsPassBucSwtSts_Status_1520: upstream-reference=TopLevelComposition.Fcu_Prototype.RP_Fcu_Body_Data.SrsPassBucSwtSts_Status, ecu-extract-reference=TopLevelCompositionPrototype.Fcu_Prototype.RP_Fcu_Body_Data.SrsPassBucSwtSts_Status
      TmsFrntBlowMod_1521: upstream-reference=TopLevelComposition.Fcu_Prototype.RP_Fcu_Body_Data.TmsFrntBlowMod, ecu-extract-reference=TopLevelCompositionPrototype.Fcu_Prototype.RP_Fcu_Body_Data.TmsFrntBlowMod
      TmsFrntBlowMod_Status_1522: upstream-reference=TopLevelComposition.Fcu_Prototype.RP_Fcu_Body_Data.TmsFrntBlowMod_Status, ecu-extract-reference=TopLevelCompositionPrototype.Fcu_Prototype.RP_Fcu_Body_Data.TmsFrntBlowMod_Status
      RP_Fcu_Chassis_Data_1523: upstream-reference=TopLevelComposition.Fcu_Prototype.RP_Fcu_Chassis_Data, ecu-extract-reference=TopLevelCompositionPrototype.Fcu_Prototype.RP_Fcu_Chassis_Data
      AdsUDLCStatus_1524: upstream-reference=TopLevelComposition.Fcu_Prototype.RP_Fcu_Chassis_Data.AdsUDLCStatus, ecu-extract-reference=TopLevelCompositionPrototype.Fcu_Prototype.RP_Fcu_Chassis_Data.AdsUDLCStatus
      AdsUDLCStatus_Status_1525: upstream-reference=TopLevelComposition.Fcu_Prototype.RP_Fcu_Chassis_Data.AdsUDLCStatus_Status, ecu-extract-reference=TopLevelCompositionPrototype.Fcu_Prototype.RP_Fcu_Chassis_Data.AdsUDLCStatus_Status
      BrakePressureSimulator_1526: upstream-reference=TopLevelComposition.Fcu_Prototype.RP_Fcu_Chassis_Data.BrakePressureSimulator, ecu-extract-reference=TopLevelCompositionPrototype.Fcu_Prototype.RP_Fcu_Chassis_Data.BrakePressureSimulator
      BrakePressureSimulator_Status_1527: upstream-reference=TopLevelComposition.Fcu_Prototype.RP_Fcu_Chassis_Data.BrakePressureSimulator_Status, ecu-extract-reference=TopLevelCompositionPrototype.Fcu_Prototype.RP_Fcu_Chassis_Data.BrakePressureSimulator_Status
      EPS_APA_EpasFAILED_1528: upstream-reference=TopLevelComposition.Fcu_Prototype.RP_Fcu_Chassis_Data.EPS_APA_EpasFAILED, ecu-extract-reference=TopLevelCompositionPrototype.Fcu_Prototype.RP_Fcu_Chassis_Data.EPS_APA_EpasFAILED
      EPS_APA_EpasFAILED_Status_1529: upstream-reference=TopLevelComposition.Fcu_Prototype.RP_Fcu_Chassis_Data.EPS_APA_EpasFAILED_Status, ecu-extract-reference=TopLevelCompositionPrototype.Fcu_Prototype.RP_Fcu_Chassis_Data.EPS_APA_EpasFAILED_Status
      EPS_ActualMotorTorq_1530: upstream-reference=TopLevelComposition.Fcu_Prototype.RP_Fcu_Chassis_Data.EPS_ActualMotorTorq, ecu-extract-reference=TopLevelCompositionPrototype.Fcu_Prototype.RP_Fcu_Chassis_Data.EPS_ActualMotorTorq
      EPS_ActualMotorTorq_Status_1531: upstream-reference=TopLevelComposition.Fcu_Prototype.RP_Fcu_Chassis_Data.EPS_ActualMotorTorq_Status, ecu-extract-reference=TopLevelCompositionPrototype.Fcu_Prototype.RP_Fcu_Chassis_Data.EPS_ActualMotorTorq_Status
      EPS_ActualTorsionBarTorq_1532: upstream-reference=TopLevelComposition.Fcu_Prototype.RP_Fcu_Chassis_Data.EPS_ActualTorsionBarTorq, ecu-extract-reference=TopLevelCompositionPrototype.Fcu_Prototype.RP_Fcu_Chassis_Data.EPS_ActualTorsionBarTorq
      EPS_ActualTorsionBarTorq_Status_1533: upstream-reference=TopLevelComposition.Fcu_Prototype.RP_Fcu_Chassis_Data.EPS_ActualTorsionBarTorq_Status, ecu-extract-reference=TopLevelCompositionPrototype.Fcu_Prototype.RP_Fcu_Chassis_Data.EPS_ActualTorsionBarTorq_Status
      EPS_MeasuredTorsionBarTorqValid_1534: upstream-reference=TopLevelComposition.Fcu_Prototype.RP_Fcu_Chassis_Data.EPS_MeasuredTorsionBarTorqValid, ecu-extract-reference=TopLevelCompositionPrototype.Fcu_Prototype.RP_Fcu_Chassis_Data.EPS_MeasuredTorsionBarTorqValid
      EPS_Pinionang_Valid_1535: upstream-reference=TopLevelComposition.Fcu_Prototype.RP_Fcu_Chassis_Data.EPS_Pinionang_Valid, ecu-extract-reference=TopLevelCompositionPrototype.Fcu_Prototype.RP_Fcu_Chassis_Data.EPS_Pinionang_Valid
      EPS_fault_state_1536: upstream-reference=TopLevelComposition.Fcu_Prototype.RP_Fcu_Chassis_Data.EPS_fault_state, ecu-extract-reference=TopLevelCompositionPrototype.Fcu_Prototype.RP_Fcu_Chassis_Data.EPS_fault_state
      EPS_fault_state_Status_1537: upstream-reference=TopLevelComposition.Fcu_Prototype.RP_Fcu_Chassis_Data.EPS_fault_state_Status, ecu-extract-reference=TopLevelCompositionPrototype.Fcu_Prototype.RP_Fcu_Chassis_Data.EPS_fault_state_Status
      ESP_LatAccelValid_1538: upstream-reference=TopLevelComposition.Fcu_Prototype.RP_Fcu_Chassis_Data.ESP_LatAccelValid, ecu-extract-reference=TopLevelCompositionPrototype.Fcu_Prototype.RP_Fcu_Chassis_Data.ESP_LatAccelValid
      ESP_LongAccelValid_1539: upstream-reference=TopLevelComposition.Fcu_Prototype.RP_Fcu_Chassis_Data.ESP_LongAccelValid, ecu-extract-reference=TopLevelCompositionPrototype.Fcu_Prototype.RP_Fcu_Chassis_Data.ESP_LongAccelValid
      ESP_YawRateValid_1540: upstream-reference=TopLevelComposition.Fcu_Prototype.RP_Fcu_Chassis_Data.ESP_YawRateValid, ecu-extract-reference=TopLevelCompositionPrototype.Fcu_Prototype.RP_Fcu_Chassis_Data.ESP_YawRateValid
      EpsConcussAvailabilityStatus_1541: upstream-reference=TopLevelComposition.Fcu_Prototype.RP_Fcu_Chassis_Data.EpsConcussAvailabilityStatus, ecu-extract-reference=TopLevelCompositionPrototype.Fcu_Prototype.RP_Fcu_Chassis_Data.EpsConcussAvailabilityStatus
      EpsConcussAvailabilityStatus_Status_1542: upstream-reference=TopLevelComposition.Fcu_Prototype.RP_Fcu_Chassis_Data.EpsConcussAvailabilityStatus_Status, ecu-extract-reference=TopLevelCompositionPrototype.Fcu_Prototype.RP_Fcu_Chassis_Data.EpsConcussAvailabilityStatus_Status
      EpsFaild_1543: upstream-reference=TopLevelComposition.Fcu_Prototype.RP_Fcu_Chassis_Data.EpsFaild, ecu-extract-reference=TopLevelCompositionPrototype.Fcu_Prototype.RP_Fcu_Chassis_Data.EpsFaild
      EpsFaild_Status_1544: upstream-reference=TopLevelComposition.Fcu_Prototype.RP_Fcu_Chassis_Data.EpsFaild_Status, ecu-extract-reference=TopLevelCompositionPrototype.Fcu_Prototype.RP_Fcu_Chassis_Data.EpsFaild_Status
      EpsIACCabortreason_1545: upstream-reference=TopLevelComposition.Fcu_Prototype.RP_Fcu_Chassis_Data.EpsIACCabortreason, ecu-extract-reference=TopLevelCompositionPrototype.Fcu_Prototype.RP_Fcu_Chassis_Data.EpsIACCabortreason
      EpsIACCabortreason_Status_1546: upstream-reference=TopLevelComposition.Fcu_Prototype.RP_Fcu_Chassis_Data.EpsIACCabortreason_Status, ecu-extract-reference=TopLevelCompositionPrototype.Fcu_Prototype.RP_Fcu_Chassis_Data.EpsIACCabortreason_Status
      EpsLatCtrlActive_1547: upstream-reference=TopLevelComposition.Fcu_Prototype.RP_Fcu_Chassis_Data.EpsLatCtrlActive, ecu-extract-reference=TopLevelCompositionPrototype.Fcu_Prototype.RP_Fcu_Chassis_Data.EpsLatCtrlActive
      EpsLatCtrlActive_Status_1548: upstream-reference=TopLevelComposition.Fcu_Prototype.RP_Fcu_Chassis_Data.EpsLatCtrlActive_Status, ecu-extract-reference=TopLevelCompositionPrototype.Fcu_Prototype.RP_Fcu_Chassis_Data.EpsLatCtrlActive_Status
      EpsLatCtrlAvailabilityStatus_1549: upstream-reference=TopLevelComposition.Fcu_Prototype.RP_Fcu_Chassis_Data.EpsLatCtrlAvailabilityStatus, ecu-extract-reference=TopLevelCompositionPrototype.Fcu_Prototype.RP_Fcu_Chassis_Data.EpsLatCtrlAvailabilityStatus
      EpsLatCtrlAvailabilityStatus_Status_1550: upstream-reference=TopLevelComposition.Fcu_Prototype.RP_Fcu_Chassis_Data.EpsLatCtrlAvailabilityStatus_Status, ecu-extract-reference=TopLevelCompositionPrototype.Fcu_Prototype.RP_Fcu_Chassis_Data.EpsLatCtrlAvailabilityStatus_Status
      EpsMeasuredTorsionBarTorq_Status_1551: upstream-reference=TopLevelComposition.Fcu_Prototype.RP_Fcu_Chassis_Data.EpsMeasuredTorsionBarTorq_Status, ecu-extract-reference=TopLevelCompositionPrototype.Fcu_Prototype.RP_Fcu_Chassis_Data.EpsMeasuredTorsionBarTorq_Status
      EpsMeasuredTorsionBarTorque_1552: upstream-reference=TopLevelComposition.Fcu_Prototype.RP_Fcu_Chassis_Data.EpsMeasuredTorsionBarTorque, ecu-extract-reference=TopLevelCompositionPrototype.Fcu_Prototype.RP_Fcu_Chassis_Data.EpsMeasuredTorsionBarTorque
      EpsMeasuredTorsionBarTorque_Status_1553: upstream-reference=TopLevelComposition.Fcu_Prototype.RP_Fcu_Chassis_Data.EpsMeasuredTorsionBarTorque_Status, ecu-extract-reference=TopLevelCompositionPrototype.Fcu_Prototype.RP_Fcu_Chassis_Data.EpsMeasuredTorsionBarTorque_Status
      EpsPinionang_1554: upstream-reference=TopLevelComposition.Fcu_Prototype.RP_Fcu_Chassis_Data.EpsPinionang, ecu-extract-reference=TopLevelCompositionPrototype.Fcu_Prototype.RP_Fcu_Chassis_Data.EpsPinionang
      EpsPinionang_Status_1555: upstream-reference=TopLevelComposition.Fcu_Prototype.RP_Fcu_Chassis_Data.EpsPinionang_Status, ecu-extract-reference=TopLevelCompositionPrototype.Fcu_Prototype.RP_Fcu_Chassis_Data.EpsPinionang_Status
      EpsSasCalSts_1556: upstream-reference=TopLevelComposition.Fcu_Prototype.RP_Fcu_Chassis_Data.EpsSasCalSts, ecu-extract-reference=TopLevelCompositionPrototype.Fcu_Prototype.RP_Fcu_Chassis_Data.EpsSasCalSts
      EpsSasCalSts_Status_1557: upstream-reference=TopLevelComposition.Fcu_Prototype.RP_Fcu_Chassis_Data.EpsSasCalSts_Status, ecu-extract-reference=TopLevelCompositionPrototype.Fcu_Prototype.RP_Fcu_Chassis_Data.EpsSasCalSts_Status
      EpsSasSteerAg_1558: upstream-reference=TopLevelComposition.Fcu_Prototype.RP_Fcu_Chassis_Data.EpsSasSteerAg, ecu-extract-reference=TopLevelCompositionPrototype.Fcu_Prototype.RP_Fcu_Chassis_Data.EpsSasSteerAg
      EpsSasSteerAgVld_1559: upstream-reference=TopLevelComposition.Fcu_Prototype.RP_Fcu_Chassis_Data.EpsSasSteerAgVld, ecu-extract-reference=TopLevelCompositionPrototype.Fcu_Prototype.RP_Fcu_Chassis_Data.EpsSasSteerAgVld
      EpsSasSteerAg_Status_1560: upstream-reference=TopLevelComposition.Fcu_Prototype.RP_Fcu_Chassis_Data.EpsSasSteerAg_Status, ecu-extract-reference=TopLevelCompositionPrototype.Fcu_Prototype.RP_Fcu_Chassis_Data.EpsSasSteerAg_Status
      EpsSteerAgRate_1561: upstream-reference=TopLevelComposition.Fcu_Prototype.RP_Fcu_Chassis_Data.EpsSteerAgRate, ecu-extract-reference=TopLevelCompositionPrototype.Fcu_Prototype.RP_Fcu_Chassis_Data.EpsSteerAgRate
      EpsSteerAgRate_Status_1562: upstream-reference=TopLevelComposition.Fcu_Prototype.RP_Fcu_Chassis_Data.EpsSteerAgRate_Status, ecu-extract-reference=TopLevelCompositionPrototype.Fcu_Prototype.RP_Fcu_Chassis_Data.EpsSteerAgRate_Status
      EpsSteerAgSensFilr_1563: upstream-reference=TopLevelComposition.Fcu_Prototype.RP_Fcu_Chassis_Data.EpsSteerAgSensFilr, ecu-extract-reference=TopLevelCompositionPrototype.Fcu_Prototype.RP_Fcu_Chassis_Data.EpsSteerAgSensFilr
      EpsSteerAgSensFilr_Status_1564: upstream-reference=TopLevelComposition.Fcu_Prototype.RP_Fcu_Chassis_Data.EpsSteerAgSensFilr_Status, ecu-extract-reference=TopLevelCompositionPrototype.Fcu_Prototype.RP_Fcu_Chassis_Data.EpsSteerAgSensFilr_Status
      EspABAactive_1565: upstream-reference=TopLevelComposition.Fcu_Prototype.RP_Fcu_Chassis_Data.EspABAactive, ecu-extract-reference=TopLevelCompositionPrototype.Fcu_Prototype.RP_Fcu_Chassis_Data.EspABAactive
      EspABAactive_Status_1566: upstream-reference=TopLevelComposition.Fcu_Prototype.RP_Fcu_Chassis_Data.EspABAactive_Status, ecu-extract-reference=TopLevelCompositionPrototype.Fcu_Prototype.RP_Fcu_Chassis_Data.EspABAactive_Status
      EspABAavailable_1567: upstream-reference=TopLevelComposition.Fcu_Prototype.RP_Fcu_Chassis_Data.EspABAavailable, ecu-extract-reference=TopLevelCompositionPrototype.Fcu_Prototype.RP_Fcu_Chassis_Data.EspABAavailable
      EspABAavailable_Status_1568: upstream-reference=TopLevelComposition.Fcu_Prototype.RP_Fcu_Chassis_Data.EspABAavailable_Status, ecu-extract-reference=TopLevelCompositionPrototype.Fcu_Prototype.RP_Fcu_Chassis_Data.EspABAavailable_Status
      EspAEBAvailable_1569: upstream-reference=TopLevelComposition.Fcu_Prototype.RP_Fcu_Chassis_Data.EspAEBAvailable, ecu-extract-reference=TopLevelCompositionPrototype.Fcu_Prototype.RP_Fcu_Chassis_Data.EspAEBAvailable
      EspAEBAvailable_Status_1570: upstream-reference=TopLevelComposition.Fcu_Prototype.RP_Fcu_Chassis_Data.EspAEBAvailable_Status, ecu-extract-reference=TopLevelCompositionPrototype.Fcu_Prototype.RP_Fcu_Chassis_Data.EspAEBAvailable_Status
      EspAEBdecActive_1571: upstream-reference=TopLevelComposition.Fcu_Prototype.RP_Fcu_Chassis_Data.EspAEBdecActive, ecu-extract-reference=TopLevelCompositionPrototype.Fcu_Prototype.RP_Fcu_Chassis_Data.EspAEBdecActive
      EspAEBdecActive_Status_1572: upstream-reference=TopLevelComposition.Fcu_Prototype.RP_Fcu_Chassis_Data.EspAEBdecActive_Status, ecu-extract-reference=TopLevelCompositionPrototype.Fcu_Prototype.RP_Fcu_Chassis_Data.EspAEBdecActive_Status
      EspAWBactive_1573: upstream-reference=TopLevelComposition.Fcu_Prototype.RP_Fcu_Chassis_Data.EspAWBactive, ecu-extract-reference=TopLevelCompositionPrototype.Fcu_Prototype.RP_Fcu_Chassis_Data.EspAWBactive
      EspAWBactive_Status_1574: upstream-reference=TopLevelComposition.Fcu_Prototype.RP_Fcu_Chassis_Data.EspAWBactive_Status, ecu-extract-reference=TopLevelCompositionPrototype.Fcu_Prototype.RP_Fcu_Chassis_Data.EspAWBactive_Status
      EspAWBavailable_1575: upstream-reference=TopLevelComposition.Fcu_Prototype.RP_Fcu_Chassis_Data.EspAWBavailable, ecu-extract-reference=TopLevelCompositionPrototype.Fcu_Prototype.RP_Fcu_Chassis_Data.EspAWBavailable
      EspAWBavailable_Status_1576: upstream-reference=TopLevelComposition.Fcu_Prototype.RP_Fcu_Chassis_Data.EspAWBavailable_Status, ecu-extract-reference=TopLevelCompositionPrototype.Fcu_Prototype.RP_Fcu_Chassis_Data.EspAWBavailable_Status
      EspAbsActv_1577: upstream-reference=TopLevelComposition.Fcu_Prototype.RP_Fcu_Chassis_Data.EspAbsActv, ecu-extract-reference=TopLevelCompositionPrototype.Fcu_Prototype.RP_Fcu_Chassis_Data.EspAbsActv
      EspAbsActv_Status_1578: upstream-reference=TopLevelComposition.Fcu_Prototype.RP_Fcu_Chassis_Data.EspAbsActv_Status, ecu-extract-reference=TopLevelCompositionPrototype.Fcu_Prototype.RP_Fcu_Chassis_Data.EspAbsActv_Status
      EspAbsFailr_1579: upstream-reference=TopLevelComposition.Fcu_Prototype.RP_Fcu_Chassis_Data.EspAbsFailr, ecu-extract-reference=TopLevelCompositionPrototype.Fcu_Prototype.RP_Fcu_Chassis_Data.EspAbsFailr
      EspAbsFailr_Status_1580: upstream-reference=TopLevelComposition.Fcu_Prototype.RP_Fcu_Chassis_Data.EspAbsFailr_Status, ecu-extract-reference=TopLevelCompositionPrototype.Fcu_Prototype.RP_Fcu_Chassis_Data.EspAbsFailr_Status
      EspActvSts_1581: upstream-reference=TopLevelComposition.Fcu_Prototype.RP_Fcu_Chassis_Data.EspActvSts, ecu-extract-reference=TopLevelCompositionPrototype.Fcu_Prototype.RP_Fcu_Chassis_Data.EspActvSts
      EspActvSts_Status_1582: upstream-reference=TopLevelComposition.Fcu_Prototype.RP_Fcu_Chassis_Data.EspActvSts_Status, ecu-extract-reference=TopLevelCompositionPrototype.Fcu_Prototype.RP_Fcu_Chassis_Data.EspActvSts_Status
      EspEbdFailr_1583: upstream-reference=TopLevelComposition.Fcu_Prototype.RP_Fcu_Chassis_Data.EspEbdFailr, ecu-extract-reference=TopLevelCompositionPrototype.Fcu_Prototype.RP_Fcu_Chassis_Data.EspEbdFailr
      EspEbdFailr_Status_1584: upstream-reference=TopLevelComposition.Fcu_Prototype.RP_Fcu_Chassis_Data.EspEbdFailr_Status, ecu-extract-reference=TopLevelCompositionPrototype.Fcu_Prototype.RP_Fcu_Chassis_Data.EspEbdFailr_Status
      EspLatAccel_1585: upstream-reference=TopLevelComposition.Fcu_Prototype.RP_Fcu_Chassis_Data.EspLatAccel, ecu-extract-reference=TopLevelCompositionPrototype.Fcu_Prototype.RP_Fcu_Chassis_Data.EspLatAccel
      EspLatAccel_Status_1586: upstream-reference=TopLevelComposition.Fcu_Prototype.RP_Fcu_Chassis_Data.EspLatAccel_Status, ecu-extract-reference=TopLevelCompositionPrototype.Fcu_Prototype.RP_Fcu_Chassis_Data.EspLatAccel_Status
      EspLongAccel_1587: upstream-reference=TopLevelComposition.Fcu_Prototype.RP_Fcu_Chassis_Data.EspLongAccel, ecu-extract-reference=TopLevelCompositionPrototype.Fcu_Prototype.RP_Fcu_Chassis_Data.EspLongAccel
      EspLongAccel_Status_1588: upstream-reference=TopLevelComposition.Fcu_Prototype.RP_Fcu_Chassis_Data.EspLongAccel_Status, ecu-extract-reference=TopLevelCompositionPrototype.Fcu_Prototype.RP_Fcu_Chassis_Data.EspLongAccel_Status
      EspPrefillActive_1589: upstream-reference=TopLevelComposition.Fcu_Prototype.RP_Fcu_Chassis_Data.EspPrefillActive, ecu-extract-reference=TopLevelCompositionPrototype.Fcu_Prototype.RP_Fcu_Chassis_Data.EspPrefillActive
      EspPrefillActive_Status_1590: upstream-reference=TopLevelComposition.Fcu_Prototype.RP_Fcu_Chassis_Data.EspPrefillActive_Status, ecu-extract-reference=TopLevelCompositionPrototype.Fcu_Prototype.RP_Fcu_Chassis_Data.EspPrefillActive_Status
      EspPrefillAvailable_1591: upstream-reference=TopLevelComposition.Fcu_Prototype.RP_Fcu_Chassis_Data.EspPrefillAvailable, ecu-extract-reference=TopLevelCompositionPrototype.Fcu_Prototype.RP_Fcu_Chassis_Data.EspPrefillAvailable
      EspPrefillAvailable_Status_1592: upstream-reference=TopLevelComposition.Fcu_Prototype.RP_Fcu_Chassis_Data.EspPrefillAvailable_Status, ecu-extract-reference=TopLevelCompositionPrototype.Fcu_Prototype.RP_Fcu_Chassis_Data.EspPrefillAvailable_Status
      EspTcsActvSts_1593: upstream-reference=TopLevelComposition.Fcu_Prototype.RP_Fcu_Chassis_Data.EspTcsActvSts, ecu-extract-reference=TopLevelCompositionPrototype.Fcu_Prototype.RP_Fcu_Chassis_Data.EspTcsActvSts
      EspTcsActvSts_Status_1594: upstream-reference=TopLevelComposition.Fcu_Prototype.RP_Fcu_Chassis_Data.EspTcsActvSts_Status, ecu-extract-reference=TopLevelCompositionPrototype.Fcu_Prototype.RP_Fcu_Chassis_Data.EspTcsActvSts_Status
      EspTcsFailr_1595: upstream-reference=TopLevelComposition.Fcu_Prototype.RP_Fcu_Chassis_Data.EspTcsFailr, ecu-extract-reference=TopLevelCompositionPrototype.Fcu_Prototype.RP_Fcu_Chassis_Data.EspTcsFailr
      EspTcsFailr_Status_1596: upstream-reference=TopLevelComposition.Fcu_Prototype.RP_Fcu_Chassis_Data.EspTcsFailr_Status, ecu-extract-reference=TopLevelCompositionPrototype.Fcu_Prototype.RP_Fcu_Chassis_Data.EspTcsFailr_Status
      EspVdcActvSts_1597: upstream-reference=TopLevelComposition.Fcu_Prototype.RP_Fcu_Chassis_Data.EspVdcActvSts, ecu-extract-reference=TopLevelCompositionPrototype.Fcu_Prototype.RP_Fcu_Chassis_Data.EspVdcActvSts
      EspVdcActvSts_Status_1598: upstream-reference=TopLevelComposition.Fcu_Prototype.RP_Fcu_Chassis_Data.EspVdcActvSts_Status, ecu-extract-reference=TopLevelCompositionPrototype.Fcu_Prototype.RP_Fcu_Chassis_Data.EspVdcActvSts_Status
      EspVehSpd_1599: upstream-reference=TopLevelComposition.Fcu_Prototype.RP_Fcu_Chassis_Data.EspVehSpd, ecu-extract-reference=TopLevelCompositionPrototype.Fcu_Prototype.RP_Fcu_Chassis_Data.EspVehSpd
      EspVehSpdVld_1600: upstream-reference=TopLevelComposition.Fcu_Prototype.RP_Fcu_Chassis_Data.EspVehSpdVld, ecu-extract-reference=TopLevelCompositionPrototype.Fcu_Prototype.RP_Fcu_Chassis_Data.EspVehSpdVld
      EspVehSpd_Status_1601: upstream-reference=TopLevelComposition.Fcu_Prototype.RP_Fcu_Chassis_Data.EspVehSpd_Status, ecu-extract-reference=TopLevelCompositionPrototype.Fcu_Prototype.RP_Fcu_Chassis_Data.EspVehSpd_Status
      EspYawRate_1602: upstream-reference=TopLevelComposition.Fcu_Prototype.RP_Fcu_Chassis_Data.EspYawRate, ecu-extract-reference=TopLevelCompositionPrototype.Fcu_Prototype.RP_Fcu_Chassis_Data.EspYawRate
      EspYawRate_Status_1603: upstream-reference=TopLevelComposition.Fcu_Prototype.RP_Fcu_Chassis_Data.EspYawRate_Status, ecu-extract-reference=TopLevelCompositionPrototype.Fcu_Prototype.RP_Fcu_Chassis_Data.EspYawRate_Status
      IBCU_PFSBrakePressureValid_1604: upstream-reference=TopLevelComposition.Fcu_Prototype.RP_Fcu_Chassis_Data.IBCU_PFSBrakePressureValid, ecu-extract-reference=TopLevelCompositionPrototype.Fcu_Prototype.RP_Fcu_Chassis_Data.IBCU_PFSBrakePressureValid
      IbBrkPedlStsGb_1605: upstream-reference=TopLevelComposition.Fcu_Prototype.RP_Fcu_Chassis_Data.IbBrkPedlStsGb, ecu-extract-reference=TopLevelCompositionPrototype.Fcu_Prototype.RP_Fcu_Chassis_Data.IbBrkPedlStsGb
      IbBrkPedlStsGbVld_1606: upstream-reference=TopLevelComposition.Fcu_Prototype.RP_Fcu_Chassis_Data.IbBrkPedlStsGbVld, ecu-extract-reference=TopLevelCompositionPrototype.Fcu_Prototype.RP_Fcu_Chassis_Data.IbBrkPedlStsGbVld
      IbBrkPedlStsGb_Status_1607: upstream-reference=TopLevelComposition.Fcu_Prototype.RP_Fcu_Chassis_Data.IbBrkPedlStsGb_Status, ecu-extract-reference=TopLevelCompositionPrototype.Fcu_Prototype.RP_Fcu_Chassis_Data.IbBrkPedlStsGb_Status
      IbBrkPedlTrvlDrvr_1608: upstream-reference=TopLevelComposition.Fcu_Prototype.RP_Fcu_Chassis_Data.IbBrkPedlTrvlDrvr, ecu-extract-reference=TopLevelCompositionPrototype.Fcu_Prototype.RP_Fcu_Chassis_Data.IbBrkPedlTrvlDrvr
      IbBrkPedlTrvlDrvrVld_1609: upstream-reference=TopLevelComposition.Fcu_Prototype.RP_Fcu_Chassis_Data.IbBrkPedlTrvlDrvrVld, ecu-extract-reference=TopLevelCompositionPrototype.Fcu_Prototype.RP_Fcu_Chassis_Data.IbBrkPedlTrvlDrvrVld
      PlungerBrakePressure_1610: upstream-reference=TopLevelComposition.Fcu_Prototype.RP_Fcu_Chassis_Data.PlungerBrakePressure, ecu-extract-reference=TopLevelCompositionPrototype.Fcu_Prototype.RP_Fcu_Chassis_Data.PlungerBrakePressure
      PlungerBrakePressure_Status_1611: upstream-reference=TopLevelComposition.Fcu_Prototype.RP_Fcu_Chassis_Data.PlungerBrakePressure_Status, ecu-extract-reference=TopLevelCompositionPrototype.Fcu_Prototype.RP_Fcu_Chassis_Data.PlungerBrakePressure_Status
      VcuAccrPedlPosn_1612: upstream-reference=TopLevelComposition.Fcu_Prototype.RP_Fcu_Chassis_Data.VcuAccrPedlPosn, ecu-extract-reference=TopLevelCompositionPrototype.Fcu_Prototype.RP_Fcu_Chassis_Data.VcuAccrPedlPosn
      VcuAccrPedlPosnVld_1613: upstream-reference=TopLevelComposition.Fcu_Prototype.RP_Fcu_Chassis_Data.VcuAccrPedlPosnVld, ecu-extract-reference=TopLevelCompositionPrototype.Fcu_Prototype.RP_Fcu_Chassis_Data.VcuAccrPedlPosnVld
      VcuAccrPedlPosn_Status_1614: upstream-reference=TopLevelComposition.Fcu_Prototype.RP_Fcu_Chassis_Data.VcuAccrPedlPosn_Status, ecu-extract-reference=TopLevelCompositionPrototype.Fcu_Prototype.RP_Fcu_Chassis_Data.VcuAccrPedlPosn_Status
      VcuGearPosn_1615: upstream-reference=TopLevelComposition.Fcu_Prototype.RP_Fcu_Chassis_Data.VcuGearPosn, ecu-extract-reference=TopLevelCompositionPrototype.Fcu_Prototype.RP_Fcu_Chassis_Data.VcuGearPosn
      VcuGearPosn_Status_1616: upstream-reference=TopLevelComposition.Fcu_Prototype.RP_Fcu_Chassis_Data.VcuGearPosn_Status, ecu-extract-reference=TopLevelCompositionPrototype.Fcu_Prototype.RP_Fcu_Chassis_Data.VcuGearPosn_Status
      VcuVehGearPosnVld_1617: upstream-reference=TopLevelComposition.Fcu_Prototype.RP_Fcu_Chassis_Data.VcuVehGearPosnVld, ecu-extract-reference=TopLevelCompositionPrototype.Fcu_Prototype.RP_Fcu_Chassis_Data.VcuVehGearPosnVld
      RP_Fcu_Powertrain_Data_1618: upstream-reference=TopLevelComposition.Fcu_Prototype.RP_Fcu_Powertrain_Data, ecu-extract-reference=TopLevelCompositionPrototype.Fcu_Prototype.RP_Fcu_Powertrain_Data
      WhlSpdFrntLePls_1619: upstream-reference=TopLevelComposition.Fcu_Prototype.RP_Fcu_Powertrain_Data.WhlSpdFrntLePls, ecu-extract-reference=TopLevelCompositionPrototype.Fcu_Prototype.RP_Fcu_Powertrain_Data.WhlSpdFrntLePls
      WhlSpdFrntLePls_Status_1620: upstream-reference=TopLevelComposition.Fcu_Prototype.RP_Fcu_Powertrain_Data.WhlSpdFrntLePls_Status, ecu-extract-reference=TopLevelCompositionPrototype.Fcu_Prototype.RP_Fcu_Powertrain_Data.WhlSpdFrntLePls_Status
      WhlSpdFrntRiPls_1621: upstream-reference=TopLevelComposition.Fcu_Prototype.RP_Fcu_Powertrain_Data.WhlSpdFrntRiPls, ecu-extract-reference=TopLevelCompositionPrototype.Fcu_Prototype.RP_Fcu_Powertrain_Data.WhlSpdFrntRiPls
      WhlSpdFrntRiPls_Status_1622: upstream-reference=TopLevelComposition.Fcu_Prototype.RP_Fcu_Powertrain_Data.WhlSpdFrntRiPls_Status, ecu-extract-reference=TopLevelCompositionPrototype.Fcu_Prototype.RP_Fcu_Powertrain_Data.WhlSpdFrntRiPls_Status
      WhlSpdLeFrntData_1623: upstream-reference=TopLevelComposition.Fcu_Prototype.RP_Fcu_Powertrain_Data.WhlSpdLeFrntData, ecu-extract-reference=TopLevelCompositionPrototype.Fcu_Prototype.RP_Fcu_Powertrain_Data.WhlSpdLeFrntData
      WhlSpdLeFrntDataVld_1624: upstream-reference=TopLevelComposition.Fcu_Prototype.RP_Fcu_Powertrain_Data.WhlSpdLeFrntDataVld, ecu-extract-reference=TopLevelCompositionPrototype.Fcu_Prototype.RP_Fcu_Powertrain_Data.WhlSpdLeFrntDataVld
      WhlSpdLeFrntData_Status_1625: upstream-reference=TopLevelComposition.Fcu_Prototype.RP_Fcu_Powertrain_Data.WhlSpdLeFrntData_Status, ecu-extract-reference=TopLevelCompositionPrototype.Fcu_Prototype.RP_Fcu_Powertrain_Data.WhlSpdLeFrntData_Status
      WhlSpdLeFrntDir_1626: upstream-reference=TopLevelComposition.Fcu_Prototype.RP_Fcu_Powertrain_Data.WhlSpdLeFrntDir, ecu-extract-reference=TopLevelCompositionPrototype.Fcu_Prototype.RP_Fcu_Powertrain_Data.WhlSpdLeFrntDir
      WhlSpdLeFrntDir_Status_1627: upstream-reference=TopLevelComposition.Fcu_Prototype.RP_Fcu_Powertrain_Data.WhlSpdLeFrntDir_Status, ecu-extract-reference=TopLevelCompositionPrototype.Fcu_Prototype.RP_Fcu_Powertrain_Data.WhlSpdLeFrntDir_Status
      WhlSpdLeReData_1628: upstream-reference=TopLevelComposition.Fcu_Prototype.RP_Fcu_Powertrain_Data.WhlSpdLeReData, ecu-extract-reference=TopLevelCompositionPrototype.Fcu_Prototype.RP_Fcu_Powertrain_Data.WhlSpdLeReData
      WhlSpdLeReDataVld_1629: upstream-reference=TopLevelComposition.Fcu_Prototype.RP_Fcu_Powertrain_Data.WhlSpdLeReDataVld, ecu-extract-reference=TopLevelCompositionPrototype.Fcu_Prototype.RP_Fcu_Powertrain_Data.WhlSpdLeReDataVld
      WhlSpdLeReData_Status_1630: upstream-reference=TopLevelComposition.Fcu_Prototype.RP_Fcu_Powertrain_Data.WhlSpdLeReData_Status, ecu-extract-reference=TopLevelCompositionPrototype.Fcu_Prototype.RP_Fcu_Powertrain_Data.WhlSpdLeReData_Status
      WhlSpdLeReDir_1631: upstream-reference=TopLevelComposition.Fcu_Prototype.RP_Fcu_Powertrain_Data.WhlSpdLeReDir, ecu-extract-reference=TopLevelCompositionPrototype.Fcu_Prototype.RP_Fcu_Powertrain_Data.WhlSpdLeReDir
      WhlSpdLeReDir_Status_1632: upstream-reference=TopLevelComposition.Fcu_Prototype.RP_Fcu_Powertrain_Data.WhlSpdLeReDir_Status, ecu-extract-reference=TopLevelCompositionPrototype.Fcu_Prototype.RP_Fcu_Powertrain_Data.WhlSpdLeReDir_Status
      WhlSpdReLePls_1633: upstream-reference=TopLevelComposition.Fcu_Prototype.RP_Fcu_Powertrain_Data.WhlSpdReLePls, ecu-extract-reference=TopLevelCompositionPrototype.Fcu_Prototype.RP_Fcu_Powertrain_Data.WhlSpdReLePls
      WhlSpdReLePls_Status_1634: upstream-reference=TopLevelComposition.Fcu_Prototype.RP_Fcu_Powertrain_Data.WhlSpdReLePls_Status, ecu-extract-reference=TopLevelCompositionPrototype.Fcu_Prototype.RP_Fcu_Powertrain_Data.WhlSpdReLePls_Status
      WhlSpdReRiPls_1635: upstream-reference=TopLevelComposition.Fcu_Prototype.RP_Fcu_Powertrain_Data.WhlSpdReRiPls, ecu-extract-reference=TopLevelCompositionPrototype.Fcu_Prototype.RP_Fcu_Powertrain_Data.WhlSpdReRiPls
      WhlSpdReRiPls_Status_1636: upstream-reference=TopLevelComposition.Fcu_Prototype.RP_Fcu_Powertrain_Data.WhlSpdReRiPls_Status, ecu-extract-reference=TopLevelCompositionPrototype.Fcu_Prototype.RP_Fcu_Powertrain_Data.WhlSpdReRiPls_Status
      WhlSpdRiFrntData_1637: upstream-reference=TopLevelComposition.Fcu_Prototype.RP_Fcu_Powertrain_Data.WhlSpdRiFrntData, ecu-extract-reference=TopLevelCompositionPrototype.Fcu_Prototype.RP_Fcu_Powertrain_Data.WhlSpdRiFrntData
      WhlSpdRiFrntDataVld_1638: upstream-reference=TopLevelComposition.Fcu_Prototype.RP_Fcu_Powertrain_Data.WhlSpdRiFrntDataVld, ecu-extract-reference=TopLevelCompositionPrototype.Fcu_Prototype.RP_Fcu_Powertrain_Data.WhlSpdRiFrntDataVld
      WhlSpdRiFrntData_Status_1639: upstream-reference=TopLevelComposition.Fcu_Prototype.RP_Fcu_Powertrain_Data.WhlSpdRiFrntData_Status, ecu-extract-reference=TopLevelCompositionPrototype.Fcu_Prototype.RP_Fcu_Powertrain_Data.WhlSpdRiFrntData_Status
      WhlSpdRiFrntDir_1640: upstream-reference=TopLevelComposition.Fcu_Prototype.RP_Fcu_Powertrain_Data.WhlSpdRiFrntDir, ecu-extract-reference=TopLevelCompositionPrototype.Fcu_Prototype.RP_Fcu_Powertrain_Data.WhlSpdRiFrntDir
      WhlSpdRiFrntDir_Status_1641: upstream-reference=TopLevelComposition.Fcu_Prototype.RP_Fcu_Powertrain_Data.WhlSpdRiFrntDir_Status, ecu-extract-reference=TopLevelCompositionPrototype.Fcu_Prototype.RP_Fcu_Powertrain_Data.WhlSpdRiFrntDir_Status
      WhlSpdRiReData_1642: upstream-reference=TopLevelComposition.Fcu_Prototype.RP_Fcu_Powertrain_Data.WhlSpdRiReData, ecu-extract-reference=TopLevelCompositionPrototype.Fcu_Prototype.RP_Fcu_Powertrain_Data.WhlSpdRiReData
      WhlSpdRiReDataVld_1643: upstream-reference=TopLevelComposition.Fcu_Prototype.RP_Fcu_Powertrain_Data.WhlSpdRiReDataVld, ecu-extract-reference=TopLevelCompositionPrototype.Fcu_Prototype.RP_Fcu_Powertrain_Data.WhlSpdRiReDataVld
      WhlSpdRiReData_Status_1644: upstream-reference=TopLevelComposition.Fcu_Prototype.RP_Fcu_Powertrain_Data.WhlSpdRiReData_Status, ecu-extract-reference=TopLevelCompositionPrototype.Fcu_Prototype.RP_Fcu_Powertrain_Data.WhlSpdRiReData_Status
      WhlSpdRiReDir_1645: upstream-reference=TopLevelComposition.Fcu_Prototype.RP_Fcu_Powertrain_Data.WhlSpdRiReDir, ecu-extract-reference=TopLevelCompositionPrototype.Fcu_Prototype.RP_Fcu_Powertrain_Data.WhlSpdRiReDir
      WhlSpdRiReDir_Status_1646: upstream-reference=TopLevelComposition.Fcu_Prototype.RP_Fcu_Powertrain_Data.WhlSpdRiReDir_Status, ecu-extract-reference=TopLevelCompositionPrototype.Fcu_Prototype.RP_Fcu_Powertrain_Data.WhlSpdRiReDir_Status
      RP_Fcu_SRI_Esh_ErrorStatusInfo_1647: upstream-reference=TopLevelComposition.Fcu_Prototype.RP_Fcu_SRI_Esh_ErrorStatusInfo, ecu-extract-reference=TopLevelCompositionPrototype.Fcu_Prototype.RP_Fcu_SRI_Esh_ErrorStatusInfo
      DE_Esh_ErrorStatusInfo_1648: upstream-reference=TopLevelComposition.Fcu_Prototype.RP_Fcu_SRI_Esh_ErrorStatusInfo.DE_Esh_ErrorStatusInfo, ecu-extract-reference=TopLevelCompositionPrototype.Fcu_Prototype.RP_Fcu_SRI_Esh_ErrorStatusInfo.DE_Esh_ErrorStatusInfo
      RP_HlaAdapter_OutputData_1649: upstream-reference=TopLevelComposition.Fcu_Prototype.RP_HlaAdapter_OutputData, ecu-extract-reference=TopLevelCompositionPrototype.Fcu_Prototype.RP_HlaAdapter_OutputData
      Hla_OutputSignals_t_1650: upstream-reference=TopLevelComposition.Fcu_Prototype.RP_HlaAdapter_OutputData.Hla_OutputSignals_t, ecu-extract-reference=TopLevelCompositionPrototype.Fcu_Prototype.RP_HlaAdapter_OutputData.Hla_OutputSignals_t
      RP_LcfAdapter_LcfSenGenericOutputData_1651: upstream-reference=TopLevelComposition.Fcu_Prototype.RP_LcfAdapter_LcfSenGenericOutputData, ecu-extract-reference=TopLevelCompositionPrototype.Fcu_Prototype.RP_LcfAdapter_LcfSenGenericOutputData
      LcfSenGenericOutputData_1652: upstream-reference=TopLevelComposition.Fcu_Prototype.RP_LcfAdapter_LcfSenGenericOutputData.LcfSenGenericOutputData, ecu-extract-reference=TopLevelCompositionPrototype.Fcu_Prototype.RP_LcfAdapter_LcfSenGenericOutputData.LcfSenGenericOutputData
      RP_LcfAdapter_LcfVehGenericOutputData_1653: upstream-reference=TopLevelComposition.Fcu_Prototype.RP_LcfAdapter_LcfVehGenericOutputData, ecu-extract-reference=TopLevelCompositionPrototype.Fcu_Prototype.RP_LcfAdapter_LcfVehGenericOutputData
      LcfVehGenricOutputData_1654: upstream-reference=TopLevelComposition.Fcu_Prototype.RP_LcfAdapter_LcfVehGenericOutputData.LcfVehGenricOutputData, ecu-extract-reference=TopLevelCompositionPrototype.Fcu_Prototype.RP_LcfAdapter_LcfVehGenericOutputData.LcfVehGenricOutputData
      RP_Nvm_HMISwitchStatus_1655: upstream-reference=TopLevelComposition.Fcu_Prototype.RP_Nvm_HMISwitchStatus, ecu-extract-reference=TopLevelCompositionPrototype.Fcu_Prototype.RP_Nvm_HMISwitchStatus
      RP_Sdc_Cem_GenObjectList_1656: upstream-reference=TopLevelComposition.Fcu_Prototype.RP_Sdc_Cem_GenObjectList, ecu-extract-reference=TopLevelCompositionPrototype.Fcu_Prototype.RP_Sdc_Cem_GenObjectList
      GenObjectList_1657: upstream-reference=TopLevelComposition.Fcu_Prototype.RP_Sdc_Cem_GenObjectList.GenObjectList, ecu-extract-reference=TopLevelCompositionPrototype.Fcu_Prototype.RP_Sdc_Cem_GenObjectList.GenObjectList
      RP_Sdc_SendInterface_Perception_1658: upstream-reference=TopLevelComposition.Fcu_Prototype.RP_Sdc_SendInterface_Perception, ecu-extract-reference=TopLevelCompositionPrototype.Fcu_Prototype.RP_Sdc_SendInterface_Perception
      FiM_Prototype_1659: upstream-reference=TopLevelComposition.FiM_Prototype, ecu-extract-reference=TopLevelCompositionPrototype.FiM_Prototype
      FI_FID_AEB_1660: upstream-reference=TopLevelComposition.FiM_Prototype.FI_FID_AEB, ecu-extract-reference=TopLevelCompositionPrototype.FiM_Prototype.FI_FID_AEB
      FI_FID_ELK_1661: upstream-reference=TopLevelComposition.FiM_Prototype.FI_FID_ELK, ecu-extract-reference=TopLevelCompositionPrototype.FiM_Prototype.FI_FID_ELK
      FI_FID_FCW_1662: upstream-reference=TopLevelComposition.FiM_Prototype.FI_FID_FCW, ecu-extract-reference=TopLevelCompositionPrototype.FiM_Prototype.FI_FID_FCW
      FI_FID_HLA_1663: upstream-reference=TopLevelComposition.FiM_Prototype.FI_FID_HLA, ecu-extract-reference=TopLevelCompositionPrototype.FiM_Prototype.FI_FID_HLA
      FI_FID_LDW_1664: upstream-reference=TopLevelComposition.FiM_Prototype.FI_FID_LDW, ecu-extract-reference=TopLevelCompositionPrototype.FiM_Prototype.FI_FID_LDW
      FI_FID_LKA_1665: upstream-reference=TopLevelComposition.FiM_Prototype.FI_FID_LKA, ecu-extract-reference=TopLevelCompositionPrototype.FiM_Prototype.FI_FID_LKA
      FI_FID_TSA_1666: upstream-reference=TopLevelComposition.FiM_Prototype.FI_FID_TSA, ecu-extract-reference=TopLevelCompositionPrototype.FiM_Prototype.FI_FID_TSA
      FI_FID_FAB_1667: upstream-reference=TopLevelComposition.FiM_Prototype.FI_FID_FAB, ecu-extract-reference=TopLevelCompositionPrototype.FiM_Prototype.FI_FID_FAB
      FI_FID_U17A1F0_1668: upstream-reference=TopLevelComposition.FiM_Prototype.FI_FID_U17A1F0, ecu-extract-reference=TopLevelCompositionPrototype.FiM_Prototype.FI_FID_U17A1F0
      HeartbeatDet_1669: upstream-reference=TopLevelComposition.HeartbeatDet, ecu-extract-reference=TopLevelCompositionPrototype.HeartbeatDet
      HlaAdapter_Prototype_1670: upstream-reference=TopLevelComposition.HlaAdapter_Prototype, ecu-extract-reference=TopLevelCompositionPrototype.HlaAdapter_Prototype
      PP_HlaAdapter_OutputData_1671: upstream-reference=TopLevelComposition.HlaAdapter_Prototype.PP_HlaAdapter_OutputData, ecu-extract-reference=TopLevelCompositionPrototype.HlaAdapter_Prototype.PP_HlaAdapter_OutputData
      Hla_OutputSignals_t_1672: upstream-reference=TopLevelComposition.HlaAdapter_Prototype.PP_HlaAdapter_OutputData.Hla_OutputSignals_t, ecu-extract-reference=TopLevelCompositionPrototype.HlaAdapter_Prototype.PP_HlaAdapter_OutputData.Hla_OutputSignals_t
      RP_Fcu_BaseCtrlData_1673: upstream-reference=TopLevelComposition.HlaAdapter_Prototype.RP_Fcu_BaseCtrlData, ecu-extract-reference=TopLevelCompositionPrototype.HlaAdapter_Prototype.RP_Fcu_BaseCtrlData
      BaseCtrlData_1674: upstream-reference=TopLevelComposition.HlaAdapter_Prototype.RP_Fcu_BaseCtrlData.BaseCtrlData, ecu-extract-reference=TopLevelCompositionPrototype.HlaAdapter_Prototype.RP_Fcu_BaseCtrlData.BaseCtrlData
      RP_Fcu_HlaInputData_1675: upstream-reference=TopLevelComposition.HlaAdapter_Prototype.RP_Fcu_HlaInputData, ecu-extract-reference=TopLevelCompositionPrototype.HlaAdapter_Prototype.RP_Fcu_HlaInputData
      Hla_InputSignals_t_1676: upstream-reference=TopLevelComposition.HlaAdapter_Prototype.RP_Fcu_HlaInputData.Hla_InputSignals_t, ecu-extract-reference=TopLevelCompositionPrototype.HlaAdapter_Prototype.RP_Fcu_HlaInputData.Hla_InputSignals_t
      RP_Fcu_VehSig_1677: upstream-reference=TopLevelComposition.HlaAdapter_Prototype.RP_Fcu_VehSig, ecu-extract-reference=TopLevelCompositionPrototype.HlaAdapter_Prototype.RP_Fcu_VehSig
      VehSig_1678: upstream-reference=TopLevelComposition.HlaAdapter_Prototype.RP_Fcu_VehSig.VehSig, ecu-extract-reference=TopLevelCompositionPrototype.HlaAdapter_Prototype.RP_Fcu_VehSig.VehSig
      RP_MtsiAdapter_MeasFreezeData_1679: upstream-reference=TopLevelComposition.HlaAdapter_Prototype.RP_MtsiAdapter_MeasFreezeData, ecu-extract-reference=TopLevelCompositionPrototype.HlaAdapter_Prototype.RP_MtsiAdapter_MeasFreezeData
      RP_UpdateTaskCycle_1680: upstream-reference=TopLevelComposition.HlaAdapter_Prototype.RP_UpdateTaskCycle, ecu-extract-reference=TopLevelCompositionPrototype.HlaAdapter_Prototype.RP_UpdateTaskCycle
      RP_VdyAdapter_VehDynData_1681: upstream-reference=TopLevelComposition.HlaAdapter_Prototype.RP_VdyAdapter_VehDynData, ecu-extract-reference=TopLevelCompositionPrototype.HlaAdapter_Prototype.RP_VdyAdapter_VehDynData
      VehDyn_1682: upstream-reference=TopLevelComposition.HlaAdapter_Prototype.RP_VdyAdapter_VehDynData.VehDyn, ecu-extract-reference=TopLevelCompositionPrototype.HlaAdapter_Prototype.RP_VdyAdapter_VehDynData.VehDyn
      LcfAdapter_Prototype_1683: upstream-reference=TopLevelComposition.LcfAdapter_Prototype, ecu-extract-reference=TopLevelCompositionPrototype.LcfAdapter_Prototype
      PP_LcfAdapter_LcfSenGenericOutputData_1684: upstream-reference=TopLevelComposition.LcfAdapter_Prototype.PP_LcfAdapter_LcfSenGenericOutputData, ecu-extract-reference=TopLevelCompositionPrototype.LcfAdapter_Prototype.PP_LcfAdapter_LcfSenGenericOutputData
      LcfSenGenericOutputData_1685: upstream-reference=TopLevelComposition.LcfAdapter_Prototype.PP_LcfAdapter_LcfSenGenericOutputData.LcfSenGenericOutputData, ecu-extract-reference=TopLevelCompositionPrototype.LcfAdapter_Prototype.PP_LcfAdapter_LcfSenGenericOutputData.LcfSenGenericOutputData
      PP_LcfAdapter_LcfVehGenericOutputData_1686: upstream-reference=TopLevelComposition.LcfAdapter_Prototype.PP_LcfAdapter_LcfVehGenericOutputData, ecu-extract-reference=TopLevelCompositionPrototype.LcfAdapter_Prototype.PP_LcfAdapter_LcfVehGenericOutputData
      LcfVehGenricOutputData_1687: upstream-reference=TopLevelComposition.LcfAdapter_Prototype.PP_LcfAdapter_LcfVehGenericOutputData.LcfVehGenricOutputData, ecu-extract-reference=TopLevelCompositionPrototype.LcfAdapter_Prototype.PP_LcfAdapter_LcfVehGenericOutputData.LcfVehGenricOutputData
      RP_Fcu_BaseCtrlData_1688: upstream-reference=TopLevelComposition.LcfAdapter_Prototype.RP_Fcu_BaseCtrlData, ecu-extract-reference=TopLevelCompositionPrototype.LcfAdapter_Prototype.RP_Fcu_BaseCtrlData
      BaseCtrlData_1689: upstream-reference=TopLevelComposition.LcfAdapter_Prototype.RP_Fcu_BaseCtrlData.BaseCtrlData, ecu-extract-reference=TopLevelCompositionPrototype.LcfAdapter_Prototype.RP_Fcu_BaseCtrlData.BaseCtrlData
      RP_Fcu_LcfGenericInputData_1690: upstream-reference=TopLevelComposition.LcfAdapter_Prototype.RP_Fcu_LcfGenericInputData, ecu-extract-reference=TopLevelCompositionPrototype.LcfAdapter_Prototype.RP_Fcu_LcfGenericInputData
      LcfGenericInputData_1691: upstream-reference=TopLevelComposition.LcfAdapter_Prototype.RP_Fcu_LcfGenericInputData.LcfGenericInputData, ecu-extract-reference=TopLevelCompositionPrototype.LcfAdapter_Prototype.RP_Fcu_LcfGenericInputData.LcfGenericInputData
      RP_Fcu_VehPar_1692: upstream-reference=TopLevelComposition.LcfAdapter_Prototype.RP_Fcu_VehPar, ecu-extract-reference=TopLevelCompositionPrototype.LcfAdapter_Prototype.RP_Fcu_VehPar
      VehPar_1693: upstream-reference=TopLevelComposition.LcfAdapter_Prototype.RP_Fcu_VehPar.VehPar, ecu-extract-reference=TopLevelCompositionPrototype.LcfAdapter_Prototype.RP_Fcu_VehPar.VehPar
      RP_Fcu_VehSig_1694: upstream-reference=TopLevelComposition.LcfAdapter_Prototype.RP_Fcu_VehSig, ecu-extract-reference=TopLevelCompositionPrototype.LcfAdapter_Prototype.RP_Fcu_VehSig
      VehSig_1695: upstream-reference=TopLevelComposition.LcfAdapter_Prototype.RP_Fcu_VehSig.VehSig, ecu-extract-reference=TopLevelCompositionPrototype.LcfAdapter_Prototype.RP_Fcu_VehSig.VehSig
      RP_MtsiAdapter_MeasFreezeData_1696: upstream-reference=TopLevelComposition.LcfAdapter_Prototype.RP_MtsiAdapter_MeasFreezeData, ecu-extract-reference=TopLevelCompositionPrototype.LcfAdapter_Prototype.RP_MtsiAdapter_MeasFreezeData
      RP_MtsiAdapter_UpdateTaskCycle_1697: upstream-reference=TopLevelComposition.LcfAdapter_Prototype.RP_MtsiAdapter_UpdateTaskCycle, ecu-extract-reference=TopLevelCompositionPrototype.LcfAdapter_Prototype.RP_MtsiAdapter_UpdateTaskCycle
      RP_Sdc_Cem_GenObjectList_1698: upstream-reference=TopLevelComposition.LcfAdapter_Prototype.RP_Sdc_Cem_GenObjectList, ecu-extract-reference=TopLevelCompositionPrototype.LcfAdapter_Prototype.RP_Sdc_Cem_GenObjectList
      GenObjectList_1699: upstream-reference=TopLevelComposition.LcfAdapter_Prototype.RP_Sdc_Cem_GenObjectList.GenObjectList, ecu-extract-reference=TopLevelCompositionPrototype.LcfAdapter_Prototype.RP_Sdc_Cem_GenObjectList.GenObjectList
      RP_Sdc_Perception_AbdOutputData_1700: upstream-reference=TopLevelComposition.LcfAdapter_Prototype.RP_Sdc_Perception_AbdOutputData, ecu-extract-reference=TopLevelCompositionPrototype.LcfAdapter_Prototype.RP_Sdc_Perception_AbdOutputData
      AbdOutputData_t_1701: upstream-reference=TopLevelComposition.LcfAdapter_Prototype.RP_Sdc_Perception_AbdOutputData.AbdOutputData_t, ecu-extract-reference=TopLevelCompositionPrototype.LcfAdapter_Prototype.RP_Sdc_Perception_AbdOutputData.AbdOutputData_t
      RP_VdyAdapter_VdyOffsets_1702: upstream-reference=TopLevelComposition.LcfAdapter_Prototype.RP_VdyAdapter_VdyOffsets, ecu-extract-reference=TopLevelCompositionPrototype.LcfAdapter_Prototype.RP_VdyAdapter_VdyOffsets
      VdyOffsets_1703: upstream-reference=TopLevelComposition.LcfAdapter_Prototype.RP_VdyAdapter_VdyOffsets.VdyOffsets, ecu-extract-reference=TopLevelCompositionPrototype.LcfAdapter_Prototype.RP_VdyAdapter_VdyOffsets.VdyOffsets
      RP_VdyAdapter_VehDyn_1704: upstream-reference=TopLevelComposition.LcfAdapter_Prototype.RP_VdyAdapter_VehDyn, ecu-extract-reference=TopLevelCompositionPrototype.LcfAdapter_Prototype.RP_VdyAdapter_VehDyn
      VehDyn_1705: upstream-reference=TopLevelComposition.LcfAdapter_Prototype.RP_VdyAdapter_VehDyn.VehDyn, ecu-extract-reference=TopLevelCompositionPrototype.LcfAdapter_Prototype.RP_VdyAdapter_VehDyn.VehDyn
      Logging_1706: upstream-reference=TopLevelComposition.Logging, ecu-extract-reference=TopLevelCompositionPrototype.Logging
      Med_Prototype_1707: upstream-reference=TopLevelComposition.Med_Prototype, ecu-extract-reference=TopLevelCompositionPrototype.Med_Prototype
      PP_Dem_CBStatusEvt_DEM_CAMERA_CALIBRATION_FAILURE_1708: upstream-reference=TopLevelComposition.Med_Prototype.PP_Dem_CBStatusEvt_DEM_CAMERA_CALIBRATION_FAILURE, ecu-extract-reference=TopLevelCompositionPrototype.Med_Prototype.PP_Dem_CBStatusEvt_DEM_CAMERA_CALIBRATION_FAILURE
      PP_Dem_CBStatusEvt_DEM_CAMERA_ONLINE_CALIBRATION_FAILURE_1709: upstream-reference=TopLevelComposition.Med_Prototype.PP_Dem_CBStatusEvt_DEM_CAMERA_ONLINE_CALIBRATION_FAILURE, ecu-extract-reference=TopLevelCompositionPrototype.Med_Prototype.PP_Dem_CBStatusEvt_DEM_CAMERA_ONLINE_CALIBRATION_FAILURE
      PP_Dem_CBStatusEvt_DEM_DTC_ADC_All_Node_Missing_1710: upstream-reference=TopLevelComposition.Med_Prototype.PP_Dem_CBStatusEvt_DEM_DTC_ADC_All_Node_Missing, ecu-extract-reference=TopLevelCompositionPrototype.Med_Prototype.PP_Dem_CBStatusEvt_DEM_DTC_ADC_All_Node_Missing
      PP_Dem_CBStatusEvt_DEM_DTC_ADC_Message_Alive_Counter_Error_1711: upstream-reference=TopLevelComposition.Med_Prototype.PP_Dem_CBStatusEvt_DEM_DTC_ADC_Message_Alive_Counter_Error, ecu-extract-reference=TopLevelCompositionPrototype.Med_Prototype.PP_Dem_CBStatusEvt_DEM_DTC_ADC_Message_Alive_Counter_Error
      PP_Dem_CBStatusEvt_DEM_DTC_BCM_All_Node_Missing_1712: upstream-reference=TopLevelComposition.Med_Prototype.PP_Dem_CBStatusEvt_DEM_DTC_BCM_All_Node_Missing, ecu-extract-reference=TopLevelCompositionPrototype.Med_Prototype.PP_Dem_CBStatusEvt_DEM_DTC_BCM_All_Node_Missing
      PP_Dem_CBStatusEvt_DEM_DTC_BCM_Brake_Lamp_Error_1713: upstream-reference=TopLevelComposition.Med_Prototype.PP_Dem_CBStatusEvt_DEM_DTC_BCM_Brake_Lamp_Error, ecu-extract-reference=TopLevelCompositionPrototype.Med_Prototype.PP_Dem_CBStatusEvt_DEM_DTC_BCM_Brake_Lamp_Error
      PP_Dem_CBStatusEvt_DEM_DTC_BCM_EmgyLi_Fault_1714: upstream-reference=TopLevelComposition.Med_Prototype.PP_Dem_CBStatusEvt_DEM_DTC_BCM_EmgyLi_Fault, ecu-extract-reference=TopLevelCompositionPrototype.Med_Prototype.PP_Dem_CBStatusEvt_DEM_DTC_BCM_EmgyLi_Fault
      PP_Dem_CBStatusEvt_DEM_DTC_BCM_FrntWiperSts_Fault_1715: upstream-reference=TopLevelComposition.Med_Prototype.PP_Dem_CBStatusEvt_DEM_DTC_BCM_FrntWiperSts_Fault, ecu-extract-reference=TopLevelCompositionPrototype.Med_Prototype.PP_Dem_CBStatusEvt_DEM_DTC_BCM_FrntWiperSts_Fault
      PP_Dem_CBStatusEvt_DEM_DTC_BCM_Message_Alive_Counter_Error_40ms_1716: upstream-reference=TopLevelComposition.Med_Prototype.PP_Dem_CBStatusEvt_DEM_DTC_BCM_Message_Alive_Counter_Error_40ms, ecu-extract-reference=TopLevelCompositionPrototype.Med_Prototype.PP_Dem_CBStatusEvt_DEM_DTC_BCM_Message_Alive_Counter_Error_40ms
      PP_Dem_CBStatusEvt_DEM_DTC_BCM_TurnIndcrLight_Fault_1717: upstream-reference=TopLevelComposition.Med_Prototype.PP_Dem_CBStatusEvt_DEM_DTC_BCM_TurnIndcrLight_Fault, ecu-extract-reference=TopLevelCompositionPrototype.Med_Prototype.PP_Dem_CBStatusEvt_DEM_DTC_BCM_TurnIndcrLight_Fault
      PP_Dem_CBStatusEvt_DEM_DTC_EPS_APA_Epas_Fault_1718: upstream-reference=TopLevelComposition.Med_Prototype.PP_Dem_CBStatusEvt_DEM_DTC_EPS_APA_Epas_Fault, ecu-extract-reference=TopLevelCompositionPrototype.Med_Prototype.PP_Dem_CBStatusEvt_DEM_DTC_EPS_APA_Epas_Fault
      PP_Dem_CBStatusEvt_DEM_DTC_EPS_ActualMotor_Invld_1719: upstream-reference=TopLevelComposition.Med_Prototype.PP_Dem_CBStatusEvt_DEM_DTC_EPS_ActualMotor_Invld, ecu-extract-reference=TopLevelCompositionPrototype.Med_Prototype.PP_Dem_CBStatusEvt_DEM_DTC_EPS_ActualMotor_Invld
      PP_Dem_CBStatusEvt_DEM_DTC_EPS_Actual_Motor_Torq_Invld_1720: upstream-reference=TopLevelComposition.Med_Prototype.PP_Dem_CBStatusEvt_DEM_DTC_EPS_Actual_Motor_Torq_Invld, ecu-extract-reference=TopLevelCompositionPrototype.Med_Prototype.PP_Dem_CBStatusEvt_DEM_DTC_EPS_Actual_Motor_Torq_Invld
      PP_Dem_CBStatusEvt_DEM_DTC_EPS_Actual_TorsionTorq_Invld_1721: upstream-reference=TopLevelComposition.Med_Prototype.PP_Dem_CBStatusEvt_DEM_DTC_EPS_Actual_TorsionTorq_Invld, ecu-extract-reference=TopLevelCompositionPrototype.Med_Prototype.PP_Dem_CBStatusEvt_DEM_DTC_EPS_Actual_TorsionTorq_Invld
      PP_Dem_CBStatusEvt_DEM_DTC_EPS_All_Node_Missing_1722: upstream-reference=TopLevelComposition.Med_Prototype.PP_Dem_CBStatusEvt_DEM_DTC_EPS_All_Node_Missing, ecu-extract-reference=TopLevelCompositionPrototype.Med_Prototype.PP_Dem_CBStatusEvt_DEM_DTC_EPS_All_Node_Missing
      PP_Dem_CBStatusEvt_DEM_DTC_EPS_Driver_handtorque_invalid_1723: upstream-reference=TopLevelComposition.Med_Prototype.PP_Dem_CBStatusEvt_DEM_DTC_EPS_Driver_handtorque_invalid, ecu-extract-reference=TopLevelCompositionPrototype.Med_Prototype.PP_Dem_CBStatusEvt_DEM_DTC_EPS_Driver_handtorque_invalid
      PP_Dem_CBStatusEvt_DEM_DTC_EPS_Fault_1724: upstream-reference=TopLevelComposition.Med_Prototype.PP_Dem_CBStatusEvt_DEM_DTC_EPS_Fault, ecu-extract-reference=TopLevelCompositionPrototype.Med_Prototype.PP_Dem_CBStatusEvt_DEM_DTC_EPS_Fault
      PP_Dem_CBStatusEvt_DEM_DTC_EPS_Message_Alive_Counter_Error_10ms_1725: upstream-reference=TopLevelComposition.Med_Prototype.PP_Dem_CBStatusEvt_DEM_DTC_EPS_Message_Alive_Counter_Error_10ms, ecu-extract-reference=TopLevelCompositionPrototype.Med_Prototype.PP_Dem_CBStatusEvt_DEM_DTC_EPS_Message_Alive_Counter_Error_10ms
      PP_Dem_CBStatusEvt_DEM_DTC_EPS_Message_Alive_Counter_Error_20ms_1726: upstream-reference=TopLevelComposition.Med_Prototype.PP_Dem_CBStatusEvt_DEM_DTC_EPS_Message_Alive_Counter_Error_20ms, ecu-extract-reference=TopLevelCompositionPrototype.Med_Prototype.PP_Dem_CBStatusEvt_DEM_DTC_EPS_Message_Alive_Counter_Error_20ms
      PP_Dem_CBStatusEvt_DEM_DTC_EPS_Pinionang_Fault_1727: upstream-reference=TopLevelComposition.Med_Prototype.PP_Dem_CBStatusEvt_DEM_DTC_EPS_Pinionang_Fault, ecu-extract-reference=TopLevelCompositionPrototype.Med_Prototype.PP_Dem_CBStatusEvt_DEM_DTC_EPS_Pinionang_Fault
      PP_Dem_CBStatusEvt_DEM_DTC_EPS_Pinionang_Invld_1728: upstream-reference=TopLevelComposition.Med_Prototype.PP_Dem_CBStatusEvt_DEM_DTC_EPS_Pinionang_Invld, ecu-extract-reference=TopLevelCompositionPrototype.Med_Prototype.PP_Dem_CBStatusEvt_DEM_DTC_EPS_Pinionang_Invld
      PP_Dem_CBStatusEvt_DEM_DTC_EPS_Sas_NOT_Cal_1729: upstream-reference=TopLevelComposition.Med_Prototype.PP_Dem_CBStatusEvt_DEM_DTC_EPS_Sas_NOT_Cal, ecu-extract-reference=TopLevelCompositionPrototype.Med_Prototype.PP_Dem_CBStatusEvt_DEM_DTC_EPS_Sas_NOT_Cal
      PP_Dem_CBStatusEvt_DEM_DTC_EPS_Steer_AgSens_Fault_1730: upstream-reference=TopLevelComposition.Med_Prototype.PP_Dem_CBStatusEvt_DEM_DTC_EPS_Steer_AgSens_Fault, ecu-extract-reference=TopLevelCompositionPrototype.Med_Prototype.PP_Dem_CBStatusEvt_DEM_DTC_EPS_Steer_AgSens_Fault
      PP_Dem_CBStatusEvt_DEM_DTC_EPS_Steering_wheelvibration_failure_1731: upstream-reference=TopLevelComposition.Med_Prototype.PP_Dem_CBStatusEvt_DEM_DTC_EPS_Steering_wheelvibration_failure, ecu-extract-reference=TopLevelCompositionPrototype.Med_Prototype.PP_Dem_CBStatusEvt_DEM_DTC_EPS_Steering_wheelvibration_failure
      PP_Dem_CBStatusEvt_DEM_DTC_ESP_ABA_NOT_Available_1732: upstream-reference=TopLevelComposition.Med_Prototype.PP_Dem_CBStatusEvt_DEM_DTC_ESP_ABA_NOT_Available, ecu-extract-reference=TopLevelCompositionPrototype.Med_Prototype.PP_Dem_CBStatusEvt_DEM_DTC_ESP_ABA_NOT_Available
      PP_Dem_CBStatusEvt_DEM_DTC_ESP_ABS_Fault_1733: upstream-reference=TopLevelComposition.Med_Prototype.PP_Dem_CBStatusEvt_DEM_DTC_ESP_ABS_Fault, ecu-extract-reference=TopLevelCompositionPrototype.Med_Prototype.PP_Dem_CBStatusEvt_DEM_DTC_ESP_ABS_Fault
      PP_Dem_CBStatusEvt_DEM_DTC_ESP_AEB_NOT_Available_1734: upstream-reference=TopLevelComposition.Med_Prototype.PP_Dem_CBStatusEvt_DEM_DTC_ESP_AEB_NOT_Available, ecu-extract-reference=TopLevelCompositionPrototype.Med_Prototype.PP_Dem_CBStatusEvt_DEM_DTC_ESP_AEB_NOT_Available
      PP_Dem_CBStatusEvt_DEM_DTC_ESP_AWB_NOT_Available_1735: upstream-reference=TopLevelComposition.Med_Prototype.PP_Dem_CBStatusEvt_DEM_DTC_ESP_AWB_NOT_Available, ecu-extract-reference=TopLevelCompositionPrototype.Med_Prototype.PP_Dem_CBStatusEvt_DEM_DTC_ESP_AWB_NOT_Available
      PP_Dem_CBStatusEvt_DEM_DTC_ESP_All_Node_Missing_1736: upstream-reference=TopLevelComposition.Med_Prototype.PP_Dem_CBStatusEvt_DEM_DTC_ESP_All_Node_Missing, ecu-extract-reference=TopLevelCompositionPrototype.Med_Prototype.PP_Dem_CBStatusEvt_DEM_DTC_ESP_All_Node_Missing
      PP_Dem_CBStatusEvt_DEM_DTC_ESP_Lat_Accel_Invld_1737: upstream-reference=TopLevelComposition.Med_Prototype.PP_Dem_CBStatusEvt_DEM_DTC_ESP_Lat_Accel_Invld, ecu-extract-reference=TopLevelCompositionPrototype.Med_Prototype.PP_Dem_CBStatusEvt_DEM_DTC_ESP_Lat_Accel_Invld
      PP_Dem_CBStatusEvt_DEM_DTC_ESP_Long_Accel_Invld_1738: upstream-reference=TopLevelComposition.Med_Prototype.PP_Dem_CBStatusEvt_DEM_DTC_ESP_Long_Accel_Invld, ecu-extract-reference=TopLevelCompositionPrototype.Med_Prototype.PP_Dem_CBStatusEvt_DEM_DTC_ESP_Long_Accel_Invld
      PP_Dem_CBStatusEvt_DEM_DTC_ESP_Message_Alive_Counter_Error_1739: upstream-reference=TopLevelComposition.Med_Prototype.PP_Dem_CBStatusEvt_DEM_DTC_ESP_Message_Alive_Counter_Error, ecu-extract-reference=TopLevelCompositionPrototype.Med_Prototype.PP_Dem_CBStatusEvt_DEM_DTC_ESP_Message_Alive_Counter_Error
      PP_Dem_CBStatusEvt_DEM_DTC_ESP_Message_Alive_Counter_Error_100ms_1740: upstream-reference=TopLevelComposition.Med_Prototype.PP_Dem_CBStatusEvt_DEM_DTC_ESP_Message_Alive_Counter_Error_100ms, ecu-extract-reference=TopLevelCompositionPrototype.Med_Prototype.PP_Dem_CBStatusEvt_DEM_DTC_ESP_Message_Alive_Counter_Error_100ms
      PP_Dem_CBStatusEvt_DEM_DTC_ESP_TCS_Fault_1741: upstream-reference=TopLevelComposition.Med_Prototype.PP_Dem_CBStatusEvt_DEM_DTC_ESP_TCS_Fault, ecu-extract-reference=TopLevelCompositionPrototype.Med_Prototype.PP_Dem_CBStatusEvt_DEM_DTC_ESP_TCS_Fault
      PP_Dem_CBStatusEvt_DEM_DTC_ESP_Veh_Spd_Invld_1742: upstream-reference=TopLevelComposition.Med_Prototype.PP_Dem_CBStatusEvt_DEM_DTC_ESP_Veh_Spd_Invld, ecu-extract-reference=TopLevelCompositionPrototype.Med_Prototype.PP_Dem_CBStatusEvt_DEM_DTC_ESP_Veh_Spd_Invld
      PP_Dem_CBStatusEvt_DEM_DTC_ESP_Yaw_Rate_Invld_1743: upstream-reference=TopLevelComposition.Med_Prototype.PP_Dem_CBStatusEvt_DEM_DTC_ESP_Yaw_Rate_Invld, ecu-extract-reference=TopLevelCompositionPrototype.Med_Prototype.PP_Dem_CBStatusEvt_DEM_DTC_ESP_Yaw_Rate_Invld
      PP_Dem_CBStatusEvt_DEM_DTC_Esp_Ebd_Failr_1744: upstream-reference=TopLevelComposition.Med_Prototype.PP_Dem_CBStatusEvt_DEM_DTC_Esp_Ebd_Failr, ecu-extract-reference=TopLevelCompositionPrototype.Med_Prototype.PP_Dem_CBStatusEvt_DEM_DTC_Esp_Ebd_Failr
      PP_Dem_CBStatusEvt_DEM_DTC_FR_All_Node_Missing_1745: upstream-reference=TopLevelComposition.Med_Prototype.PP_Dem_CBStatusEvt_DEM_DTC_FR_All_Node_Missing, ecu-extract-reference=TopLevelCompositionPrototype.Med_Prototype.PP_Dem_CBStatusEvt_DEM_DTC_FR_All_Node_Missing
      PP_Dem_CBStatusEvt_DEM_DTC_Fradar_hardware_error_1746: upstream-reference=TopLevelComposition.Med_Prototype.PP_Dem_CBStatusEvt_DEM_DTC_Fradar_hardware_error, ecu-extract-reference=TopLevelCompositionPrototype.Med_Prototype.PP_Dem_CBStatusEvt_DEM_DTC_Fradar_hardware_error
      PP_Dem_CBStatusEvt_DEM_DTC_Fradar_not_calibration_or_blockage_1747: upstream-reference=TopLevelComposition.Med_Prototype.PP_Dem_CBStatusEvt_DEM_DTC_Fradar_not_calibration_or_blockage, ecu-extract-reference=TopLevelCompositionPrototype.Med_Prototype.PP_Dem_CBStatusEvt_DEM_DTC_Fradar_not_calibration_or_blockage
      PP_Dem_CBStatusEvt_DEM_DTC_Front_Radar_Alive_Counter_Error_1748: upstream-reference=TopLevelComposition.Med_Prototype.PP_Dem_CBStatusEvt_DEM_DTC_Front_Radar_Alive_Counter_Error, ecu-extract-reference=TopLevelCompositionPrototype.Med_Prototype.PP_Dem_CBStatusEvt_DEM_DTC_Front_Radar_Alive_Counter_Error
      PP_Dem_CBStatusEvt_DEM_DTC_IB_Brk_Pedl_Invld_1749: upstream-reference=TopLevelComposition.Med_Prototype.PP_Dem_CBStatusEvt_DEM_DTC_IB_Brk_Pedl_Invld, ecu-extract-reference=TopLevelCompositionPrototype.Med_Prototype.PP_Dem_CBStatusEvt_DEM_DTC_IB_Brk_Pedl_Invld
      PP_Dem_CBStatusEvt_DEM_DTC_IP_message_alive_counter_error_1750: upstream-reference=TopLevelComposition.Med_Prototype.PP_Dem_CBStatusEvt_DEM_DTC_IP_message_alive_counter_error, ecu-extract-reference=TopLevelCompositionPrototype.Med_Prototype.PP_Dem_CBStatusEvt_DEM_DTC_IP_message_alive_counter_error
      PP_Dem_CBStatusEvt_DEM_DTC_IP_node_missing_1751: upstream-reference=TopLevelComposition.Med_Prototype.PP_Dem_CBStatusEvt_DEM_DTC_IP_node_missing, ecu-extract-reference=TopLevelCompositionPrototype.Med_Prototype.PP_Dem_CBStatusEvt_DEM_DTC_IP_node_missing
      PP_Dem_CBStatusEvt_DEM_DTC_IP_warning_invalid_1752: upstream-reference=TopLevelComposition.Med_Prototype.PP_Dem_CBStatusEvt_DEM_DTC_IP_warning_invalid, ecu-extract-reference=TopLevelCompositionPrototype.Med_Prototype.PP_Dem_CBStatusEvt_DEM_DTC_IP_warning_invalid
      PP_Dem_CBStatusEvt_DEM_DTC_J3_Camera_Blockage_1753: upstream-reference=TopLevelComposition.Med_Prototype.PP_Dem_CBStatusEvt_DEM_DTC_J3_Camera_Blockage, ecu-extract-reference=TopLevelCompositionPrototype.Med_Prototype.PP_Dem_CBStatusEvt_DEM_DTC_J3_Camera_Blockage
      PP_Dem_CBStatusEvt_DEM_DTC_J3_Camera_Error_1754: upstream-reference=TopLevelComposition.Med_Prototype.PP_Dem_CBStatusEvt_DEM_DTC_J3_Camera_Error, ecu-extract-reference=TopLevelCompositionPrototype.Med_Prototype.PP_Dem_CBStatusEvt_DEM_DTC_J3_Camera_Error
      PP_Dem_CBStatusEvt_DEM_DTC_J3_SOC_CPU_Error_PWM_Missing_1755: upstream-reference=TopLevelComposition.Med_Prototype.PP_Dem_CBStatusEvt_DEM_DTC_J3_SOC_CPU_Error_PWM_Missing, ecu-extract-reference=TopLevelCompositionPrototype.Med_Prototype.PP_Dem_CBStatusEvt_DEM_DTC_J3_SOC_CPU_Error_PWM_Missing
      PP_Dem_CBStatusEvt_DEM_DTC_J3_SOC_Perception_Error_1756: upstream-reference=TopLevelComposition.Med_Prototype.PP_Dem_CBStatusEvt_DEM_DTC_J3_SOC_Perception_Error, ecu-extract-reference=TopLevelCompositionPrototype.Med_Prototype.PP_Dem_CBStatusEvt_DEM_DTC_J3_SOC_Perception_Error
      PP_Dem_CBStatusEvt_DEM_DTC_J3_SOC_Safetylib_Error_1757: upstream-reference=TopLevelComposition.Med_Prototype.PP_Dem_CBStatusEvt_DEM_DTC_J3_SOC_Safetylib_Error, ecu-extract-reference=TopLevelCompositionPrototype.Med_Prototype.PP_Dem_CBStatusEvt_DEM_DTC_J3_SOC_Safetylib_Error
      PP_Dem_CBStatusEvt_DEM_DTC_J3_SOC_System_Service_Error_1758: upstream-reference=TopLevelComposition.Med_Prototype.PP_Dem_CBStatusEvt_DEM_DTC_J3_SOC_System_Service_Error, ecu-extract-reference=TopLevelCompositionPrototype.Med_Prototype.PP_Dem_CBStatusEvt_DEM_DTC_J3_SOC_System_Service_Error
      PP_Dem_CBStatusEvt_DEM_DTC_J3_Time_Sync_Error_1759: upstream-reference=TopLevelComposition.Med_Prototype.PP_Dem_CBStatusEvt_DEM_DTC_J3_Time_Sync_Error, ecu-extract-reference=TopLevelCompositionPrototype.Med_Prototype.PP_Dem_CBStatusEvt_DEM_DTC_J3_Time_Sync_Error
      PP_Dem_CBStatusEvt_DEM_DTC_MCU_TEMP_INITIAL_HIGH_1760: upstream-reference=TopLevelComposition.Med_Prototype.PP_Dem_CBStatusEvt_DEM_DTC_MCU_TEMP_INITIAL_HIGH, ecu-extract-reference=TopLevelCompositionPrototype.Med_Prototype.PP_Dem_CBStatusEvt_DEM_DTC_MCU_TEMP_INITIAL_HIGH
      PP_Dem_CBStatusEvt_DEM_DTC_Private_CAN_Bus_Off_1761: upstream-reference=TopLevelComposition.Med_Prototype.PP_Dem_CBStatusEvt_DEM_DTC_Private_CAN_Bus_Off, ecu-extract-reference=TopLevelCompositionPrototype.Med_Prototype.PP_Dem_CBStatusEvt_DEM_DTC_Private_CAN_Bus_Off
      PP_Dem_CBStatusEvt_DEM_DTC_Public_CAN_Bus_Off_1762: upstream-reference=TopLevelComposition.Med_Prototype.PP_Dem_CBStatusEvt_DEM_DTC_Public_CAN_Bus_Off, ecu-extract-reference=TopLevelCompositionPrototype.Med_Prototype.PP_Dem_CBStatusEvt_DEM_DTC_Public_CAN_Bus_Off
      PP_Dem_CBStatusEvt_DEM_DTC_RLR_Message_Alive_Counter_Error_1763: upstream-reference=TopLevelComposition.Med_Prototype.PP_Dem_CBStatusEvt_DEM_DTC_RLR_Message_Alive_Counter_Error, ecu-extract-reference=TopLevelCompositionPrototype.Med_Prototype.PP_Dem_CBStatusEvt_DEM_DTC_RLR_Message_Alive_Counter_Error
      PP_Dem_CBStatusEvt_DEM_DTC_SRS_All_Node_Missing_1764: upstream-reference=TopLevelComposition.Med_Prototype.PP_Dem_CBStatusEvt_DEM_DTC_SRS_All_Node_Missing, ecu-extract-reference=TopLevelCompositionPrototype.Med_Prototype.PP_Dem_CBStatusEvt_DEM_DTC_SRS_All_Node_Missing
      PP_Dem_CBStatusEvt_DEM_DTC_SRS_Drvr_BucSwt_Invld_1765: upstream-reference=TopLevelComposition.Med_Prototype.PP_Dem_CBStatusEvt_DEM_DTC_SRS_Drvr_BucSwt_Invld, ecu-extract-reference=TopLevelCompositionPrototype.Med_Prototype.PP_Dem_CBStatusEvt_DEM_DTC_SRS_Drvr_BucSwt_Invld
      PP_Dem_CBStatusEvt_DEM_DTC_SRS_Message_Alive_Counter_Error_1766: upstream-reference=TopLevelComposition.Med_Prototype.PP_Dem_CBStatusEvt_DEM_DTC_SRS_Message_Alive_Counter_Error, ecu-extract-reference=TopLevelCompositionPrototype.Med_Prototype.PP_Dem_CBStatusEvt_DEM_DTC_SRS_Message_Alive_Counter_Error
      PP_Dem_CBStatusEvt_DEM_DTC_VCU_Accr_Pedl_Posn_Invld_1767: upstream-reference=TopLevelComposition.Med_Prototype.PP_Dem_CBStatusEvt_DEM_DTC_VCU_Accr_Pedl_Posn_Invld, ecu-extract-reference=TopLevelCompositionPrototype.Med_Prototype.PP_Dem_CBStatusEvt_DEM_DTC_VCU_Accr_Pedl_Posn_Invld
      PP_Dem_CBStatusEvt_DEM_DTC_VCU_All_Node_Missing_1768: upstream-reference=TopLevelComposition.Med_Prototype.PP_Dem_CBStatusEvt_DEM_DTC_VCU_All_Node_Missing, ecu-extract-reference=TopLevelCompositionPrototype.Med_Prototype.PP_Dem_CBStatusEvt_DEM_DTC_VCU_All_Node_Missing
      PP_Dem_CBStatusEvt_DEM_DTC_VCU_Gear_Posn_Invld_1769: upstream-reference=TopLevelComposition.Med_Prototype.PP_Dem_CBStatusEvt_DEM_DTC_VCU_Gear_Posn_Invld, ecu-extract-reference=TopLevelCompositionPrototype.Med_Prototype.PP_Dem_CBStatusEvt_DEM_DTC_VCU_Gear_Posn_Invld
      PP_Dem_CBStatusEvt_DEM_DTC_VCU_Message_Alive_Counter_Error_1770: upstream-reference=TopLevelComposition.Med_Prototype.PP_Dem_CBStatusEvt_DEM_DTC_VCU_Message_Alive_Counter_Error, ecu-extract-reference=TopLevelCompositionPrototype.Med_Prototype.PP_Dem_CBStatusEvt_DEM_DTC_VCU_Message_Alive_Counter_Error
      PP_Dem_CBStatusEvt_DEM_DTC_Whl_Spd_Data_Invld_1771: upstream-reference=TopLevelComposition.Med_Prototype.PP_Dem_CBStatusEvt_DEM_DTC_Whl_Spd_Data_Invld, ecu-extract-reference=TopLevelCompositionPrototype.Med_Prototype.PP_Dem_CBStatusEvt_DEM_DTC_Whl_Spd_Data_Invld
      PP_Dem_CBStatusEvt_DEM_DTC_Whl_Spd_Dir_Invld_1772: upstream-reference=TopLevelComposition.Med_Prototype.PP_Dem_CBStatusEvt_DEM_DTC_Whl_Spd_Dir_Invld, ecu-extract-reference=TopLevelCompositionPrototype.Med_Prototype.PP_Dem_CBStatusEvt_DEM_DTC_Whl_Spd_Dir_Invld
      PP_Dem_CBStatusEvt_DEM_DTC_Whl_Spd_Pls_Invld_1773: upstream-reference=TopLevelComposition.Med_Prototype.PP_Dem_CBStatusEvt_DEM_DTC_Whl_Spd_Pls_Invld, ecu-extract-reference=TopLevelCompositionPrototype.Med_Prototype.PP_Dem_CBStatusEvt_DEM_DTC_Whl_Spd_Pls_Invld
      PP_Dem_CBStatusEvt_DEM_J3_SYS_KERNEL_SW_1774: upstream-reference=TopLevelComposition.Med_Prototype.PP_Dem_CBStatusEvt_DEM_J3_SYS_KERNEL_SW, ecu-extract-reference=TopLevelCompositionPrototype.Med_Prototype.PP_Dem_CBStatusEvt_DEM_J3_SYS_KERNEL_SW
      PP_Dem_CBStatusEvt_DEM_MCU_TEMP_EXT_HIGH_1775: upstream-reference=TopLevelComposition.Med_Prototype.PP_Dem_CBStatusEvt_DEM_MCU_TEMP_EXT_HIGH, ecu-extract-reference=TopLevelCompositionPrototype.Med_Prototype.PP_Dem_CBStatusEvt_DEM_MCU_TEMP_EXT_HIGH
      PP_Dem_CBStatusEvt_DEM_MCU_TEMP_EXT_LOW_1776: upstream-reference=TopLevelComposition.Med_Prototype.PP_Dem_CBStatusEvt_DEM_MCU_TEMP_EXT_LOW, ecu-extract-reference=TopLevelCompositionPrototype.Med_Prototype.PP_Dem_CBStatusEvt_DEM_MCU_TEMP_EXT_LOW
      PP_Dem_CBStatusEvt_DEM_SOCJ3_TEMP_EXT_HIGH_1777: upstream-reference=TopLevelComposition.Med_Prototype.PP_Dem_CBStatusEvt_DEM_SOCJ3_TEMP_EXT_HIGH, ecu-extract-reference=TopLevelCompositionPrototype.Med_Prototype.PP_Dem_CBStatusEvt_DEM_SOCJ3_TEMP_EXT_HIGH
      PP_Dem_CBStatusEvt_DEM_VMON_BATT_HIGH_1778: upstream-reference=TopLevelComposition.Med_Prototype.PP_Dem_CBStatusEvt_DEM_VMON_BATT_HIGH, ecu-extract-reference=TopLevelCompositionPrototype.Med_Prototype.PP_Dem_CBStatusEvt_DEM_VMON_BATT_HIGH
      PP_Dem_CBStatusEvt_DEM_VMON_BATT_LOW_1779: upstream-reference=TopLevelComposition.Med_Prototype.PP_Dem_CBStatusEvt_DEM_VMON_BATT_LOW, ecu-extract-reference=TopLevelCompositionPrototype.Med_Prototype.PP_Dem_CBStatusEvt_DEM_VMON_BATT_LOW
      PP_Dem_CBStatusEvt_SPI_E_HARDWARE_ERROR_1780: upstream-reference=TopLevelComposition.Med_Prototype.PP_Dem_CBStatusEvt_SPI_E_HARDWARE_ERROR, ecu-extract-reference=TopLevelCompositionPrototype.Med_Prototype.PP_Dem_CBStatusEvt_SPI_E_HARDWARE_ERROR
      RP_Cpr_Adas_Data_SRI_Cpr_RxSignal_Adas_1781: upstream-reference=TopLevelComposition.Med_Prototype.RP_Cpr_Adas_Data_SRI_Cpr_RxSignal_Adas, ecu-extract-reference=TopLevelCompositionPrototype.Med_Prototype.RP_Cpr_Adas_Data_SRI_Cpr_RxSignal_Adas
      ACCMode_1782: upstream-reference=TopLevelComposition.Med_Prototype.RP_Cpr_Adas_Data_SRI_Cpr_RxSignal_Adas.ACCMode, ecu-extract-reference=TopLevelCompositionPrototype.Med_Prototype.RP_Cpr_Adas_Data_SRI_Cpr_RxSignal_Adas.ACCMode
      ACCMode_Status_1783: upstream-reference=TopLevelComposition.Med_Prototype.RP_Cpr_Adas_Data_SRI_Cpr_RxSignal_Adas.ACCMode_Status, ecu-extract-reference=TopLevelCompositionPrototype.Med_Prototype.RP_Cpr_Adas_Data_SRI_Cpr_RxSignal_Adas.ACCMode_Status
      FR_RadarFailureStatus_1784: upstream-reference=TopLevelComposition.Med_Prototype.RP_Cpr_Adas_Data_SRI_Cpr_RxSignal_Adas.FR_RadarFailureStatus, ecu-extract-reference=TopLevelCompositionPrototype.Med_Prototype.RP_Cpr_Adas_Data_SRI_Cpr_RxSignal_Adas.FR_RadarFailureStatus
      FR_RadarFailureStatus_Status_1785: upstream-reference=TopLevelComposition.Med_Prototype.RP_Cpr_Adas_Data_SRI_Cpr_RxSignal_Adas.FR_RadarFailureStatus_Status, ecu-extract-reference=TopLevelCompositionPrototype.Med_Prototype.RP_Cpr_Adas_Data_SRI_Cpr_RxSignal_Adas.FR_RadarFailureStatus_Status
      FRadarCalibrationStatus_1786: upstream-reference=TopLevelComposition.Med_Prototype.RP_Cpr_Adas_Data_SRI_Cpr_RxSignal_Adas.FRadarCalibrationStatus, ecu-extract-reference=TopLevelCompositionPrototype.Med_Prototype.RP_Cpr_Adas_Data_SRI_Cpr_RxSignal_Adas.FRadarCalibrationStatus
      FRadarCalibrationStatus_Status_1787: upstream-reference=TopLevelComposition.Med_Prototype.RP_Cpr_Adas_Data_SRI_Cpr_RxSignal_Adas.FRadarCalibrationStatus_Status, ecu-extract-reference=TopLevelCompositionPrototype.Med_Prototype.RP_Cpr_Adas_Data_SRI_Cpr_RxSignal_Adas.FRadarCalibrationStatus_Status
      RadarObj1_Dx_1788: upstream-reference=TopLevelComposition.Med_Prototype.RP_Cpr_Adas_Data_SRI_Cpr_RxSignal_Adas.RadarObj1_Dx, ecu-extract-reference=TopLevelCompositionPrototype.Med_Prototype.RP_Cpr_Adas_Data_SRI_Cpr_RxSignal_Adas.RadarObj1_Dx
      RadarObj1_Dx_Status_1789: upstream-reference=TopLevelComposition.Med_Prototype.RP_Cpr_Adas_Data_SRI_Cpr_RxSignal_Adas.RadarObj1_Dx_Status, ecu-extract-reference=TopLevelCompositionPrototype.Med_Prototype.RP_Cpr_Adas_Data_SRI_Cpr_RxSignal_Adas.RadarObj1_Dx_Status
      RadarObj1_Dy_1790: upstream-reference=TopLevelComposition.Med_Prototype.RP_Cpr_Adas_Data_SRI_Cpr_RxSignal_Adas.RadarObj1_Dy, ecu-extract-reference=TopLevelCompositionPrototype.Med_Prototype.RP_Cpr_Adas_Data_SRI_Cpr_RxSignal_Adas.RadarObj1_Dy
      RadarObj1_Dy_Status_1791: upstream-reference=TopLevelComposition.Med_Prototype.RP_Cpr_Adas_Data_SRI_Cpr_RxSignal_Adas.RadarObj1_Dy_Status, ecu-extract-reference=TopLevelCompositionPrototype.Med_Prototype.RP_Cpr_Adas_Data_SRI_Cpr_RxSignal_Adas.RadarObj1_Dy_Status
      RadarObj1_ExistProb_1792: upstream-reference=TopLevelComposition.Med_Prototype.RP_Cpr_Adas_Data_SRI_Cpr_RxSignal_Adas.RadarObj1_ExistProb, ecu-extract-reference=TopLevelCompositionPrototype.Med_Prototype.RP_Cpr_Adas_Data_SRI_Cpr_RxSignal_Adas.RadarObj1_ExistProb
      RadarObj1_ExistProb_Status_1793: upstream-reference=TopLevelComposition.Med_Prototype.RP_Cpr_Adas_Data_SRI_Cpr_RxSignal_Adas.RadarObj1_ExistProb_Status, ecu-extract-reference=TopLevelCompositionPrototype.Med_Prototype.RP_Cpr_Adas_Data_SRI_Cpr_RxSignal_Adas.RadarObj1_ExistProb_Status
      RadarObj1_Length_1794: upstream-reference=TopLevelComposition.Med_Prototype.RP_Cpr_Adas_Data_SRI_Cpr_RxSignal_Adas.RadarObj1_Length, ecu-extract-reference=TopLevelCompositionPrototype.Med_Prototype.RP_Cpr_Adas_Data_SRI_Cpr_RxSignal_Adas.RadarObj1_Length
      RadarObj1_Length_Status_1795: upstream-reference=TopLevelComposition.Med_Prototype.RP_Cpr_Adas_Data_SRI_Cpr_RxSignal_Adas.RadarObj1_Length_Status, ecu-extract-reference=TopLevelCompositionPrototype.Med_Prototype.RP_Cpr_Adas_Data_SRI_Cpr_RxSignal_Adas.RadarObj1_Length_Status
      RadarObj1_Location_1796: upstream-reference=TopLevelComposition.Med_Prototype.RP_Cpr_Adas_Data_SRI_Cpr_RxSignal_Adas.RadarObj1_Location, ecu-extract-reference=TopLevelCompositionPrototype.Med_Prototype.RP_Cpr_Adas_Data_SRI_Cpr_RxSignal_Adas.RadarObj1_Location
      RadarObj1_Location_Status_1797: upstream-reference=TopLevelComposition.Med_Prototype.RP_Cpr_Adas_Data_SRI_Cpr_RxSignal_Adas.RadarObj1_Location_Status, ecu-extract-reference=TopLevelCompositionPrototype.Med_Prototype.RP_Cpr_Adas_Data_SRI_Cpr_RxSignal_Adas.RadarObj1_Location_Status
      RadarObj1_Measured_1798: upstream-reference=TopLevelComposition.Med_Prototype.RP_Cpr_Adas_Data_SRI_Cpr_RxSignal_Adas.RadarObj1_Measured, ecu-extract-reference=TopLevelCompositionPrototype.Med_Prototype.RP_Cpr_Adas_Data_SRI_Cpr_RxSignal_Adas.RadarObj1_Measured
      RadarObj1_Measured_Status_1799: upstream-reference=TopLevelComposition.Med_Prototype.RP_Cpr_Adas_Data_SRI_Cpr_RxSignal_Adas.RadarObj1_Measured_Status, ecu-extract-reference=TopLevelCompositionPrototype.Med_Prototype.RP_Cpr_Adas_Data_SRI_Cpr_RxSignal_Adas.RadarObj1_Measured_Status
      RadarObj1_RelAx_1800: upstream-reference=TopLevelComposition.Med_Prototype.RP_Cpr_Adas_Data_SRI_Cpr_RxSignal_Adas.RadarObj1_RelAx, ecu-extract-reference=TopLevelCompositionPrototype.Med_Prototype.RP_Cpr_Adas_Data_SRI_Cpr_RxSignal_Adas.RadarObj1_RelAx
      RadarObj1_RelAx_Status_1801: upstream-reference=TopLevelComposition.Med_Prototype.RP_Cpr_Adas_Data_SRI_Cpr_RxSignal_Adas.RadarObj1_RelAx_Status, ecu-extract-reference=TopLevelCompositionPrototype.Med_Prototype.RP_Cpr_Adas_Data_SRI_Cpr_RxSignal_Adas.RadarObj1_RelAx_Status
      RadarObj1_RelVx_1802: upstream-reference=TopLevelComposition.Med_Prototype.RP_Cpr_Adas_Data_SRI_Cpr_RxSignal_Adas.RadarObj1_RelVx, ecu-extract-reference=TopLevelCompositionPrototype.Med_Prototype.RP_Cpr_Adas_Data_SRI_Cpr_RxSignal_Adas.RadarObj1_RelVx
      RadarObj1_RelVx_Status_1803: upstream-reference=TopLevelComposition.Med_Prototype.RP_Cpr_Adas_Data_SRI_Cpr_RxSignal_Adas.RadarObj1_RelVx_Status, ecu-extract-reference=TopLevelCompositionPrototype.Med_Prototype.RP_Cpr_Adas_Data_SRI_Cpr_RxSignal_Adas.RadarObj1_RelVx_Status
