AUTOSAR XML (schema 4-0-3)
package /AUTOSAR_I2c/BswModuleDescriptions
  bsw module description I2c: module-id=255, provided-entrys=I2c_Init
    bsw internal behavior InternalBehavior_0
      bsw called entity I2c_Init: implemented-entry=I2c_Init
package /AUTOSAR_I2c/BswModuleEntrys
  bsw module entry I2c_Init: service-id=1000, is-reentrant=false, is-synchronous=true, call-type=REGULAR, execution-context=UNSPECIFIED, sw-service-impl-policy=STANDARD
package /I2c_Aurix2GAS422/Implementations
  bsw implementation BswImplementation_0: programming-language=C, sw-version=20.0.2, vendor-id=17, ar-release-version=4.2.2, behavior=InternalBehavior_0, vendor-specific-module-def=I2c
    code-descriptors:
      code Files: artifact-descriptors=[{short-label=make::I2c_defs.mak, category=SWMAKE}, {short-label=make::I2c_rules.mak, category=SWMAKE}]
    resource consumption ResourceConsumption
      6 x memory section, all with options=coreLocal:
        VAR_CLEARED_QM_LOCAL_8: alignment=8, size=2, sw-addrmethod=VAR_CLEARED_LOCAL
        VAR_CLEARED_QM_LOCAL_32: alignment=32, size=10, sw-addrmethod=VAR_CLEARED_LOCAL
        VAR_CLEARED_QM_LOCAL_UNSPECIFIED: alignment=UNSPECIFIED, size=10, sw-addrmethod=VAR_CLEARED_LOCAL
        CONST_QM_LOCAL_32: alignment=32, size=10, sw-addrmethod=CONST_QM_LOCAL_32
        CONFIG_DATA_QM_LOCAL_UNSPECIFIED: alignment=UNSPECIFIED, size=20, sw-addrmethod=CONFIG_DATA_LOCAL
        CODE_QM_LOCAL: alignment=UNSPECIFIED, size=20, sw-addrmethod=CODE_QM_LOCAL
      section name prefix I2C
