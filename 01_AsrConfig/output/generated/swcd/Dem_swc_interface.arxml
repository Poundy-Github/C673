AUTOSAR XML (schema 4-0-3)
package /AUTOSAR_Dem/CompuMethods
  compu method CM_DebouncingStateType: 1=DEM_TEMPORARILY_DEFECTIVE, 2=DEM_FINALY_DEFECTIVE, 4=DEM_TEMPORARILY_HEALED, 8=DEM_TEST_COMPLETE, 16=DEM_DTR_UPDATE
package /AUTOSAR_Dem/ImplementationDataTypes
  21 x impl type:
    Dem_EventIdType:
      compu {1=DemConf_DemEventParameter_MCU_E_CLOCK_FAILURE, 2=DemConf_DemEventParameter_MCU_E_OSC_FAILURE, 3=DemConf_DemEventParameter_MCU_E_SYSTEM_PLL_TIMEOUT_ERR, 4=DemConf_DemEventParameter_MCU_E_PERIPHERAL_PLL_TIMEOUT_ERR, 5=DemConf_DemEventParameter_MCU_E_SYSTEM_PLL_LOCK_LOSS, 6=DemConf_DemEventParameter_MCU_E_PERIPHERAL_PLL_LOCK_LOSS, 7=DemConf_DemEventParameter_MCU_E_GTM_CLC_ENABLE_ERR, 8=DemConf_DemEventParameter_MCU_E_GTM_CLC_DISABLE_ERR, 9=DemConf_DemEventParameter_MCU_E_CONVCTRL_CLC_ENABLE_ERR, 10=DemConf_DemEventParameter_MCU_E_CONVCTRL_CLC_DISABLE_ERR, 11=DemConf_DemEventParameter_MCU_E_CCUCON_UPDATE_ERR, 12=DemConf_DemEventParameter_MCU_E_CCU6_CLC_ENABLE_ERR, 13=DemConf_DemEventParameter_MCU_E_CCU6_CLC_DISABLE_ERR, 14=DemConf_DemEventParameter_MCU_E_GPT12_CLC_ENABLE_ERR, 15=DemConf_DemEventParameter_MCU_E_GPT12_CLC_DISABLE_ERR, 16=DemConf_DemEventParameter_MCU_E_PMSWCR_UPDATE_ERR, 17=DemConf_DemEventParameter_CANSM_BUSOFF_PublicCAN, 18=DemConf_DemEventParameter_SPI_E_HARDWARE_ERROR, 19=DemConf_DemEventParameter_DEM_VMON_BATT_HIGH, 20=DemConf_DemEventParameter_DEM_VMON_BATT_LOW, 21=DemConf_DemEventParameter_DEM_MCU_TEMP_EXT_HIGH, 22=DemConf_DemEventParameter_DEM_MCU_TEMP_EXT_LOW, 23=DemConf_DemEventParameter_DEM_SOCJ3_TEMP_EXT_HIGH, 24=DemConf_DemEventParameter_DEM_J3_SYS_KERNEL_SW, 25=DemConf_DemEventParameter_AdcClcFailureNotification, 26=DemConf_DemEventParameter_AdcConvStopTimeNotification, 27=DemConf_DemEventParameter_FEE_E_GC_INIT, 28=DemConf_DemEventParameter_FEE_E_WRITE, 29=DemConf_DemEventParameter_FEE_E_READ, 30=DemConf_DemEventParameter_FEE_E_GC_READ, 31=DemConf_DemEventParameter_FEE_E_GC_WRITE, 32=DemConf_DemEventParameter_FEE_E_GC_ERASE, 33=DemConf_DemEventParameter_FEE_E_INVALIDATE, 34=DemConf_DemEventParameter_FEE_E_WRITE_CYCLES_EXHAUSTED, 35=DemConf_DemEventParameter_FEE_E_GC_TRIG, 36=DemConf_DemEventParameter_FEE_E_UNCONFIG_BLK_EXCEEDED, 37=DemConf_DemEventParameter_FLS_E_COMPARE_FAILED, 38=DemConf_DemEventParameter_FLS_E_ERASE_FAILED, 39=DemConf_DemEventParameter_FLS_E_READ_FAILED, 40=DemConf_DemEventParameter_FLS_E_UNEXPECTED_FLASH_ID, 41=DemConf_DemEventParameter_FLS_E_WRITE_FAILED, 42=DemConf_DemEventParameter_DEM_CAMERA_CALIBRATION_FAILURE, 43=DemConf_DemEventParameter_DEM_CAMERA_ONLINE_CALIBRATION_FAILURE, 44=DemConf_DemEventParameter_CANSM_BUSOFF_PrivateCAN, 45=DemConf_DemEventParameter_DEM_DTC_VCU_Accr_Pedl_Posn_Invld, 46=DemConf_DemEventParameter_DEM_DTC_VCU_Gear_Posn_Invld, 47=DemConf_DemEventParameter_DEM_DTC_BCM_Turn_Indcr_Light_Fault, 48=DemConf_DemEventParameter_DEM_DTC_BCM_Frnt_Wiper_Sts_Fault, 49=DemConf_DemEventParameter_DEM_DTC_ESP_Veh_Spd_Invld, 50=DemConf_DemEventParameter_DEM_DTC_Whl_Spd_Pls_Invld, 51=DemConf_DemEventParameter_DEM_DTC_Whl_Spd_Dir_Invld, 52=DemConf_DemEventParameter_DEM_DTC_Whl_Spd_Data_Invld, 53=DemConf_DemEventParameter_DEM_DTC_EPS_Sas_NOT_Cal, 54=DemConf_DemEventParameter_DEM_DTC_EPS_Actual_Motor_Torq_Invld, 55=DemConf_DemEventParameter_DEM_DTC_ESP_Lat_Accel_Invld, 56=DemConf_DemEventParameter_DEM_DTC_ESP_Long_Accel_Invld, 57=DemConf_DemEventParameter_DEM_DTC_ESP_Yaw_Rate_Invld, 58=DemConf_DemEventParameter_DEM_DTC_EPS_Fault, 59=DemConf_DemEventParameter_DEM_DTC_VCU_All_Node_Missing, 60=DemConf_DemEventParameter_DEM_DTC_ESP_All_Node_Missing, 61=DemConf_DemEventParameter_DEM_DTC_EPS_All_Node_Missing, 62=DemConf_DemEventParameter_DEM_DTC_VCU_Message_Alive_Counter_Error, 63=DemConf_DemEventParameter_DEM_DTC_ESP_Message_Alive_Counter_Error, 64=DemConf_DemEventParameter_DEM_DTC_EPS_Message_Alive_Counter_Error_10ms, 65=DemConf_DemEventParameter_DEM_DTC_Front_Radar_Alive_Counter_Error, 66=DemConf_DemEventParameter_DEM_DTC_ESP_ABS_Fault, 67=DemConf_DemEventParameter_DEM_DTC_ESP_TCS_Fault, 68=DemConf_DemEventParameter_DEM_DTC_ESP_ABA_NOT_Available, 69=DemConf_DemEventParameter_DEM_DTC_ESP_AEB_NOT_Available, 70=DemConf_DemEventParameter_DEM_DTC_ESP_AWB_NOT_Available, 71=DemConf_DemEventParameter_DEM_DTC_IB_Brk_Pedl_Invld, 72=DemConf_DemEventParameter_DEM_DTC_EPS_Actual_Torsion_Torq_Invld, 73=DemConf_DemEventParameter_DEM_DTC_EPS_Actual_Motor_Invld, 74=DemConf_DemEventParameter_DEM_DTC_EPS_Steer_AgSens_Fault, 75=DemConf_DemEventParameter_DEM_DTC_SRS_Drvr_BucSwt_Invld, 76=DemConf_DemEventParameter_DEM_DTC_EPS_Pinionang_Invld, 77=DemConf_DemEventParameter_DEM_DTC_EPS_Pinionang_Fault, 78=DemConf_DemEventParameter_DEM_DTC_EPS_APA_Epas_Fault, 79=DemConf_DemEventParameter_DEM_DTC_BCM_EmgyLi_Fault, 80=DemConf_DemEventParameter_DEM_DTC_BCM_All_Node_Missing, 81=DemConf_DemEventParameter_DEM_DTC_BCM_Message_Alive_Counter_Error_40ms, 82=DemConf_DemEventParameter_DEM_DTC_J3_Camera_Blockage, 83=DemConf_DemEventParameter_DEM_DTC_Private_CAN_Bus_Off, 84=DemConf_DemEventParameter_DEM_DTC_Public_CAN_Bus_Off, 85=DemConf_DemEventParameter_DEM_DTC_Ethernet_Unexpected_Link_Down, 86=DemConf_DemEventParameter_DEM_DTC_J3_SoC_ETH_IP_Ubnormal, 87=DemConf_DemEventParameter_ECUM_E_RAM_CHECK_FAILED, 88=DemConf_DemEventParameter_DEM_DTC_J3_SOC_Safetylib_Error, 89=DemConf_DemEventParameter_DEM_DTC_EPS_Steering_wheel_vibration_failure, 90=DemConf_DemEventParameter_DEM_DTC_EPS_Driver_hand_torque_invalid, 91=DemConf_DemEventParameter_DEM_DTC_IP_warning_invalid, 92=DemConf_DemEventParameter_DEM_DTC_IP_node_missing, 93=DemConf_DemEventParameter_DEM_DTC_IP_message_alive_counter_error, 94=DemConf_DemEventParameter_DEM_DTC_Fradar_not_calibration_or_blockage, 95=DemConf_DemEventParameter_DEM_DTC_Fradar_hardware_error, 96=DemConf_DemEventParameter_DEM_DTC_SRS_All_Node_Missing, 97=DemConf_DemEventParameter_DEM_DTC_ADC_Message_Alive_Counter_Error, 98=DemConf_DemEventParameter_DEM_DTC_RLR_Message_Alive_Counter_Error, 99=DemConf_DemEventParameter_DEM_DTC_SRS_Message_Alive_Counter_Error, 100=DemConf_DemEventParameter_DEM_DTC_EPS_Message_Alive_Counter_Error_20ms, 101=DemConf_DemEventParameter_DEM_DTC_BCM_Message_Alive_Counter_Error_100ms, 102=DemConf_DemEventParameter_DEM_DTC_Private_CAN_Bus_Off_TOCAN, 103=DemConf_DemEventParameter_DEM_DTC_Public_CAN_Bus_Off_TOCAN, 104=DemConf_DemEventParameter_DEM_DTC_J3_Heavy_Rain_Detected, 105=DemConf_DemEventParameter_DEM_DTC_J3_Snow_Detected, 106=DemConf_DemEventParameter_DEM_DTC_J3_Low_Sun_Detected, 107=DemConf_DemEventParameter_DEM_DTC_J3_SOC_System_Service_Error, 108=DemConf_DemEventParameter_DEM_DTC_J3_Camera_Error, 109=DemConf_DemEventParameter_DEM_DTC_J3_SOC_CPU_Error_PWM_Missing, 110=DemConf_DemEventParameter_DEM_DTC_J3_SOC_Perception_Error, 111=DemConf_DemEventParameter_DEM_DTC_ETH_CRC_ERROR, 112=DemConf_DemEventParameter_DEM_DTC_ETH_LINK_SIGNAL_WAKE, 113=DemConf_DemEventParameter_DEM_DTC_ETH_CABLE_FAULT, 114=DemConf_DemEventParameter_DEM_DTC_ETH_ICMP_ERROR, 115=DemConf_DemEventParameter_DEM_DTC_SPI_DRIVER_ERROR, 116=DemConf_DemEventParameter_DEM_DTC_DFLASH_ERROR, 117=DemConf_DemEventParameter_DEM_DTC_BCM_Brake_Lamp_Error, 118=DemConf_DemEventParameter_DEM_DTC_Esp_Ebd_Failr, 119=DemConf_DemEventParameter_DEM_DTC_FR_All_Node_Missing, 120=DemConf_DemEventParameter_DEM_DTC_ADC_All_Node_Missing, 121=DemConf_DemEventParameter_DEM_DTC_J3_Time_Sync_Error, 122=DemConf_DemEventParameter_NVM_E_INTEGRITY_FAILED, 123=DemConf_DemEventParameter_NVM_E_REQ_FAILED, 124=DemConf_DemEventParameter_NVM_E_WRONG_BLOCK_ID, 125=DemConf_DemEventParameter_NVM_E_VERIFY_FAILED, 126=DemConf_DemEventParameter_NVM_E_WRITE_PROTECTED, 127=DemConf_DemEventParameter_DEM_DTC_MCU_TEMP_INITIAL_HIGH, 128=DemConf_DemEventParameter_DEM_DTC_ESP_Message_Alive_Counter_Error_100ms, 129=DemConf_DemEventParameter_WDG_E_DISABLE_REJECTED, 130=DemConf_DemEventParameter_WDG_E_MODE_FAILED, 131=DemConf_DemEventParameter_SmuActivateRunStateFailureNotification, 132=DemConf_DemEventParameter_SmuClearAlarmStatusFailureNotification, 133=DemConf_DemEventParameter_SmuReleaseFSPFailureNotification, 134=DemConf_DemEventParameter_SmuCoreAliveFailureNotification, 135=DemConf_DemEventParameter_SmuRTStopFailureNotification, 136=DemConf_DemEventParameter_SmuActivatePESFailureNotification, 137=DemConf_DemEventParameter_SmuActivateFSPFailureNotification, 138=DemConf_DemEventParameter_SmuSetAlarmStatusFailureNotification, 139=DemConf_DemEventParameter_SmuSffFailureNotification}
      range raw 1..139
      implementation-data-type=uint16
    Dem_EventStatusType: compu {0=DEM_EVENT_STATUS_PASSED, 1=DEM_EVENT_STATUS_FAILED, 2=DEM_EVENT_STATUS_PREPASSED, 3=DEM_EVENT_STATUS_PREFAILED}, range raw 0..3, implementation-data-type=uint8
    Dem_DebounceResetStatusType: compu {0=DEM_DEBOUNCE_STATUS_FREEZE, 1=DEM_DEBOUNCE_STATUS_RESET}, range raw 0..1, implementation-data-type=uint8
    Dem_EventStatusExtendedType: compu {1=DEM_UDS_STATUS_TF, 2=DEM_UDS_STATUS_TFTOC, 4=DEM_UDS_STATUS_PDTC, 8=DEM_UDS_STATUS_CDTC, 16=DEM_UDS_STATUS_TNCSLC, 32=DEM_UDS_STATUS_TFSLC, 64=DEM_UDS_STATUS_TNCTOC, 128=DEM_UDS_STATUS_WIR}, implementation-data-type=uint8
    Dem_DTCOriginType: compu {1=DEM_DTC_ORIGIN_PRIMARY_MEMORY, 2=DEM_DTC_ORIGIN_MIRROR_MEMORY, 3=DEM_DTC_ORIGIN_PERMANENT_MEMORY, 4=DEM_DTC_ORIGIN_SECONDARY_MEMORY, 0=DEM_DTC_ORIGIN_USERDEFINED_MEMORY_MAPPED_TO_SECONDARY}, range raw 1..4, implementation-data-type=uint16
    Dem_DTCFormatType: compu {0=DEM_DTC_FORMAT_OBD, 1=DEM_DTC_FORMAT_UDS}, range raw 0..1, implementation-data-type=uint8
    Dem_InitMonitorReasonType: compu {1=DEM_INIT_MONITOR_CLEAR, 2=DEM_INIT_MONITOR_RESTART}, range raw 1..2, implementation-data-type=uint8
    Dem_OperationCycleStateType: compu {0=DEM_CYCLE_STATE_START, 1=DEM_CYCLE_STATE_END}, range raw 0..1, implementation-data-type=uint8
    Dem_DTCStatusMaskType: implementation-data-type=uint8
    Dem_IndicatorStatusType: compu {0=DEM_INDICATOR_OFF, 1=DEM_INDICATOR_CONTINUOUS, 2=DEM_INDICATOR_BLINKING, 3=DEM_INDICATOR_BLINK_CONT, 4=DEM_INDICATOR_SLOW_FLASH, 5=DEM_INDICATOR_FAST_FLASH}, range raw 0..5, implementation-data-type=uint8
    Dem_MaxDataValueType: category=ARRAY
      element Dem_MaxDataValueElement: array-size=32, array-size-semantics=FIXED-SIZE, implementation-data-type=uint8
    Dem_DataDemDataElementClass_Odometer_ArrayType: category=ARRAY
      element Dem_DataDemDataElementClass_Odometer_ArrayElement: array-size=4, array-size-semantics=FIXED-SIZE, implementation-data-type=uint8
    Dem_DataDemDataElementClass_Voltage_ArrayType: category=ARRAY
      element Dem_DataDemDataElementClass_Voltage_ArrayElement: array-size=1, array-size-semantics=FIXED-SIZE, implementation-data-type=uint8
    Dem_DataDemDataElementClass_VehicleSpeed_ArrayType: category=ARRAY
      element Dem_DataDemDataElementClass_VehicleSpeed_ArrayElement: array-size=2, array-size-semantics=FIXED-SIZE, implementation-data-type=uint8
    Dem_DataDemDataElementClass_LocalTime_ArrayType: category=ARRAY
      element Dem_DataDemDataElementClass_LocalTime_ArrayElement: array-size=6, array-size-semantics=FIXED-SIZE, implementation-data-type=uint8
    Dem_DataDemDataElementClass_ECUTemperature_ArrayType: category=ARRAY
      element Dem_DataDemDataElementClass_ECUTemperature_ArrayElement: array-size=2, array-size-semantics=FIXED-SIZE, implementation-data-type=uint8
    Dem_DataDemDataElementClass_Yawrate_ArrayType: category=ARRAY
      element Dem_DataDemDataElementClass_Yawrate_ArrayElement: array-size=2, array-size-semantics=FIXED-SIZE, implementation-data-type=uint8
    Dem_DataDemDataElementClass_EngineSpeed_ArrayType: category=ARRAY
      element Dem_DataDemDataElementClass_EngineSpeed_ArrayElement: array-size=2, array-size-semantics=FIXED-SIZE, implementation-data-type=uint8
    Dem_DataDemDataElementClass_GearPosition_ArrayType: category=ARRAY
      element Dem_DataDemDataElementClass_GearPosition_ArrayElement: array-size=1, array-size-semantics=FIXED-SIZE, implementation-data-type=uint8
    Dem_DataDemDataElementClass_SteeringAngle_ArrayType: category=ARRAY
      element Dem_DataDemDataElementClass_SteeringAngle_ArrayElement: array-size=2, array-size-semantics=FIXED-SIZE, implementation-data-type=uint8
    Dem_DataDemDataElementClass_Extended_SystemKernelErrMap_ArrayType: category=ARRAY
      element Dem_DataDemDataElementClass_Extended_SystemKernelErrMap_ArrayElement: array-size=10, array-size-semantics=FIXED-SIZE, implementation-data-type=uint8
package /AUTOSAR_Dem/PortInterfaces
  31 x client server interface, all with is-service=true:
    DiagnosticMonitor
      5 x operation, all with possible-error=DiagnosticMonitor/E_NOT_OK:
        SetEventStatus
          arg EventStatus: type=Dem_EventStatusType, direction=IN
        ResetEventStatus
        ResetEventDebounceStatus
          arg DebounceResetStatus: type=Dem_DebounceResetStatusType, direction=IN
        PrestoreFreezeFrame
        ClearPrestoredFreezeFrame
      error E_NOT_OK: error-code=1
    DiagnosticInfo
      7 x operation:
        GetEventStatus: possible-error=DiagnosticInfo/E_NOT_OK
          arg EventStatusExtended: type=Dem_EventStatusExtendedType, direction=OUT
        GetEventFailed: possible-error=DiagnosticInfo/E_NOT_OK
          arg EventFailed: type=boolean, direction=OUT
        GetEventTested: possible-error=DiagnosticInfo/E_NOT_OK
          arg EventTested: type=boolean, direction=OUT
        GetDTCOfEvent: possible-error=[DiagnosticInfo/E_NOT_OK, DiagnosticInfo/DEM_E_NO_DTC_AVAILABLE]
          arg DTCFormat: type=Dem_DTCFormatType, direction=IN
          arg DTCOfEvent: type=uint32, direction=OUT
        GetFaultDetectionCounter: possible-error=DiagnosticInfo/E_NOT_OK
          arg FaultDetectionCounter: type=sint8, direction=OUT
        GetEventFreezeFrameData: possible-error=DiagnosticInfo/E_NOT_OK
          4 x arg:
            RecordNumber: type=uint8, direction=IN
            ReportTotalRecord: type=boolean, direction=IN
            DataId: type=uint16, direction=IN
            DestBuffer: type=Dem_MaxDataValueType, direction=OUT
        GetEventExtendedDataRecord: possible-error=DiagnosticInfo/E_NOT_OK
          arg RecordNumber: type=uint8, direction=IN
          arg DestBuffer: type=Dem_MaxDataValueType, direction=OUT
      error E_NOT_OK: error-code=1
      error DEM_E_NO_DTC_AVAILABLE: error-code=2
    GeneralDiagnosticInfo
      7 x operation:
        GetEventStatus: possible-error=GeneralDiagnosticInfo/E_NOT_OK
          arg EventId: type=Dem_EventIdType, direction=IN
          arg EventStatusExtended: type=Dem_EventStatusExtendedType, direction=OUT
        GetEventFailed: possible-error=GeneralDiagnosticInfo/E_NOT_OK
          arg EventId: type=Dem_EventIdType, direction=IN
          arg EventFailed: type=boolean, direction=OUT
        GetEventTested: possible-error=GeneralDiagnosticInfo/E_NOT_OK
          arg EventId: type=Dem_EventIdType, direction=IN
          arg EventTested: type=boolean, direction=OUT
        GetDTCOfEvent: possible-error=[GeneralDiagnosticInfo/E_NOT_OK, GeneralDiagnosticInfo/DEM_E_NO_DTC_AVAILABLE]
          arg EventId: type=Dem_EventIdType, direction=IN
          arg DTCFormat: type=Dem_DTCFormatType, direction=IN
          arg DTCOfEvent: type=uint32, direction=OUT
        GetFaultDetectionCounter: possible-error=GeneralDiagnosticInfo/E_NOT_OK
          arg EventId: type=Dem_EventIdType, direction=IN
          arg FaultDetectionCounter: type=sint8, direction=OUT
        GetEventFreezeFrameData: possible-error=GeneralDiagnosticInfo/E_NOT_OK
          5 x arg:
            EventId: type=Dem_EventIdType, direction=IN
            RecordNumber: type=uint8, direction=IN
            ReportTotalRecord: type=boolean, direction=IN
            DataId: type=uint16, direction=IN
            DestBuffer: type=Dem_MaxDataValueType, direction=OUT
        GetEventExtendedDataRecord: possible-error=GeneralDiagnosticInfo/E_NOT_OK
          arg EventId: type=Dem_EventIdType, direction=IN
          arg RecordNumber: type=uint8, direction=IN
          arg DestBuffer: type=Dem_MaxDataValueType, direction=OUT
      error E_NOT_OK: error-code=1
      error DEM_E_NO_DTC_AVAILABLE: error-code=2
    OperationCycle
      operation SetOperationCycleState: possible-error=OperationCycle/E_NOT_OK
        arg CycleState: type=Dem_OperationCycleStateType, direction=IN
      operation SetCycleQualified: possible-error=OperationCycle/E_NOT_OK
      error E_NOT_OK: error-code=1
    AgingCycle
      operation SetAgingCycleState: possible-error=AgingCycle/E_NOT_OK
      error E_NOT_OK: error-code=1
    ExternalAgingCycle
      operation SetAgingCycleCounterValue: possible-error=ExternalAgingCycle/E_NOT_OK
        arg CounterValue: type=uint8, direction=IN
      error E_NOT_OK: error-code=1
    EnableCondition
      operation SetEnableCondition: possible-error=EnableCondition/E_NOT_OK
        arg ConditionFulfilled: type=boolean, direction=IN
      error E_NOT_OK: error-code=1
    StorageCondition
      operation SetStorageCondition: possible-error=StorageCondition/E_NOT_OK
        arg ConditionFulfilled: type=boolean, direction=IN
      error E_NOT_OK: error-code=1
    IndicatorStatus
      operation GetIndicatorStatus: possible-error=IndicatorStatus/E_NOT_OK
        arg IndicatorStatus: type=Dem_IndicatorStatusType, direction=OUT
      error E_NOT_OK: error-code=1
    EvMemOverflowIndication
      operation GetEventMemoryOverflow: possible-error=EvMemOverflowIndication/E_NOT_OK
        arg OverflowIndication: type=boolean, direction=OUT
      operation GetNumberOfEventMemoryEntries: possible-error=EvMemOverflowIndication/E_NOT_OK
        arg GetNumberOfEventMemoryEntries: type=uint8, direction=OUT
      error E_NOT_OK: error-code=1
    IUMPRNumerator
      operation RepIUMPRFaultDetect: possible-error=IUMPRNumerator/E_NOT_OK
      error E_NOT_OK: error-code=1
    IUMPRDenominator
      operation RepIUMPRDenLock: possible-error=IUMPRDenominator/E_NOT_OK
      operation RepIUMPRDenRelease: possible-error=IUMPRDenominator/E_NOT_OK
      error E_NOT_OK: error-code=1
    CallbackInitMonitorForEvent
      operation InitMonitorForEvent: possible-error=CallbackInitMonitorForEvent/E_NOT_OK
        arg InitMonitorReason: type=Dem_InitMonitorReasonType, direction=IN
      error E_NOT_OK: error-code=1
    CallbackInitMonitorForFunction
      operation InitMonitorForFunction: possible-error=CallbackInitMonitorForFunction/E_NOT_OK
      error E_NOT_OK: error-code=1
    CallbackEventStatusChange
      operation EventStatusChanged: possible-error=CallbackEventStatusChange/E_NOT_OK
        arg EventStatusOld: type=Dem_EventStatusExtendedType, direction=IN
        arg EventStatusNew: type=Dem_EventStatusExtendedType, direction=IN
      error E_NOT_OK: error-code=1
    GeneralCallbackEventStatusChange
      operation EventStatusChanged: possible-error=GeneralCallbackEventStatusChange/E_NOT_OK
        arg EventId: type=Dem_EventIdType, direction=IN
        arg EventStatusOld: type=Dem_EventStatusExtendedType, direction=IN
        arg EventStatusNew: type=Dem_EventStatusExtendedType, direction=IN
      error E_NOT_OK: error-code=1
    CallbackDTCStatusChange
      operation DTCStatusChanged: possible-error=CallbackDTCStatusChange/E_NOT_OK
        arg DTC: type=uint32, direction=IN
        arg DTCStatusOld: type=Dem_DTCStatusMaskType, direction=IN
        arg DTCStatusNew: type=Dem_DTCStatusMaskType, direction=IN
      error E_NOT_OK: error-code=1
    CallbackEventDataChanged
      operation EventDataChanged: possible-error=CallbackEventDataChanged/E_NOT_OK
      error E_NOT_OK: error-code=1
    GeneralCallbackEventDataChanged
      operation EventDataChanged: possible-error=GeneralCallbackEventDataChanged/E_NOT_OK
        arg EventId: type=Dem_EventIdType, direction=IN
      error E_NOT_OK: error-code=1
    CallbackClearEventAllowed
      operation ClearEventAllowed: possible-error=CallbackClearEventAllowed/E_NOT_OK
        arg Allowed: type=boolean, direction=OUT
      error E_NOT_OK: error-code=1
    CSDataServices_DemDataElementClass_Odometer
      operation ReadData: possible-error=CSDataServices_DemDataElementClass_Odometer/E_NOT_OK
        arg Data: type=Dem_DataDemDataElementClass_Odometer_ArrayType, direction=OUT
        arg EventId: type=Dem_EventIdType, direction=IN
      error E_NOT_OK: error-code=1
    CSDataServices_DemDataElementClass_Voltage
      operation ReadData: possible-error=CSDataServices_DemDataElementClass_Voltage/E_NOT_OK
        arg Data: type=Dem_DataDemDataElementClass_Voltage_ArrayType, direction=OUT
        arg EventId: type=Dem_EventIdType, direction=IN
      error E_NOT_OK: error-code=1
    CSDataServices_DemDataElementClass_VehicleSpeed
      operation ReadData: possible-error=CSDataServices_DemDataElementClass_VehicleSpeed/E_NOT_OK
        arg Data: type=Dem_DataDemDataElementClass_VehicleSpeed_ArrayType, direction=OUT
        arg EventId: type=Dem_EventIdType, direction=IN
      error E_NOT_OK: error-code=1
    CSDataServices_DemDataElementClass_LocalTime
      operation ReadData: possible-error=CSDataServices_DemDataElementClass_LocalTime/E_NOT_OK
        arg Data: type=Dem_DataDemDataElementClass_LocalTime_ArrayType, direction=OUT
        arg EventId: type=Dem_EventIdType, direction=IN
      error E_NOT_OK: error-code=1
    CSDataServices_DemDataElementClass_ECUTemperature
      operation ReadData: possible-error=CSDataServices_DemDataElementClass_ECUTemperature/E_NOT_OK
        arg Data: type=Dem_DataDemDataElementClass_ECUTemperature_ArrayType, direction=OUT
        arg EventId: type=Dem_EventIdType, direction=IN
      error E_NOT_OK: error-code=1
    CSDataServices_DemDataElementClass_Yawrate
      operation ReadData: possible-error=CSDataServices_DemDataElementClass_Yawrate/E_NOT_OK
        arg Data: type=Dem_DataDemDataElementClass_Yawrate_ArrayType, direction=OUT
        arg EventId: type=Dem_EventIdType, direction=IN
      error E_NOT_OK: error-code=1
    CSDataServices_DemDataElementClass_EngineSpeed
      operation ReadData: possible-error=CSDataServices_DemDataElementClass_EngineSpeed/E_NOT_OK
        arg Data: type=Dem_DataDemDataElementClass_EngineSpeed_ArrayType, direction=OUT
        arg EventId: type=Dem_EventIdType, direction=IN
      error E_NOT_OK: error-code=1
    CSDataServices_DemDataElementClass_GearPosition
      operation ReadData: possible-error=CSDataServices_DemDataElementClass_GearPosition/E_NOT_OK
        arg Data: type=Dem_DataDemDataElementClass_GearPosition_ArrayType, direction=OUT
        arg EventId: type=Dem_EventIdType, direction=IN
      error E_NOT_OK: error-code=1
    CSDataServices_DemDataElementClass_SteeringAngle
      operation ReadData: possible-error=CSDataServices_DemDataElementClass_SteeringAngle/E_NOT_OK
        arg Data: type=Dem_DataDemDataElementClass_SteeringAngle_ArrayType, direction=OUT
        arg EventId: type=Dem_EventIdType, direction=IN
      error E_NOT_OK: error-code=1
    CSDataServices_DemDataElementClass_Extended_SystemKernelErrMap
      operation ReadData: possible-error=CSDataServices_DemDataElementClass_Extended_SystemKernelErrMap/E_NOT_OK
        arg Data: type=Dem_DataDemDataElementClass_Extended_SystemKernelErrMap_ArrayType, direction=OUT
        arg EventId: type=Dem_EventIdType, direction=IN
      error E_NOT_OK: error-code=1
    CallbackGetFaultDetectCounter
      operation GetFaultDetectionCounter: possible-error=CallbackGetFaultDetectCounter/E_NOT_OK
        arg FaultDetectionCounter: type=sint8, direction=OUT
      error E_NOT_OK: error-code=1
