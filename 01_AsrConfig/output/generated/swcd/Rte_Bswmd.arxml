AUTOSAR XML (schema 4-0-3)
package /AUTOSAR_MemMap/SwAddrMethods
  sw addr method CODE: memory-allocation-keyword-policy=ADDR-METHOD-SHORT-NAME, section-type=CODE
  sw addr method CONST: memory-allocation-keyword-policy=ADDR-METHOD-SHORT-NAME-AND-ALIGNMENT, section-type=CONST
  sw addr method VAR: memory-allocation-keyword-policy=ADDR-METHOD-SHORT-NAME-AND-ALIGNMENT, section-initialization-policy=INIT, section-type=VAR
package /AUTOSAR_Rte/BswModuleDescriptions
  bsw module description Rte: module-id=2
    provided-entrys:
      Rte_Start
      Rte_Stop
      Rte_PartitionTerminated_OsApplication_C{0..3}
      SchM_Init
      SchM_Deinit
      SchM_GetVersionInfo
    outgoing-callbacks:
      Rte_Runnable_Esm_Core1_Esm_Core1_MainFunction_Return
      Rte_Runnable_FctAdapter_FctAdapter_FCTSen_Exec_Start
      Rte_Runnable_FctAdapter_FctAdapter_FCTSen_Exec_Return
      Rte_Runnable_FctAdapter_FctAdapter_FCTVeh_Exec_Return
      Rte_Runnable_FctAdapter_FctAdapter_MainFunction_Return
      Rte_Runnable_LcfAdapter_LcfAdapter_LcfSenExec_Start
      Rte_Runnable_LcfAdapter_LcfAdapter_LcfSenExec_Return
      Rte_Runnable_LcfAdapter_LcfAdapter_MainFunction_Start
      Rte_Runnable_VdyAdapter_VdyAdapter_MainFunction_Start
      SchM_Schedulable_EcuM_1_Core_1_MainFunction_Start
    bsw internal behavior InternalBehavior_0
      9 x bsw called entity:
        Rte_Start: implemented-entry=Rte_Start
        Rte_Stop: implemented-entry=Rte_Stop
        Rte_PartitionTerminated_OsApplication_C{0..3}: implemented-entry=Rte_PartitionTerminated_OsApplication_C{0..3}
        SchM_Init: implemented-entry=SchM_Init
        SchM_Deinit: implemented-entry=SchM_Deinit
        SchM_GetVersionInfo: implemented-entry=SchM_GetVersionInfo
package /AUTOSAR_Rte/BswModuleEntrys
  19 x bsw module entry, all with is-reentrant=false, is-synchronous=true, execution-context=TASK, sw-service-impl-policy=STANDARD:
    Rte_Runnable_Esm_Core1_Esm_Core1_MainFunction_Return: category=TRACE, call-type=CALLBACK
    Rte_Runnable_FctAdapter_FctAdapter_FCTSen_Exec_Start: category=TRACE, call-type=CALLBACK
    Rte_Runnable_FctAdapter_FctAdapter_FCTSen_Exec_Return: category=TRACE, call-type=CALLBACK
    Rte_Runnable_FctAdapter_FctAdapter_FCTVeh_Exec_Return: category=TRACE, call-type=CALLBACK
    Rte_Runnable_FctAdapter_FctAdapter_MainFunction_Return: category=TRACE, call-type=CALLBACK
    Rte_Runnable_LcfAdapter_LcfAdapter_LcfSenExec_Start: category=TRACE, call-type=CALLBACK
    Rte_Runnable_LcfAdapter_LcfAdapter_LcfSenExec_Return: category=TRACE, call-type=CALLBACK
    Rte_Runnable_LcfAdapter_LcfAdapter_MainFunction_Start: category=TRACE, call-type=CALLBACK
    Rte_Runnable_VdyAdapter_VdyAdapter_MainFunction_Start: category=TRACE, call-type=CALLBACK
    SchM_Schedulable_EcuM_1_Core_1_MainFunction_Start: category=TRACE, call-type=CALLBACK
    Rte_Start: call-type=REGULAR
      return type returnType: direction=OUT, implementation-data-type=Std_ReturnType
    Rte_Stop: call-type=REGULAR
      return type returnType: direction=OUT, implementation-data-type=Std_ReturnType
    Rte_PartitionTerminated_OsApplication_C{0..3}: call-type=REGULAR
    SchM_Init: call-type=REGULAR
    SchM_Deinit: call-type=REGULAR
    SchM_GetVersionInfo: call-type=REGULAR
      sw service arg versioninfo: direction=OUT, implementation-data-type=Std_VersionInfoType
package /EB_Rte/Implementations
  bsw implementation BswImplementation_0: programming-language=C, sw-version=6.6.3, vendor-id=1, ar-release-version=4.0.3, behavior=InternalBehavior_0
    code-descriptors:
      code Files
        artifact-descriptors:
          short-label=Autosar::include::Rte_Version.h, category=SWHDR
          short-label=make::Rte_defs.mak, category=SWMAKE
          short-label=make::Rte_rules.mak, category=SWMAKE
    resource consumption ResourceConsumption
      59 x memory section:
        CODE: sw-addrmethod=CODE
        OSAPPLICATION_C0_CONST_UNSPECIFIED: alignment=UNSPECIFIED, sw-addrmethod=CONST
        OSAPPLICATION_C0_VAR_8: alignment=8, sw-addrmethod=VAR
        OSAPPLICATION_C0_VAR_32: alignment=32, sw-addrmethod=VAR
        OSAPPLICATION_C0_VAR_16: alignment=16, sw-addrmethod=VAR
        OSAPPLICATION_C0_VAR_64: alignment=64, sw-addrmethod=VAR
        SHARED_OSAPPLICATION_C0_VAR_32: alignment=32, sw-addrmethod=VAR
        SHARED_OSAPPLICATION_C0_VAR_8: alignment=8, sw-addrmethod=VAR
        SHARED_OSAPPLICATION_C0_VAR_16: alignment=16, sw-addrmethod=VAR
        SHARED_OSAPPLICATION_C0_VAR_UNSPECIFIED: alignment=UNSPECIFIED, sw-addrmethod=VAR
        OSAPPLICATION_C0_CONST_8: alignment=8, sw-addrmethod=CONST
        OSAPPLICATION_C0_CONST_32: alignment=32, sw-addrmethod=CONST
        OSAPPLICATION_C0_CONST_16: alignment=16, sw-addrmethod=CONST
        OSAPPLICATION_C0_CODE: sw-addrmethod=CODE
        OSAPPLICATION_C0_APPL_CODE: sw-addrmethod=CODE
        OSAPPLICATION_C0_VAR_UNSPECIFIED: alignment=UNSPECIFIED, sw-addrmethod=VAR
        OSAPPLICATION_C1_CONST_UNSPECIFIED: alignment=UNSPECIFIED, sw-addrmethod=CONST
        OSAPPLICATION_C1_VAR_16: alignment=16, sw-addrmethod=VAR
        OSAPPLICATION_C1_VAR_8: alignment=8, sw-addrmethod=VAR
        SHARED_OSAPPLICATION_C1_VAR_32: alignment=32, sw-addrmethod=VAR
        SHARED_OSAPPLICATION_C1_VAR_8: alignment=8, sw-addrmethod=VAR
        SHARED_OSAPPLICATION_C1_VAR_16: alignment=16, sw-addrmethod=VAR
        SHARED_OSAPPLICATION_C1_VAR_UNSPECIFIED: alignment=UNSPECIFIED, sw-addrmethod=VAR
        OSAPPLICATION_C1_CONST_8: alignment=8, sw-addrmethod=CONST
        OSAPPLICATION_C1_CODE: sw-addrmethod=CODE
        OSAPPLICATION_C1_APPL_CODE: sw-addrmethod=CODE
        OSAPPLICATION_C1_VAR_UNSPECIFIED: alignment=UNSPECIFIED, sw-addrmethod=VAR
        OSAPPLICATION_C2_CONST_UNSPECIFIED: alignment=UNSPECIFIED, sw-addrmethod=CONST
        OSAPPLICATION_C2_VAR_16: alignment=16, sw-addrmethod=VAR
        OSAPPLICATION_C2_VAR_8: alignment=8, sw-addrmethod=VAR
        SHARED_OSAPPLICATION_C2_VAR_32: alignment=32, sw-addrmethod=VAR
        SHARED_OSAPPLICATION_C2_VAR_8: alignment=8, sw-addrmethod=VAR
        SHARED_OSAPPLICATION_C2_VAR_16: alignment=16, sw-addrmethod=VAR
        SHARED_OSAPPLICATION_C2_VAR_UNSPECIFIED: alignment=UNSPECIFIED, sw-addrmethod=VAR
        OSAPPLICATION_C2_CONST_8: alignment=8, sw-addrmethod=CONST
        OSAPPLICATION_C2_CODE: sw-addrmethod=CODE
        OSAPPLICATION_C2_APPL_CODE: sw-addrmethod=CODE
        OSAPPLICATION_C2_VAR_UNSPECIFIED: alignment=UNSPECIFIED, sw-addrmethod=VAR
        OSAPPLICATION_C3_CONST_UNSPECIFIED: alignment=UNSPECIFIED, sw-addrmethod=CONST
        OSAPPLICATION_C3_VAR_16: alignment=16, sw-addrmethod=VAR
        OSAPPLICATION_C3_VAR_8: alignment=8, sw-addrmethod=VAR
        SHARED_OSAPPLICATION_C3_VAR_32: alignment=32, sw-addrmethod=VAR
        SHARED_OSAPPLICATION_C3_VAR_8: alignment=8, sw-addrmethod=VAR
        SHARED_OSAPPLICATION_C3_VAR_16: alignment=16, sw-addrmethod=VAR
        SHARED_OSAPPLICATION_C3_VAR_UNSPECIFIED: alignment=UNSPECIFIED, sw-addrmethod=VAR
        OSAPPLICATION_C3_CONST_8: alignment=8, sw-addrmethod=CONST
        OSAPPLICATION_C3_CODE: sw-addrmethod=CODE
        OSAPPLICATION_C3_APPL_CODE: sw-addrmethod=CODE
        OSAPPLICATION_C3_VAR_UNSPECIFIED: alignment=UNSPECIFIED, sw-addrmethod=VAR
        SHARED_OSAPPLICATION_C0_OSAPPLICATION_C1_OSAPPLICATION_C3_VAR_16: alignment=16, sw-addrmethod=VAR
        SHARED_OSAPPLICATION_C0_OSAPPLICATION_C1_OSAPPLICATION_C3_VAR_32: alignment=32, sw-addrmethod=VAR
        SHARED_OSAPPLICATION_C0_OSAPPLICATION_C1_OSAPPLICATION_C3_VAR_UNSPECIFIED: alignment=UNSPECIFIED, sw-addrmethod=VAR
        SHARED_OSAPPLICATION_C0_OSAPPLICATION_C1_OSAPPLICATION_C3_VAR_8: alignment=8, sw-addrmethod=VAR
        SHARED_OSAPPLICATION_C0_OSAPPLICATION_C1_OSAPPLICATION_C2_OSAPPLICATION_C3_VAR_16: alignment=16, sw-addrmethod=VAR
        SHARED_OSAPPLICATION_C0_OSAPPLICATION_C1_OSAPPLICATION_C2_OSAPPLICATION_C3_VAR_8: alignment=8, sw-addrmethod=VAR
        SHARED_OSAPPLICATION_C0_OSAPPLICATION_C{1..3}_VAR_8: alignment=8, sw-addrmethod=VAR
        SHARED_OSAPPLICATION_C1_OSAPPLICATION_C2_OSAPPLICATION_C3_VAR_8: alignment=8, sw-addrmethod=VAR
