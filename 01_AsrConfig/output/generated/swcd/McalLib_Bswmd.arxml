AUTOSAR XML (schema 4-0-3)
package /AUTOSAR_McalLib/BswModuleDescriptions
  bsw module description McalLib: module-id=255, provided-entrys=McalLib_SetBitAtomic
    bsw internal behavior InternalBehavior_0
      4 x exclusive area:
        CpuEndInit
        PeripheralEndInit
        SafetyEndInit
        StmTimerResolution
      bsw called entity Mcal_SetBitAtomic: can-enter-exclusive-area=[CpuEndInit, PeripheralEndInit, SafetyEndInit, StmTimerResolution], implemented-entry=McalLib_SetBitAtomic
package /AUTOSAR_McalLib/BswModuleEntrys
  bsw module entry McalLib_SetBitAtomic: service-id=1000, is-reentrant=false, is-synchronous=true, call-type=REGULAR, execution-context=UNSPECIFIED, sw-service-impl-policy=STANDARD
package /McalLib_Aurix2GAS422/Implementations
  bsw implementation BswImplementation_0: programming-language=C, sw-version=20.0.1, vendor-id=17, ar-release-version=4.2.2, behavior=InternalBehavior_0, vendor-specific-module-def=McalLib
    code-descriptors:
      code Files
        artifact-descriptors:
          short-label=make::McalLib_defs.mak, category=SWMAKE
          short-label=make::McalLib_rules.mak, category=SWMAKE
    resource consumption ResourceConsumption
      4 x memory section, all with options=safetyAsilB:
        CONST_ASIL_B_GLOBAL_8: alignment=8, sw-addrmethod=CONST_ASIL_B
        VAR_CLEARED_ASIL_B_GLOBAL_32: alignment=32, sw-addrmethod=VAR_CLEARED_ASIL_B
        CONST_ASIL_B_GLOBAL_32: alignment=32, sw-addrmethod=CONST_ASIL_B
        CODE_ASIL_B_GLOBAL: alignment=UNSPECIFIED, sw-addrmethod=CODE_ASIL_B
      section name prefix MCALLIB
