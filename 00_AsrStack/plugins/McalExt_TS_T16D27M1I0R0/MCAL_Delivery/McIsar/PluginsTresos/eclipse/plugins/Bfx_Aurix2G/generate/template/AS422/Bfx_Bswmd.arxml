AUTOSAR XML (schema 4-2-2)
# Copyright (C) Infineon Technologies (2020)
# All rights reserved.
package /AUTOSAR_Bfx/BswModuleDescriptions
  bsw module description Bfx: category=BSW_MODULE, module-id=205  # Bfx Library
    provided-entrys:
      Bfx_SetBit_u8u8
      Bfx_SetBit_u16u8
      Bfx_SetBit_u32u8
      Bfx_SetBit_u64u8
      Bfx_ClrBit_u8u8
      Bfx_ClrBit_u16u8
      Bfx_ClrBit_u32u8
      Bfx_ClrBit_u64u8
      Bfx_GetBit_u8u8_u8
      Bfx_GetBit_u16u8_u8
      Bfx_GetBit_u32u8_u8
      Bfx_GetBit_u64u8_u8
      Bfx_SetBits_u8u8u8u8
      Bfx_SetBits_u16u8u8u8
      Bfx_SetBits_u32u8u8u8
      Bfx_SetBits_u64u8u8u8
      Bfx_GetBits_u8u8u8_u8
      Bfx_GetBits_u16u8u8_u16
      Bfx_GetBits_u32u8u8_u32
      Bfx_GetBits_u64u8u8_u64
      Bfx_SetBitMask_u8u8
      Bfx_SetBitMask_u16u16
      Bfx_SetBitMask_u32u32
      Bfx_SetBitMask_u64u64
      Bfx_ClrBitMask_u8u8
      Bfx_ClrBitMask_u16u16
      Bfx_ClrBitMask_u32u32
      Bfx_ClrBitMask_u64u64
      Bfx_TstBitMask_u8u8_u8
      Bfx_TstBitMask_u16u16_u8
      Bfx_TstBitMask_u32u32_u8
      Bfx_TstBitMask_u64u64_u8
      Bfx_TstBitLnMask_u8u8_u8
      Bfx_TstBitLnMask_u16u16_u8
      Bfx_TstBitLnMask_u32u32_u8
      Bfx_TstBitLnMask_u64u64_u8
      Bfx_TstParityEven_u8_u8
      Bfx_TstParityEven_u16_u8
      Bfx_TstParityEven_u32_u8
      Bfx_TstParityEven_u64_u8
      Bfx_ToggleBits_u8
      Bfx_ToggleBits_u16
      Bfx_ToggleBits_u32
      Bfx_ToggleBits_u64
      Bfx_ToggleBitMask_u8u8
      Bfx_ToggleBitMask_u16u16
      Bfx_ToggleBitMask_u32u32
      Bfx_ToggleBitMask_u64u64
      Bfx_ShiftBitRt_u8u8
      Bfx_ShiftBitRt_u16u8
      Bfx_ShiftBitRt_u32u8
      Bfx_ShiftBitRt_u64u8
      Bfx_ShiftBitLt_u8u8
      Bfx_ShiftBitLt_u16u8
      Bfx_ShiftBitLt_u32u8
      Bfx_ShiftBitLt_u64u8
      Bfx_RotBitRt_u8u8
      Bfx_RotBitRt_u16u8
      Bfx_RotBitRt_u32u8
      Bfx_RotBitRt_u64u8
      Bfx_RotBitLt_u8u8
      Bfx_RotBitLt_u16u8
      Bfx_RotBitLt_u32u8
      Bfx_RotBitLt_u64u8
      Bfx_CopyBit_u8u8u8u8
      Bfx_CopyBit_u16u8u16u8
      Bfx_CopyBit_u32u8u32u8
      Bfx_CopyBit_u64u8u64u8
      Bfx_PutBits_u8u8u8u8
      Bfx_PutBits_u16u8u8u16
      Bfx_PutBits_u32u8u8u32
      Bfx_PutBits_u64u8u8u64
      Bfx_PutBitsMask_u8u8u8
      Bfx_PutBitsMask_u16u16u16
      Bfx_PutBitsMask_u32u32u32
      Bfx_PutBitsMask_u64u64u64
      Bfx_PutBit_u8u8u8
      Bfx_PutBit_u16u8u8
      Bfx_PutBit_u32u8u8
      Bfx_PutBit_u64u8u8
      Bfx_GetVersionInfo
    bsw internal behavior BfxBehavior
      81 x bsw called entity, all with reentrancy-level=MULTICORE-REENTRANT:
        Bfx_SetBit_u8u8: implemented-entry=Bfx_SetBit_u8u8
        Bfx_SetBit_u16u8: implemented-entry=Bfx_SetBit_u16u8
        Bfx_SetBit_u32u8: implemented-entry=Bfx_SetBit_u32u8
        Bfx_SetBit_u64u8: implemented-entry=Bfx_SetBit_u64u8
        Bfx_ClrBit_u8u8: implemented-entry=Bfx_ClrBit_u8u8
        Bfx_ClrBit_u16u8: implemented-entry=Bfx_ClrBit_u16u8
        Bfx_ClrBit_u32u8: implemented-entry=Bfx_ClrBit_u32u8
        Bfx_ClrBit_u64u8: implemented-entry=Bfx_ClrBit_u64u8
        Bfx_GetBit_u8u8_u8: implemented-entry=Bfx_GetBit_u8u8_u8
        Bfx_GetBit_u16u8_u8: implemented-entry=Bfx_GetBit_u16u8_u8
        Bfx_GetBit_u32u8_u8: implemented-entry=Bfx_GetBit_u32u8_u8
        Bfx_GetBit_u64u8_u8: implemented-entry=Bfx_GetBit_u64u8_u8
        Bfx_SetBits_u8u8u8u8: implemented-entry=Bfx_SetBits_u8u8u8u8
        Bfx_SetBits_u16u8u8u8: implemented-entry=Bfx_SetBits_u16u8u8u8
        Bfx_SetBits_u32u8u8u8: implemented-entry=Bfx_SetBits_u32u8u8u8
        Bfx_SetBits_u64u8u8u8: implemented-entry=Bfx_SetBits_u64u8u8u8
        Bfx_GetBits_u8u8u8_u8: implemented-entry=Bfx_GetBits_u8u8u8_u8
        Bfx_GetBits_u16u8u8_u16: implemented-entry=Bfx_GetBits_u16u8u8_u16
        Bfx_GetBits_u32u8u8_u32: implemented-entry=Bfx_GetBits_u32u8u8_u32
        Bfx_GetBits_u64u8u8_u64: implemented-entry=Bfx_GetBits_u64u8u8_u64
        Bfx_SetBitMask_u8u8: implemented-entry=Bfx_SetBitMask_u8u8
        Bfx_SetBitMask_u16u16: implemented-entry=Bfx_SetBitMask_u16u16
        Bfx_SetBitMask_u32u32: implemented-entry=Bfx_SetBitMask_u32u32
        Bfx_SetBitMask_u64u64: implemented-entry=Bfx_SetBitMask_u64u64
        Bfx_ClrBitMask_u8u8: implemented-entry=Bfx_ClrBitMask_u8u8
        Bfx_ClrBitMask_u16u16: implemented-entry=Bfx_ClrBitMask_u16u16
        Bfx_ClrBitMask_u32u32: implemented-entry=Bfx_ClrBitMask_u32u32
        Bfx_ClrBitMask_u64u64: implemented-entry=Bfx_ClrBitMask_u64u64
        Bfx_TstBitMask_u8u8_u8: implemented-entry=Bfx_TstBitMask_u8u8_u8
        Bfx_TstBitMask_u16u16_u8: implemented-entry=Bfx_TstBitMask_u16u16_u8
        Bfx_TstBitMask_u32u32_u8: implemented-entry=Bfx_TstBitMask_u32u32_u8
        Bfx_TstBitMask_u64u64_u8: implemented-entry=Bfx_TstBitMask_u64u64_u8
        Bfx_TstBitLnMask_u8u8_u8: implemented-entry=Bfx_TstBitLnMask_u8u8_u8
        Bfx_TstBitLnMask_u16u16_u8: implemented-entry=Bfx_TstBitLnMask_u16u16_u8
        Bfx_TstBitLnMask_u32u32_u8: implemented-entry=Bfx_TstBitLnMask_u32u32_u8
        Bfx_TstBitLnMask_u64u64_u8: implemented-entry=Bfx_TstBitLnMask_u64u64_u8
        Bfx_TstParityEven_u8_u8: implemented-entry=Bfx_TstParityEven_u8_u8
        Bfx_TstParityEven_u16_u8: implemented-entry=Bfx_TstParityEven_u16_u8
        Bfx_TstParityEven_u32_u8: implemented-entry=Bfx_TstParityEven_u32_u8
        Bfx_TstParityEven_u64_u8: implemented-entry=Bfx_TstParityEven_u64_u8
        Bfx_ToggleBits_u8: implemented-entry=Bfx_ToggleBits_u8
        Bfx_ToggleBits_u16: implemented-entry=Bfx_ToggleBits_u16
        Bfx_ToggleBits_u32: implemented-entry=Bfx_ToggleBits_u32
        Bfx_ToggleBits_u64: implemented-entry=Bfx_ToggleBits_u64
        Bfx_ToggleBitMask_u8u8: implemented-entry=Bfx_ToggleBitMask_u8u8
        Bfx_ToggleBitMask_u16u16: implemented-entry=Bfx_ToggleBitMask_u16u16
        Bfx_ToggleBitMask_u32u32: implemented-entry=Bfx_ToggleBitMask_u32u32
        Bfx_ToggleBitMask_u64u64: implemented-entry=Bfx_ToggleBitMask_u64u64
        Bfx_ShiftBitRt_u8u8: implemented-entry=Bfx_ShiftBitRt_u8u8
        Bfx_ShiftBitRt_u16u8: implemented-entry=Bfx_ShiftBitRt_u16u8
        Bfx_ShiftBitRt_u32u8: implemented-entry=Bfx_ShiftBitRt_u32u8
        Bfx_ShiftBitRt_u64u8: implemented-entry=Bfx_ShiftBitRt_u64u8
        Bfx_ShiftBitLt_u8u8: implemented-entry=Bfx_ShiftBitLt_u8u8
        Bfx_ShiftBitLt_u16u8: implemented-entry=Bfx_ShiftBitLt_u16u8
        Bfx_ShiftBitLt_u32u8: implemented-entry=Bfx_ShiftBitLt_u32u8
        Bfx_ShiftBitLt_u64u8: implemented-entry=Bfx_ShiftBitLt_u64u8
        Bfx_RotBitRt_u8u8: implemented-entry=Bfx_RotBitRt_u8u8
        Bfx_RotBitRt_u16u8: implemented-entry=Bfx_RotBitRt_u16u8
        Bfx_RotBitRt_u32u8: implemented-entry=Bfx_RotBitRt_u32u8
        Bfx_RotBitRt_u64u8: implemented-entry=Bfx_RotBitRt_u64u8
        Bfx_RotBitLt_u8u8: implemented-entry=Bfx_RotBitLt_u8u8
        Bfx_RotBitLt_u16u8: implemented-entry=Bfx_RotBitLt_u16u8
        Bfx_RotBitLt_u32u8: implemented-entry=Bfx_RotBitLt_u32u8
        Bfx_RotBitLt_u64u8: implemented-entry=Bfx_RotBitLt_u64u8
        Bfx_CopyBit_u8u8u8u8: implemented-entry=Bfx_CopyBit_u8u8u8u8
        Bfx_CopyBit_u16u8u16u8: implemented-entry=Bfx_CopyBit_u16u8u16u8
        Bfx_CopyBit_u32u8u32u8: implemented-entry=Bfx_CopyBit_u32u8u32u8
        Bfx_CopyBit_u64u8u64u8: implemented-entry=Bfx_CopyBit_u64u8u64u8
        Bfx_PutBits_u8u8u8u8: implemented-entry=Bfx_PutBits_u8u8u8u8
        Bfx_PutBits_u16u8u8u16: implemented-entry=Bfx_PutBits_u16u8u8u16
        Bfx_PutBits_u32u8u8u32: implemented-entry=Bfx_PutBits_u32u8u8u32
        Bfx_PutBits_u64u8u8u64: implemented-entry=Bfx_PutBits_u64u8u8u64
        Bfx_PutBitsMask_u8u8u8: implemented-entry=Bfx_PutBitsMask_u8u8u8
        Bfx_PutBitsMask_u16u16u16: implemented-entry=Bfx_PutBitsMask_u16u16u16
        Bfx_PutBitsMask_u32u32u32: implemented-entry=Bfx_PutBitsMask_u32u32u32
        Bfx_PutBitsMask_u64u64u64: implemented-entry=Bfx_PutBitsMask_u64u64u64
        Bfx_PutBit_u8u8u8: implemented-entry=Bfx_PutBit_u8u8u8
        Bfx_PutBit_u16u8u8: implemented-entry=Bfx_PutBit_u16u8u8
        Bfx_PutBit_u32u8u8: implemented-entry=Bfx_PutBit_u32u8u8
        Bfx_PutBit_u64u8u8: implemented-entry=Bfx_PutBit_u64u8u8
        Bfx_GetVersionInfo: implemented-entry=Bfx_GetVersionInfo
package /AUTOSAR_Bfx/BswModuleEntrys
  81 x bsw module entry, all with is-reentrant=true, is-synchronous=true, call-type=REGULAR, sw-service-impl-policy=STANDARD:
    Bfx_SetBit_u8u8: service-id=1, execution-context=UNSPECIFIED
      sw service arg Data: category=DATA_REFERENCE, sw-pointer-target-props={target-category=TYPE_REFERENCE, implementation-data-type=uint8}
      sw service arg BitPn: implementation-data-type=uint8
    Bfx_SetBit_u16u8: service-id=2, execution-context=UNSPECIFIED
      sw service arg Data: category=DATA_REFERENCE, sw-pointer-target-props={target-category=TYPE_REFERENCE, implementation-data-type=uint16}
      sw service arg BitPn: implementation-data-type=uint8
    Bfx_SetBit_u32u8: service-id=3, execution-context=UNSPECIFIED
      sw service arg Data: category=DATA_REFERENCE, sw-pointer-target-props={target-category=TYPE_REFERENCE, implementation-data-type=uint32}
      sw service arg BitPn: implementation-data-type=uint8
    Bfx_SetBit_u64u8: service-id=4, execution-context=UNSPECIFIED
      sw service arg Data: category=DATA_REFERENCE, sw-pointer-target-props={target-category=TYPE_REFERENCE, implementation-data-type=uint64}
      sw service arg BitPn: implementation-data-type=uint8
    Bfx_ClrBit_u8u8: service-id=6, execution-context=UNSPECIFIED
      sw service arg Data: category=DATA_REFERENCE, sw-pointer-target-props={target-category=TYPE_REFERENCE, implementation-data-type=uint8}
      sw service arg BitPn: implementation-data-type=uint8
    Bfx_ClrBit_u16u8: service-id=7, execution-context=UNSPECIFIED
      sw service arg Data: category=DATA_REFERENCE, sw-pointer-target-props={target-category=TYPE_REFERENCE, implementation-data-type=uint16}
      sw service arg BitPn: implementation-data-type=uint8
    Bfx_ClrBit_u32u8: service-id=8, execution-context=UNSPECIFIED
      sw service arg Data: category=DATA_REFERENCE, sw-pointer-target-props={target-category=TYPE_REFERENCE, implementation-data-type=uint32}
      sw service arg BitPn: implementation-data-type=uint8
    Bfx_ClrBit_u64u8: service-id=9, execution-context=UNSPECIFIED
      sw service arg Data: category=DATA_REFERENCE, sw-pointer-target-props={target-category=TYPE_REFERENCE, implementation-data-type=uint64}
      sw service arg BitPn: implementation-data-type=uint8
    Bfx_GetBit_u8u8_u8: service-id=10, execution-context=UNSPECIFIED
      return type Return: implementation-data-type=boolean
      sw service arg Data: implementation-data-type=uint8
      sw service arg BitPn: implementation-data-type=uint8
    Bfx_GetBit_u16u8_u8: service-id=11, execution-context=UNSPECIFIED
      return type Return: implementation-data-type=boolean
      sw service arg Data: implementation-data-type=uint16
      sw service arg BitPn: implementation-data-type=uint8
    Bfx_GetBit_u32u8_u8: service-id=12, execution-context=UNSPECIFIED
      return type Return: implementation-data-type=boolean
      sw service arg Data: implementation-data-type=uint32
      sw service arg BitPn: implementation-data-type=uint8
    Bfx_GetBit_u64u8_u8: service-id=13, execution-context=UNSPECIFIED
      return type Return: implementation-data-type=boolean
      sw service arg Data: implementation-data-type=uint64
      sw service arg BitPn: implementation-data-type=uint8
    Bfx_SetBits_u8u8u8u8: service-id=32, execution-context=UNSPECIFIED
      4 x sw service arg:
        Data: category=DATA_REFERENCE, sw-pointer-target-props={target-category=TYPE_REFERENCE, implementation-data-type=uint8}
        BitStartPn: implementation-data-type=uint8
        BitLn: implementation-data-type=uint8
        Status: implementation-data-type=uint8
    Bfx_SetBits_u16u8u8u8: service-id=33, execution-context=UNSPECIFIED
      4 x sw service arg:
        Data: category=DATA_REFERENCE, sw-pointer-target-props={target-category=TYPE_REFERENCE, implementation-data-type=uint16}
        BitStartPn: implementation-data-type=uint8
        BitLn: implementation-data-type=uint8
        Status: implementation-data-type=uint8
    Bfx_SetBits_u32u8u8u8: service-id=34, execution-context=UNSPECIFIED
      4 x sw service arg:
        Data: category=DATA_REFERENCE, sw-pointer-target-props={target-category=TYPE_REFERENCE, implementation-data-type=uint32}
        BitStartPn: implementation-data-type=uint8
        BitLn: implementation-data-type=uint8
        Status: implementation-data-type=uint8
    Bfx_SetBits_u64u8u8u8: service-id=35, execution-context=UNSPECIFIED
      4 x sw service arg:
        Data: category=DATA_REFERENCE, sw-pointer-target-props={target-category=TYPE_REFERENCE, implementation-data-type=uint64}
        BitStartPn: implementation-data-type=uint8
        BitLn: implementation-data-type=uint8
        Status: implementation-data-type=uint8
    Bfx_GetBits_u8u8u8_u8: service-id=38, execution-context=UNSPECIFIED
      return type Return: implementation-data-type=uint8
      sw service arg Data: implementation-data-type=uint8
      sw service arg BitStartPn: implementation-data-type=uint8
      sw service arg BitLn: implementation-data-type=uint8
    Bfx_GetBits_u16u8u8_u16: service-id=39, execution-context=UNSPECIFIED
      return type Return: implementation-data-type=uint16
      sw service arg Data: implementation-data-type=uint16
      sw service arg BitStartPn: implementation-data-type=uint8
      sw service arg BitLn: implementation-data-type=uint8
    Bfx_GetBits_u32u8u8_u32: service-id=40, execution-context=UNSPECIFIED
      return type Return: implementation-data-type=uint32
      sw service arg Data: implementation-data-type=uint32
      sw service arg BitStartPn: implementation-data-type=uint8
      sw service arg BitLn: implementation-data-type=uint8
    Bfx_GetBits_u64u8u8_u64: service-id=41, execution-context=UNSPECIFIED
      return type Return: implementation-data-type=uint64
      sw service arg Data: implementation-data-type=uint64
      sw service arg BitStartPn: implementation-data-type=uint8
      sw service arg BitLn: implementation-data-type=uint8
    Bfx_SetBitMask_u8u8: service-id=42, execution-context=UNSPECIFIED
      sw service arg Data: category=DATA_REFERENCE, sw-pointer-target-props={target-category=TYPE_REFERENCE, implementation-data-type=uint8}
      sw service arg Mask: implementation-data-type=uint8
    Bfx_SetBitMask_u16u16: service-id=43, execution-context=UNSPECIFIED
      sw service arg Data: category=DATA_REFERENCE, sw-pointer-target-props={target-category=TYPE_REFERENCE, implementation-data-type=uint16}
      sw service arg Mask: implementation-data-type=uint16
    Bfx_SetBitMask_u32u32: service-id=44, execution-context=UNSPECIFIED
      sw service arg Data: category=DATA_REFERENCE, sw-pointer-target-props={target-category=TYPE_REFERENCE, implementation-data-type=uint32}
      sw service arg Mask: implementation-data-type=uint32
    Bfx_SetBitMask_u64u64: service-id=45, execution-context=UNSPECIFIED
      sw service arg Data: category=DATA_REFERENCE, sw-pointer-target-props={target-category=TYPE_REFERENCE, implementation-data-type=uint64}
      sw service arg Mask: implementation-data-type=uint64
    Bfx_ClrBitMask_u8u8: service-id=48, execution-context=UNSPECIFIED
      sw service arg Data: category=DATA_REFERENCE, sw-pointer-target-props={target-category=TYPE_REFERENCE, implementation-data-type=uint8}
      sw service arg Mask: implementation-data-type=uint8
    Bfx_ClrBitMask_u16u16: service-id=49, execution-context=UNSPECIFIED
      sw service arg Data: category=DATA_REFERENCE, sw-pointer-target-props={target-category=TYPE_REFERENCE, implementation-data-type=uint16}
      sw service arg Mask: implementation-data-type=uint16
    Bfx_ClrBitMask_u32u32: service-id=50, execution-context=UNSPECIFIED
      sw service arg Data: category=DATA_REFERENCE, sw-pointer-target-props={target-category=TYPE_REFERENCE, implementation-data-type=uint32}
      sw service arg Mask: implementation-data-type=uint32
    Bfx_ClrBitMask_u64u64: service-id=51, execution-context=UNSPECIFIED
      sw service arg Data: category=DATA_REFERENCE, sw-pointer-target-props={target-category=TYPE_REFERENCE, implementation-data-type=uint64}
      sw service arg Mask: implementation-data-type=uint64
    Bfx_TstBitMask_u8u8_u8: service-id=54, execution-context=UNSPECIFIED
      return type Return: implementation-data-type=boolean
      sw service arg Data: implementation-data-type=uint8
      sw service arg Mask: implementation-data-type=uint8
    Bfx_TstBitMask_u16u16_u8: service-id=55, execution-context=UNSPECIFIED
      return type Return: implementation-data-type=boolean
      sw service arg Data: implementation-data-type=uint16
      sw service arg Mask: implementation-data-type=uint16
    Bfx_TstBitMask_u32u32_u8: service-id=56, execution-context=UNSPECIFIED
      return type Return: implementation-data-type=boolean
      sw service arg Data: implementation-data-type=uint32
      sw service arg Mask: implementation-data-type=uint32
    Bfx_TstBitMask_u64u64_u8: service-id=57, execution-context=UNSPECIFIED
      return type Return: implementation-data-type=boolean
      sw service arg Data: implementation-data-type=uint64
      sw service arg Mask: implementation-data-type=uint64
    Bfx_TstBitLnMask_u8u8_u8: service-id=58, execution-context=UNSPECIFIED
      return type Return: implementation-data-type=boolean
      sw service arg Data: implementation-data-type=uint8
      sw service arg Mask: implementation-data-type=uint8
    Bfx_TstBitLnMask_u16u16_u8: service-id=59, execution-context=UNSPECIFIED
      return type Return: implementation-data-type=boolean
      sw service arg Data: implementation-data-type=uint16
      sw service arg Mask: implementation-data-type=uint16
    Bfx_TstBitLnMask_u32u32_u8: service-id=60, execution-context=UNSPECIFIED
      return type Return: implementation-data-type=boolean
      sw service arg Data: implementation-data-type=uint32
      sw service arg Mask: implementation-data-type=uint32
    Bfx_TstBitLnMask_u64u64_u8: service-id=61, execution-context=UNSPECIFIED
      return type Return: implementation-data-type=boolean
      sw service arg Data: implementation-data-type=uint64
      sw service arg Mask: implementation-data-type=uint64
    Bfx_TstParityEven_u8_u8: service-id=64, execution-context=UNSPECIFIED
      return type Return: implementation-data-type=boolean
      sw service arg Data: implementation-data-type=uint8
    Bfx_TstParityEven_u16_u8: service-id=65, execution-context=UNSPECIFIED
      return type Return: implementation-data-type=boolean
      sw service arg Data: implementation-data-type=uint16
    Bfx_TstParityEven_u32_u8: service-id=66, execution-context=UNSPECIFIED
      return type Return: implementation-data-type=boolean
      sw service arg Data: implementation-data-type=uint32
    Bfx_TstParityEven_u64_u8: service-id=67, execution-context=UNSPECIFIED
      return type Return: implementation-data-type=boolean
      sw service arg Data: implementation-data-type=uint64
    Bfx_ToggleBits_u8: service-id=70, execution-context=UNSPECIFIED
      sw service arg Data: category=DATA_REFERENCE, sw-pointer-target-props={target-category=TYPE_REFERENCE, implementation-data-type=uint8}
    Bfx_ToggleBits_u16: service-id=71, execution-context=UNSPECIFIED
      sw service arg Data: category=DATA_REFERENCE, sw-pointer-target-props={target-category=TYPE_REFERENCE, implementation-data-type=uint16}
    Bfx_ToggleBits_u32: service-id=72, execution-context=UNSPECIFIED
      sw service arg Data: category=DATA_REFERENCE, sw-pointer-target-props={target-category=TYPE_REFERENCE, implementation-data-type=uint32}
    Bfx_ToggleBits_u64: service-id=73, execution-context=UNSPECIFIED
      sw service arg Data: category=DATA_REFERENCE, sw-pointer-target-props={target-category=TYPE_REFERENCE, implementation-data-type=uint64}
    Bfx_ToggleBitMask_u8u8: service-id=74, execution-context=UNSPECIFIED
      sw service arg Data: category=DATA_REFERENCE, sw-pointer-target-props={target-category=TYPE_REFERENCE, implementation-data-type=uint8}
      sw service arg Mask: implementation-data-type=uint8
    Bfx_ToggleBitMask_u16u16: service-id=75, execution-context=UNSPECIFIED
      sw service arg Data: category=DATA_REFERENCE, sw-pointer-target-props={target-category=TYPE_REFERENCE, implementation-data-type=uint16}
      sw service arg Mask: implementation-data-type=uint16
    Bfx_ToggleBitMask_u32u32: service-id=76, execution-context=UNSPECIFIED
      sw service arg Data: category=DATA_REFERENCE, sw-pointer-target-props={target-category=TYPE_REFERENCE, implementation-data-type=uint32}
      sw service arg Mask: implementation-data-type=uint32
    Bfx_ToggleBitMask_u64u64: service-id=77, execution-context=UNSPECIFIED
      sw service arg Data: category=DATA_REFERENCE, sw-pointer-target-props={target-category=TYPE_REFERENCE, implementation-data-type=uint64}
      sw service arg Mask: implementation-data-type=uint64
    Bfx_ShiftBitRt_u8u8: service-id=80, execution-context=UNSPECIFIED
      sw service arg Data: category=DATA_REFERENCE, sw-pointer-target-props={target-category=TYPE_REFERENCE, implementation-data-type=uint8}
      sw service arg ShiftCnt: implementation-data-type=uint8
    Bfx_ShiftBitRt_u16u8: service-id=81, execution-context=UNSPECIFIED
      sw service arg Data: category=DATA_REFERENCE, sw-pointer-target-props={target-category=TYPE_REFERENCE, implementation-data-type=uint16}
      sw service arg ShiftCnt: implementation-data-type=uint8
    Bfx_ShiftBitRt_u32u8: service-id=82, execution-context=UNSPECIFIED
      sw service arg Data: category=DATA_REFERENCE, sw-pointer-target-props={target-category=TYPE_REFERENCE, implementation-data-type=uint32}
      sw service arg ShiftCnt: implementation-data-type=uint8
    Bfx_ShiftBitRt_u64u8: service-id=83, execution-context=UNSPECIFIED
      sw service arg Data: category=DATA_REFERENCE, sw-pointer-target-props={target-category=TYPE_REFERENCE, implementation-data-type=uint64}
      sw service arg ShiftCnt: implementation-data-type=uint8
    Bfx_ShiftBitLt_u8u8: service-id=86, execution-context=UNSPECIFIED
      sw service arg Data: category=DATA_REFERENCE, sw-pointer-target-props={target-category=TYPE_REFERENCE, implementation-data-type=uint8}
      sw service arg ShiftCnt: implementation-data-type=uint8
    Bfx_ShiftBitLt_u16u8: service-id=87, execution-context=UNSPECIFIED
      sw service arg Data: category=DATA_REFERENCE, sw-pointer-target-props={target-category=TYPE_REFERENCE, implementation-data-type=uint16}
      sw service arg ShiftCnt: implementation-data-type=uint8
    Bfx_ShiftBitLt_u32u8: service-id=88, execution-context=UNSPECIFIED
      sw service arg Data: category=DATA_REFERENCE, sw-pointer-target-props={target-category=TYPE_REFERENCE, implementation-data-type=uint32}
      sw service arg ShiftCnt: implementation-data-type=uint8
    Bfx_ShiftBitLt_u64u8: service-id=89, execution-context=UNSPECIFIED
      sw service arg Data: category=DATA_REFERENCE, sw-pointer-target-props={target-category=TYPE_REFERENCE, implementation-data-type=uint64}
      sw service arg ShiftCnt: implementation-data-type=uint8
    Bfx_RotBitRt_u8u8: service-id=90, execution-context=UNSPECIFIED
      sw service arg Data: category=DATA_REFERENCE, sw-pointer-target-props={target-category=TYPE_REFERENCE, implementation-data-type=uint8}
      sw service arg ShiftCnt: implementation-data-type=uint8
    Bfx_RotBitRt_u16u8: service-id=91, execution-context=UNSPECIFIED
      sw service arg Data: category=DATA_REFERENCE, sw-pointer-target-props={target-category=TYPE_REFERENCE, implementation-data-type=uint16}
      sw service arg ShiftCnt: implementation-data-type=uint8
    Bfx_RotBitRt_u32u8: service-id=92, execution-context=UNSPECIFIED
      sw service arg Data: category=DATA_REFERENCE, sw-pointer-target-props={target-category=TYPE_REFERENCE, implementation-data-type=uint32}
      sw service arg ShiftCnt: implementation-data-type=uint8
    Bfx_RotBitRt_u64u8: service-id=93, execution-context=UNSPECIFIED
      sw service arg Data: category=DATA_REFERENCE, sw-pointer-target-props={target-category=TYPE_REFERENCE, implementation-data-type=uint64}
      sw service arg ShiftCnt: implementation-data-type=uint8
    Bfx_RotBitLt_u8u8: service-id=96, execution-context=UNSPECIFIED
      sw service arg Data: category=DATA_REFERENCE, sw-pointer-target-props={target-category=TYPE_REFERENCE, implementation-data-type=uint8}
      sw service arg ShiftCnt: implementation-data-type=uint8
    Bfx_RotBitLt_u16u8: service-id=97, execution-context=UNSPECIFIED
      sw service arg Data: category=DATA_REFERENCE, sw-pointer-target-props={target-category=TYPE_REFERENCE, implementation-data-type=uint16}
      sw service arg ShiftCnt: implementation-data-type=uint8
    Bfx_RotBitLt_u32u8: service-id=98, execution-context=UNSPECIFIED
      sw service arg Data: category=DATA_REFERENCE, sw-pointer-target-props={target-category=TYPE_REFERENCE, implementation-data-type=uint32}
      sw service arg ShiftCnt: implementation-data-type=uint8
    Bfx_RotBitLt_u64u8: service-id=99, execution-context=UNSPECIFIED
      sw service arg Data: category=DATA_REFERENCE, sw-pointer-target-props={target-category=TYPE_REFERENCE, implementation-data-type=uint64}
      sw service arg ShiftCnt: implementation-data-type=uint8
    Bfx_CopyBit_u8u8u8u8: service-id=102, execution-context=UNSPECIFIED
      4 x sw service arg:
        DestinationData: category=DATA_REFERENCE, sw-pointer-target-props={target-category=TYPE_REFERENCE, implementation-data-type=uint8}
        DestinationPosition: implementation-data-type=uint8
        SourceData: implementation-data-type=uint8
        SourcePosition: implementation-data-type=uint8
    Bfx_CopyBit_u16u8u16u8: service-id=103, execution-context=UNSPECIFIED
      4 x sw service arg:
        DestinationData: category=DATA_REFERENCE, sw-pointer-target-props={target-category=TYPE_REFERENCE, implementation-data-type=uint16}
        DestinationPosition: implementation-data-type=uint8
        SourceData: implementation-data-type=uint16
        SourcePosition: implementation-data-type=uint8
    Bfx_CopyBit_u32u8u32u8: service-id=104, execution-context=UNSPECIFIED
      4 x sw service arg:
        DestinationData: category=DATA_REFERENCE, sw-pointer-target-props={target-category=TYPE_REFERENCE, implementation-data-type=uint32}
        DestinationPosition: implementation-data-type=uint8
        SourceData: implementation-data-type=uint32
        SourcePosition: implementation-data-type=uint8
    Bfx_CopyBit_u64u8u64u8: service-id=105, execution-context=UNSPECIFIED
      4 x sw service arg:
        DestinationData: category=DATA_REFERENCE, sw-pointer-target-props={target-category=TYPE_REFERENCE, implementation-data-type=uint64}
        DestinationPosition: implementation-data-type=uint8
        SourceData: implementation-data-type=uint64
        SourcePosition: implementation-data-type=uint8
    Bfx_PutBits_u8u8u8u8: service-id=112, execution-context=UNSPECIFIED
      4 x sw service arg:
        Data: category=DATA_REFERENCE, sw-pointer-target-props={target-category=TYPE_REFERENCE, implementation-data-type=uint8}
        BitStartPn: implementation-data-type=uint8
        BitLn: implementation-data-type=uint8
        Pattern: implementation-data-type=uint8
    Bfx_PutBits_u16u8u8u16: service-id=113, execution-context=UNSPECIFIED
      4 x sw service arg:
        Data: category=DATA_REFERENCE, sw-pointer-target-props={target-category=TYPE_REFERENCE, implementation-data-type=uint16}
        BitStartPn: implementation-data-type=uint8
        BitLn: implementation-data-type=uint8
        Pattern: implementation-data-type=uint16
    Bfx_PutBits_u32u8u8u32: service-id=114, execution-context=UNSPECIFIED
      4 x sw service arg:
        Data: category=DATA_REFERENCE, sw-pointer-target-props={target-category=TYPE_REFERENCE, implementation-data-type=uint32}
        BitStartPn: implementation-data-type=uint8
        BitLn: implementation-data-type=uint8
        Pattern: implementation-data-type=uint32
    Bfx_PutBits_u64u8u8u64: service-id=115, execution-context=UNSPECIFIED
      4 x sw service arg:
        Data: category=DATA_REFERENCE, sw-pointer-target-props={target-category=TYPE_REFERENCE, implementation-data-type=uint64}
        BitStartPn: implementation-data-type=uint8
        BitLn: implementation-data-type=uint8
        Pattern: implementation-data-type=uint64
    Bfx_PutBitsMask_u8u8u8: service-id=128, execution-context=UNSPECIFIED
      sw service arg Data: category=DATA_REFERENCE, sw-pointer-target-props={target-category=TYPE_REFERENCE, implementation-data-type=uint8}
      sw service arg Pattern: implementation-data-type=uint8
      sw service arg Mask: implementation-data-type=uint8
    Bfx_PutBitsMask_u16u16u16: service-id=129, execution-context=UNSPECIFIED
      sw service arg Data: category=DATA_REFERENCE, sw-pointer-target-props={target-category=TYPE_REFERENCE, implementation-data-type=uint16}
      sw service arg Pattern: implementation-data-type=uint16
      sw service arg Mask: implementation-data-type=uint16
    Bfx_PutBitsMask_u32u32u32: service-id=130, execution-context=UNSPECIFIED
      sw service arg Data: category=DATA_REFERENCE, sw-pointer-target-props={target-category=TYPE_REFERENCE, implementation-data-type=uint32}
      sw service arg Pattern: implementation-data-type=uint32
      sw service arg Mask: implementation-data-type=uint32
    Bfx_PutBitsMask_u64u64u64: service-id=131, execution-context=UNSPECIFIED
      sw service arg Data: category=DATA_REFERENCE, sw-pointer-target-props={target-category=TYPE_REFERENCE, implementation-data-type=uint64}
      sw service arg Pattern: implementation-data-type=uint64
      sw service arg Mask: implementation-data-type=uint64
    Bfx_PutBit_u8u8u8: service-id=133, execution-context=UNSPECIFIED
      sw service arg Data: category=DATA_REFERENCE, sw-pointer-target-props={target-category=TYPE_REFERENCE, implementation-data-type=uint8}
      sw service arg BitPn: implementation-data-type=uint8
      sw service arg Status: implementation-data-type=boolean
    Bfx_PutBit_u16u8u8: service-id=134, execution-context=UNSPECIFIED
      sw service arg Data: category=DATA_REFERENCE, sw-pointer-target-props={target-category=TYPE_REFERENCE, implementation-data-type=uint16}
      sw service arg BitPn: implementation-data-type=uint8
      sw service arg Status: implementation-data-type=boolean
    Bfx_PutBit_u32u8u8: service-id=135, execution-context=UNSPECIFIED
      sw service arg Data: category=DATA_REFERENCE, sw-pointer-target-props={target-category=TYPE_REFERENCE, implementation-data-type=uint32}
      sw service arg BitPn: implementation-data-type=uint8
      sw service arg Status: implementation-data-type=boolean
    Bfx_PutBit_u64u8u8: service-id=136, execution-context=UNSPECIFIED
      sw service arg Data: category=DATA_REFERENCE, sw-pointer-target-props={target-category=TYPE_REFERENCE, implementation-data-type=uint64}
      sw service arg BitPn: implementation-data-type=uint8
      sw service arg Status: implementation-data-type=boolean
    Bfx_GetVersionInfo: service-id=255, execution-context=TASK
      sw service arg Versioninfo: category=DATA_REFERENCE, sw-pointer-target-props={target-category=TYPE_REFERENCE, implementation-data-type=Std_VersionInfoType}
package /AUTOSAR_Bfx/Implementations
  bsw implementation Bfx: programming-language=C, sw-version=20.0.1, vendor-id=17, ar-release-version=4.2.2, behavior=BfxBehavior, vendor-specific-module-def=Bfx
    code-descriptors:
      code Files: artifact-descriptors=[{short-label=ssc::src::Bfx.c, category=SWSRC}, {short-label=ssc::inc::Bfx.h, category=SWHDR}]
    resource consumption ResourceConsumption
      memory section CODE_ASIL_B_GLOBAL: alignment=UNSPECIFIED, sw-addrmethod=CODE
      section name prefix BFX
