entry &CORENAME
global &gCORENAME &gBASEPATH &gPROJECTNAME &gPLATFORM

&gCORENAME="&CORENAME"
&gBASEPATH="../.."
&gPROJECTNAME="mfc431"
&gPLATFORM="tda2"

do &(gBASEPATH)\common\init.cmm
