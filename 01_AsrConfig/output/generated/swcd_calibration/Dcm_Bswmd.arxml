AUTOSAR XML (schema 4-2-1)
package /AUTOSAR_Dcm/BswModuleDescriptions
  bsw module description Dcm: module-id=53, provided-entrys=Dcm_MainFunction
    bsw internal behavior InternalBehavior_0
      bsw schedulable entity Dcm_MainFunction: implemented-entry=Dcm_MainFunction
      bsw timing event TimingEvent_MainFunction: starts-on-event=Dcm_MainFunction, period=0.01
package /AUTOSAR_Dcm/BswModuleEntrys
  bsw module entry Dcm_MainFunction: service-id=37, is-reentrant=false, is-synchronous=true, call-type=SCHEDULED, execution-context=TASK, sw-service-impl-policy=STANDARD
package /EB_Dcm/Implementations
  bsw implementation BswImplementation_0: programming-language=C, sw-version=5.0.10, vendor-id=1, ar-release-version=4.0.3, behavior=InternalBehavior_0
    code-descriptors:
      code Files
        artifact-descriptors:
          short-label=Autosar::include::Dcm.h, category=SWHDR
          short-label=Autosar::include::Dcm_Cbk.h, category=SWHDR
          short-label=Autosar::include::Dcm_Dsl_ComMChannelStateManager.h, category=SWHDR
          short-label=Autosar::include::Dcm_Dsl_ComMChannelStateManager_External_Interface.h, category=SWHDR
          short-label=Autosar::include::Dcm_Dsl_CommunicationServices.h, category=SWHDR
          short-label=Autosar::include::Dcm_Dsl_CommunicationServices_BufferManager.h, category=SWHDR
          short-label=Autosar::include::Dcm_Dsl_CommunicationServices_MetaData.h, category=SWHDR
          short-label=Autosar::include::Dcm_Dsl_CommunicationServices_RxConnections.h, category=SWHDR
          short-label=Autosar::include::Dcm_Dsl_CommunicationServices_TxConnections.h, category=SWHDR
          short-label=Autosar::include::Dcm_Dsl_DiagnosticSessionHandler.h, category=SWHDR
          short-label=Autosar::include::Dcm_Dsl_PostBootOperationsHandler.h, category=SWHDR
          short-label=Autosar::include::Dcm_Dsl_RoeServices.h, category=SWHDR
          short-label=Autosar::include::Dcm_Dsl_SecurityLevelHandler.h, category=SWHDR
          short-label=Autosar::include::Dcm_Dsl_Supervisor.h, category=SWHDR
          short-label=Autosar::include::Dcm_Dsl_Supervisor_CommunicationSessionHandling.h, category=SWHDR
          short-label=Autosar::include::Dcm_Dsl_Supervisor_MainConnectionHandling.h, category=SWHDR
          short-label=Autosar::include::Dcm_Dsl_Supervisor_ProtocolHandling.h, category=SWHDR
          short-label=Autosar::include::Dcm_DspExternal.h, category=SWHDR
          short-label=Autosar::include::Dcm_Dsp_ApplicationDiagnosticRequests.h, category=SWHDR
          short-label=Autosar::include::Dcm_Dsp_Contexts.h, category=SWHDR
          short-label=Autosar::include::Dcm_Dsp_DataTransferServices.h, category=SWHDR
          short-label=Autosar::include::Dcm_Dsp_DemFacade.h, category=SWHDR
          short-label=Autosar::include::Dcm_Dsp_DidServices.h, category=SWHDR
          short-label=Autosar::include::Dcm_Dsp_DidSignals.h, category=SWHDR
          short-label=Autosar::include::Dcm_Dsp_EndiannessInterpretation.h, category=SWHDR
          short-label=Autosar::include::Dcm_Dsp_MemoryServices.h, category=SWHDR
          short-label=Autosar::include::Dcm_Dsp_MidServices.h, category=SWHDR
          short-label=Autosar::include::Dcm_Dsp_PidServices.h, category=SWHDR
          short-label=Autosar::include::Dcm_Dsp_SvcH_CommunicationControl.h, category=SWHDR
          short-label=Autosar::include::Dcm_Dsp_SvcH_ControlDTCSetting.h, category=SWHDR
          short-label=Autosar::include::Dcm_Dsp_SvcH_DynamicallyDefineDataIdentifier.h, category=SWHDR
          short-label=Autosar::include::Dcm_Dsp_SvcH_InputOutputControlByIdentifier.h, category=SWHDR
          short-label=Autosar::include::Dcm_Dsp_SvcH_LinkControl.h, category=SWHDR
          short-label=Autosar::include::Dcm_Dsp_SvcH_ReadDTCInformation.h, category=SWHDR
          short-label=Autosar::include::Dcm_Dsp_SvcH_ReadDataByIdentifier.h, category=SWHDR
          short-label=Autosar::include::Dcm_Dsp_SvcH_ReadDataByPeriodicIdentifier.h, category=SWHDR
          short-label=Autosar::include::Dcm_Dsp_SvcH_ReadMemoryByAddress.h, category=SWHDR
          short-label=Autosar::include::Dcm_Dsp_SvcH_ReadScalingDataByIdentifier.h, category=SWHDR
          short-label=Autosar::include::Dcm_Dsp_SvcH_RequestControlOfOnBoardSysTstComp.h, category=SWHDR
          short-label=Autosar::include::Dcm_Dsp_SvcH_RequestDownload.h, category=SWHDR
          short-label=Autosar::include::Dcm_Dsp_SvcH_RequestOnboardMonitoringTestResults.h, category=SWHDR
          short-label=Autosar::include::Dcm_Dsp_SvcH_RequestTransferExit.h, category=SWHDR
          short-label=Autosar::include::Dcm_Dsp_SvcH_RequestUpload.h, category=SWHDR
          short-label=Autosar::include::Dcm_Dsp_SvcH_RequestVehicleInformation.h, category=SWHDR
          short-label=Autosar::include::Dcm_Dsp_SvcH_ResponseOnEvent.h, category=SWHDR
          short-label=Autosar::include::Dcm_Dsp_SvcH_RoutineControl.h, category=SWHDR
          short-label=Autosar::include::Dcm_Dsp_SvcH_SecurityAccess.h, category=SWHDR
          short-label=Autosar::include::Dcm_Dsp_SvcH_TesterPresent.h, category=SWHDR
          short-label=Autosar::include::Dcm_Dsp_SvcH_TransferData.h, category=SWHDR
          short-label=Autosar::include::Dcm_Dsp_SvcH_WriteDataByIdentifier.h, category=SWHDR
          short-label=Autosar::include::Dcm_Dsp_SvcH_WriteMemoryByAddress.h, category=SWHDR
          short-label=Autosar::include::Dcm_Dsp_VinServices.h, category=SWHDR
          short-label=Autosar::include::Dcm_GenericServiceHandlers.h, category=SWHDR
          short-label=Autosar::include::Dcm_Hsm.h, category=SWHDR
          short-label=Autosar::include::Dcm_HsmCfg.h, category=SWHDR
          short-label=Autosar::include::Dcm_HsmDcm.h, category=SWHDR
          short-label=Autosar::include::Dcm_HsmDcmInt.h, category=SWHDR
          short-label=Autosar::include::Dcm_Int.h, category=SWHDR
          short-label=Autosar::include::Dcm_Trace.h, category=SWHDR
          short-label=Autosar::include::Dcm_Trace_Internal.h, category=SWHDR
          short-label=Autosar::include::Dcm_Types.h, category=SWHDR
          short-label=Autosar::include::Dcm_Version.h, category=SWHDR
          short-label=Autosar::src::Dcm.c, category=SWSRC
          short-label=Autosar::src::Dcm_Dsd.c, category=SWSRC
          short-label=Autosar::src::Dcm_Dsl_ComMChannelStateManager.c, category=SWSRC
          short-label=Autosar::src::Dcm_Dsl_CommunicationServices.c, category=SWSRC
          short-label=Autosar::src::Dcm_Dsl_CommunicationServices_BufferManager.c, category=SWSRC
          short-label=Autosar::src::Dcm_Dsl_CommunicationServices_MetaData.c, category=SWSRC
          short-label=Autosar::src::Dcm_Dsl_CommunicationServices_RxConnections.c, category=SWSRC
          short-label=Autosar::src::Dcm_Dsl_CommunicationServices_TxConnections.c, category=SWSRC
          short-label=Autosar::src::Dcm_Dsl_DiagnosticSessionHandler.c, category=SWSRC
          short-label=Autosar::src::Dcm_Dsl_PostBootOperationsHandler.c, category=SWSRC
          short-label=Autosar::src::Dcm_Dsl_RoeServices.c, category=SWSRC
          short-label=Autosar::src::Dcm_Dsl_SecurityLevelHandler.c, category=SWSRC
          short-label=Autosar::src::Dcm_Dsl_Supervisor.c, category=SWSRC
          short-label=Autosar::src::Dcm_Dsl_Supervisor_CommunicationSessionHandling.c, category=SWSRC
          short-label=Autosar::src::Dcm_Dsl_Supervisor_MainConnectionHandling.c, category=SWSRC
          short-label=Autosar::src::Dcm_Dsl_Supervisor_ProtocolHandling.c, category=SWSRC
          short-label=Autosar::src::Dcm_Dsp.c, category=SWSRC
          short-label=Autosar::src::Dcm_Dsp_ApplicationDiagnosticRequests.c, category=SWSRC
          short-label=Autosar::src::Dcm_Dsp_Contexts.c, category=SWSRC
          short-label=Autosar::src::Dcm_Dsp_DataTransferServices.c, category=SWSRC
          short-label=Autosar::src::Dcm_Dsp_DemFacade.c, category=SWSRC
          short-label=Autosar::src::Dcm_Dsp_DidServices.c, category=SWSRC
          short-label=Autosar::src::Dcm_Dsp_DidSignals.c, category=SWSRC
          short-label=Autosar::src::Dcm_Dsp_EndiannessInterpretation.c, category=SWSRC
          short-label=Autosar::src::Dcm_Dsp_MemoryServices.c, category=SWSRC
          short-label=Autosar::src::Dcm_Dsp_MidServices.c, category=SWSRC
          short-label=Autosar::src::Dcm_Dsp_PidServices.c, category=SWSRC
          short-label=Autosar::src::Dcm_Dsp_SvcH_CommunicationControl.c, category=SWSRC
          short-label=Autosar::src::Dcm_Dsp_SvcH_ControlDTCSetting.c, category=SWSRC
          short-label=Autosar::src::Dcm_Dsp_SvcH_DynamicallyDefineDataIdentifier.c, category=SWSRC
          short-label=Autosar::src::Dcm_Dsp_SvcH_InputOutputControlByIdentifier.c, category=SWSRC
          short-label=Autosar::src::Dcm_Dsp_SvcH_LinkControl.c, category=SWSRC
          short-label=Autosar::src::Dcm_Dsp_SvcH_ReadDTCInformation.c, category=SWSRC
          short-label=Autosar::src::Dcm_Dsp_SvcH_ReadDataByIdentifier.c, category=SWSRC
          short-label=Autosar::src::Dcm_Dsp_SvcH_ReadDataByPeriodicIdentifier.c, category=SWSRC
          short-label=Autosar::src::Dcm_Dsp_SvcH_ReadMemoryByAddress.c, category=SWSRC
          short-label=Autosar::src::Dcm_Dsp_SvcH_ReadScalingDataByIdentifier.c, category=SWSRC
          short-label=Autosar::src::Dcm_Dsp_SvcH_RequestControlOfOnBoardSysTstComp.c, category=SWSRC
          short-label=Autosar::src::Dcm_Dsp_SvcH_RequestDownload.c, category=SWSRC
          short-label=Autosar::src::Dcm_Dsp_SvcH_RequestOnboardMonitoringTestResults.c, category=SWSRC
          short-label=Autosar::src::Dcm_Dsp_SvcH_RequestTransferExit.c, category=SWSRC
          short-label=Autosar::src::Dcm_Dsp_SvcH_RequestUpload.c, category=SWSRC
          short-label=Autosar::src::Dcm_Dsp_SvcH_RequestVehicleInformation.c, category=SWSRC
          short-label=Autosar::src::Dcm_Dsp_SvcH_ResponseOnEvent.c, category=SWSRC
          short-label=Autosar::src::Dcm_Dsp_SvcH_RoutineControl.c, category=SWSRC
          short-label=Autosar::src::Dcm_Dsp_SvcH_SecurityAccess.c, category=SWSRC
          short-label=Autosar::src::Dcm_Dsp_SvcH_TesterPresent.c, category=SWSRC
          short-label=Autosar::src::Dcm_Dsp_SvcH_TransferData.c, category=SWSRC
          short-label=Autosar::src::Dcm_Dsp_SvcH_WriteDataByIdentifier.c, category=SWSRC
          short-label=Autosar::src::Dcm_Dsp_SvcH_WriteMemoryByAddress.c, category=SWSRC
          short-label=Autosar::src::Dcm_Dsp_VinServices.c, category=SWSRC
          short-label=Autosar::src::Dcm_Hsm.c, category=SWSRC
          short-label=Autosar::src::Dcm_HsmDcmData.c, category=SWSRC
          short-label=Autosar::src::Dcm_HsmDcmFnct.c, category=SWSRC
          short-label=make::Dcm_defs.mak, category=SWMAKE
          short-label=make::Dcm_rules.mak, category=SWMAKE
    mc-parameter-instances:
      mc data instance Dcm_DsdServiceUsed: category=ARRAY, array-size=2
        13 x mc data instance, all with category=VALUE:
          ServiceTable_0_DiagnosticSessionControl_ServiceId_16: resulting-properties={base-type=uint8, sw-bit-representation={bit-position=0, number-of-bits=1}, sw-calibration-access=READ-WRITE, data-constr=uint8}, symbol=[0][0]  # DcmDsdServiceUsed parameter for service DiagnosticSessionControl in Servicetable DcmDsdServiceTable_0
          ServiceTable_0_EcuReset_ServiceId_17: resulting-properties={base-type=uint8, sw-bit-representation={bit-position=1, number-of-bits=1}, sw-calibration-access=READ-WRITE, data-constr=uint8}, symbol=[0][0]  # DcmDsdServiceUsed parameter for service EcuReset in Servicetable DcmDsdServiceTable_0
          ServiceTable_0_ClearDiagnosticInformation_ServiceId_20: resulting-properties={base-type=uint8, sw-bit-representation={bit-position=2, number-of-bits=1}, sw-calibration-access=READ-WRITE, data-constr=uint8}, symbol=[0][0]  # DcmDsdServiceUsed parameter for service ClearDiagnosticInformation in Servicetable DcmDsdServiceTable_0
          ServiceTable_0_ReadDTCInformation_ServiceId_25: resulting-properties={base-type=uint8, sw-bit-representation={bit-position=3, number-of-bits=1}, sw-calibration-access=READ-WRITE, data-constr=uint8}, symbol=[0][0]  # DcmDsdServiceUsed parameter for service ReadDTCInformation in Servicetable DcmDsdServiceTable_0
          ServiceTable_0_ReadDid_ServiceId_34: resulting-properties={base-type=uint8, sw-bit-representation={bit-position=4, number-of-bits=1}, sw-calibration-access=READ-WRITE, data-constr=uint8}, symbol=[0][0]  # DcmDsdServiceUsed parameter for service ReadDid in Servicetable DcmDsdServiceTable_0
          ServiceTable_0_SecurityAccess_ServiceId_39: resulting-properties={base-type=uint8, sw-bit-representation={bit-position=5, number-of-bits=1}, sw-calibration-access=READ-WRITE, data-constr=uint8}, symbol=[0][0]  # DcmDsdServiceUsed parameter for service SecurityAccess in Servicetable DcmDsdServiceTable_0
          ServiceTable_0_CommunicationControl_ServiceId_40: resulting-properties={base-type=uint8, sw-bit-representation={bit-position=6, number-of-bits=1}, sw-calibration-access=READ-WRITE, data-constr=uint8}, symbol=[0][0]  # DcmDsdServiceUsed parameter for service CommunicationControl in Servicetable DcmDsdServiceTable_0
          ServiceTable_0_ReadDataByPeriodicIdentifier_ServiceId_42: resulting-properties={base-type=uint8, sw-bit-representation={bit-position=7, number-of-bits=1}, sw-calibration-access=READ-WRITE, data-constr=uint8}, symbol=[0][0]  # DcmDsdServiceUsed parameter for service ReadDataByPeriodicIdentifier in Servicetable DcmDsdServiceTable_0
          ServiceTable_0_WriteDid_ServiceId_46: resulting-properties={base-type=uint8, sw-bit-representation={bit-position=0, number-of-bits=1}, sw-calibration-access=READ-WRITE, data-constr=uint8}, symbol=[0][1]  # DcmDsdServiceUsed parameter for service WriteDid in Servicetable DcmDsdServiceTable_0
          ServiceTable_0_InputOutputControlByIdentifier_ServiceId_47: resulting-properties={base-type=uint8, sw-bit-representation={bit-position=1, number-of-bits=1}, sw-calibration-access=READ-WRITE, data-constr=uint8}, symbol=[0][1]  # DcmDsdServiceUsed parameter for service InputOutputControlByIdentifier in Servicetable DcmDsdServiceTable_0
          ServiceTable_0_RoutineControl_ServiceId_49: resulting-properties={base-type=uint8, sw-bit-representation={bit-position=2, number-of-bits=1}, sw-calibration-access=READ-WRITE, data-constr=uint8}, symbol=[0][1]  # DcmDsdServiceUsed parameter for service RoutineControl in Servicetable DcmDsdServiceTable_0
          ServiceTable_0_TesterPresent_ServiceId_62: resulting-properties={base-type=uint8, sw-bit-representation={bit-position=3, number-of-bits=1}, sw-calibration-access=READ-WRITE, data-constr=uint8}, symbol=[0][1]  # DcmDsdServiceUsed parameter for service TesterPresent in Servicetable DcmDsdServiceTable_0
          ServiceTable_0_ControlDTCSetting_ServiceId_133: resulting-properties={base-type=uint8, sw-bit-representation={bit-position=4, number-of-bits=1}, sw-calibration-access=READ-WRITE, data-constr=uint8}, symbol=[0][1]  # DcmDsdServiceUsed parameter for service ControlDTCSetting in Servicetable DcmDsdServiceTable_0
    resource consumption ResourceConsumption
