; Default command for "detach"
sys.mode nodebug
