AUTOSAR XML (schema 4-2-1)
package /AUTOSAR_CanNm/BswModuleDescriptions
  bsw module description CanNm: module-id=31, provided-entrys=CanNm_MainFunction
    bsw internal behavior InternalBehavior_0
      exclusive area SCHM_CANNM_EXCLUSIVE_AREA_0
      static-memorys:
        data CanNm_HsmInstCanNm_StateId_0: type=CanNm_HsmStateIdxType
      bsw schedulable entity CanNm_MainFunction: can-enter-exclusive-area=SCHM_CANNM_EXCLUSIVE_AREA_0, implemented-entry=CanNm_MainFunction
      bsw timing event TimingEvent_MainFunction: starts-on-event=CanNm_MainFunction, period=0.005
package /AUTOSAR_CanNm/BswModuleEntrys
  bsw module entry CanNm_MainFunction: service-id=0x13, is-reentrant=false, is-synchronous=true, call-type=SCHEDULED, execution-context=TASK, sw-service-impl-policy=STANDARD
package /AUTOSAR_CanNm/ImplementationDataTypes
  4 x impl type, all with category=TYPE_REFERENCE, type-emitter=BSW:
    CanNm_HsmStatechartPtrType: implementation-data-type=VoidPtr
    CanNm_HsmEventType: implementation-data-type=uint8
    CanNm_TimeType: implementation-data-type=uint16
    CanNm_HsmStateIdxType: implementation-data-type=uint8
package /EB_CanNm/Implementations
  bsw implementation BswImplementation_0: programming-language=C, sw-version=6.19.8, vendor-id=1, ar-release-version=4.0.3, behavior=InternalBehavior_0, vendor-specific-module-def=CanNm
    code-descriptors:
      code Files
        artifact-descriptors:
          short-label=Autosar::include::CanNm.h, category=SWHDR
          short-label=Autosar::include::CanNm_Api.h, category=SWHDR
          short-label=Autosar::include::CanNm_Cbk.h, category=SWHDR
          short-label=Autosar::include::CanNm_Hsm.h, category=SWHDR
          short-label=Autosar::include::CanNm_HsmCanNm.h, category=SWHDR
          short-label=Autosar::include::CanNm_HsmCanNmInt.h, category=SWHDR
          short-label=Autosar::include::CanNm_HsmCfg.h, category=SWHDR
          short-label=Autosar::include::CanNm_Int.h, category=SWHDR
          short-label=Autosar::include::CanNm_Lcfg_Static.h, category=SWHDR
          short-label=Autosar::include::CanNm_Trace.h, category=SWHDR
          short-label=Autosar::include::CanNm_Trace_Internal.h, category=SWHDR
          short-label=Autosar::include::CanNm_Version.h, category=SWHDR
          short-label=Autosar::src::CanNm.c, category=SWSRC
          short-label=Autosar::src::CanNm_Hsm.c, category=SWSRC
          short-label=Autosar::src::CanNm_HsmCanNmData.c, category=SWSRC
          short-label=Autosar::src::CanNm_HsmCanNmFnct.c, category=SWSRC
          short-label=make::CanNm_defs.mak, category=SWMAKE
          short-label=make::CanNm_rules.mak, category=SWMAKE
    resource consumption ResourceConsumption
      10 x memory section:
        CONST_8: alignment=8, sw-addrmethod=CONST
        CONST_32: alignment=32, sw-addrmethod=CONST
        VAR_INIT_8: alignment=8, sw-addrmethod=VAR
        CONST_UNSPECIFIED: alignment=UNSPECIFIED, sw-addrmethod=CONST
        CODE: sw-addrmethod=CODE
        VAR_INIT_UNSPECIFIED: alignment=UNSPECIFIED, sw-addrmethod=VAR
        VAR_CLEARED_8: alignment=8, sw-addrmethod=VAR_CLEARED
        VAR_CLEARED_UNSPECIFIED: alignment=UNSPECIFIED, sw-addrmethod=VAR_CLEARED
        VAR_INIT_BOOLEAN: alignment=8, sw-addrmethod=VAR
        CONFIG_DATA_UNSPECIFIED: alignment=UNSPECIFIED, sw-addrmethod=CONFIG_DATA
