AUTOSAR XML (schema 00045)
package /HeartbeatDet
  complex device driver sw component type HeartbeatDet
    behavior HeartbeatDet_IB_1: handle-termination-and-restart=NO-SUPPORT
      init event Cdd_HeartbeatDet_InitFunction_InitEvent: start-on-event=Cdd_HeartbeatDet_InitFunction
      timing event Cdd_HeartbeatDet_MainFunction_TimingEvent: start-on-event=Cdd_HeartbeatDet_MainFunction, period=0.005
      runnable Cdd_HeartbeatDet_InitFunction
      runnable Cdd_HeartbeatDet_MainFunction
  swc implementation HeartbeatDetImplementation: programming-language=C, sw-version=0.0.1, vendor-id=0, behavior=HeartbeatDet_IB_1
    code-descriptors:
      code CodeGen: artifact-descriptors=[{short-label=HeartbeatDet_C, category=SWSRC}, {short-label=HeartbeatDet_H, category=SWHDR}]
    resource consumption HeartbeatDet_Resource
      memory section CODE: sw-addrmethod=CODE
      memory section VAR_UNSPECIFIED: sw-addrmethod=VAR
