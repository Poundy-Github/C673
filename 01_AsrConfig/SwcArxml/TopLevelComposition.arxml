AUTOSAR XML (schema 00045)
package /TopLevelComposition
  composition sw component type TopLevelComposition
    49 x component:
      AebDs: type=AebDs
      BswM_OsApplication_C{0..3}_Prototype: type=BswM_OsApplication_C{0..3}
      Cdd_EvAdc: type=EvAdc
      Cdm_Prototype: type=Cdm
      ComM_Prototype: type=ComM
      Comco: type=Comco
      Cpr_Prototype: type=Cpr
      Cps_Prototype: type=Cps
      CtCdSPI: type=CtCdSPI
      Dcm_Prototype: type=Dcm
      Dem_Prototype: type=Dem
      DevelopmentErrorTracer_Prototype: type=DevelopmentErrorTracer
      Dsm_Prototype: type=Dsm
      EcuM_Prototype: type=EcuM
      Esh: type=Esh
      Esm_Core{1..3}_Prototype: type=Esm_Core{1..3}
      Esm_Prototype: type=Esm
      FSMonitor_Prototype: type=FSMonitor
      FctAdapter_Prototype: type=FctAdapter
      Fcu_Prototype: type=Fcu
      FiM_Prototype: type=FiM
      HeartbeatDet: type=HeartbeatDet
      HlaAdapter_Prototype: type=HlaAdapter
      LcfAdapter_Prototype: type=LcfAdapter
      Logging: type=Logging  # Logging_Prototype
      Med_Prototype: type=Med
      ModM: type=ModM
      MtsiAdapter_Prototype: type=MtsiAdapter
      Nvm_Prototype: type=NvM
      Qsm_Prototype: type=Qsm
      RtaAdapter_C{0..3}: type=RtaAdapter_C{0..3}
      Sdc_Prototype: type=Sdc
      Sed_Prototype: type=Sed
      SpiSync_Prototype: type=SpiSync
      StbM_Prototype: type=StbM
      Time_Prototype: type=Time
      TsaAdapter_Prototype: type=TsaAdapter
      VdyAdapter_Prototype: type=VdyAdapter
      VoltMonI: type=VoltMonI
      WdgM_CORE_0_Prototype: type=WdgM_CORE_0
      WdgM_CORE_1_Prototype: type=WdgM_CORE_1
    connect VdyAdapter_Prototype.PP_VdyAdapter_VdyOutputNvMData -> Cdm_Prototype.RP_VdyAdapter_VdyOutputNvMData
    connect Cdm_Prototype.PP_Cdm_VdyInputNvMData -> VdyAdapter_Prototype.RP_Cdm_VdyInputNvMData
    connect Sdc_Prototype.PP_Sdc_Cem_FusionObjectList -> FctAdapter_Prototype.RP_Sdc_Cem_FusionObjectList
    connect Sdc_Prototype.PP_Sdc_Cem_GenObjectList -> FctAdapter_Prototype.RP_Sdc_Cem_GenObjectList
    connect FctAdapter_Prototype.PP_FctAdapter_HeadOutputCustomData -> Fcu_Prototype.RP_FctAdapter_HeadOutputCustomData
    connect VdyAdapter_Prototype.PP_VdyAdapter_VehDyn -> FctAdapter_Prototype.RP_VdyAdapter_VehDyn
    connect Fcu_Prototype.PP_Fcu_VehPar -> LcfAdapter_Prototype.RP_Fcu_VehPar
    connect Fcu_Prototype.PP_Fcu_VehSig -> LcfAdapter_Prototype.RP_Fcu_VehSig
    connect Fcu_Prototype.PP_Fcu_LcfGenericInputData -> LcfAdapter_Prototype.RP_Fcu_LcfGenericInputData
    connect Fcu_Prototype.PP_Fcu_VehPar -> VdyAdapter_Prototype.RP_Fcu_VehPar
    connect Fcu_Prototype.PP_Fcu_VehSig -> VdyAdapter_Prototype.RP_Fcu_VehSig
    connect Fcu_Prototype.PP_Fcu_VehSig -> HlaAdapter_Prototype.RP_Fcu_VehSig
    connect Fcu_Prototype.PP_Fcu_DimInputCustomData -> FctAdapter_Prototype.RP_Fcu_DimInputCustomData
    connect Sdc_Prototype.PP_Sdc_Cem_GenObjectList -> Fcu_Prototype.RP_Sdc_Cem_GenObjectList
    connect LcfAdapter_Prototype.PP_LcfAdapter_LcfSenGenericOutputData -> Fcu_Prototype.RP_LcfAdapter_LcfSenGenericOutputData
    connect Fcu_Prototype.PP_Fcu_BaseCtrlData -> VdyAdapter_Prototype.RP_Fcu_BaseCtrlData
    connect Fcu_Prototype.PP_Fcu_BaseCtrlData -> LcfAdapter_Prototype.RP_Fcu_BaseCtrlData
    connect Fcu_Prototype.PP_Fcu_BaseCtrlData -> HlaAdapter_Prototype.RP_Fcu_BaseCtrlData
    connect LcfAdapter_Prototype.PP_LcfAdapter_LcfVehGenericOutputData -> Fcu_Prototype.RP_LcfAdapter_LcfVehGenericOutputData
    connect Sdc_Prototype.PP_Sdc_Perception_AbdOutputData -> LcfAdapter_Prototype.RP_Sdc_Perception_AbdOutputData
    connect Fcu_Prototype.PP_Fcu_DimInputGenericData -> FctAdapter_Prototype.RP_Fcu_DimInputGenericData
    connect VdyAdapter_Prototype.PP_VdyAdapter_VdyOffsets -> LcfAdapter_Prototype.RP_VdyAdapter_VdyOffsets
    connect VdyAdapter_Prototype.PP_VdyAdapter_VehDyn -> LcfAdapter_Prototype.RP_VdyAdapter_VehDyn
    connect Sdc_Prototype.PP_Sdc_Cem_GenObjectList -> LcfAdapter_Prototype.RP_Sdc_Cem_GenObjectList
    connect MtsiAdapter_Prototype.ppMtsiTxCallback -> MtsiAdapter_Prototype.rpMtsiTxCallback
    connect VdyAdapter_Prototype.PP_VdyAdapter_VehDyn -> Sdc_Prototype.RP_VdyAdapter_VehDyn
    connect Fcu_Prototype.PP_Fcu_FctCtrlData -> FctAdapter_Prototype.RP_Fcu_FctCtrlData
    connect Dsm_Prototype.PP_Dsm_ServiceRequestSupplierNotification -> Dcm_Prototype.ServiceRequestSupplierNotification_ServiceRequestSupplierNotification
    connect Fcu_Prototype.PP_Fcu_HeadInputCustomData -> FctAdapter_Prototype.RP_Fcu_HeadInputCustomData
    connect Fcu_Prototype.PP_Fcu_HeadInputGenericData -> FctAdapter_Prototype.RP_Fcu_HeadInputGenericData
    connect Fcu_Prototype.PP_Fcu_VehPar -> FctAdapter_Prototype.RP_Fcu_VehPar
    connect Fcu_Prototype.PP_Fcu_VehSig -> FctAdapter_Prototype.RP_Fcu_VehSig
    connect Sdc_Prototype.PP_Sdc_Cem_ARSObjectList -> FctAdapter_Prototype.RP_Sdc_Cem_ARSObjectList
    connect BswM_OsApplication_C0_Prototype.BswM_ModeSwitchPort_OsApplication_C0_BswMSwitchPort_DiagComControlState -> Comco.RP_BswM_MSI_DiagComControlMode
    connect BswM_OsApplication_C0_Prototype.BswM_ModeSwitchPort_OsApplication_C0_CanSMState_PrivateCan -> Esh.RP_BswM_CanSMState_PrivateCan
    connect BswM_OsApplication_C0_Prototype.BswM_ModeSwitchPort_OsApplication_C0_CanSMState_PublicCan -> Esh.RP_BswM_CanSMState_PublicCan
    connect Cdd_EvAdc.PP_Port_Cdd_EvAdc_GetValue_TMON_SYS1 -> Dsm_Prototype.RP_EvAdc_GetValue_TMON_SYS1
    connect Cdd_EvAdc.PP_Port_Cdd_EvAdc_GetValue_TMON_SYS1 -> Esh.RP_EvAdc_GetValue_TMON_SYS1
    connect Cdd_EvAdc.PP_Port_Cdd_EvAdc_GetValue_TMON_SYS1 -> FSMonitor_Prototype.RP_Fs_EvAdc_GetValue_VMON_SocExtTemp
    connect Cdd_EvAdc.PP_Port_Cdd_EvAdc_GetValue_TMON_SYS2 -> Dsm_Prototype.RP_EvAdc_GetValue_TMON_SYS2
    connect Cdd_EvAdc.PP_Port_Cdd_EvAdc_GetValue_TMON_SYS2 -> Esh.RP_EvAdc_GetValue_TMON_SYS2
    connect Cdd_EvAdc.PP_Port_Cdd_EvAdc_GetValue_TMON_SYS2 -> FSMonitor_Prototype.RP_Fs_EvAdc_GetValue_VMON_McuExtTemp
    connect Cdd_EvAdc.PP_Port_Cdd_EvAdc_GetValue_VMON_BATT -> Cdm_Prototype.RP_EvAdc_GetValue_VMON_BATT
    connect Cdd_EvAdc.PP_Port_Cdd_EvAdc_GetValue_VMON_BATT -> Dsm_Prototype.RP_EvAdc_GetValue_VMON_BATT
    connect Cdd_EvAdc.PP_Port_Cdd_EvAdc_GetValue_VMON_BATT -> Esh.RP_EvAdc_GetValue_VMON_BATT
    connect Cdd_EvAdc.PP_Port_Cdd_EvAdc_GetValue_VMON_BATT -> FSMonitor_Prototype.RP_Fs_EvAdc_GetValue_VMON_BATT
    connect Cdd_EvAdc.PP_Port_Cdd_EvAdc_GetValue_VMON_BATT -> VoltMonI.RP_EvAdc_GetValue_VMON_BATT
    connect Cdd_EvAdc.PP_Port_Cdd_EvAdc_GetValue_VMON_IGN -> Comco.RP_EvAdc_GetValue_VMON_IGN
    connect Cdd_EvAdc.PP_Port_Cdd_EvAdc_GetValue_VMON_IGN -> FSMonitor_Prototype.RP_Fs_EvAdc_GetValue_VMON_IGN
    connect Cdd_EvAdc.PP_Port_Cdd_EvAdc_GetValue_VMON_IGN -> VoltMonI.RP_EvAdc_GetValue_VMON_IGN
    connect Cdm_Prototype.PP_Cdm_BlockOp -> Dsm_Prototype.RP_Cdm_DsmBlockOp
    connect Cdm_Prototype.PP_Cdm_BlockOp -> Fcu_Prototype.RP_Cdm_FcuBlockOp
    connect Cdm_Prototype.PP_Cdm_NvmVdyMirror -> Nvm_Prototype.PMirror_NvM_BLOCK_VDYData
    connect ComM_Prototype.UR_ComMUser_Private -> Comco.RP_ComM_UserRequest_Private
    connect ComM_Prototype.UR_ComMUser_Public -> Comco.RP_ComM_UserRequest_Public
    connect Comco.PP_Comco_CSI_NMWakupFlag -> Esh.RP_Comco_CSI_NMWakupFlag
    connect Comco.PP_Comco_CSI_NMWakupFlag -> Esm_Prototype.RP_Comco_CSI_NMWakupFlag
    connect Comco.PP_Comco_CSI_NMWakupFlag -> VoltMonI.RP_Comco_CSI_NMWakupFlag
    connect Comco.PP_Comco_CSI_nmCurrentState -> Esm_Prototype.RP_Comco_CSI_nmCurrentState
    connect Comco.PP_Comco_MSI_RxPduGroupSwitch -> BswM_OsApplication_C0_Prototype.ModeNotificationPort_BswMSwcModeNotification_Comco_RxReq
    connect Comco.PP_Comco_MSI_TxPduGroupSwitch -> BswM_OsApplication_C0_Prototype.ModeNotificationPort_BswMSwcModeNotification_Comco_TxReq
    connect Cpr_Prototype.PP_Cpr_Adas_Data -> Fcu_Prototype.RP_Fcu_Adas_Data
    connect Cpr_Prototype.PP_Cpr_Adas_Data -> Med_Prototype.RP_Cpr_Adas_Data_SRI_Cpr_RxSignal_Adas
    connect Cpr_Prototype.PP_Cpr_Adas_Data -> Sdc_Prototype.RP_Sdc_Adas_Data
    connect Cpr_Prototype.PP_Cpr_Body_Data -> Esh.RP_Cpr_Body_Data
    connect Cpr_Prototype.PP_Cpr_Body_Data -> Fcu_Prototype.RP_Fcu_Body_Data
    connect Cpr_Prototype.PP_Cpr_Body_Data -> Med_Prototype.RP_Cpr_Body_Data_SRI_Cpr_Rxsignal_Body
    connect Cpr_Prototype.PP_Cpr_Body_Data -> Sdc_Prototype.RP_Sdc_Body_Data
    connect Cpr_Prototype.PP_Cpr_Chassis_Data -> AebDs.RP_Cpr_Chassis_Data
    connect Cpr_Prototype.PP_Cpr_Chassis_Data -> FSMonitor_Prototype.RP_Fs_Chassis_Data_EspVehSpd_Status
    connect Cpr_Prototype.PP_Cpr_Chassis_Data -> Fcu_Prototype.RP_Fcu_Chassis_Data
    connect Cpr_Prototype.PP_Cpr_Chassis_Data -> Med_Prototype.RP_Cpr_Chassis_Data_SRI_Cpr_RxSignal_Chassisd
    connect Cpr_Prototype.PP_Cpr_Chassis_Data -> Sdc_Prototype.RP_Sdc_Chassis_Data
    connect Cpr_Prototype.PP_Cpr_GetMsgStatusInfo -> Med_Prototype.RP_Cpr_GetMsgStatusInfo_CSI_Cpr_RxMessageState
    connect Cpr_Prototype.PP_Cpr_Powertrain_Data -> Fcu_Prototype.RP_Fcu_Powertrain_Data
    connect Cpr_Prototype.PP_Cpr_Powertrain_Data -> Med_Prototype.RP_Cpr_Powertrain_Data_SRI_Cpr_RxSignal_Powertrain
    connect Cpr_Prototype.PP_Cpr_Powertrain_Data -> Sdc_Prototype.RP_Sdc_Powertrain_Data
    connect Dcm_Prototype.DCMServices -> Dsm_Prototype.RP_Dcm_DCMServices
    connect Dem_Prototype.EnableCond_CONDITION_BcmPwrStsFbON -> Esh.RP_Dem_EC_BCMPowerModeState
    connect Dem_Prototype.EnableCond_CONDITION_EspVehSpd -> Esh.RP_Dem_EC_EspVehSpd
    connect Dem_Prototype.EnableCond_CONDITION_NO_BUSOFF_PrivateCAN -> Esh.RP_Dem_EC_PrivateBusoffEventCheck
    connect Dem_Prototype.EnableCond_CONDITION_NO_BUSOFF_PublicCAN -> Esh.RP_Dem_EC_PublicBusoffEventCheck
    connect Dem_Prototype.EnableCond_CONDITION_PowerON_3000ms -> Esh.RP_Dem_EC_PoweronTimer
    connect Dem_Prototype.EnableCond_CONDITION_Voltage_Normal -> Esh.RP_Dem_EC_BattVoltInNormalScope
    connect Dem_Prototype.OpCycle_DEM_OPCYC_IGN -> Esh.RP_Dem_OpCycle_OperationCycle_IGN
    connect Dsm_Prototype.PP_Dsm_RC_ApplicationRollback -> Dcm_Prototype.RoutineServices_DcmDspRoutine_0x0205
    connect Dsm_Prototype.PP_Dsm_RC_ClearNvM -> Dcm_Prototype.RoutineServices_DcmDspRoutine_0xF012
    connect Dsm_Prototype.PP_Dsm_RC_EOLCalibration -> Dcm_Prototype.RoutineServices_DcmDspRoutine_0x800B
    connect Dsm_Prototype.PP_Dsm_RC_ETHCableDiagnostic -> Dcm_Prototype.RoutineServices_DcmDspRoutine_0x0305
    connect Dsm_Prototype.PP_Dsm_RC_ETHCableLengthDiagnostic -> Dcm_Prototype.RoutineServices_DcmDspRoutine_0x030A
    connect Dsm_Prototype.PP_Dsm_RC_ETHEnableTestMode -> Dcm_Prototype.RoutineServices_DcmDspRoutine_0x0306
    connect Dsm_Prototype.PP_Dsm_RC_ETHPhyLoopBackTest -> Dcm_Prototype.RoutineServices_DcmDspRoutine_0x0307
    connect Dsm_Prototype.PP_Dsm_RC_ETHReadPhyRegister -> Dcm_Prototype.RoutineServices_DcmDspRoutine_0x0303
    connect Dsm_Prototype.PP_Dsm_RC_ETHResetMACAddress -> Dcm_Prototype.RoutineServices_DcmDspRoutine_0x0308
    connect Dsm_Prototype.PP_Dsm_RC_ETHResetMACLayerStatistic -> Dcm_Prototype.RoutineServices_DcmDspRoutine_0x0309
    connect Dsm_Prototype.PP_Dsm_RC_ETHResetPortConfiguration -> Dcm_Prototype.RoutineServices_DcmDspRoutine_0x0302
    connect Dsm_Prototype.PP_Dsm_RC_ETHSetPortConfiguration -> Dcm_Prototype.RoutineServices_DcmDspRoutine_0x0301
    connect Dsm_Prototype.PP_Dsm_RC_ExchangeApplicationRunningArea -> Dcm_Prototype.RoutineServices_DcmDspRoutine_0x0204
    connect Dsm_Prototype.PP_Dsm_RC_JTAGDisable -> Dcm_Prototype.RoutineServices_DcmDspRoutine_0x8010
    connect Dsm_Prototype.PP_Dsm_RC_OTPEnable -> Dcm_Prototype.RoutineServices_DcmDspRoutine_0x8011
    connect Dsm_Prototype.PP_Dsm_RC_ProgrammingPreconditionCheck -> Dcm_Prototype.RoutineServices_DcmDspRoutine_0x0203
    connect Dsm_Prototype.PP_Dsm_RC_SDACalibration -> Dcm_Prototype.RoutineServices_DcmDspRoutine_0x800C
    connect Dsm_Prototype.PP_Dsm_RC_SaveNvM -> Dcm_Prototype.RoutineServices_DcmDspRoutine_0xF013
    connect Dsm_Prototype.PP_Dsm_RDBI_AEB_Lastappeared -> Dcm_Prototype.DataServices_DcmDspData_FD19
    connect Dsm_Prototype.PP_Dsm_RDBI_AEB_Lastbutoneappeared -> Dcm_Prototype.DataServices_DcmDspData_FD16
    connect Dsm_Prototype.PP_Dsm_RDBI_APPDownloadArea -> Dcm_Prototype.DataServices_DcmDspData_F010
    connect Dsm_Prototype.PP_Dsm_RDBI_AWB_Lastappeared -> Dcm_Prototype.DataServices_DcmDspData_FD18
    connect Dsm_Prototype.PP_Dsm_RDBI_AWB_Lastbutoneappeared -> Dcm_Prototype.DataServices_DcmDspData_FD15
    connect Dsm_Prototype.PP_Dsm_RDBI_ActiveDiagnosticSessionDataIdentifier -> Dcm_Prototype.DataServices_DcmDspData_F186
    connect Dsm_Prototype.PP_Dsm_RDBI_BodyHeightWheelHouseEdge -> Dcm_Prototype.DataServices_DcmDspData_F1F5
    connect Dsm_Prototype.PP_Dsm_RDBI_CalibrationBoardDistance -> Dcm_Prototype.DataServices_DcmDspData_3BAF
    connect Dsm_Prototype.PP_Dsm_RDBI_CalibrationStatus -> Dcm_Prototype.DataServices_DcmDspData_F1F7
    connect Dsm_Prototype.PP_Dsm_RDBI_CurrentStaticCalibrationDetails -> Dcm_Prototype.DataServices_DcmDspData_F1F8
    connect Dsm_Prototype.PP_Dsm_RDBI_DiagnosticDefinitionDataIdentifier -> Dcm_Prototype.DataServices_DcmDspData_F122
    connect Dsm_Prototype.PP_Dsm_RDBI_ECUHardwareVersionNumber -> Dcm_Prototype.DataServices_DcmDspData_F191
    connect Dsm_Prototype.PP_Dsm_RDBI_ECUInternalSoftwareVersionNumber -> Dcm_Prototype.DataServices_DcmDspData_FD28
    connect Dsm_Prototype.PP_Dsm_RDBI_ECUSoftwareVersionNumberDataIdentifier -> Dcm_Prototype.DataServices_DcmDspData_F189
    connect Dsm_Prototype.PP_Dsm_RDBI_ECUSupplierVoltage -> Dcm_Prototype.DataServices_DcmDspData_11B5
    connect Dsm_Prototype.PP_Dsm_RDBI_ECUTemperature -> Dcm_Prototype.DataServices_DcmDspData_11B7
    connect Dsm_Prototype.PP_Dsm_RDBI_EOL_CalibrationParameters -> Dcm_Prototype.DataServices_DcmDspData_F1F9
    connect Dsm_Prototype.PP_Dsm_RDBI_EOL_LastResult -> Dcm_Prototype.DataServices_DcmDspData_F1FA
    connect Dsm_Prototype.PP_Dsm_RDBI_EOL_Previous_EOLResult -> Dcm_Prototype.DataServices_DcmDspData_F1FB
    connect Dsm_Prototype.PP_Dsm_RDBI_ETH_MAC_Address -> Dcm_Prototype.DataServices_DcmDspData_F1A3
    connect Dsm_Prototype.PP_Dsm_RDBI_ETH_ReadCommunication_ReadyStatus -> Dcm_Prototype.DataServices_DcmDspData_F1A9
    connect Dsm_Prototype.PP_Dsm_RDBI_ETH_ReadMACLayer_Statistics -> Dcm_Prototype.DataServices_DcmDspData_F1AB
    connect Dsm_Prototype.PP_Dsm_RDBI_ETH_ReadMasterSlave_Configures -> Dcm_Prototype.DataServices_DcmDspData_F1AA
    connect Dsm_Prototype.PP_Dsm_RDBI_ETH_ReadPHYLink_State -> Dcm_Prototype.DataServices_DcmDspData_F1A4
    connect Dsm_Prototype.PP_Dsm_RDBI_ETH_ReadPHYSignal_QualityIndex -> Dcm_Prototype.DataServices_DcmDspData_F1A5
    connect Dsm_Prototype.PP_Dsm_RDBI_ETH_ReadPort_Configuration -> Dcm_Prototype.DataServices_DcmDspData_F1A8
    connect Dsm_Prototype.PP_Dsm_RDBI_ETH_Read_NumberOfPorts -> Dcm_Prototype.DataServices_DcmDspData_F1A7
    connect Dsm_Prototype.PP_Dsm_RDBI_FBLRequirementSpecification -> Dcm_Prototype.DataServices_DcmDspData_F171
    connect Dsm_Prototype.PP_Dsm_RDBI_FBLVersionInformation -> Dcm_Prototype.DataServices_DcmDspData_F170
    connect Dsm_Prototype.PP_Dsm_RDBI_FCW_Lastappeared -> Dcm_Prototype.DataServices_DcmDspData_FD17
    connect Dsm_Prototype.PP_Dsm_RDBI_FCW_Lastbutoneappeared -> Dcm_Prototype.DataServices_DcmDspData_FD14
    connect Dsm_Prototype.PP_Dsm_RDBI_FunctionSpecificationDataIdentifier -> Dcm_Prototype.DataServices_DcmDspData_F121
    connect Dsm_Prototype.PP_Dsm_RDBI_ImagerTemperature -> Dcm_Prototype.DataServices_DcmDspData_FD25
    connect Dsm_Prototype.PP_Dsm_RDBI_InternalSocTemperature -> Dcm_Prototype.DataServices_DcmDspData_FD1E
    connect Dsm_Prototype.PP_Dsm_RDBI_InvalidAttemptCounter -> Dcm_Prototype.DataServices_DcmDspData_0103
    connect Dsm_Prototype.PP_Dsm_RDBI_MCU_AbankError -> Dcm_Prototype.DataServices_DcmDspData_FD26
    connect Dsm_Prototype.PP_Dsm_RDBI_MCU_BbankError -> Dcm_Prototype.DataServices_DcmDspData_FD27
    connect Dsm_Prototype.PP_Dsm_RDBI_NetworkInformationDataIdentifier -> Dcm_Prototype.DataServices_DcmDspData_F120
    connect Dsm_Prototype.PP_Dsm_RDBI_OMCalibrationStatus -> Dcm_Prototype.DataServices_DcmDspData_FD20
    connect Dsm_Prototype.PP_Dsm_RDBI_OMSN -> Dcm_Prototype.DataServices_DcmDspData_FD22
    connect Dsm_Prototype.PP_Dsm_RDBI_ProjectID -> Dcm_Prototype.DataServices_DcmDspData_FD21
    connect Dsm_Prototype.PP_Dsm_RDBI_SDA_LastResults -> Dcm_Prototype.DataServices_DcmDspData_F1FC
    connect Dsm_Prototype.PP_Dsm_RDBI_SecureUpdateLog -> Dcm_Prototype.DataServices_DcmDspData_FEC0
    connect Dsm_Prototype.PP_Dsm_RDBI_SocBootSensor -> Dcm_Prototype.DataServices_DcmDspData_FD23
    connect Dsm_Prototype.PP_Dsm_RDBI_SocSoftwareNumberDataIdentifier -> Dcm_Prototype.DataServices_DcmDspData_FD29
    connect Dsm_Prototype.PP_Dsm_RDBI_SocSoftwareVersion -> Dcm_Prototype.DataServices_DcmDspData_FD1F
    connect Dsm_Prototype.PP_Dsm_RDBI_SocSupplierSoftwareNumber -> Dcm_Prototype.DataServices_DcmDspData_F194
    connect Dsm_Prototype.PP_Dsm_RDBI_SoftwareNumber -> Dcm_Prototype.DataServices_DcmDspData_F188
    connect Dsm_Prototype.PP_Dsm_RDBI_applicationSoftwareFingerprintDataIdentifier -> Dcm_Prototype.DataServices_DcmDspData_F184
    connect Dsm_Prototype.PP_Dsm_RDBI_CalibrationDataIdentifier -> Dcm_Prototype.DataServices_DcmDspData_F123
    connect Dsm_Prototype.PP_Dsm_RWDBI_ECUHardwareVersionNumberDataIdentifier -> Dcm_Prototype.DataServices_DcmDspData_F089
    connect Dsm_Prototype.PP_Dsm_RWDBI_ECUSerialNumberDataIdentifier -> Dcm_Prototype.DataServices_DcmDspData_F18C
    connect Dsm_Prototype.PP_Dsm_RWDBI_EOL_ModeGate -> Dcm_Prototype.DataServices_DcmDspData_F1FF
    connect Dsm_Prototype.PP_Dsm_RWDBI_EcuOperationMode -> Dcm_Prototype.DataServices_DcmDspData_F1FD
    connect Dsm_Prototype.PP_Dsm_RWDBI_FABSwitch -> Dcm_Prototype.DataServices_DcmDspData_F1F1
    connect Dsm_Prototype.PP_Dsm_RWDBI_Fusa_Debug_Statua -> Dcm_Prototype.DataServices_DcmDspData_FD2A
    connect Dsm_Prototype.PP_Dsm_RWDBI_InternalTestMode -> Dcm_Prototype.DataServices_DcmDspData_FDFF
    connect Dsm_Prototype.PP_Dsm_RWDBI_LaneFunctionConfiguration -> Dcm_Prototype.DataServices_DcmDspData_F1FE
    connect Dsm_Prototype.PP_Dsm_RWDBI_PCBASerialNumberDataIdentifier -> Dcm_Prototype.DataServices_DcmDspData_FD24
    connect Dsm_Prototype.PP_Dsm_RWDBI_PartNumberDataIdentifier -> Dcm_Prototype.DataServices_DcmDspData_F187
    connect Dsm_Prototype.PP_Dsm_RWDBI_SocResetControl -> Dcm_Prototype.DataServices_DcmDspData_FD00
    connect Dsm_Prototype.PP_Dsm_RWDBI_SystemSupplierIdentifier -> Dcm_Prototype.DataServices_DcmDspData_F18A
    connect Dsm_Prototype.PP_Dsm_RWDBI_TLASwitch -> Dcm_Prototype.DataServices_DcmDspData_F1F3
    connect Dsm_Prototype.PP_Dsm_RWDBI_TSRSwitch -> Dcm_Prototype.DataServices_DcmDspData_F1F2
    connect Dsm_Prototype.PP_Dsm_RWDBI_VINDataIdentifier -> Dcm_Prototype.DataServices_DcmDspData_F190
    connect Dsm_Prototype.PP_Dsm_RWDBI_VehicleType -> Dcm_Prototype.DataServices_DcmDspData_F1F0
    connect Dsm_Prototype.PP_Dsm_SRI_InternalTestMode -> Med_Prototype.RP_Dsm_SRI_InternalTestMode
    connect Dsm_Prototype.PP_Dsm_SRI_InternalTestMode -> Sdc_Prototype.RP_Dsm_SRI_InternalTestMode
    connect Dsm_Prototype.PP_Dsm_SRI_SocResetControlState -> Esm_Prototype.RP_Dsm_SRI_SocResetControlState
    connect Dsm_Prototype.PP_Dsm_SecurityAccess_SA_Level1 -> Dcm_Prototype.SecurityAccess_SA_Level1
    connect EcuM_Prototype.shutdownTarget -> Esm_Prototype.RP_EcuM_ShutdownTarget_Switchoff
    connect Esh.PP_Esh_DemDataElementClass_ActualGearPosition -> Dem_Prototype.CBReadData_DemDataElementClass_GearPosition
    connect Esh.PP_Esh_DemDataElementClass_ECUTemperature -> Dem_Prototype.CBReadData_DemDataElementClass_ECUTemperature
    connect Esh.PP_Esh_DemDataElementClass_EngineSpeed -> Dem_Prototype.CBReadData_DemDataElementClass_EngineSpeed
    connect Esh.PP_Esh_DemDataElementClass_LocalTime -> Dem_Prototype.CBReadData_DemDataElementClass_LocalTime
    connect Esh.PP_Esh_DemDataElementClass_Odometer -> Dem_Prototype.CBReadData_DemDataElementClass_Odometer
    connect Esh.PP_Esh_DemDataElementClass_SOCErrMap -> Dem_Prototype.CBReadData_DemDataElementClass_Extended_SystemKernelErrMap
    connect Esh.PP_Esh_DemDataElementClass_SteeringAngle -> Dem_Prototype.CBReadData_DemDataElementClass_SteeringAngle
    connect Esh.PP_Esh_DemDataElementClass_VehicleSpeed -> Dem_Prototype.CBReadData_DemDataElementClass_VehicleSpeed
    connect Esh.PP_Esh_DemDataElementClass_Voltage -> Dem_Prototype.CBReadData_DemDataElementClass_Voltage
    connect Esh.PP_Esh_DemDataElementClass_YawRate -> Dem_Prototype.CBReadData_DemDataElementClass_Yawrate
    connect Esh.PP_Esh_SRI_Esh_ErrorStatusInfo -> Fcu_Prototype.RP_Fcu_SRI_Esh_ErrorStatusInfo
    connect FctAdapter_Prototype.PP_FctAdapter_HeadOutputCustomData -> AebDs.RP_FctAdapter_HeadOutputCustomData
    connect Fcu_Prototype.PP_Fcu_Cps_TxSignal_Acc -> Cps_Prototype.RP_Cps_SRI_TxSignal_Acc
    connect Fcu_Prototype.PP_Fcu_Cps_TxSignal_Aeb -> AebDs.RP_Fcu_Aeb_Data
    connect Fcu_Prototype.PP_Fcu_Cps_TxSignal_Aeb -> Cps_Prototype.RP_Cps_SRI_TxSignal_Aeb
    connect Fcu_Prototype.PP_Fcu_Cps_TxSignal_Hla -> Cps_Prototype.RP_Cps_SRI_TxSignal_Hla
    connect Fcu_Prototype.PP_Fcu_Cps_TxSignal_Lcf -> Cps_Prototype.RP_Cps_SRI_TxSignal_Lcf
    connect Fcu_Prototype.PP_Fcu_HlaInputData -> HlaAdapter_Prototype.RP_Fcu_HlaInputData
    connect FiM_Prototype.FI_FID_AEB -> Esh.RP_FIM_FunctionInhibition_AEB
    connect FiM_Prototype.FI_FID_ELK -> Esh.RP_FIM_FunctionInhibition_ELK
    connect FiM_Prototype.FI_FID_FAB -> Esh.RP_FIM_FunctionInhibition_FAB
    connect FiM_Prototype.FI_FID_FCW -> Esh.RP_FIM_FunctionInhibition_FCW
    connect FiM_Prototype.FI_FID_HLA -> Esh.RP_FIM_FunctionInhibition_HLA
    connect FiM_Prototype.FI_FID_LDW -> Esh.RP_FIM_FunctionInhibition_LDW
    connect FiM_Prototype.FI_FID_LKA -> Esh.RP_FIM_FunctionInhibition_LKA
    connect FiM_Prototype.FI_FID_TSA -> Esh.RP_FIM_FunctionInhibition_TSA
    connect FiM_Prototype.FI_FID_U17A1F0 -> Esh.RP_FIM_FunctionInhibition_LDW_U17A1F0
    connect HlaAdapter_Prototype.PP_HlaAdapter_OutputData -> Fcu_Prototype.RP_HlaAdapter_OutputData
    connect Med_Prototype.PP_Dem_CBStatusEvt_DEM_CAMERA_CALIBRATION_FAILURE -> Dem_Prototype.CBStatusEvt_DEM_CAMERA_CALIBRATION_FAILURE_1
    connect Med_Prototype.PP_Dem_CBStatusEvt_DEM_CAMERA_ONLINE_CALIBRATION_FAILURE -> Dem_Prototype.CBStatusEvt_DEM_CAMERA_ONLINE_CALIBRATION_FAILURE_1
    connect Med_Prototype.PP_Dem_CBStatusEvt_DEM_DTC_ADC_All_Node_Missing -> Dem_Prototype.CBStatusEvt_DEM_DTC_ADC_All_Node_Missing_1
    connect Med_Prototype.PP_Dem_CBStatusEvt_DEM_DTC_ADC_Message_Alive_Counter_Error -> Dem_Prototype.CBStatusEvt_DEM_DTC_ADC_Message_Alive_Counter_Error_1
    connect Med_Prototype.PP_Dem_CBStatusEvt_DEM_DTC_BCM_All_Node_Missing -> Dem_Prototype.CBStatusEvt_DEM_DTC_BCM_All_Node_Missing_1
    connect Med_Prototype.PP_Dem_CBStatusEvt_DEM_DTC_BCM_Brake_Lamp_Error -> Dem_Prototype.CBStatusEvt_DEM_DTC_BCM_Brake_Lamp_Error_1
    connect Med_Prototype.PP_Dem_CBStatusEvt_DEM_DTC_BCM_EmgyLi_Fault -> Dem_Prototype.CBStatusEvt_DEM_DTC_BCM_EmgyLi_Fault_1
    connect Med_Prototype.PP_Dem_CBStatusEvt_DEM_DTC_BCM_FrntWiperSts_Fault -> Dem_Prototype.CBStatusEvt_DEM_DTC_BCM_Frnt_Wiper_Sts_Fault_1
    connect Med_Prototype.PP_Dem_CBStatusEvt_DEM_DTC_BCM_Message_Alive_Counter_Error_40ms -> Dem_Prototype.CBStatusEvt_DEM_DTC_BCM_Message_Alive_Counter_Error_40ms_1
    connect Med_Prototype.PP_Dem_CBStatusEvt_DEM_DTC_BCM_TurnIndcrLight_Fault -> Dem_Prototype.CBStatusEvt_DEM_DTC_BCM_Turn_Indcr_Light_Fault_1
    connect Med_Prototype.PP_Dem_CBStatusEvt_DEM_DTC_EPS_APA_Epas_Fault -> Dem_Prototype.CBStatusEvt_DEM_DTC_EPS_APA_Epas_Fault_1
    connect Med_Prototype.PP_Dem_CBStatusEvt_DEM_DTC_EPS_ActualMotor_Invld -> Dem_Prototype.CBStatusEvt_DEM_DTC_EPS_Actual_Motor_Invld_1
    connect Med_Prototype.PP_Dem_CBStatusEvt_DEM_DTC_EPS_Actual_Motor_Torq_Invld -> Dem_Prototype.CBStatusEvt_DEM_DTC_EPS_Actual_Motor_Torq_Invld_1
    connect Med_Prototype.PP_Dem_CBStatusEvt_DEM_DTC_EPS_Actual_TorsionTorq_Invld -> Dem_Prototype.CBStatusEvt_DEM_DTC_EPS_Actual_Torsion_Torq_Invld_1
    connect Med_Prototype.PP_Dem_CBStatusEvt_DEM_DTC_EPS_All_Node_Missing -> Dem_Prototype.CBStatusEvt_DEM_DTC_EPS_All_Node_Missing_1
    connect Med_Prototype.PP_Dem_CBStatusEvt_DEM_DTC_EPS_Driver_handtorque_invalid -> Dem_Prototype.CBStatusEvt_DEM_DTC_EPS_Driver_hand_torque_invalid_1
    connect Med_Prototype.PP_Dem_CBStatusEvt_DEM_DTC_EPS_Fault -> Dem_Prototype.CBStatusEvt_DEM_DTC_EPS_Fault_1
    connect Med_Prototype.PP_Dem_CBStatusEvt_DEM_DTC_EPS_Message_Alive_Counter_Error_10ms -> Dem_Prototype.CBStatusEvt_DEM_DTC_EPS_Message_Alive_Counter_Error_10ms_1
    connect Med_Prototype.PP_Dem_CBStatusEvt_DEM_DTC_EPS_Message_Alive_Counter_Error_20ms -> Dem_Prototype.CBStatusEvt_DEM_DTC_EPS_Message_Alive_Counter_Error_20ms_1
    connect Med_Prototype.PP_Dem_CBStatusEvt_DEM_DTC_EPS_Pinionang_Fault -> Dem_Prototype.CBStatusEvt_DEM_DTC_EPS_Pinionang_Fault_1
    connect Med_Prototype.PP_Dem_CBStatusEvt_DEM_DTC_EPS_Pinionang_Invld -> Dem_Prototype.CBStatusEvt_DEM_DTC_EPS_Pinionang_Invld_1
    connect Med_Prototype.PP_Dem_CBStatusEvt_DEM_DTC_EPS_Sas_NOT_Cal -> Dem_Prototype.CBStatusEvt_DEM_DTC_EPS_Sas_NOT_Cal_1
    connect Med_Prototype.PP_Dem_CBStatusEvt_DEM_DTC_EPS_Steer_AgSens_Fault -> Dem_Prototype.CBStatusEvt_DEM_DTC_EPS_Steer_AgSens_Fault_1
    connect Med_Prototype.PP_Dem_CBStatusEvt_DEM_DTC_EPS_Steering_wheelvibration_failure -> Dem_Prototype.CBStatusEvt_DEM_DTC_EPS_Steering_wheel_vibration_failure_1
    connect Med_Prototype.PP_Dem_CBStatusEvt_DEM_DTC_ESP_ABA_NOT_Available -> Dem_Prototype.CBStatusEvt_DEM_DTC_ESP_ABA_NOT_Available_1
    connect Med_Prototype.PP_Dem_CBStatusEvt_DEM_DTC_ESP_ABS_Fault -> Dem_Prototype.CBStatusEvt_DEM_DTC_ESP_ABS_Fault_1
    connect Med_Prototype.PP_Dem_CBStatusEvt_DEM_DTC_ESP_AEB_NOT_Available -> Dem_Prototype.CBStatusEvt_DEM_DTC_ESP_AEB_NOT_Available_1
    connect Med_Prototype.PP_Dem_CBStatusEvt_DEM_DTC_ESP_AWB_NOT_Available -> Dem_Prototype.CBStatusEvt_DEM_DTC_ESP_AWB_NOT_Available_1
    connect Med_Prototype.PP_Dem_CBStatusEvt_DEM_DTC_ESP_All_Node_Missing -> Dem_Prototype.CBStatusEvt_DEM_DTC_ESP_All_Node_Missing_1
    connect Med_Prototype.PP_Dem_CBStatusEvt_DEM_DTC_ESP_Lat_Accel_Invld -> Dem_Prototype.CBStatusEvt_DEM_DTC_ESP_Lat_Accel_Invld_1
    connect Med_Prototype.PP_Dem_CBStatusEvt_DEM_DTC_ESP_Long_Accel_Invld -> Dem_Prototype.CBStatusEvt_DEM_DTC_ESP_Long_Accel_Invld_1
    connect Med_Prototype.PP_Dem_CBStatusEvt_DEM_DTC_ESP_Message_Alive_Counter_Error -> Dem_Prototype.CBStatusEvt_DEM_DTC_ESP_Message_Alive_Counter_Error_1
    connect Med_Prototype.PP_Dem_CBStatusEvt_DEM_DTC_ESP_Message_Alive_Counter_Error_100ms -> Dem_Prototype.CBStatusEvt_DEM_DTC_ESP_Message_Alive_Counter_Error_100ms_1
    connect Med_Prototype.PP_Dem_CBStatusEvt_DEM_DTC_ESP_TCS_Fault -> Dem_Prototype.CBStatusEvt_DEM_DTC_ESP_TCS_Fault_1
    connect Med_Prototype.PP_Dem_CBStatusEvt_DEM_DTC_ESP_Veh_Spd_Invld -> Dem_Prototype.CBStatusEvt_DEM_DTC_ESP_Veh_Spd_Invld_1
    connect Med_Prototype.PP_Dem_CBStatusEvt_DEM_DTC_ESP_Yaw_Rate_Invld -> Dem_Prototype.CBStatusEvt_DEM_DTC_ESP_Yaw_Rate_Invld_1
    connect Med_Prototype.PP_Dem_CBStatusEvt_DEM_DTC_Esp_Ebd_Failr -> Dem_Prototype.CBStatusEvt_DEM_DTC_Esp_Ebd_Failr_1
    connect Med_Prototype.PP_Dem_CBStatusEvt_DEM_DTC_FR_All_Node_Missing -> Dem_Prototype.CBStatusEvt_DEM_DTC_FR_All_Node_Missing_1
    connect Med_Prototype.PP_Dem_CBStatusEvt_DEM_DTC_Fradar_hardware_error -> Dem_Prototype.CBStatusEvt_DEM_DTC_Fradar_hardware_error_1
    connect Med_Prototype.PP_Dem_CBStatusEvt_DEM_DTC_Fradar_not_calibration_or_blockage -> Dem_Prototype.CBStatusEvt_DEM_DTC_Fradar_not_calibration_or_blockage_1
    connect Med_Prototype.PP_Dem_CBStatusEvt_DEM_DTC_Front_Radar_Alive_Counter_Error -> Dem_Prototype.CBStatusEvt_DEM_DTC_Front_Radar_Alive_Counter_Error_1
    connect Med_Prototype.PP_Dem_CBStatusEvt_DEM_DTC_IB_Brk_Pedl_Invld -> Dem_Prototype.CBStatusEvt_DEM_DTC_IB_Brk_Pedl_Invld_1
    connect Med_Prototype.PP_Dem_CBStatusEvt_DEM_DTC_IP_message_alive_counter_error -> Dem_Prototype.CBStatusEvt_DEM_DTC_IP_message_alive_counter_error_1
    connect Med_Prototype.PP_Dem_CBStatusEvt_DEM_DTC_IP_node_missing -> Dem_Prototype.CBStatusEvt_DEM_DTC_IP_node_missing_1
    connect Med_Prototype.PP_Dem_CBStatusEvt_DEM_DTC_IP_warning_invalid -> Dem_Prototype.CBStatusEvt_DEM_DTC_IP_warning_invalid_1
    connect Med_Prototype.PP_Dem_CBStatusEvt_DEM_DTC_J3_Camera_Blockage -> Dem_Prototype.CBStatusEvt_DEM_DTC_J3_Camera_Blockage_1
    connect Med_Prototype.PP_Dem_CBStatusEvt_DEM_DTC_J3_Camera_Error -> Dem_Prototype.CBStatusEvt_DEM_DTC_J3_Camera_Error_1
    connect Med_Prototype.PP_Dem_CBStatusEvt_DEM_DTC_J3_SOC_CPU_Error_PWM_Missing -> Dem_Prototype.CBStatusEvt_DEM_DTC_J3_SOC_CPU_Error_PWM_Missing_1
    connect Med_Prototype.PP_Dem_CBStatusEvt_DEM_DTC_J3_SOC_Perception_Error -> Dem_Prototype.CBStatusEvt_DEM_DTC_J3_SOC_Perception_Error_1
    connect Med_Prototype.PP_Dem_CBStatusEvt_DEM_DTC_J3_SOC_Safetylib_Error -> Dem_Prototype.CBStatusEvt_DEM_DTC_J3_SOC_Safetylib_Error_1
    connect Med_Prototype.PP_Dem_CBStatusEvt_DEM_DTC_J3_SOC_System_Service_Error -> Dem_Prototype.CBStatusEvt_DEM_DTC_J3_SOC_System_Service_Error_1
    connect Med_Prototype.PP_Dem_CBStatusEvt_DEM_DTC_J3_Time_Sync_Error -> Dem_Prototype.CBStatusEvt_DEM_DTC_J3_Time_Sync_Error_1
    connect Med_Prototype.PP_Dem_CBStatusEvt_DEM_DTC_MCU_TEMP_INITIAL_HIGH -> Dem_Prototype.CBStatusEvt_DEM_DTC_MCU_TEMP_INITIAL_HIGH_1
    connect Med_Prototype.PP_Dem_CBStatusEvt_DEM_DTC_Private_CAN_Bus_Off -> Dem_Prototype.CBStatusEvt_DEM_DTC_Private_CAN_Bus_Off_1
    connect Med_Prototype.PP_Dem_CBStatusEvt_DEM_DTC_Public_CAN_Bus_Off -> Dem_Prototype.CBStatusEvt_DEM_DTC_Public_CAN_Bus_Off_1
    connect Med_Prototype.PP_Dem_CBStatusEvt_DEM_DTC_RLR_Message_Alive_Counter_Error -> Dem_Prototype.CBStatusEvt_DEM_DTC_RLR_Message_Alive_Counter_Error_1
    connect Med_Prototype.PP_Dem_CBStatusEvt_DEM_DTC_SRS_All_Node_Missing -> Dem_Prototype.CBStatusEvt_DEM_DTC_SRS_All_Node_Missing_1
    connect Med_Prototype.PP_Dem_CBStatusEvt_DEM_DTC_SRS_Drvr_BucSwt_Invld -> Dem_Prototype.CBStatusEvt_DEM_DTC_SRS_Drvr_BucSwt_Invld_1
    connect Med_Prototype.PP_Dem_CBStatusEvt_DEM_DTC_SRS_Message_Alive_Counter_Error -> Dem_Prototype.CBStatusEvt_DEM_DTC_SRS_Message_Alive_Counter_Error_1
    connect Med_Prototype.PP_Dem_CBStatusEvt_DEM_DTC_VCU_Accr_Pedl_Posn_Invld -> Dem_Prototype.CBStatusEvt_DEM_DTC_VCU_Accr_Pedl_Posn_Invld_1
    connect Med_Prototype.PP_Dem_CBStatusEvt_DEM_DTC_VCU_All_Node_Missing -> Dem_Prototype.CBStatusEvt_DEM_DTC_VCU_All_Node_Missing_1
    connect Med_Prototype.PP_Dem_CBStatusEvt_DEM_DTC_VCU_Gear_Posn_Invld -> Dem_Prototype.CBStatusEvt_DEM_DTC_VCU_Gear_Posn_Invld_1
    connect Med_Prototype.PP_Dem_CBStatusEvt_DEM_DTC_VCU_Message_Alive_Counter_Error -> Dem_Prototype.CBStatusEvt_DEM_DTC_VCU_Message_Alive_Counter_Error_1
    connect Med_Prototype.PP_Dem_CBStatusEvt_DEM_DTC_Whl_Spd_Data_Invld -> Dem_Prototype.CBStatusEvt_DEM_DTC_Whl_Spd_Data_Invld_1
    connect Med_Prototype.PP_Dem_CBStatusEvt_DEM_DTC_Whl_Spd_Dir_Invld -> Dem_Prototype.CBStatusEvt_DEM_DTC_Whl_Spd_Dir_Invld_1
    connect Med_Prototype.PP_Dem_CBStatusEvt_DEM_DTC_Whl_Spd_Pls_Invld -> Dem_Prototype.CBStatusEvt_DEM_DTC_Whl_Spd_Pls_Invld_1
    connect Med_Prototype.PP_Dem_CBStatusEvt_DEM_J3_SYS_KERNEL_SW -> Dem_Prototype.CBStatusEvt_DEM_J3_SYS_KERNEL_SW_1
    connect Med_Prototype.PP_Dem_CBStatusEvt_DEM_MCU_TEMP_EXT_HIGH -> Dem_Prototype.CBStatusEvt_DEM_MCU_TEMP_EXT_HIGH_1
    connect Med_Prototype.PP_Dem_CBStatusEvt_DEM_MCU_TEMP_EXT_LOW -> Dem_Prototype.CBStatusEvt_DEM_MCU_TEMP_EXT_LOW_1
    connect Med_Prototype.PP_Dem_CBStatusEvt_DEM_SOCJ3_TEMP_EXT_HIGH -> Dem_Prototype.CBStatusEvt_DEM_SOCJ3_TEMP_EXT_HIGH_1
    connect Med_Prototype.PP_Dem_CBStatusEvt_DEM_VMON_BATT_HIGH -> Dem_Prototype.CBStatusEvt_DEM_VMON_BATT_HIGH_1
    connect Med_Prototype.PP_Dem_CBStatusEvt_DEM_VMON_BATT_LOW -> Dem_Prototype.CBStatusEvt_DEM_VMON_BATT_LOW_1
    connect Med_Prototype.PP_Dem_CBStatusEvt_SPI_E_HARDWARE_ERROR -> Dem_Prototype.CBStatusEvt_SPI_E_HARDWARE_ERROR_1
    connect MtsiAdapter_Prototype.ppMeasFreezeData -> FctAdapter_Prototype.RP_MtsiAdapter_MeasFreezeData
    connect MtsiAdapter_Prototype.ppMeasFreezeData -> HlaAdapter_Prototype.RP_MtsiAdapter_MeasFreezeData
    connect MtsiAdapter_Prototype.ppMeasFreezeData -> LcfAdapter_Prototype.RP_MtsiAdapter_MeasFreezeData
    connect MtsiAdapter_Prototype.ppMeasFreezeData -> VdyAdapter_Prototype.RP_MtsiAdapter_MeasFreezeData
    connect MtsiAdapter_Prototype.ppUpdateTaskCycle -> FctAdapter_Prototype.RP_UpdateTaskCycle
    connect MtsiAdapter_Prototype.ppUpdateTaskCycle -> HlaAdapter_Prototype.RP_UpdateTaskCycle
    connect MtsiAdapter_Prototype.ppUpdateTaskCycle -> LcfAdapter_Prototype.RP_MtsiAdapter_UpdateTaskCycle
    connect MtsiAdapter_Prototype.ppUpdateTaskCycle -> RtaAdapter_C{0..3}.RP_MtsiAdapter_UpdateTaskCycle
    connect MtsiAdapter_Prototype.ppUpdateTaskCycle -> VdyAdapter_Prototype.RP_MtsiAdapter_UpdateTaskCycle
    connect Nvm_Prototype.PS_NVM_BLOCK_AEBLastappearFD19 -> Dsm_Prototype.RP_Nvm_AEBLastappearFD19
    connect Nvm_Prototype.PS_NVM_BLOCK_AEBLastbutoneappearFD16 -> Dsm_Prototype.RP_Nvm_AEBLastbutoneappearFD16
    connect Nvm_Prototype.PS_NVM_BLOCK_AWBLastbutoneappearFD15 -> Dsm_Prototype.RP_Nvm_AWBLastbutoneappearFD15
    connect Nvm_Prototype.PS_NVM_BLOCK_AWBLasteappearFD18 -> Dsm_Prototype.RP_Nvm_AWBLasteappearFD18
    connect Nvm_Prototype.PS_NVM_BLOCK_EOL_Info_Input -> Dsm_Prototype.RP_Nvm_EOL_Info_Input
    connect Nvm_Prototype.PS_NVM_BLOCK_FAB_switch -> Dsm_Prototype.RP_Nvm_FAB_switch
    connect Nvm_Prototype.PS_NVM_BLOCK_FCWLastappearFD17 -> Dsm_Prototype.RP_Nvm_FCWLastappearFD17
    connect Nvm_Prototype.PS_NVM_BLOCK_FCWLastbutoneappearedFD14 -> Dsm_Prototype.RP_Nvm_FCWLastbutoneappearedFD14
    connect Nvm_Prototype.PS_NVM_BLOCK_Security_AttemptCount -> Dsm_Prototype.RP_Nvm_Security_AttemptCount
    connect Nvm_Prototype.PS_NVM_BLOCK_SerialNumberDataId -> Dsm_Prototype.RP_Nvm_SerialNumberDataId
    connect Nvm_Prototype.PS_NVM_BLOCK_TLA_switch -> Dsm_Prototype.RP_Nvm_TLA_switch
    connect Nvm_Prototype.PS_NVM_BLOCK_TSR_switch -> Dsm_Prototype.RP_Nvm_TSR_switch
    connect Nvm_Prototype.PS_NVM_BLOCK_VINDataIdentifier -> Dsm_Prototype.RP_Nvm_VINDataIdentifier
    connect Nvm_Prototype.PS_NvM_BLOCK_FS_Debug_Status -> Dsm_Prototype.RP_Nvm_FS_Debug_Status
    connect Nvm_Prototype.PS_NvM_BLOCK_VDYData -> Dsm_Prototype.RP_Nvm_VdyBlockOperation
    connect Nvm_Prototype.PS_NvM_BLOCK_VDYData -> VdyAdapter_Prototype.RP_NvM_VdyBlockOperation
    connect Nvm_Prototype.PS_NvM_Block_EOLCalibrationData -> Dsm_Prototype.RP_Nvm_EOLCalibrationData
    connect Nvm_Prototype.PS_NvM_Block_Fingerprint -> Dsm_Prototype.RP_Nvm_Fingerprint
    connect Nvm_Prototype.PS_NvM_Block_HMISwitchStatus -> Fcu_Prototype.RP_Nvm_HMISwitchStatus
    connect Nvm_Prototype.PS_NvM_Block_LaneFunctionConfiguration -> Dsm_Prototype.RP_Nvm_LaneFunctionConfiguration
    connect Nvm_Prototype.PS_NvM_Block_PCBASerialNumberDataIdentifier -> Dsm_Prototype.RP_Nvm_PCBASerialNumberDataIdentifier
    connect Nvm_Prototype.PS_NvM_Block_SDACalibrationData -> Dsm_Prototype.RP_Nvm_SDACalibrationData
    connect Nvm_Prototype.PS_NvM_Block_Vehicletype -> Dsm_Prototype.RP_Nvm_Vehicletype
    connect Qsm_Prototype.PP_QsmDsmBlockStartup_Flag -> Cdm_Prototype.PP_Qsm_DsmBlock_Startup_Flag
    connect Qsm_Prototype.PP_QsmDsmBlockStartup_Flag -> Dsm_Prototype.RP_Qsm_BlockStartup_FlagOp
    connect Qsm_Prototype.PP_Qsm_DsmBlockPartNumber_Sector -> Cdm_Prototype.RP_Qsm_DsmBlock_PartNumber_Sector
    connect Qsm_Prototype.PP_Qsm_DsmBlockPartNumber_Sector -> Dsm_Prototype.RP_Qsm_BlockPartNumber_SectorOp
    connect Qsm_Prototype.PP_Qsm_DsmBlock_EOLModeGateOp -> Cdm_Prototype.RP_Qsm_DsmBlock_EOLModeGateOp
    connect Qsm_Prototype.PP_Qsm_DsmBlock_EOLModeGateOp -> Dsm_Prototype.RP_Qsm_Block_EOLModeGateOP
    connect Qsm_Prototype.PP_Qsm_DsmSecureUpdateLogOp -> Cdm_Prototype.PP_Qsm_DsmBlock_SecureUpdateLogOp
    connect Qsm_Prototype.PP_Qsm_DsmSecureUpdateLogOp -> Dsm_Prototype.RP_Qsm_BlockSecureUpdateLogOp
    connect Sdc_Prototype.PP_Sdc_Cem_GenObjectList -> AebDs.RP_Sdc_Cem_GenObjectList
    connect Sdc_Prototype.PP_Sdc_SendInterface_Calibration -> Dsm_Prototype.RP_Sdc_SendInterface_Calibration
    connect Sdc_Prototype.PP_Sdc_SendInterface_Calibration -> Esh.RP_Sdc_SendInterface_Calibration
    connect Sdc_Prototype.PP_Sdc_SendInterface_Diag -> Dsm_Prototype.RP_Sdc_SendInterface_Diag
    connect Sdc_Prototype.PP_Sdc_SendInterface_Diag -> Esh.RP_Sdc_SendInterface_Diag
    connect Sdc_Prototype.PP_Sdc_SendInterface_Diag -> Sed_Prototype.RP_Sdc_SendInterface_Diag
    connect Sdc_Prototype.PP_Sdc_SendInterface_Eth -> Dsm_Prototype.RP_Sdc_SendInterface_Eth
    connect Sdc_Prototype.PP_Sdc_SendInterface_Eth -> Sed_Prototype.RP_Sdc_SendInterface_Eth
    connect Sdc_Prototype.PP_Sdc_SendInterface_Perception -> Fcu_Prototype.RP_Sdc_SendInterface_Perception
    connect Sdc_Prototype.PP_Sdc_SendInterface_SocInfo -> Dsm_Prototype.RP_Sdc_SendInterface_SocInfo
    connect Sdc_Prototype.PP_Sdc_SendInterface_SocInfo -> Esm_Prototype.RP_Sdc_SendInterface_SocInfo
    connect Sdc_Prototype.PP_Sdc_SendInterface_TSync -> SpiSync_Prototype.RP_Sdc_TimeSync
    connect StbM_Prototype.GlobalTime_Slave_StbMSynchronizedTimeBase_0 -> Time_Prototype.GlobalTime_Slave_StbMSynchronizedTimeBase_0
    connect Time_Prototype.CS_Time_GetTimeStampInfo -> Dsm_Prototype.RP_Time_GlobalTime
    connect Time_Prototype.CS_Time_GetTimeStampInfo -> Esh.RP_Time_GlobalTime
    connect Time_Prototype.CS_Time_GetTimeStampInfo -> Esm_Prototype.RP_Time_GlobalTime
    connect VdyAdapter_Prototype.PP_VdyAdapter_VehDyn -> HlaAdapter_Prototype.RP_VdyAdapter_VehDynData
    connect VoltMonI.PP_VoltMonI_SRI_DisableCommunication -> Comco.RP_VoltMonI_SRI_DisableCommunication
    connect VoltMonI.PP_VoltMonI_SRI_VoltState -> Med_Prototype.RP_VoltMonI_SRI_VoltState
