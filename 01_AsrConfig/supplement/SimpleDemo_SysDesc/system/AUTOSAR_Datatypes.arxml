AUTOSAR XML (schema 4-0-3)
standard types defined: void, sint8, sint16, sint32, uint8, uint16, uint32, uint64, sint8_least, sint16_least, sint32_least, uint8_least, uint16_least, uint32_least, float32, float64, boolean
package /AUTOSAR_Platform/CompuMethods
  compu method boolean_Literals: 0=FALSE, 1=TRUE
