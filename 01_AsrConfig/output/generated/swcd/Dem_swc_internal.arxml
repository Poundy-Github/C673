[part 3 of 3: packages /AUTOSAR_Dem/SwComponentTypes to /EB_Dem/SwcImplementations]
AUTOSAR XML (schema 4-0-3)
package /AUTOSAR_Dem/SwComponentTypes  (continued)
  service sw component type Dem  (continued)
    behavior DemIntBeh: handle-termination-and-restart=NO-SUPPORT, included-data-type-set=data-type=[Dem_EventStatusType, Dem_InitMonitorReasonType, Dem_IndicatorStatusType, Dem_EnableConditionType]  (continued)
      1413 x operation invoked event:  (continued)
        EV_PrestoreFreezeFrame_EvtDEM_DTC_FR_All_Node_Missing: start-on-event=RE_PrestoreFreezeFrame, operation=Event_DEM_DTC_FR_All_Node_Missing.PrestoreFreezeFrame
        EV_ClearPrestoredFF_EvtDEM_DTC_FR_All_Node_Missing: start-on-event=RE_ClearPrestoredFreezeFrame, operation=Event_DEM_DTC_FR_All_Node_Missing.ClearPrestoredFreezeFrame
        EV_ResetEventDebounceStatus_EvtDEM_DTC_FR_All_Node_Missing: start-on-event=RE_ResetEventDebounceStatus, operation=Event_DEM_DTC_FR_All_Node_Missing.ResetEventDebounceStatus
        EV_GetEventStatus_EvtDEM_DTC_FR_All_Node_Missing: start-on-event=RE_GetEventStatus, operation=EvtInfo_DEM_DTC_FR_All_Node_Missing.GetEventStatus
        EV_GetEventFailed_EvtDEM_DTC_FR_All_Node_Missing: start-on-event=RE_GetEventFailed, operation=EvtInfo_DEM_DTC_FR_All_Node_Missing.GetEventFailed
        EV_GetEventTested_EvtDEM_DTC_FR_All_Node_Missing: start-on-event=RE_GetEventTested, operation=EvtInfo_DEM_DTC_FR_All_Node_Missing.GetEventTested
        EV_GetDTCOfEvent_EvtDEM_DTC_FR_All_Node_Missing: start-on-event=RE_GetDTCOfEvent, operation=EvtInfo_DEM_DTC_FR_All_Node_Missing.GetDTCOfEvent
        EV_GetFDC_EvtDEM_DTC_FR_All_Node_Missing: start-on-event=RE_GetFaultDetectionCounter, operation=EvtInfo_DEM_DTC_FR_All_Node_Missing.GetFaultDetectionCounter
        EV_GetEventFF_EvtDEM_DTC_FR_All_Node_Missing: start-on-event=RE_GetEventFreezeFrameData, operation=EvtInfo_DEM_DTC_FR_All_Node_Missing.GetEventFreezeFrameData
        EV_GetEventEDR_EvtDEM_DTC_FR_All_Node_Missing: start-on-event=RE_GetEventExtendedDataRecord, operation=EvtInfo_DEM_DTC_FR_All_Node_Missing.GetEventExtendedDataRecord
        EV_SetEventStatus_EvtDEM_DTC_ADC_All_Node_Missing: start-on-event=RE_SetEventStatus, operation=Event_DEM_DTC_ADC_All_Node_Missing.SetEventStatus
        EV_ResetEventStatus_EvtDEM_DTC_ADC_All_Node_Missing: start-on-event=RE_ResetEventStatus, operation=Event_DEM_DTC_ADC_All_Node_Missing.ResetEventStatus
        EV_PrestoreFreezeFrame_EvtDEM_DTC_ADC_All_Node_Missing: start-on-event=RE_PrestoreFreezeFrame, operation=Event_DEM_DTC_ADC_All_Node_Missing.PrestoreFreezeFrame
        EV_ClearPrestoredFF_EvtDEM_DTC_ADC_All_Node_Missing: start-on-event=RE_ClearPrestoredFreezeFrame, operation=Event_DEM_DTC_ADC_All_Node_Missing.ClearPrestoredFreezeFrame
        EV_ResetEventDebounceStatus_EvtDEM_DTC_ADC_All_Node_Missing: start-on-event=RE_ResetEventDebounceStatus, operation=Event_DEM_DTC_ADC_All_Node_Missing.ResetEventDebounceStatus
        EV_GetEventStatus_EvtDEM_DTC_ADC_All_Node_Missing: start-on-event=RE_GetEventStatus, operation=EvtInfo_DEM_DTC_ADC_All_Node_Missing.GetEventStatus
        EV_GetEventFailed_EvtDEM_DTC_ADC_All_Node_Missing: start-on-event=RE_GetEventFailed, operation=EvtInfo_DEM_DTC_ADC_All_Node_Missing.GetEventFailed
        EV_GetEventTested_EvtDEM_DTC_ADC_All_Node_Missing: start-on-event=RE_GetEventTested, operation=EvtInfo_DEM_DTC_ADC_All_Node_Missing.GetEventTested
        EV_GetDTCOfEvent_EvtDEM_DTC_ADC_All_Node_Missing: start-on-event=RE_GetDTCOfEvent, operation=EvtInfo_DEM_DTC_ADC_All_Node_Missing.GetDTCOfEvent
        EV_GetFDC_EvtDEM_DTC_ADC_All_Node_Missing: start-on-event=RE_GetFaultDetectionCounter, operation=EvtInfo_DEM_DTC_ADC_All_Node_Missing.GetFaultDetectionCounter
        EV_GetEventFF_EvtDEM_DTC_ADC_All_Node_Missing: start-on-event=RE_GetEventFreezeFrameData, operation=EvtInfo_DEM_DTC_ADC_All_Node_Missing.GetEventFreezeFrameData
        EV_GetEventEDR_EvtDEM_DTC_ADC_All_Node_Missing: start-on-event=RE_GetEventExtendedDataRecord, operation=EvtInfo_DEM_DTC_ADC_All_Node_Missing.GetEventExtendedDataRecord
        EV_SetEventStatus_EvtDEM_DTC_J3_Time_Sync_Error: start-on-event=RE_SetEventStatus, operation=Event_DEM_DTC_J3_Time_Sync_Error.SetEventStatus
        EV_ResetEventStatus_EvtDEM_DTC_J3_Time_Sync_Error: start-on-event=RE_ResetEventStatus, operation=Event_DEM_DTC_J3_Time_Sync_Error.ResetEventStatus
        EV_PrestoreFreezeFrame_EvtDEM_DTC_J3_Time_Sync_Error: start-on-event=RE_PrestoreFreezeFrame, operation=Event_DEM_DTC_J3_Time_Sync_Error.PrestoreFreezeFrame
        EV_ClearPrestoredFF_EvtDEM_DTC_J3_Time_Sync_Error: start-on-event=RE_ClearPrestoredFreezeFrame, operation=Event_DEM_DTC_J3_Time_Sync_Error.ClearPrestoredFreezeFrame
        EV_ResetEventDebounceStatus_EvtDEM_DTC_J3_Time_Sync_Error: start-on-event=RE_ResetEventDebounceStatus, operation=Event_DEM_DTC_J3_Time_Sync_Error.ResetEventDebounceStatus
        EV_GetEventStatus_EvtDEM_DTC_J3_Time_Sync_Error: start-on-event=RE_GetEventStatus, operation=EvtInfo_DEM_DTC_J3_Time_Sync_Error.GetEventStatus
        EV_GetEventFailed_EvtDEM_DTC_J3_Time_Sync_Error: start-on-event=RE_GetEventFailed, operation=EvtInfo_DEM_DTC_J3_Time_Sync_Error.GetEventFailed
        EV_GetEventTested_EvtDEM_DTC_J3_Time_Sync_Error: start-on-event=RE_GetEventTested, operation=EvtInfo_DEM_DTC_J3_Time_Sync_Error.GetEventTested
        EV_GetDTCOfEvent_EvtDEM_DTC_J3_Time_Sync_Error: start-on-event=RE_GetDTCOfEvent, operation=EvtInfo_DEM_DTC_J3_Time_Sync_Error.GetDTCOfEvent
        EV_GetFDC_EvtDEM_DTC_J3_Time_Sync_Error: start-on-event=RE_GetFaultDetectionCounter, operation=EvtInfo_DEM_DTC_J3_Time_Sync_Error.GetFaultDetectionCounter
        EV_GetEventFF_EvtDEM_DTC_J3_Time_Sync_Error: start-on-event=RE_GetEventFreezeFrameData, operation=EvtInfo_DEM_DTC_J3_Time_Sync_Error.GetEventFreezeFrameData
        EV_GetEventEDR_EvtDEM_DTC_J3_Time_Sync_Error: start-on-event=RE_GetEventExtendedDataRecord, operation=EvtInfo_DEM_DTC_J3_Time_Sync_Error.GetEventExtendedDataRecord
        EV_GetEventStatus_EvtNVM_E_INTEGRITY_FAILED: start-on-event=RE_GetEventStatus, operation=EvtInfo_NVM_E_INTEGRITY_FAILED.GetEventStatus
        EV_GetEventFailed_EvtNVM_E_INTEGRITY_FAILED: start-on-event=RE_GetEventFailed, operation=EvtInfo_NVM_E_INTEGRITY_FAILED.GetEventFailed
        EV_GetEventTested_EvtNVM_E_INTEGRITY_FAILED: start-on-event=RE_GetEventTested, operation=EvtInfo_NVM_E_INTEGRITY_FAILED.GetEventTested
        EV_GetDTCOfEvent_EvtNVM_E_INTEGRITY_FAILED: start-on-event=RE_GetDTCOfEvent, operation=EvtInfo_NVM_E_INTEGRITY_FAILED.GetDTCOfEvent
        EV_GetFDC_EvtNVM_E_INTEGRITY_FAILED: start-on-event=RE_GetFaultDetectionCounter, operation=EvtInfo_NVM_E_INTEGRITY_FAILED.GetFaultDetectionCounter
        EV_GetEventFF_EvtNVM_E_INTEGRITY_FAILED: start-on-event=RE_GetEventFreezeFrameData, operation=EvtInfo_NVM_E_INTEGRITY_FAILED.GetEventFreezeFrameData
        EV_GetEventEDR_EvtNVM_E_INTEGRITY_FAILED: start-on-event=RE_GetEventExtendedDataRecord, operation=EvtInfo_NVM_E_INTEGRITY_FAILED.GetEventExtendedDataRecord
        EV_GetEventStatus_EvtNVM_E_REQ_FAILED: start-on-event=RE_GetEventStatus, operation=EvtInfo_NVM_E_REQ_FAILED.GetEventStatus
        EV_GetEventFailed_EvtNVM_E_REQ_FAILED: start-on-event=RE_GetEventFailed, operation=EvtInfo_NVM_E_REQ_FAILED.GetEventFailed
        EV_GetEventTested_EvtNVM_E_REQ_FAILED: start-on-event=RE_GetEventTested, operation=EvtInfo_NVM_E_REQ_FAILED.GetEventTested
        EV_GetDTCOfEvent_EvtNVM_E_REQ_FAILED: start-on-event=RE_GetDTCOfEvent, operation=EvtInfo_NVM_E_REQ_FAILED.GetDTCOfEvent
        EV_GetFDC_EvtNVM_E_REQ_FAILED: start-on-event=RE_GetFaultDetectionCounter, operation=EvtInfo_NVM_E_REQ_FAILED.GetFaultDetectionCounter
        EV_GetEventFF_EvtNVM_E_REQ_FAILED: start-on-event=RE_GetEventFreezeFrameData, operation=EvtInfo_NVM_E_REQ_FAILED.GetEventFreezeFrameData
        EV_GetEventEDR_EvtNVM_E_REQ_FAILED: start-on-event=RE_GetEventExtendedDataRecord, operation=EvtInfo_NVM_E_REQ_FAILED.GetEventExtendedDataRecord
        EV_GetEventStatus_EvtNVM_E_WRONG_BLOCK_ID: start-on-event=RE_GetEventStatus, operation=EvtInfo_NVM_E_WRONG_BLOCK_ID.GetEventStatus
        EV_GetEventFailed_EvtNVM_E_WRONG_BLOCK_ID: start-on-event=RE_GetEventFailed, operation=EvtInfo_NVM_E_WRONG_BLOCK_ID.GetEventFailed
        EV_GetEventTested_EvtNVM_E_WRONG_BLOCK_ID: start-on-event=RE_GetEventTested, operation=EvtInfo_NVM_E_WRONG_BLOCK_ID.GetEventTested
        EV_GetDTCOfEvent_EvtNVM_E_WRONG_BLOCK_ID: start-on-event=RE_GetDTCOfEvent, operation=EvtInfo_NVM_E_WRONG_BLOCK_ID.GetDTCOfEvent
        EV_GetFDC_EvtNVM_E_WRONG_BLOCK_ID: start-on-event=RE_GetFaultDetectionCounter, operation=EvtInfo_NVM_E_WRONG_BLOCK_ID.GetFaultDetectionCounter
        EV_GetEventFF_EvtNVM_E_WRONG_BLOCK_ID: start-on-event=RE_GetEventFreezeFrameData, operation=EvtInfo_NVM_E_WRONG_BLOCK_ID.GetEventFreezeFrameData
        EV_GetEventEDR_EvtNVM_E_WRONG_BLOCK_ID: start-on-event=RE_GetEventExtendedDataRecord, operation=EvtInfo_NVM_E_WRONG_BLOCK_ID.GetEventExtendedDataRecord
        EV_GetEventStatus_EvtNVM_E_VERIFY_FAILED: start-on-event=RE_GetEventStatus, operation=EvtInfo_NVM_E_VERIFY_FAILED.GetEventStatus
        EV_GetEventFailed_EvtNVM_E_VERIFY_FAILED: start-on-event=RE_GetEventFailed, operation=EvtInfo_NVM_E_VERIFY_FAILED.GetEventFailed
        EV_GetEventTested_EvtNVM_E_VERIFY_FAILED: start-on-event=RE_GetEventTested, operation=EvtInfo_NVM_E_VERIFY_FAILED.GetEventTested
        EV_GetDTCOfEvent_EvtNVM_E_VERIFY_FAILED: start-on-event=RE_GetDTCOfEvent, operation=EvtInfo_NVM_E_VERIFY_FAILED.GetDTCOfEvent
        EV_GetFDC_EvtNVM_E_VERIFY_FAILED: start-on-event=RE_GetFaultDetectionCounter, operation=EvtInfo_NVM_E_VERIFY_FAILED.GetFaultDetectionCounter
        EV_GetEventFF_EvtNVM_E_VERIFY_FAILED: start-on-event=RE_GetEventFreezeFrameData, operation=EvtInfo_NVM_E_VERIFY_FAILED.GetEventFreezeFrameData
        EV_GetEventEDR_EvtNVM_E_VERIFY_FAILED: start-on-event=RE_GetEventExtendedDataRecord, operation=EvtInfo_NVM_E_VERIFY_FAILED.GetEventExtendedDataRecord
        EV_GetEventStatus_EvtNVM_E_WRITE_PROTECTED: start-on-event=RE_GetEventStatus, operation=EvtInfo_NVM_E_WRITE_PROTECTED.GetEventStatus
        EV_GetEventFailed_EvtNVM_E_WRITE_PROTECTED: start-on-event=RE_GetEventFailed, operation=EvtInfo_NVM_E_WRITE_PROTECTED.GetEventFailed
        EV_GetEventTested_EvtNVM_E_WRITE_PROTECTED: start-on-event=RE_GetEventTested, operation=EvtInfo_NVM_E_WRITE_PROTECTED.GetEventTested
        EV_GetDTCOfEvent_EvtNVM_E_WRITE_PROTECTED: start-on-event=RE_GetDTCOfEvent, operation=EvtInfo_NVM_E_WRITE_PROTECTED.GetDTCOfEvent
        EV_GetFDC_EvtNVM_E_WRITE_PROTECTED: start-on-event=RE_GetFaultDetectionCounter, operation=EvtInfo_NVM_E_WRITE_PROTECTED.GetFaultDetectionCounter
        EV_GetEventFF_EvtNVM_E_WRITE_PROTECTED: start-on-event=RE_GetEventFreezeFrameData, operation=EvtInfo_NVM_E_WRITE_PROTECTED.GetEventFreezeFrameData
        EV_GetEventEDR_EvtNVM_E_WRITE_PROTECTED: start-on-event=RE_GetEventExtendedDataRecord, operation=EvtInfo_NVM_E_WRITE_PROTECTED.GetEventExtendedDataRecord
        EV_SetEventStatus_EvtDEM_DTC_MCU_TEMP_INITIAL_HIGH: start-on-event=RE_SetEventStatus, operation=Event_DEM_DTC_MCU_TEMP_INITIAL_HIGH.SetEventStatus
        EV_ResetEventStatus_EvtDEM_DTC_MCU_TEMP_INITIAL_HIGH: start-on-event=RE_ResetEventStatus, operation=Event_DEM_DTC_MCU_TEMP_INITIAL_HIGH.ResetEventStatus
        EV_PrestoreFreezeFrame_EvtDEM_DTC_MCU_TEMP_INITIAL_HIGH: start-on-event=RE_PrestoreFreezeFrame, operation=Event_DEM_DTC_MCU_TEMP_INITIAL_HIGH.PrestoreFreezeFrame
        EV_ClearPrestoredFF_EvtDEM_DTC_MCU_TEMP_INITIAL_HIGH: start-on-event=RE_ClearPrestoredFreezeFrame, operation=Event_DEM_DTC_MCU_TEMP_INITIAL_HIGH.ClearPrestoredFreezeFrame
        EV_ResetEventDebounceStatus_EvtDEM_DTC_MCU_TEMP_INITIAL_HIGH: start-on-event=RE_ResetEventDebounceStatus, operation=Event_DEM_DTC_MCU_TEMP_INITIAL_HIGH.ResetEventDebounceStatus
        EV_GetEventStatus_EvtDEM_DTC_MCU_TEMP_INITIAL_HIGH: start-on-event=RE_GetEventStatus, operation=EvtInfo_DEM_DTC_MCU_TEMP_INITIAL_HIGH.GetEventStatus
        EV_GetEventFailed_EvtDEM_DTC_MCU_TEMP_INITIAL_HIGH: start-on-event=RE_GetEventFailed, operation=EvtInfo_DEM_DTC_MCU_TEMP_INITIAL_HIGH.GetEventFailed
        EV_GetEventTested_EvtDEM_DTC_MCU_TEMP_INITIAL_HIGH: start-on-event=RE_GetEventTested, operation=EvtInfo_DEM_DTC_MCU_TEMP_INITIAL_HIGH.GetEventTested
        EV_GetDTCOfEvent_EvtDEM_DTC_MCU_TEMP_INITIAL_HIGH: start-on-event=RE_GetDTCOfEvent, operation=EvtInfo_DEM_DTC_MCU_TEMP_INITIAL_HIGH.GetDTCOfEvent
        EV_GetFDC_EvtDEM_DTC_MCU_TEMP_INITIAL_HIGH: start-on-event=RE_GetFaultDetectionCounter, operation=EvtInfo_DEM_DTC_MCU_TEMP_INITIAL_HIGH.GetFaultDetectionCounter
        EV_GetEventFF_EvtDEM_DTC_MCU_TEMP_INITIAL_HIGH: start-on-event=RE_GetEventFreezeFrameData, operation=EvtInfo_DEM_DTC_MCU_TEMP_INITIAL_HIGH.GetEventFreezeFrameData
        EV_GetEventEDR_EvtDEM_DTC_MCU_TEMP_INITIAL_HIGH: start-on-event=RE_GetEventExtendedDataRecord, operation=EvtInfo_DEM_DTC_MCU_TEMP_INITIAL_HIGH.GetEventExtendedDataRecord
        EV_SetEventStatus_EvtDEM_DTC_ESP_Message_Alive_Counter_Error_100ms: start-on-event=RE_SetEventStatus, operation=Event_DEM_DTC_ESP_Message_Alive_Counter_Error_100ms.SetEventStatus
        EV_ResetEventStatus_EvtDEM_DTC_ESP_Message_Alive_Counter_Error_100ms: start-on-event=RE_ResetEventStatus, operation=Event_DEM_DTC_ESP_Message_Alive_Counter_Error_100ms.ResetEventStatus
        EV_PrestoreFreezeFrame_EvtDEM_DTC_ESP_Message_Alive_Counter_Error_100ms: start-on-event=RE_PrestoreFreezeFrame, operation=Event_DEM_DTC_ESP_Message_Alive_Counter_Error_100ms.PrestoreFreezeFrame
        EV_ClearPrestoredFF_EvtDEM_DTC_ESP_Message_Alive_Counter_Error_100ms: start-on-event=RE_ClearPrestoredFreezeFrame, operation=Event_DEM_DTC_ESP_Message_Alive_Counter_Error_100ms.ClearPrestoredFreezeFrame
        EV_ResetEventDebounceStatus_EvtDEM_DTC_ESP_Message_Alive_Counter_Error_100ms: start-on-event=RE_ResetEventDebounceStatus, operation=Event_DEM_DTC_ESP_Message_Alive_Counter_Error_100ms.ResetEventDebounceStatus
        EV_GetEventStatus_EvtDEM_DTC_ESP_Message_Alive_Counter_Error_100ms: start-on-event=RE_GetEventStatus, operation=EvtInfo_DEM_DTC_ESP_Message_Alive_Counter_Error_100ms.GetEventStatus
        EV_GetEventFailed_EvtDEM_DTC_ESP_Message_Alive_Counter_Error_100ms: start-on-event=RE_GetEventFailed, operation=EvtInfo_DEM_DTC_ESP_Message_Alive_Counter_Error_100ms.GetEventFailed
        EV_GetEventTested_EvtDEM_DTC_ESP_Message_Alive_Counter_Error_100ms: start-on-event=RE_GetEventTested, operation=EvtInfo_DEM_DTC_ESP_Message_Alive_Counter_Error_100ms.GetEventTested
        EV_GetDTCOfEvent_EvtDEM_DTC_ESP_Message_Alive_Counter_Error_100ms: start-on-event=RE_GetDTCOfEvent, operation=EvtInfo_DEM_DTC_ESP_Message_Alive_Counter_Error_100ms.GetDTCOfEvent
        EV_GetFDC_EvtDEM_DTC_ESP_Message_Alive_Counter_Error_100ms: start-on-event=RE_GetFaultDetectionCounter, operation=EvtInfo_DEM_DTC_ESP_Message_Alive_Counter_Error_100ms.GetFaultDetectionCounter
        EV_GetEventFF_EvtDEM_DTC_ESP_Message_Alive_Counter_Error_100ms: start-on-event=RE_GetEventFreezeFrameData, operation=EvtInfo_DEM_DTC_ESP_Message_Alive_Counter_Error_100ms.GetEventFreezeFrameData
        EV_GetEventEDR_EvtDEM_DTC_ESP_Message_Alive_Counter_Error_100ms: start-on-event=RE_GetEventExtendedDataRecord, operation=EvtInfo_DEM_DTC_ESP_Message_Alive_Counter_Error_100ms.GetEventExtendedDataRecord
        EV_GetEventStatus_EvtWDG_E_DISABLE_REJECTED: start-on-event=RE_GetEventStatus, operation=EvtInfo_WDG_E_DISABLE_REJECTED.GetEventStatus
        EV_GetEventFailed_EvtWDG_E_DISABLE_REJECTED: start-on-event=RE_GetEventFailed, operation=EvtInfo_WDG_E_DISABLE_REJECTED.GetEventFailed
        EV_GetEventTested_EvtWDG_E_DISABLE_REJECTED: start-on-event=RE_GetEventTested, operation=EvtInfo_WDG_E_DISABLE_REJECTED.GetEventTested
        EV_GetDTCOfEvent_EvtWDG_E_DISABLE_REJECTED: start-on-event=RE_GetDTCOfEvent, operation=EvtInfo_WDG_E_DISABLE_REJECTED.GetDTCOfEvent
        EV_GetFDC_EvtWDG_E_DISABLE_REJECTED: start-on-event=RE_GetFaultDetectionCounter, operation=EvtInfo_WDG_E_DISABLE_REJECTED.GetFaultDetectionCounter
        EV_GetEventFF_EvtWDG_E_DISABLE_REJECTED: start-on-event=RE_GetEventFreezeFrameData, operation=EvtInfo_WDG_E_DISABLE_REJECTED.GetEventFreezeFrameData
        EV_GetEventEDR_EvtWDG_E_DISABLE_REJECTED: start-on-event=RE_GetEventExtendedDataRecord, operation=EvtInfo_WDG_E_DISABLE_REJECTED.GetEventExtendedDataRecord
        EV_GetEventStatus_EvtWDG_E_MODE_FAILED: start-on-event=RE_GetEventStatus, operation=EvtInfo_WDG_E_MODE_FAILED.GetEventStatus
        EV_GetEventFailed_EvtWDG_E_MODE_FAILED: start-on-event=RE_GetEventFailed, operation=EvtInfo_WDG_E_MODE_FAILED.GetEventFailed
        EV_GetEventTested_EvtWDG_E_MODE_FAILED: start-on-event=RE_GetEventTested, operation=EvtInfo_WDG_E_MODE_FAILED.GetEventTested
        EV_GetDTCOfEvent_EvtWDG_E_MODE_FAILED: start-on-event=RE_GetDTCOfEvent, operation=EvtInfo_WDG_E_MODE_FAILED.GetDTCOfEvent
        EV_GetFDC_EvtWDG_E_MODE_FAILED: start-on-event=RE_GetFaultDetectionCounter, operation=EvtInfo_WDG_E_MODE_FAILED.GetFaultDetectionCounter
        EV_GetEventFF_EvtWDG_E_MODE_FAILED: start-on-event=RE_GetEventFreezeFrameData, operation=EvtInfo_WDG_E_MODE_FAILED.GetEventFreezeFrameData
        EV_GetEventEDR_EvtWDG_E_MODE_FAILED: start-on-event=RE_GetEventExtendedDataRecord, operation=EvtInfo_WDG_E_MODE_FAILED.GetEventExtendedDataRecord
        EV_GetEventStatus_EvtSmuActivateRunStateFailureNotification: start-on-event=RE_GetEventStatus, operation=EvtInfo_SmuActivateRunStateFailureNotification.GetEventStatus
        EV_GetEventFailed_EvtSmuActivateRunStateFailureNotification: start-on-event=RE_GetEventFailed, operation=EvtInfo_SmuActivateRunStateFailureNotification.GetEventFailed
        EV_GetEventTested_EvtSmuActivateRunStateFailureNotification: start-on-event=RE_GetEventTested, operation=EvtInfo_SmuActivateRunStateFailureNotification.GetEventTested
        EV_GetDTCOfEvent_EvtSmuActivateRunStateFailureNotification: start-on-event=RE_GetDTCOfEvent, operation=EvtInfo_SmuActivateRunStateFailureNotification.GetDTCOfEvent
        EV_GetFDC_EvtSmuActivateRunStateFailureNotification: start-on-event=RE_GetFaultDetectionCounter, operation=EvtInfo_SmuActivateRunStateFailureNotification.GetFaultDetectionCounter
        EV_GetEventFF_EvtSmuActivateRunStateFailureNotification: start-on-event=RE_GetEventFreezeFrameData, operation=EvtInfo_SmuActivateRunStateFailureNotification.GetEventFreezeFrameData
        EV_GetEventEDR_EvtSmuActivateRunStateFailureNotification: start-on-event=RE_GetEventExtendedDataRecord, operation=EvtInfo_SmuActivateRunStateFailureNotification.GetEventExtendedDataRecord
        EV_GetEventStatus_EvtSmuClearAlarmStatusFailureNotification: start-on-event=RE_GetEventStatus, operation=EvtInfo_SmuClearAlarmStatusFailureNotification.GetEventStatus
        EV_GetEventFailed_EvtSmuClearAlarmStatusFailureNotification: start-on-event=RE_GetEventFailed, operation=EvtInfo_SmuClearAlarmStatusFailureNotification.GetEventFailed
        EV_GetEventTested_EvtSmuClearAlarmStatusFailureNotification: start-on-event=RE_GetEventTested, operation=EvtInfo_SmuClearAlarmStatusFailureNotification.GetEventTested
        EV_GetDTCOfEvent_EvtSmuClearAlarmStatusFailureNotification: start-on-event=RE_GetDTCOfEvent, operation=EvtInfo_SmuClearAlarmStatusFailureNotification.GetDTCOfEvent
        EV_GetFDC_EvtSmuClearAlarmStatusFailureNotification: start-on-event=RE_GetFaultDetectionCounter, operation=EvtInfo_SmuClearAlarmStatusFailureNotification.GetFaultDetectionCounter
        EV_GetEventFF_EvtSmuClearAlarmStatusFailureNotification: start-on-event=RE_GetEventFreezeFrameData, operation=EvtInfo_SmuClearAlarmStatusFailureNotification.GetEventFreezeFrameData
        EV_GetEventEDR_EvtSmuClearAlarmStatusFailureNotification: start-on-event=RE_GetEventExtendedDataRecord, operation=EvtInfo_SmuClearAlarmStatusFailureNotification.GetEventExtendedDataRecord
        EV_GetEventStatus_EvtSmuReleaseFSPFailureNotification: start-on-event=RE_GetEventStatus, operation=EvtInfo_SmuReleaseFSPFailureNotification.GetEventStatus
        EV_GetEventFailed_EvtSmuReleaseFSPFailureNotification: start-on-event=RE_GetEventFailed, operation=EvtInfo_SmuReleaseFSPFailureNotification.GetEventFailed
        EV_GetEventTested_EvtSmuReleaseFSPFailureNotification: start-on-event=RE_GetEventTested, operation=EvtInfo_SmuReleaseFSPFailureNotification.GetEventTested
        EV_GetDTCOfEvent_EvtSmuReleaseFSPFailureNotification: start-on-event=RE_GetDTCOfEvent, operation=EvtInfo_SmuReleaseFSPFailureNotification.GetDTCOfEvent
        EV_GetFDC_EvtSmuReleaseFSPFailureNotification: start-on-event=RE_GetFaultDetectionCounter, operation=EvtInfo_SmuReleaseFSPFailureNotification.GetFaultDetectionCounter
        EV_GetEventFF_EvtSmuReleaseFSPFailureNotification: start-on-event=RE_GetEventFreezeFrameData, operation=EvtInfo_SmuReleaseFSPFailureNotification.GetEventFreezeFrameData
        EV_GetEventEDR_EvtSmuReleaseFSPFailureNotification: start-on-event=RE_GetEventExtendedDataRecord, operation=EvtInfo_SmuReleaseFSPFailureNotification.GetEventExtendedDataRecord
        EV_GetEventStatus_EvtSmuCoreAliveFailureNotification: start-on-event=RE_GetEventStatus, operation=EvtInfo_SmuCoreAliveFailureNotification.GetEventStatus
        EV_GetEventFailed_EvtSmuCoreAliveFailureNotification: start-on-event=RE_GetEventFailed, operation=EvtInfo_SmuCoreAliveFailureNotification.GetEventFailed
        EV_GetEventTested_EvtSmuCoreAliveFailureNotification: start-on-event=RE_GetEventTested, operation=EvtInfo_SmuCoreAliveFailureNotification.GetEventTested
        EV_GetDTCOfEvent_EvtSmuCoreAliveFailureNotification: start-on-event=RE_GetDTCOfEvent, operation=EvtInfo_SmuCoreAliveFailureNotification.GetDTCOfEvent
        EV_GetFDC_EvtSmuCoreAliveFailureNotification: start-on-event=RE_GetFaultDetectionCounter, operation=EvtInfo_SmuCoreAliveFailureNotification.GetFaultDetectionCounter
        EV_GetEventFF_EvtSmuCoreAliveFailureNotification: start-on-event=RE_GetEventFreezeFrameData, operation=EvtInfo_SmuCoreAliveFailureNotification.GetEventFreezeFrameData
        EV_GetEventEDR_EvtSmuCoreAliveFailureNotification: start-on-event=RE_GetEventExtendedDataRecord, operation=EvtInfo_SmuCoreAliveFailureNotification.GetEventExtendedDataRecord
        EV_GetEventStatus_EvtSmuRTStopFailureNotification: start-on-event=RE_GetEventStatus, operation=EvtInfo_SmuRTStopFailureNotification.GetEventStatus
        EV_GetEventFailed_EvtSmuRTStopFailureNotification: start-on-event=RE_GetEventFailed, operation=EvtInfo_SmuRTStopFailureNotification.GetEventFailed
        EV_GetEventTested_EvtSmuRTStopFailureNotification: start-on-event=RE_GetEventTested, operation=EvtInfo_SmuRTStopFailureNotification.GetEventTested
        EV_GetDTCOfEvent_EvtSmuRTStopFailureNotification: start-on-event=RE_GetDTCOfEvent, operation=EvtInfo_SmuRTStopFailureNotification.GetDTCOfEvent
        EV_GetFDC_EvtSmuRTStopFailureNotification: start-on-event=RE_GetFaultDetectionCounter, operation=EvtInfo_SmuRTStopFailureNotification.GetFaultDetectionCounter
        EV_GetEventFF_EvtSmuRTStopFailureNotification: start-on-event=RE_GetEventFreezeFrameData, operation=EvtInfo_SmuRTStopFailureNotification.GetEventFreezeFrameData
        EV_GetEventEDR_EvtSmuRTStopFailureNotification: start-on-event=RE_GetEventExtendedDataRecord, operation=EvtInfo_SmuRTStopFailureNotification.GetEventExtendedDataRecord
        EV_GetEventStatus_EvtSmuActivatePESFailureNotification: start-on-event=RE_GetEventStatus, operation=EvtInfo_SmuActivatePESFailureNotification.GetEventStatus
        EV_GetEventFailed_EvtSmuActivatePESFailureNotification: start-on-event=RE_GetEventFailed, operation=EvtInfo_SmuActivatePESFailureNotification.GetEventFailed
        EV_GetEventTested_EvtSmuActivatePESFailureNotification: start-on-event=RE_GetEventTested, operation=EvtInfo_SmuActivatePESFailureNotification.GetEventTested
        EV_GetDTCOfEvent_EvtSmuActivatePESFailureNotification: start-on-event=RE_GetDTCOfEvent, operation=EvtInfo_SmuActivatePESFailureNotification.GetDTCOfEvent
        EV_GetFDC_EvtSmuActivatePESFailureNotification: start-on-event=RE_GetFaultDetectionCounter, operation=EvtInfo_SmuActivatePESFailureNotification.GetFaultDetectionCounter
        EV_GetEventFF_EvtSmuActivatePESFailureNotification: start-on-event=RE_GetEventFreezeFrameData, operation=EvtInfo_SmuActivatePESFailureNotification.GetEventFreezeFrameData
        EV_GetEventEDR_EvtSmuActivatePESFailureNotification: start-on-event=RE_GetEventExtendedDataRecord, operation=EvtInfo_SmuActivatePESFailureNotification.GetEventExtendedDataRecord
        EV_GetEventStatus_EvtSmuActivateFSPFailureNotification: start-on-event=RE_GetEventStatus, operation=EvtInfo_SmuActivateFSPFailureNotification.GetEventStatus
        EV_GetEventFailed_EvtSmuActivateFSPFailureNotification: start-on-event=RE_GetEventFailed, operation=EvtInfo_SmuActivateFSPFailureNotification.GetEventFailed
        EV_GetEventTested_EvtSmuActivateFSPFailureNotification: start-on-event=RE_GetEventTested, operation=EvtInfo_SmuActivateFSPFailureNotification.GetEventTested
        EV_GetDTCOfEvent_EvtSmuActivateFSPFailureNotification: start-on-event=RE_GetDTCOfEvent, operation=EvtInfo_SmuActivateFSPFailureNotification.GetDTCOfEvent
        EV_GetFDC_EvtSmuActivateFSPFailureNotification: start-on-event=RE_GetFaultDetectionCounter, operation=EvtInfo_SmuActivateFSPFailureNotification.GetFaultDetectionCounter
        EV_GetEventFF_EvtSmuActivateFSPFailureNotification: start-on-event=RE_GetEventFreezeFrameData, operation=EvtInfo_SmuActivateFSPFailureNotification.GetEventFreezeFrameData
        EV_GetEventEDR_EvtSmuActivateFSPFailureNotification: start-on-event=RE_GetEventExtendedDataRecord, operation=EvtInfo_SmuActivateFSPFailureNotification.GetEventExtendedDataRecord
        EV_GetEventStatus_EvtSmuSetAlarmStatusFailureNotification: start-on-event=RE_GetEventStatus, operation=EvtInfo_SmuSetAlarmStatusFailureNotification.GetEventStatus
        EV_GetEventFailed_EvtSmuSetAlarmStatusFailureNotification: start-on-event=RE_GetEventFailed, operation=EvtInfo_SmuSetAlarmStatusFailureNotification.GetEventFailed
        EV_GetEventTested_EvtSmuSetAlarmStatusFailureNotification: start-on-event=RE_GetEventTested, operation=EvtInfo_SmuSetAlarmStatusFailureNotification.GetEventTested
        EV_GetDTCOfEvent_EvtSmuSetAlarmStatusFailureNotification: start-on-event=RE_GetDTCOfEvent, operation=EvtInfo_SmuSetAlarmStatusFailureNotification.GetDTCOfEvent
        EV_GetFDC_EvtSmuSetAlarmStatusFailureNotification: start-on-event=RE_GetFaultDetectionCounter, operation=EvtInfo_SmuSetAlarmStatusFailureNotification.GetFaultDetectionCounter
        EV_GetEventFF_EvtSmuSetAlarmStatusFailureNotification: start-on-event=RE_GetEventFreezeFrameData, operation=EvtInfo_SmuSetAlarmStatusFailureNotification.GetEventFreezeFrameData
        EV_GetEventEDR_EvtSmuSetAlarmStatusFailureNotification: start-on-event=RE_GetEventExtendedDataRecord, operation=EvtInfo_SmuSetAlarmStatusFailureNotification.GetEventExtendedDataRecord
        EV_GetEventStatus_EvtSmuSffFailureNotification: start-on-event=RE_GetEventStatus, operation=EvtInfo_SmuSffFailureNotification.GetEventStatus
        EV_GetEventFailed_EvtSmuSffFailureNotification: start-on-event=RE_GetEventFailed, operation=EvtInfo_SmuSffFailureNotification.GetEventFailed
        EV_GetEventTested_EvtSmuSffFailureNotification: start-on-event=RE_GetEventTested, operation=EvtInfo_SmuSffFailureNotification.GetEventTested
        EV_GetDTCOfEvent_EvtSmuSffFailureNotification: start-on-event=RE_GetDTCOfEvent, operation=EvtInfo_SmuSffFailureNotification.GetDTCOfEvent
        EV_GetFDC_EvtSmuSffFailureNotification: start-on-event=RE_GetFaultDetectionCounter, operation=EvtInfo_SmuSffFailureNotification.GetFaultDetectionCounter
        EV_GetEventFF_EvtSmuSffFailureNotification: start-on-event=RE_GetEventFreezeFrameData, operation=EvtInfo_SmuSffFailureNotification.GetEventFreezeFrameData
        EV_GetEventEDR_EvtSmuSffFailureNotification: start-on-event=RE_GetEventExtendedDataRecord, operation=EvtInfo_SmuSffFailureNotification.GetEventExtendedDataRecord
        EV_GetEventStatus_GeneralEvt: start-on-event=RE_GetEventStatus, operation=GeneralEvtInfo.GetEventStatus
        EV_GetEventFailed_GeneralEvt: start-on-event=RE_GetEventFailed, operation=GeneralEvtInfo.GetEventFailed
        EV_GetEventTested_GeneralEvt: start-on-event=RE_GetEventTested, operation=GeneralEvtInfo.GetEventTested
        EV_GetDTCOfEvent_GeneralEvt: start-on-event=RE_GetDTCOfEvent, operation=GeneralEvtInfo.GetDTCOfEvent
        EV_GetFDC_GeneralEvt: start-on-event=RE_GetFaultDetectionCounter, operation=GeneralEvtInfo.GetFaultDetectionCounter
        EV_GetEventFF_GeneralEvt: start-on-event=RE_GetEventFreezeFrameData, operation=GeneralEvtInfo.GetEventFreezeFrameData
        EV_GetEventEDR_GeneralEvt: start-on-event=RE_GetEventExtendedDataRecord, operation=GeneralEvtInfo.GetEventExtendedDataRecord
        EV_SetOperationCycleState_OpCycDEM_OPCYC_POWER: start-on-event=RE_SetOperationCycleState, operation=OpCycle_DEM_OPCYC_POWER.SetOperationCycleState
        EV_SetCycleQualified_OpCycDEM_OPCYC_POWER: start-on-event=RE_SetCycleQualified, operation=OpCycle_DEM_OPCYC_POWER.SetCycleQualified
        EV_SetOperationCycleState_OpCycDEM_OPCYC_IGN: start-on-event=RE_SetOperationCycleState, operation=OpCycle_DEM_OPCYC_IGN.SetOperationCycleState
        EV_SetCycleQualified_OpCycDEM_OPCYC_IGN: start-on-event=RE_SetCycleQualified, operation=OpCycle_DEM_OPCYC_IGN.SetCycleQualified
        EV_SetEnableCondition_EnCondCONDITION_Voltage_Normal: start-on-event=RE_SetEnableCondition, operation=EnableCond_CONDITION_Voltage_Normal.SetEnableCondition
        EV_SetEnableCondition_EnCondCONDITION_PowerON_3000ms: start-on-event=RE_SetEnableCondition, operation=EnableCond_CONDITION_PowerON_3000ms.SetEnableCondition
        EV_SetEnableCondition_EnCondCONDITION_Voltage_InRange: start-on-event=RE_SetEnableCondition, operation=EnableCond_CONDITION_Voltage_InRange.SetEnableCondition
        EV_SetEnableCondition_EnCondCONDITION_NO_BUSOFF_PublicCAN: start-on-event=RE_SetEnableCondition, operation=EnableCond_CONDITION_NO_BUSOFF_PublicCAN.SetEnableCondition
        EV_SetEnableCondition_EnCondCONDITION_NO_BUSOFF_PrivateCAN: start-on-event=RE_SetEnableCondition, operation=EnableCond_CONDITION_NO_BUSOFF_PrivateCAN.SetEnableCondition
        EV_SetEnableCondition_EnCondCONDITION_BcmPwrStsFbON: start-on-event=RE_SetEnableCondition, operation=EnableCond_CONDITION_BcmPwrStsFbON.SetEnableCondition
        EV_SetEnableCondition_EnCondCONDITION_EspVehSpd: start-on-event=RE_SetEnableCondition, operation=EnableCond_CONDITION_EspVehSpd.SetEnableCondition
        EV_GetEventMemoryOverflow_Primary: start-on-event=RE_GetEventMemoryOverflow, operation=OverflowIndPrimaryMemory.GetEventMemoryOverflow
        EV_GetNumberOfEventMemoryEntries_Primary: start-on-event=RE_GetNumberOfEventMemoryEntries, operation=OverflowIndPrimaryMemory.GetNumberOfEventMemoryEntries
      port-api-options:
        {enable-take-address=false, indirect-api=false, port-defined-argument-value{value=DemConf_DemEventParameter_MCU_E_CLOCK_FAILURE, value-type=Dem_EventIdType}, port=EvtInfo_MCU_E_CLOCK_FAILURE}
        {enable-take-address=false, indirect-api=false, port-defined-argument-value{value=DemConf_DemEventParameter_MCU_E_OSC_FAILURE, value-type=Dem_EventIdType}, port=EvtInfo_MCU_E_OSC_FAILURE}
        {enable-take-address=false, indirect-api=false, port-defined-argument-value{value=DemConf_DemEventParameter_MCU_E_SYSTEM_PLL_TIMEOUT_ERR, value-type=Dem_EventIdType}, port=EvtInfo_MCU_E_SYSTEM_PLL_TIMEOUT_ERR}
        {enable-take-address=false, indirect-api=false, port-defined-argument-value{value=DemConf_DemEventParameter_MCU_E_PERIPHERAL_PLL_TIMEOUT_ERR, value-type=Dem_EventIdType}, port=EvtInfo_MCU_E_PERIPHERAL_PLL_TIMEOUT_ERR}
        {enable-take-address=false, indirect-api=false, port-defined-argument-value{value=DemConf_DemEventParameter_MCU_E_SYSTEM_PLL_LOCK_LOSS, value-type=Dem_EventIdType}, port=EvtInfo_MCU_E_SYSTEM_PLL_LOCK_LOSS}
        {enable-take-address=false, indirect-api=false, port-defined-argument-value{value=DemConf_DemEventParameter_MCU_E_PERIPHERAL_PLL_LOCK_LOSS, value-type=Dem_EventIdType}, port=EvtInfo_MCU_E_PERIPHERAL_PLL_LOCK_LOSS}
        {enable-take-address=false, indirect-api=false, port-defined-argument-value{value=DemConf_DemEventParameter_MCU_E_GTM_CLC_ENABLE_ERR, value-type=Dem_EventIdType}, port=EvtInfo_MCU_E_GTM_CLC_ENABLE_ERR}
        {enable-take-address=false, indirect-api=false, port-defined-argument-value{value=DemConf_DemEventParameter_MCU_E_GTM_CLC_DISABLE_ERR, value-type=Dem_EventIdType}, port=EvtInfo_MCU_E_GTM_CLC_DISABLE_ERR}
        {enable-take-address=false, indirect-api=false, port-defined-argument-value{value=DemConf_DemEventParameter_MCU_E_CONVCTRL_CLC_ENABLE_ERR, value-type=Dem_EventIdType}, port=EvtInfo_MCU_E_CONVCTRL_CLC_ENABLE_ERR}
        {enable-take-address=false, indirect-api=false, port-defined-argument-value{value=DemConf_DemEventParameter_MCU_E_CONVCTRL_CLC_DISABLE_ERR, value-type=Dem_EventIdType}, port=EvtInfo_MCU_E_CONVCTRL_CLC_DISABLE_ERR}
        {enable-take-address=false, indirect-api=false, port-defined-argument-value{value=DemConf_DemEventParameter_MCU_E_CCUCON_UPDATE_ERR, value-type=Dem_EventIdType}, port=EvtInfo_MCU_E_CCUCON_UPDATE_ERR}
        {enable-take-address=false, indirect-api=false, port-defined-argument-value{value=DemConf_DemEventParameter_MCU_E_CCU6_CLC_ENABLE_ERR, value-type=Dem_EventIdType}, port=EvtInfo_MCU_E_CCU6_CLC_ENABLE_ERR}
        {enable-take-address=false, indirect-api=false, port-defined-argument-value{value=DemConf_DemEventParameter_MCU_E_CCU6_CLC_DISABLE_ERR, value-type=Dem_EventIdType}, port=EvtInfo_MCU_E_CCU6_CLC_DISABLE_ERR}
        {enable-take-address=false, indirect-api=false, port-defined-argument-value{value=DemConf_DemEventParameter_MCU_E_GPT12_CLC_ENABLE_ERR, value-type=Dem_EventIdType}, port=EvtInfo_MCU_E_GPT12_CLC_ENABLE_ERR}
        {enable-take-address=false, indirect-api=false, port-defined-argument-value{value=DemConf_DemEventParameter_MCU_E_GPT12_CLC_DISABLE_ERR, value-type=Dem_EventIdType}, port=EvtInfo_MCU_E_GPT12_CLC_DISABLE_ERR}
        {enable-take-address=false, indirect-api=false, port-defined-argument-value{value=DemConf_DemEventParameter_MCU_E_PMSWCR_UPDATE_ERR, value-type=Dem_EventIdType}, port=EvtInfo_MCU_E_PMSWCR_UPDATE_ERR}
        {enable-take-address=false, indirect-api=false, port-defined-argument-value{value=DemConf_DemEventParameter_CANSM_BUSOFF_PublicCAN, value-type=Dem_EventIdType}, port=EvtInfo_CANSM_BUSOFF_PublicCAN}
        {enable-take-address=false, indirect-api=false, port-defined-argument-value{value=DemConf_DemEventParameter_SPI_E_HARDWARE_ERROR, value-type=Dem_EventIdType}, port=EvtInfo_SPI_E_HARDWARE_ERROR}
        enable-take-address=true, indirect-api=false, port=CBStatusEvt_SPI_E_HARDWARE_ERROR_1
        {enable-take-address=false, indirect-api=false, port-defined-argument-value{value=DemConf_DemEventParameter_DEM_VMON_BATT_HIGH, value-type=Dem_EventIdType}, port=Event_DEM_VMON_BATT_HIGH}
        {enable-take-address=false, indirect-api=false, port-defined-argument-value{value=DemConf_DemEventParameter_DEM_VMON_BATT_HIGH, value-type=Dem_EventIdType}, port=EvtInfo_DEM_VMON_BATT_HIGH}
        enable-take-address=true, indirect-api=false, port=CBStatusEvt_DEM_VMON_BATT_HIGH_1
        {enable-take-address=false, indirect-api=false, port-defined-argument-value{value=DemConf_DemEventParameter_DEM_VMON_BATT_LOW, value-type=Dem_EventIdType}, port=Event_DEM_VMON_BATT_LOW}
        {enable-take-address=false, indirect-api=false, port-defined-argument-value{value=DemConf_DemEventParameter_DEM_VMON_BATT_LOW, value-type=Dem_EventIdType}, port=EvtInfo_DEM_VMON_BATT_LOW}
        enable-take-address=true, indirect-api=false, port=CBStatusEvt_DEM_VMON_BATT_LOW_1
        {enable-take-address=false, indirect-api=false, port-defined-argument-value{value=DemConf_DemEventParameter_DEM_MCU_TEMP_EXT_HIGH, value-type=Dem_EventIdType}, port=Event_DEM_MCU_TEMP_EXT_HIGH}
        {enable-take-address=false, indirect-api=false, port-defined-argument-value{value=DemConf_DemEventParameter_DEM_MCU_TEMP_EXT_HIGH, value-type=Dem_EventIdType}, port=EvtInfo_DEM_MCU_TEMP_EXT_HIGH}
        enable-take-address=true, indirect-api=false, port=CBStatusEvt_DEM_MCU_TEMP_EXT_HIGH_1
        {enable-take-address=false, indirect-api=false, port-defined-argument-value{value=DemConf_DemEventParameter_DEM_MCU_TEMP_EXT_LOW, value-type=Dem_EventIdType}, port=Event_DEM_MCU_TEMP_EXT_LOW}
        {enable-take-address=false, indirect-api=false, port-defined-argument-value{value=DemConf_DemEventParameter_DEM_MCU_TEMP_EXT_LOW, value-type=Dem_EventIdType}, port=EvtInfo_DEM_MCU_TEMP_EXT_LOW}
        enable-take-address=true, indirect-api=false, port=CBStatusEvt_DEM_MCU_TEMP_EXT_LOW_1
        {enable-take-address=false, indirect-api=false, port-defined-argument-value{value=DemConf_DemEventParameter_DEM_SOCJ3_TEMP_EXT_HIGH, value-type=Dem_EventIdType}, port=Event_DEM_SOCJ3_TEMP_EXT_HIGH}
        {enable-take-address=false, indirect-api=false, port-defined-argument-value{value=DemConf_DemEventParameter_DEM_SOCJ3_TEMP_EXT_HIGH, value-type=Dem_EventIdType}, port=EvtInfo_DEM_SOCJ3_TEMP_EXT_HIGH}
        enable-take-address=true, indirect-api=false, port=CBStatusEvt_DEM_SOCJ3_TEMP_EXT_HIGH_1
        {enable-take-address=false, indirect-api=false, port-defined-argument-value{value=DemConf_DemEventParameter_DEM_J3_SYS_KERNEL_SW, value-type=Dem_EventIdType}, port=Event_DEM_J3_SYS_KERNEL_SW}
        {enable-take-address=false, indirect-api=false, port-defined-argument-value{value=DemConf_DemEventParameter_DEM_J3_SYS_KERNEL_SW, value-type=Dem_EventIdType}, port=EvtInfo_DEM_J3_SYS_KERNEL_SW}
        enable-take-address=true, indirect-api=false, port=CBStatusEvt_DEM_J3_SYS_KERNEL_SW_1
        {enable-take-address=false, indirect-api=false, port-defined-argument-value{value=DemConf_DemEventParameter_AdcClcFailureNotification, value-type=Dem_EventIdType}, port=EvtInfo_AdcClcFailureNotification}
        {enable-take-address=false, indirect-api=false, port-defined-argument-value{value=DemConf_DemEventParameter_AdcConvStopTimeNotification, value-type=Dem_EventIdType}, port=EvtInfo_AdcConvStopTimeNotification}
        {enable-take-address=false, indirect-api=false, port-defined-argument-value{value=DemConf_DemEventParameter_FEE_E_GC_INIT, value-type=Dem_EventIdType}, port=EvtInfo_FEE_E_GC_INIT}
        {enable-take-address=false, indirect-api=false, port-defined-argument-value{value=DemConf_DemEventParameter_FEE_E_WRITE, value-type=Dem_EventIdType}, port=EvtInfo_FEE_E_WRITE}
        {enable-take-address=false, indirect-api=false, port-defined-argument-value{value=DemConf_DemEventParameter_FEE_E_READ, value-type=Dem_EventIdType}, port=EvtInfo_FEE_E_READ}
        {enable-take-address=false, indirect-api=false, port-defined-argument-value{value=DemConf_DemEventParameter_FEE_E_GC_READ, value-type=Dem_EventIdType}, port=EvtInfo_FEE_E_GC_READ}
        {enable-take-address=false, indirect-api=false, port-defined-argument-value{value=DemConf_DemEventParameter_FEE_E_GC_WRITE, value-type=Dem_EventIdType}, port=EvtInfo_FEE_E_GC_WRITE}
        {enable-take-address=false, indirect-api=false, port-defined-argument-value{value=DemConf_DemEventParameter_FEE_E_GC_ERASE, value-type=Dem_EventIdType}, port=EvtInfo_FEE_E_GC_ERASE}
        {enable-take-address=false, indirect-api=false, port-defined-argument-value{value=DemConf_DemEventParameter_FEE_E_INVALIDATE, value-type=Dem_EventIdType}, port=EvtInfo_FEE_E_INVALIDATE}
        {enable-take-address=false, indirect-api=false, port-defined-argument-value{value=DemConf_DemEventParameter_FEE_E_WRITE_CYCLES_EXHAUSTED, value-type=Dem_EventIdType}, port=EvtInfo_FEE_E_WRITE_CYCLES_EXHAUSTED}
        {enable-take-address=false, indirect-api=false, port-defined-argument-value{value=DemConf_DemEventParameter_FEE_E_GC_TRIG, value-type=Dem_EventIdType}, port=EvtInfo_FEE_E_GC_TRIG}
        {enable-take-address=false, indirect-api=false, port-defined-argument-value{value=DemConf_DemEventParameter_FEE_E_UNCONFIG_BLK_EXCEEDED, value-type=Dem_EventIdType}, port=EvtInfo_FEE_E_UNCONFIG_BLK_EXCEEDED}
        {enable-take-address=false, indirect-api=false, port-defined-argument-value{value=DemConf_DemEventParameter_FLS_E_COMPARE_FAILED, value-type=Dem_EventIdType}, port=EvtInfo_FLS_E_COMPARE_FAILED}
        {enable-take-address=false, indirect-api=false, port-defined-argument-value{value=DemConf_DemEventParameter_FLS_E_ERASE_FAILED, value-type=Dem_EventIdType}, port=EvtInfo_FLS_E_ERASE_FAILED}
        {enable-take-address=false, indirect-api=false, port-defined-argument-value{value=DemConf_DemEventParameter_FLS_E_READ_FAILED, value-type=Dem_EventIdType}, port=EvtInfo_FLS_E_READ_FAILED}
        {enable-take-address=false, indirect-api=false, port-defined-argument-value{value=DemConf_DemEventParameter_FLS_E_UNEXPECTED_FLASH_ID, value-type=Dem_EventIdType}, port=EvtInfo_FLS_E_UNEXPECTED_FLASH_ID}
        {enable-take-address=false, indirect-api=false, port-defined-argument-value{value=DemConf_DemEventParameter_FLS_E_WRITE_FAILED, value-type=Dem_EventIdType}, port=EvtInfo_FLS_E_WRITE_FAILED}
        {enable-take-address=false, indirect-api=false, port-defined-argument-value{value=DemConf_DemEventParameter_DEM_CAMERA_CALIBRATION_FAILURE, value-type=Dem_EventIdType}, port=Event_DEM_CAMERA_CALIBRATION_FAILURE}
        {enable-take-address=false, indirect-api=false, port-defined-argument-value{value=DemConf_DemEventParameter_DEM_CAMERA_CALIBRATION_FAILURE, value-type=Dem_EventIdType}, port=EvtInfo_DEM_CAMERA_CALIBRATION_FAILURE}
        enable-take-address=true, indirect-api=false, port=CBStatusEvt_DEM_CAMERA_CALIBRATION_FAILURE_1
        {enable-take-address=false, indirect-api=false, port-defined-argument-value{value=DemConf_DemEventParameter_DEM_CAMERA_ONLINE_CALIBRATION_FAILURE, value-type=Dem_EventIdType}, port=Event_DEM_CAMERA_ONLINE_CALIBRATION_FAILURE}
        {enable-take-address=false, indirect-api=false, port-defined-argument-value{value=DemConf_DemEventParameter_DEM_CAMERA_ONLINE_CALIBRATION_FAILURE, value-type=Dem_EventIdType}, port=EvtInfo_DEM_CAMERA_ONLINE_CALIBRATION_FAILURE}
        enable-take-address=true, indirect-api=false, port=CBStatusEvt_DEM_CAMERA_ONLINE_CALIBRATION_FAILURE_1
        {enable-take-address=false, indirect-api=false, port-defined-argument-value{value=DemConf_DemEventParameter_CANSM_BUSOFF_PrivateCAN, value-type=Dem_EventIdType}, port=EvtInfo_CANSM_BUSOFF_PrivateCAN}
        {enable-take-address=false, indirect-api=false, port-defined-argument-value{value=DemConf_DemEventParameter_DEM_DTC_VCU_Accr_Pedl_Posn_Invld, value-type=Dem_EventIdType}, port=Event_DEM_DTC_VCU_Accr_Pedl_Posn_Invld}
        {enable-take-address=false, indirect-api=false, port-defined-argument-value{value=DemConf_DemEventParameter_DEM_DTC_VCU_Accr_Pedl_Posn_Invld, value-type=Dem_EventIdType}, port=EvtInfo_DEM_DTC_VCU_Accr_Pedl_Posn_Invld}
        enable-take-address=true, indirect-api=false, port=CBStatusEvt_DEM_DTC_VCU_Accr_Pedl_Posn_Invld_1
        {enable-take-address=false, indirect-api=false, port-defined-argument-value{value=DemConf_DemEventParameter_DEM_DTC_VCU_Gear_Posn_Invld, value-type=Dem_EventIdType}, port=Event_DEM_DTC_VCU_Gear_Posn_Invld}
        {enable-take-address=false, indirect-api=false, port-defined-argument-value{value=DemConf_DemEventParameter_DEM_DTC_VCU_Gear_Posn_Invld, value-type=Dem_EventIdType}, port=EvtInfo_DEM_DTC_VCU_Gear_Posn_Invld}
        enable-take-address=true, indirect-api=false, port=CBStatusEvt_DEM_DTC_VCU_Gear_Posn_Invld_1
        {enable-take-address=false, indirect-api=false, port-defined-argument-value{value=DemConf_DemEventParameter_DEM_DTC_BCM_Turn_Indcr_Light_Fault, value-type=Dem_EventIdType}, port=Event_DEM_DTC_BCM_Turn_Indcr_Light_Fault}
        {enable-take-address=false, indirect-api=false, port-defined-argument-value{value=DemConf_DemEventParameter_DEM_DTC_BCM_Turn_Indcr_Light_Fault, value-type=Dem_EventIdType}, port=EvtInfo_DEM_DTC_BCM_Turn_Indcr_Light_Fault}
        enable-take-address=true, indirect-api=false, port=CBStatusEvt_DEM_DTC_BCM_Turn_Indcr_Light_Fault_1
        {enable-take-address=false, indirect-api=false, port-defined-argument-value{value=DemConf_DemEventParameter_DEM_DTC_BCM_Frnt_Wiper_Sts_Fault, value-type=Dem_EventIdType}, port=Event_DEM_DTC_BCM_Frnt_Wiper_Sts_Fault}
        {enable-take-address=false, indirect-api=false, port-defined-argument-value{value=DemConf_DemEventParameter_DEM_DTC_BCM_Frnt_Wiper_Sts_Fault, value-type=Dem_EventIdType}, port=EvtInfo_DEM_DTC_BCM_Frnt_Wiper_Sts_Fault}
        enable-take-address=true, indirect-api=false, port=CBStatusEvt_DEM_DTC_BCM_Frnt_Wiper_Sts_Fault_1
        {enable-take-address=false, indirect-api=false, port-defined-argument-value{value=DemConf_DemEventParameter_DEM_DTC_ESP_Veh_Spd_Invld, value-type=Dem_EventIdType}, port=Event_DEM_DTC_ESP_Veh_Spd_Invld}
        {enable-take-address=false, indirect-api=false, port-defined-argument-value{value=DemConf_DemEventParameter_DEM_DTC_ESP_Veh_Spd_Invld, value-type=Dem_EventIdType}, port=EvtInfo_DEM_DTC_ESP_Veh_Spd_Invld}
        enable-take-address=true, indirect-api=false, port=CBStatusEvt_DEM_DTC_ESP_Veh_Spd_Invld_1
        {enable-take-address=false, indirect-api=false, port-defined-argument-value{value=DemConf_DemEventParameter_DEM_DTC_Whl_Spd_Pls_Invld, value-type=Dem_EventIdType}, port=Event_DEM_DTC_Whl_Spd_Pls_Invld}
        {enable-take-address=false, indirect-api=false, port-defined-argument-value{value=DemConf_DemEventParameter_DEM_DTC_Whl_Spd_Pls_Invld, value-type=Dem_EventIdType}, port=EvtInfo_DEM_DTC_Whl_Spd_Pls_Invld}
        enable-take-address=true, indirect-api=false, port=CBStatusEvt_DEM_DTC_Whl_Spd_Pls_Invld_1
        {enable-take-address=false, indirect-api=false, port-defined-argument-value{value=DemConf_DemEventParameter_DEM_DTC_Whl_Spd_Dir_Invld, value-type=Dem_EventIdType}, port=Event_DEM_DTC_Whl_Spd_Dir_Invld}
        {enable-take-address=false, indirect-api=false, port-defined-argument-value{value=DemConf_DemEventParameter_DEM_DTC_Whl_Spd_Dir_Invld, value-type=Dem_EventIdType}, port=EvtInfo_DEM_DTC_Whl_Spd_Dir_Invld}
        enable-take-address=true, indirect-api=false, port=CBStatusEvt_DEM_DTC_Whl_Spd_Dir_Invld_1
        {enable-take-address=false, indirect-api=false, port-defined-argument-value{value=DemConf_DemEventParameter_DEM_DTC_Whl_Spd_Data_Invld, value-type=Dem_EventIdType}, port=Event_DEM_DTC_Whl_Spd_Data_Invld}
        {enable-take-address=false, indirect-api=false, port-defined-argument-value{value=DemConf_DemEventParameter_DEM_DTC_Whl_Spd_Data_Invld, value-type=Dem_EventIdType}, port=EvtInfo_DEM_DTC_Whl_Spd_Data_Invld}
        enable-take-address=true, indirect-api=false, port=CBStatusEvt_DEM_DTC_Whl_Spd_Data_Invld_1
        {enable-take-address=false, indirect-api=false, port-defined-argument-value{value=DemConf_DemEventParameter_DEM_DTC_EPS_Sas_NOT_Cal, value-type=Dem_EventIdType}, port=Event_DEM_DTC_EPS_Sas_NOT_Cal}
        {enable-take-address=false, indirect-api=false, port-defined-argument-value{value=DemConf_DemEventParameter_DEM_DTC_EPS_Sas_NOT_Cal, value-type=Dem_EventIdType}, port=EvtInfo_DEM_DTC_EPS_Sas_NOT_Cal}
        enable-take-address=true, indirect-api=false, port=CBStatusEvt_DEM_DTC_EPS_Sas_NOT_Cal_1
        {enable-take-address=false, indirect-api=false, port-defined-argument-value{value=DemConf_DemEventParameter_DEM_DTC_EPS_Actual_Motor_Torq_Invld, value-type=Dem_EventIdType}, port=Event_DEM_DTC_EPS_Actual_Motor_Torq_Invld}
        {enable-take-address=false, indirect-api=false, port-defined-argument-value{value=DemConf_DemEventParameter_DEM_DTC_EPS_Actual_Motor_Torq_Invld, value-type=Dem_EventIdType}, port=EvtInfo_DEM_DTC_EPS_Actual_Motor_Torq_Invld}
        enable-take-address=true, indirect-api=false, port=CBStatusEvt_DEM_DTC_EPS_Actual_Motor_Torq_Invld_1
        {enable-take-address=false, indirect-api=false, port-defined-argument-value{value=DemConf_DemEventParameter_DEM_DTC_ESP_Lat_Accel_Invld, value-type=Dem_EventIdType}, port=Event_DEM_DTC_ESP_Lat_Accel_Invld}
        {enable-take-address=false, indirect-api=false, port-defined-argument-value{value=DemConf_DemEventParameter_DEM_DTC_ESP_Lat_Accel_Invld, value-type=Dem_EventIdType}, port=EvtInfo_DEM_DTC_ESP_Lat_Accel_Invld}
        enable-take-address=true, indirect-api=false, port=CBStatusEvt_DEM_DTC_ESP_Lat_Accel_Invld_1
        {enable-take-address=false, indirect-api=false, port-defined-argument-value{value=DemConf_DemEventParameter_DEM_DTC_ESP_Long_Accel_Invld, value-type=Dem_EventIdType}, port=Event_DEM_DTC_ESP_Long_Accel_Invld}
        {enable-take-address=false, indirect-api=false, port-defined-argument-value{value=DemConf_DemEventParameter_DEM_DTC_ESP_Long_Accel_Invld, value-type=Dem_EventIdType}, port=EvtInfo_DEM_DTC_ESP_Long_Accel_Invld}
        enable-take-address=true, indirect-api=false, port=CBStatusEvt_DEM_DTC_ESP_Long_Accel_Invld_1
        {enable-take-address=false, indirect-api=false, port-defined-argument-value{value=DemConf_DemEventParameter_DEM_DTC_ESP_Yaw_Rate_Invld, value-type=Dem_EventIdType}, port=Event_DEM_DTC_ESP_Yaw_Rate_Invld}
        {enable-take-address=false, indirect-api=false, port-defined-argument-value{value=DemConf_DemEventParameter_DEM_DTC_ESP_Yaw_Rate_Invld, value-type=Dem_EventIdType}, port=EvtInfo_DEM_DTC_ESP_Yaw_Rate_Invld}
        enable-take-address=true, indirect-api=false, port=CBStatusEvt_DEM_DTC_ESP_Yaw_Rate_Invld_1
        {enable-take-address=false, indirect-api=false, port-defined-argument-value{value=DemConf_DemEventParameter_DEM_DTC_EPS_Fault, value-type=Dem_EventIdType}, port=Event_DEM_DTC_EPS_Fault}
        {enable-take-address=false, indirect-api=false, port-defined-argument-value{value=DemConf_DemEventParameter_DEM_DTC_EPS_Fault, value-type=Dem_EventIdType}, port=EvtInfo_DEM_DTC_EPS_Fault}
        enable-take-address=true, indirect-api=false, port=CBStatusEvt_DEM_DTC_EPS_Fault_1
        {enable-take-address=false, indirect-api=false, port-defined-argument-value{value=DemConf_DemEventParameter_DEM_DTC_VCU_All_Node_Missing, value-type=Dem_EventIdType}, port=Event_DEM_DTC_VCU_All_Node_Missing}
        {enable-take-address=false, indirect-api=false, port-defined-argument-value{value=DemConf_DemEventParameter_DEM_DTC_VCU_All_Node_Missing, value-type=Dem_EventIdType}, port=EvtInfo_DEM_DTC_VCU_All_Node_Missing}
        enable-take-address=true, indirect-api=false, port=CBStatusEvt_DEM_DTC_VCU_All_Node_Missing_1
        {enable-take-address=false, indirect-api=false, port-defined-argument-value{value=DemConf_DemEventParameter_DEM_DTC_ESP_All_Node_Missing, value-type=Dem_EventIdType}, port=Event_DEM_DTC_ESP_All_Node_Missing}
        {enable-take-address=false, indirect-api=false, port-defined-argument-value{value=DemConf_DemEventParameter_DEM_DTC_ESP_All_Node_Missing, value-type=Dem_EventIdType}, port=EvtInfo_DEM_DTC_ESP_All_Node_Missing}
        enable-take-address=true, indirect-api=false, port=CBStatusEvt_DEM_DTC_ESP_All_Node_Missing_1
        {enable-take-address=false, indirect-api=false, port-defined-argument-value{value=DemConf_DemEventParameter_DEM_DTC_EPS_All_Node_Missing, value-type=Dem_EventIdType}, port=Event_DEM_DTC_EPS_All_Node_Missing}
        {enable-take-address=false, indirect-api=false, port-defined-argument-value{value=DemConf_DemEventParameter_DEM_DTC_EPS_All_Node_Missing, value-type=Dem_EventIdType}, port=EvtInfo_DEM_DTC_EPS_All_Node_Missing}
        enable-take-address=true, indirect-api=false, port=CBStatusEvt_DEM_DTC_EPS_All_Node_Missing_1
        {enable-take-address=false, indirect-api=false, port-defined-argument-value{value=DemConf_DemEventParameter_DEM_DTC_VCU_Message_Alive_Counter_Error, value-type=Dem_EventIdType}, port=Event_DEM_DTC_VCU_Message_Alive_Counter_Error}
        {enable-take-address=false, indirect-api=false, port-defined-argument-value{value=DemConf_DemEventParameter_DEM_DTC_VCU_Message_Alive_Counter_Error, value-type=Dem_EventIdType}, port=EvtInfo_DEM_DTC_VCU_Message_Alive_Counter_Error}
        enable-take-address=true, indirect-api=false, port=CBStatusEvt_DEM_DTC_VCU_Message_Alive_Counter_Error_1
        {enable-take-address=false, indirect-api=false, port-defined-argument-value{value=DemConf_DemEventParameter_DEM_DTC_ESP_Message_Alive_Counter_Error, value-type=Dem_EventIdType}, port=Event_DEM_DTC_ESP_Message_Alive_Counter_Error}
        {enable-take-address=false, indirect-api=false, port-defined-argument-value{value=DemConf_DemEventParameter_DEM_DTC_ESP_Message_Alive_Counter_Error, value-type=Dem_EventIdType}, port=EvtInfo_DEM_DTC_ESP_Message_Alive_Counter_Error}
        enable-take-address=true, indirect-api=false, port=CBStatusEvt_DEM_DTC_ESP_Message_Alive_Counter_Error_1
        {enable-take-address=false, indirect-api=false, port-defined-argument-value{value=DemConf_DemEventParameter_DEM_DTC_EPS_Message_Alive_Counter_Error_10ms, value-type=Dem_EventIdType}, port=Event_DEM_DTC_EPS_Message_Alive_Counter_Error_10ms}
        {enable-take-address=false, indirect-api=false, port-defined-argument-value{value=DemConf_DemEventParameter_DEM_DTC_EPS_Message_Alive_Counter_Error_10ms, value-type=Dem_EventIdType}, port=EvtInfo_DEM_DTC_EPS_Message_Alive_Counter_Error_10ms}
        enable-take-address=true, indirect-api=false, port=CBStatusEvt_DEM_DTC_EPS_Message_Alive_Counter_Error_10ms_1
        {enable-take-address=false, indirect-api=false, port-defined-argument-value{value=DemConf_DemEventParameter_DEM_DTC_Front_Radar_Alive_Counter_Error, value-type=Dem_EventIdType}, port=Event_DEM_DTC_Front_Radar_Alive_Counter_Error}
        {enable-take-address=false, indirect-api=false, port-defined-argument-value{value=DemConf_DemEventParameter_DEM_DTC_Front_Radar_Alive_Counter_Error, value-type=Dem_EventIdType}, port=EvtInfo_DEM_DTC_Front_Radar_Alive_Counter_Error}
        enable-take-address=true, indirect-api=false, port=CBStatusEvt_DEM_DTC_Front_Radar_Alive_Counter_Error_1
        {enable-take-address=false, indirect-api=false, port-defined-argument-value{value=DemConf_DemEventParameter_DEM_DTC_ESP_ABS_Fault, value-type=Dem_EventIdType}, port=Event_DEM_DTC_ESP_ABS_Fault}
        {enable-take-address=false, indirect-api=false, port-defined-argument-value{value=DemConf_DemEventParameter_DEM_DTC_ESP_ABS_Fault, value-type=Dem_EventIdType}, port=EvtInfo_DEM_DTC_ESP_ABS_Fault}
        enable-take-address=true, indirect-api=false, port=CBStatusEvt_DEM_DTC_ESP_ABS_Fault_1
        {enable-take-address=false, indirect-api=false, port-defined-argument-value{value=DemConf_DemEventParameter_DEM_DTC_ESP_TCS_Fault, value-type=Dem_EventIdType}, port=Event_DEM_DTC_ESP_TCS_Fault}
        {enable-take-address=false, indirect-api=false, port-defined-argument-value{value=DemConf_DemEventParameter_DEM_DTC_ESP_TCS_Fault, value-type=Dem_EventIdType}, port=EvtInfo_DEM_DTC_ESP_TCS_Fault}
        enable-take-address=true, indirect-api=false, port=CBStatusEvt_DEM_DTC_ESP_TCS_Fault_1
        {enable-take-address=false, indirect-api=false, port-defined-argument-value{value=DemConf_DemEventParameter_DEM_DTC_ESP_ABA_NOT_Available, value-type=Dem_EventIdType}, port=Event_DEM_DTC_ESP_ABA_NOT_Available}
        {enable-take-address=false, indirect-api=false, port-defined-argument-value{value=DemConf_DemEventParameter_DEM_DTC_ESP_ABA_NOT_Available, value-type=Dem_EventIdType}, port=EvtInfo_DEM_DTC_ESP_ABA_NOT_Available}
        enable-take-address=true, indirect-api=false, port=CBStatusEvt_DEM_DTC_ESP_ABA_NOT_Available_1
        {enable-take-address=false, indirect-api=false, port-defined-argument-value{value=DemConf_DemEventParameter_DEM_DTC_ESP_AEB_NOT_Available, value-type=Dem_EventIdType}, port=Event_DEM_DTC_ESP_AEB_NOT_Available}
        {enable-take-address=false, indirect-api=false, port-defined-argument-value{value=DemConf_DemEventParameter_DEM_DTC_ESP_AEB_NOT_Available, value-type=Dem_EventIdType}, port=EvtInfo_DEM_DTC_ESP_AEB_NOT_Available}
        enable-take-address=true, indirect-api=false, port=CBStatusEvt_DEM_DTC_ESP_AEB_NOT_Available_1
        {enable-take-address=false, indirect-api=false, port-defined-argument-value{value=DemConf_DemEventParameter_DEM_DTC_ESP_AWB_NOT_Available, value-type=Dem_EventIdType}, port=Event_DEM_DTC_ESP_AWB_NOT_Available}
        {enable-take-address=false, indirect-api=false, port-defined-argument-value{value=DemConf_DemEventParameter_DEM_DTC_ESP_AWB_NOT_Available, value-type=Dem_EventIdType}, port=EvtInfo_DEM_DTC_ESP_AWB_NOT_Available}
        enable-take-address=true, indirect-api=false, port=CBStatusEvt_DEM_DTC_ESP_AWB_NOT_Available_1
        {enable-take-address=false, indirect-api=false, port-defined-argument-value{value=DemConf_DemEventParameter_DEM_DTC_IB_Brk_Pedl_Invld, value-type=Dem_EventIdType}, port=Event_DEM_DTC_IB_Brk_Pedl_Invld}
        {enable-take-address=false, indirect-api=false, port-defined-argument-value{value=DemConf_DemEventParameter_DEM_DTC_IB_Brk_Pedl_Invld, value-type=Dem_EventIdType}, port=EvtInfo_DEM_DTC_IB_Brk_Pedl_Invld}
        enable-take-address=true, indirect-api=false, port=CBStatusEvt_DEM_DTC_IB_Brk_Pedl_Invld_1
        {enable-take-address=false, indirect-api=false, port-defined-argument-value{value=DemConf_DemEventParameter_DEM_DTC_EPS_Actual_Torsion_Torq_Invld, value-type=Dem_EventIdType}, port=Event_DEM_DTC_EPS_Actual_Torsion_Torq_Invld}
        {enable-take-address=false, indirect-api=false, port-defined-argument-value{value=DemConf_DemEventParameter_DEM_DTC_EPS_Actual_Torsion_Torq_Invld, value-type=Dem_EventIdType}, port=EvtInfo_DEM_DTC_EPS_Actual_Torsion_Torq_Invld}
        enable-take-address=true, indirect-api=false, port=CBStatusEvt_DEM_DTC_EPS_Actual_Torsion_Torq_Invld_1
        {enable-take-address=false, indirect-api=false, port-defined-argument-value{value=DemConf_DemEventParameter_DEM_DTC_EPS_Actual_Motor_Invld, value-type=Dem_EventIdType}, port=Event_DEM_DTC_EPS_Actual_Motor_Invld}
        {enable-take-address=false, indirect-api=false, port-defined-argument-value{value=DemConf_DemEventParameter_DEM_DTC_EPS_Actual_Motor_Invld, value-type=Dem_EventIdType}, port=EvtInfo_DEM_DTC_EPS_Actual_Motor_Invld}
        enable-take-address=true, indirect-api=false, port=CBStatusEvt_DEM_DTC_EPS_Actual_Motor_Invld_1
        {enable-take-address=false, indirect-api=false, port-defined-argument-value{value=DemConf_DemEventParameter_DEM_DTC_EPS_Steer_AgSens_Fault, value-type=Dem_EventIdType}, port=Event_DEM_DTC_EPS_Steer_AgSens_Fault}
        {enable-take-address=false, indirect-api=false, port-defined-argument-value{value=DemConf_DemEventParameter_DEM_DTC_EPS_Steer_AgSens_Fault, value-type=Dem_EventIdType}, port=EvtInfo_DEM_DTC_EPS_Steer_AgSens_Fault}
        enable-take-address=true, indirect-api=false, port=CBStatusEvt_DEM_DTC_EPS_Steer_AgSens_Fault_1
        {enable-take-address=false, indirect-api=false, port-defined-argument-value{value=DemConf_DemEventParameter_DEM_DTC_SRS_Drvr_BucSwt_Invld, value-type=Dem_EventIdType}, port=Event_DEM_DTC_SRS_Drvr_BucSwt_Invld}
        {enable-take-address=false, indirect-api=false, port-defined-argument-value{value=DemConf_DemEventParameter_DEM_DTC_SRS_Drvr_BucSwt_Invld, value-type=Dem_EventIdType}, port=EvtInfo_DEM_DTC_SRS_Drvr_BucSwt_Invld}
        enable-take-address=true, indirect-api=false, port=CBStatusEvt_DEM_DTC_SRS_Drvr_BucSwt_Invld_1
        {enable-take-address=false, indirect-api=false, port-defined-argument-value{value=DemConf_DemEventParameter_DEM_DTC_EPS_Pinionang_Invld, value-type=Dem_EventIdType}, port=Event_DEM_DTC_EPS_Pinionang_Invld}
        {enable-take-address=false, indirect-api=false, port-defined-argument-value{value=DemConf_DemEventParameter_DEM_DTC_EPS_Pinionang_Invld, value-type=Dem_EventIdType}, port=EvtInfo_DEM_DTC_EPS_Pinionang_Invld}
        enable-take-address=true, indirect-api=false, port=CBStatusEvt_DEM_DTC_EPS_Pinionang_Invld_1
        {enable-take-address=false, indirect-api=false, port-defined-argument-value{value=DemConf_DemEventParameter_DEM_DTC_EPS_Pinionang_Fault, value-type=Dem_EventIdType}, port=Event_DEM_DTC_EPS_Pinionang_Fault}
        {enable-take-address=false, indirect-api=false, port-defined-argument-value{value=DemConf_DemEventParameter_DEM_DTC_EPS_Pinionang_Fault, value-type=Dem_EventIdType}, port=EvtInfo_DEM_DTC_EPS_Pinionang_Fault}
        enable-take-address=true, indirect-api=false, port=CBStatusEvt_DEM_DTC_EPS_Pinionang_Fault_1
        {enable-take-address=false, indirect-api=false, port-defined-argument-value{value=DemConf_DemEventParameter_DEM_DTC_EPS_APA_Epas_Fault, value-type=Dem_EventIdType}, port=Event_DEM_DTC_EPS_APA_Epas_Fault}
        {enable-take-address=false, indirect-api=false, port-defined-argument-value{value=DemConf_DemEventParameter_DEM_DTC_EPS_APA_Epas_Fault, value-type=Dem_EventIdType}, port=EvtInfo_DEM_DTC_EPS_APA_Epas_Fault}
        enable-take-address=true, indirect-api=false, port=CBStatusEvt_DEM_DTC_EPS_APA_Epas_Fault_1
        {enable-take-address=false, indirect-api=false, port-defined-argument-value{value=DemConf_DemEventParameter_DEM_DTC_BCM_EmgyLi_Fault, value-type=Dem_EventIdType}, port=Event_DEM_DTC_BCM_EmgyLi_Fault}
        {enable-take-address=false, indirect-api=false, port-defined-argument-value{value=DemConf_DemEventParameter_DEM_DTC_BCM_EmgyLi_Fault, value-type=Dem_EventIdType}, port=EvtInfo_DEM_DTC_BCM_EmgyLi_Fault}
        enable-take-address=true, indirect-api=false, port=CBStatusEvt_DEM_DTC_BCM_EmgyLi_Fault_1
        {enable-take-address=false, indirect-api=false, port-defined-argument-value{value=DemConf_DemEventParameter_DEM_DTC_BCM_All_Node_Missing, value-type=Dem_EventIdType}, port=Event_DEM_DTC_BCM_All_Node_Missing}
        {enable-take-address=false, indirect-api=false, port-defined-argument-value{value=DemConf_DemEventParameter_DEM_DTC_BCM_All_Node_Missing, value-type=Dem_EventIdType}, port=EvtInfo_DEM_DTC_BCM_All_Node_Missing}
        enable-take-address=true, indirect-api=false, port=CBStatusEvt_DEM_DTC_BCM_All_Node_Missing_1
        {enable-take-address=false, indirect-api=false, port-defined-argument-value{value=DemConf_DemEventParameter_DEM_DTC_BCM_Message_Alive_Counter_Error_40ms, value-type=Dem_EventIdType}, port=Event_DEM_DTC_BCM_Message_Alive_Counter_Error_40ms}
        {enable-take-address=false, indirect-api=false, port-defined-argument-value{value=DemConf_DemEventParameter_DEM_DTC_BCM_Message_Alive_Counter_Error_40ms, value-type=Dem_EventIdType}, port=EvtInfo_DEM_DTC_BCM_Message_Alive_Counter_Error_40ms}
        enable-take-address=true, indirect-api=false, port=CBStatusEvt_DEM_DTC_BCM_Message_Alive_Counter_Error_40ms_1
        {enable-take-address=false, indirect-api=false, port-defined-argument-value{value=DemConf_DemEventParameter_DEM_DTC_J3_Camera_Blockage, value-type=Dem_EventIdType}, port=Event_DEM_DTC_J3_Camera_Blockage}
        {enable-take-address=false, indirect-api=false, port-defined-argument-value{value=DemConf_DemEventParameter_DEM_DTC_J3_Camera_Blockage, value-type=Dem_EventIdType}, port=EvtInfo_DEM_DTC_J3_Camera_Blockage}
        enable-take-address=true, indirect-api=false, port=CBStatusEvt_DEM_DTC_J3_Camera_Blockage_1
        {enable-take-address=false, indirect-api=false, port-defined-argument-value{value=DemConf_DemEventParameter_DEM_DTC_Private_CAN_Bus_Off, value-type=Dem_EventIdType}, port=EvtInfo_DEM_DTC_Private_CAN_Bus_Off}
        enable-take-address=true, indirect-api=false, port=CBStatusEvt_DEM_DTC_Private_CAN_Bus_Off_1
        {enable-take-address=false, indirect-api=false, port-defined-argument-value{value=DemConf_DemEventParameter_DEM_DTC_Public_CAN_Bus_Off, value-type=Dem_EventIdType}, port=EvtInfo_DEM_DTC_Public_CAN_Bus_Off}
        enable-take-address=true, indirect-api=false, port=CBStatusEvt_DEM_DTC_Public_CAN_Bus_Off_1
        {enable-take-address=false, indirect-api=false, port-defined-argument-value{value=DemConf_DemEventParameter_DEM_DTC_Ethernet_Unexpected_Link_Down, value-type=Dem_EventIdType}, port=Event_DEM_DTC_Ethernet_Unexpected_Link_Down}
        {enable-take-address=false, indirect-api=false, port-defined-argument-value{value=DemConf_DemEventParameter_DEM_DTC_Ethernet_Unexpected_Link_Down, value-type=Dem_EventIdType}, port=EvtInfo_DEM_DTC_Ethernet_Unexpected_Link_Down}
        {enable-take-address=false, indirect-api=false, port-defined-argument-value{value=DemConf_DemEventParameter_DEM_DTC_J3_SoC_ETH_IP_Ubnormal, value-type=Dem_EventIdType}, port=Event_DEM_DTC_J3_SoC_ETH_IP_Ubnormal}
        {enable-take-address=false, indirect-api=false, port-defined-argument-value{value=DemConf_DemEventParameter_DEM_DTC_J3_SoC_ETH_IP_Ubnormal, value-type=Dem_EventIdType}, port=EvtInfo_DEM_DTC_J3_SoC_ETH_IP_Ubnormal}
        {enable-take-address=false, indirect-api=false, port-defined-argument-value{value=DemConf_DemEventParameter_ECUM_E_RAM_CHECK_FAILED, value-type=Dem_EventIdType}, port=EvtInfo_ECUM_E_RAM_CHECK_FAILED}
        {enable-take-address=false, indirect-api=false, port-defined-argument-value{value=DemConf_DemEventParameter_DEM_DTC_J3_SOC_Safetylib_Error, value-type=Dem_EventIdType}, port=Event_DEM_DTC_J3_SOC_Safetylib_Error}
        {enable-take-address=false, indirect-api=false, port-defined-argument-value{value=DemConf_DemEventParameter_DEM_DTC_J3_SOC_Safetylib_Error, value-type=Dem_EventIdType}, port=EvtInfo_DEM_DTC_J3_SOC_Safetylib_Error}
        enable-take-address=true, indirect-api=false, port=CBStatusEvt_DEM_DTC_J3_SOC_Safetylib_Error_1
        {enable-take-address=false, indirect-api=false, port-defined-argument-value{value=DemConf_DemEventParameter_DEM_DTC_EPS_Steering_wheel_vibration_failure, value-type=Dem_EventIdType}, port=Event_DEM_DTC_EPS_Steering_wheel_vibration_failure}
        {enable-take-address=false, indirect-api=false, port-defined-argument-value{value=DemConf_DemEventParameter_DEM_DTC_EPS_Steering_wheel_vibration_failure, value-type=Dem_EventIdType}, port=EvtInfo_DEM_DTC_EPS_Steering_wheel_vibration_failure}
        enable-take-address=true, indirect-api=false, port=CBStatusEvt_DEM_DTC_EPS_Steering_wheel_vibration_failure_1
        {enable-take-address=false, indirect-api=false, port-defined-argument-value{value=DemConf_DemEventParameter_DEM_DTC_EPS_Driver_hand_torque_invalid, value-type=Dem_EventIdType}, port=Event_DEM_DTC_EPS_Driver_hand_torque_invalid}
        {enable-take-address=false, indirect-api=false, port-defined-argument-value{value=DemConf_DemEventParameter_DEM_DTC_EPS_Driver_hand_torque_invalid, value-type=Dem_EventIdType}, port=EvtInfo_DEM_DTC_EPS_Driver_hand_torque_invalid}
        enable-take-address=true, indirect-api=false, port=CBStatusEvt_DEM_DTC_EPS_Driver_hand_torque_invalid_1
        {enable-take-address=false, indirect-api=false, port-defined-argument-value{value=DemConf_DemEventParameter_DEM_DTC_IP_warning_invalid, value-type=Dem_EventIdType}, port=Event_DEM_DTC_IP_warning_invalid}
        {enable-take-address=false, indirect-api=false, port-defined-argument-value{value=DemConf_DemEventParameter_DEM_DTC_IP_warning_invalid, value-type=Dem_EventIdType}, port=EvtInfo_DEM_DTC_IP_warning_invalid}
        enable-take-address=true, indirect-api=false, port=CBStatusEvt_DEM_DTC_IP_warning_invalid_1
        {enable-take-address=false, indirect-api=false, port-defined-argument-value{value=DemConf_DemEventParameter_DEM_DTC_IP_node_missing, value-type=Dem_EventIdType}, port=Event_DEM_DTC_IP_node_missing}
        {enable-take-address=false, indirect-api=false, port-defined-argument-value{value=DemConf_DemEventParameter_DEM_DTC_IP_node_missing, value-type=Dem_EventIdType}, port=EvtInfo_DEM_DTC_IP_node_missing}
        enable-take-address=true, indirect-api=false, port=CBStatusEvt_DEM_DTC_IP_node_missing_1
        {enable-take-address=false, indirect-api=false, port-defined-argument-value{value=DemConf_DemEventParameter_DEM_DTC_IP_message_alive_counter_error, value-type=Dem_EventIdType}, port=Event_DEM_DTC_IP_message_alive_counter_error}
        {enable-take-address=false, indirect-api=false, port-defined-argument-value{value=DemConf_DemEventParameter_DEM_DTC_IP_message_alive_counter_error, value-type=Dem_EventIdType}, port=EvtInfo_DEM_DTC_IP_message_alive_counter_error}
        enable-take-address=true, indirect-api=false, port=CBStatusEvt_DEM_DTC_IP_message_alive_counter_error_1
        {enable-take-address=false, indirect-api=false, port-defined-argument-value{value=DemConf_DemEventParameter_DEM_DTC_Fradar_not_calibration_or_blockage, value-type=Dem_EventIdType}, port=Event_DEM_DTC_Fradar_not_calibration_or_blockage}
        {enable-take-address=false, indirect-api=false, port-defined-argument-value{value=DemConf_DemEventParameter_DEM_DTC_Fradar_not_calibration_or_blockage, value-type=Dem_EventIdType}, port=EvtInfo_DEM_DTC_Fradar_not_calibration_or_blockage}
        enable-take-address=true, indirect-api=false, port=CBStatusEvt_DEM_DTC_Fradar_not_calibration_or_blockage_1
        {enable-take-address=false, indirect-api=false, port-defined-argument-value{value=DemConf_DemEventParameter_DEM_DTC_Fradar_hardware_error, value-type=Dem_EventIdType}, port=Event_DEM_DTC_Fradar_hardware_error}
        {enable-take-address=false, indirect-api=false, port-defined-argument-value{value=DemConf_DemEventParameter_DEM_DTC_Fradar_hardware_error, value-type=Dem_EventIdType}, port=EvtInfo_DEM_DTC_Fradar_hardware_error}
        enable-take-address=true, indirect-api=false, port=CBStatusEvt_DEM_DTC_Fradar_hardware_error_1
        {enable-take-address=false, indirect-api=false, port-defined-argument-value{value=DemConf_DemEventParameter_DEM_DTC_SRS_All_Node_Missing, value-type=Dem_EventIdType}, port=Event_DEM_DTC_SRS_All_Node_Missing}
        {enable-take-address=false, indirect-api=false, port-defined-argument-value{value=DemConf_DemEventParameter_DEM_DTC_SRS_All_Node_Missing, value-type=Dem_EventIdType}, port=EvtInfo_DEM_DTC_SRS_All_Node_Missing}
        enable-take-address=true, indirect-api=false, port=CBStatusEvt_DEM_DTC_SRS_All_Node_Missing_1
        {enable-take-address=false, indirect-api=false, port-defined-argument-value{value=DemConf_DemEventParameter_DEM_DTC_ADC_Message_Alive_Counter_Error, value-type=Dem_EventIdType}, port=Event_DEM_DTC_ADC_Message_Alive_Counter_Error}
        {enable-take-address=false, indirect-api=false, port-defined-argument-value{value=DemConf_DemEventParameter_DEM_DTC_ADC_Message_Alive_Counter_Error, value-type=Dem_EventIdType}, port=EvtInfo_DEM_DTC_ADC_Message_Alive_Counter_Error}
        enable-take-address=true, indirect-api=false, port=CBStatusEvt_DEM_DTC_ADC_Message_Alive_Counter_Error_1
        {enable-take-address=false, indirect-api=false, port-defined-argument-value{value=DemConf_DemEventParameter_DEM_DTC_RLR_Message_Alive_Counter_Error, value-type=Dem_EventIdType}, port=Event_DEM_DTC_RLR_Message_Alive_Counter_Error}
        {enable-take-address=false, indirect-api=false, port-defined-argument-value{value=DemConf_DemEventParameter_DEM_DTC_RLR_Message_Alive_Counter_Error, value-type=Dem_EventIdType}, port=EvtInfo_DEM_DTC_RLR_Message_Alive_Counter_Error}
        enable-take-address=true, indirect-api=false, port=CBStatusEvt_DEM_DTC_RLR_Message_Alive_Counter_Error_1
        {enable-take-address=false, indirect-api=false, port-defined-argument-value{value=DemConf_DemEventParameter_DEM_DTC_SRS_Message_Alive_Counter_Error, value-type=Dem_EventIdType}, port=Event_DEM_DTC_SRS_Message_Alive_Counter_Error}
        {enable-take-address=false, indirect-api=false, port-defined-argument-value{value=DemConf_DemEventParameter_DEM_DTC_SRS_Message_Alive_Counter_Error, value-type=Dem_EventIdType}, port=EvtInfo_DEM_DTC_SRS_Message_Alive_Counter_Error}
        enable-take-address=true, indirect-api=false, port=CBStatusEvt_DEM_DTC_SRS_Message_Alive_Counter_Error_1
        {enable-take-address=false, indirect-api=false, port-defined-argument-value{value=DemConf_DemEventParameter_DEM_DTC_EPS_Message_Alive_Counter_Error_20ms, value-type=Dem_EventIdType}, port=Event_DEM_DTC_EPS_Message_Alive_Counter_Error_20ms}
        {enable-take-address=false, indirect-api=false, port-defined-argument-value{value=DemConf_DemEventParameter_DEM_DTC_EPS_Message_Alive_Counter_Error_20ms, value-type=Dem_EventIdType}, port=EvtInfo_DEM_DTC_EPS_Message_Alive_Counter_Error_20ms}
        enable-take-address=true, indirect-api=false, port=CBStatusEvt_DEM_DTC_EPS_Message_Alive_Counter_Error_20ms_1
        {enable-take-address=false, indirect-api=false, port-defined-argument-value{value=DemConf_DemEventParameter_DEM_DTC_BCM_Message_Alive_Counter_Error_100ms, value-type=Dem_EventIdType}, port=Event_DEM_DTC_BCM_Message_Alive_Counter_Error_100ms}
        {enable-take-address=false, indirect-api=false, port-defined-argument-value{value=DemConf_DemEventParameter_DEM_DTC_BCM_Message_Alive_Counter_Error_100ms, value-type=Dem_EventIdType}, port=EvtInfo_DEM_DTC_BCM_Message_Alive_Counter_Error_100ms}
        {enable-take-address=false, indirect-api=false, port-defined-argument-value{value=DemConf_DemEventParameter_DEM_DTC_Private_CAN_Bus_Off_TOCAN, value-type=Dem_EventIdType}, port=Event_DEM_DTC_Private_CAN_Bus_Off_TOCAN}
        {enable-take-address=false, indirect-api=false, port-defined-argument-value{value=DemConf_DemEventParameter_DEM_DTC_Private_CAN_Bus_Off_TOCAN, value-type=Dem_EventIdType}, port=EvtInfo_DEM_DTC_Private_CAN_Bus_Off_TOCAN}
        {enable-take-address=false, indirect-api=false, port-defined-argument-value{value=DemConf_DemEventParameter_DEM_DTC_Public_CAN_Bus_Off_TOCAN, value-type=Dem_EventIdType}, port=Event_DEM_DTC_Public_CAN_Bus_Off_TOCAN}
        {enable-take-address=false, indirect-api=false, port-defined-argument-value{value=DemConf_DemEventParameter_DEM_DTC_Public_CAN_Bus_Off_TOCAN, value-type=Dem_EventIdType}, port=EvtInfo_DEM_DTC_Public_CAN_Bus_Off_TOCAN}
        {enable-take-address=false, indirect-api=false, port-defined-argument-value{value=DemConf_DemEventParameter_DEM_DTC_J3_Heavy_Rain_Detected, value-type=Dem_EventIdType}, port=Event_DEM_DTC_J3_Heavy_Rain_Detected}
        {enable-take-address=false, indirect-api=false, port-defined-argument-value{value=DemConf_DemEventParameter_DEM_DTC_J3_Heavy_Rain_Detected, value-type=Dem_EventIdType}, port=EvtInfo_DEM_DTC_J3_Heavy_Rain_Detected}
        {enable-take-address=false, indirect-api=false, port-defined-argument-value{value=DemConf_DemEventParameter_DEM_DTC_J3_Snow_Detected, value-type=Dem_EventIdType}, port=Event_DEM_DTC_J3_Snow_Detected}
        {enable-take-address=false, indirect-api=false, port-defined-argument-value{value=DemConf_DemEventParameter_DEM_DTC_J3_Snow_Detected, value-type=Dem_EventIdType}, port=EvtInfo_DEM_DTC_J3_Snow_Detected}
        {enable-take-address=false, indirect-api=false, port-defined-argument-value{value=DemConf_DemEventParameter_DEM_DTC_J3_Low_Sun_Detected, value-type=Dem_EventIdType}, port=Event_DEM_DTC_J3_Low_Sun_Detected}
        {enable-take-address=false, indirect-api=false, port-defined-argument-value{value=DemConf_DemEventParameter_DEM_DTC_J3_Low_Sun_Detected, value-type=Dem_EventIdType}, port=EvtInfo_DEM_DTC_J3_Low_Sun_Detected}
        {enable-take-address=false, indirect-api=false, port-defined-argument-value{value=DemConf_DemEventParameter_DEM_DTC_J3_SOC_System_Service_Error, value-type=Dem_EventIdType}, port=Event_DEM_DTC_J3_SOC_System_Service_Error}
        {enable-take-address=false, indirect-api=false, port-defined-argument-value{value=DemConf_DemEventParameter_DEM_DTC_J3_SOC_System_Service_Error, value-type=Dem_EventIdType}, port=EvtInfo_DEM_DTC_J3_SOC_System_Service_Error}
        enable-take-address=true, indirect-api=false, port=CBStatusEvt_DEM_DTC_J3_SOC_System_Service_Error_1
        {enable-take-address=false, indirect-api=false, port-defined-argument-value{value=DemConf_DemEventParameter_DEM_DTC_J3_Camera_Error, value-type=Dem_EventIdType}, port=Event_DEM_DTC_J3_Camera_Error}
        {enable-take-address=false, indirect-api=false, port-defined-argument-value{value=DemConf_DemEventParameter_DEM_DTC_J3_Camera_Error, value-type=Dem_EventIdType}, port=EvtInfo_DEM_DTC_J3_Camera_Error}
        enable-take-address=true, indirect-api=false, port=CBStatusEvt_DEM_DTC_J3_Camera_Error_1
        {enable-take-address=false, indirect-api=false, port-defined-argument-value{value=DemConf_DemEventParameter_DEM_DTC_J3_SOC_CPU_Error_PWM_Missing, value-type=Dem_EventIdType}, port=Event_DEM_DTC_J3_SOC_CPU_Error_PWM_Missing}
        {enable-take-address=false, indirect-api=false, port-defined-argument-value{value=DemConf_DemEventParameter_DEM_DTC_J3_SOC_CPU_Error_PWM_Missing, value-type=Dem_EventIdType}, port=EvtInfo_DEM_DTC_J3_SOC_CPU_Error_PWM_Missing}
        enable-take-address=true, indirect-api=false, port=CBStatusEvt_DEM_DTC_J3_SOC_CPU_Error_PWM_Missing_1
        {enable-take-address=false, indirect-api=false, port-defined-argument-value{value=DemConf_DemEventParameter_DEM_DTC_J3_SOC_Perception_Error, value-type=Dem_EventIdType}, port=Event_DEM_DTC_J3_SOC_Perception_Error}
        {enable-take-address=false, indirect-api=false, port-defined-argument-value{value=DemConf_DemEventParameter_DEM_DTC_J3_SOC_Perception_Error, value-type=Dem_EventIdType}, port=EvtInfo_DEM_DTC_J3_SOC_Perception_Error}
        enable-take-address=true, indirect-api=false, port=CBStatusEvt_DEM_DTC_J3_SOC_Perception_Error_1
        {enable-take-address=false, indirect-api=false, port-defined-argument-value{value=DemConf_DemEventParameter_DEM_DTC_ETH_CRC_ERROR, value-type=Dem_EventIdType}, port=Event_DEM_DTC_ETH_CRC_ERROR}
        {enable-take-address=false, indirect-api=false, port-defined-argument-value{value=DemConf_DemEventParameter_DEM_DTC_ETH_CRC_ERROR, value-type=Dem_EventIdType}, port=EvtInfo_DEM_DTC_ETH_CRC_ERROR}
        {enable-take-address=false, indirect-api=false, port-defined-argument-value{value=DemConf_DemEventParameter_DEM_DTC_ETH_LINK_SIGNAL_WAKE, value-type=Dem_EventIdType}, port=Event_DEM_DTC_ETH_LINK_SIGNAL_WAKE}
        {enable-take-address=false, indirect-api=false, port-defined-argument-value{value=DemConf_DemEventParameter_DEM_DTC_ETH_LINK_SIGNAL_WAKE, value-type=Dem_EventIdType}, port=EvtInfo_DEM_DTC_ETH_LINK_SIGNAL_WAKE}
        {enable-take-address=false, indirect-api=false, port-defined-argument-value{value=DemConf_DemEventParameter_DEM_DTC_ETH_CABLE_FAULT, value-type=Dem_EventIdType}, port=Event_DEM_DTC_ETH_CABLE_FAULT}
        {enable-take-address=false, indirect-api=false, port-defined-argument-value{value=DemConf_DemEventParameter_DEM_DTC_ETH_CABLE_FAULT, value-type=Dem_EventIdType}, port=EvtInfo_DEM_DTC_ETH_CABLE_FAULT}
        {enable-take-address=false, indirect-api=false, port-defined-argument-value{value=DemConf_DemEventParameter_DEM_DTC_ETH_ICMP_ERROR, value-type=Dem_EventIdType}, port=Event_DEM_DTC_ETH_ICMP_ERROR}
        {enable-take-address=false, indirect-api=false, port-defined-argument-value{value=DemConf_DemEventParameter_DEM_DTC_ETH_ICMP_ERROR, value-type=Dem_EventIdType}, port=EvtInfo_DEM_DTC_ETH_ICMP_ERROR}
        {enable-take-address=false, indirect-api=false, port-defined-argument-value{value=DemConf_DemEventParameter_DEM_DTC_SPI_DRIVER_ERROR, value-type=Dem_EventIdType}, port=Event_DEM_DTC_SPI_DRIVER_ERROR}
        {enable-take-address=false, indirect-api=false, port-defined-argument-value{value=DemConf_DemEventParameter_DEM_DTC_SPI_DRIVER_ERROR, value-type=Dem_EventIdType}, port=EvtInfo_DEM_DTC_SPI_DRIVER_ERROR}
        {enable-take-address=false, indirect-api=false, port-defined-argument-value{value=DemConf_DemEventParameter_DEM_DTC_DFLASH_ERROR, value-type=Dem_EventIdType}, port=Event_DEM_DTC_DFLASH_ERROR}
        {enable-take-address=false, indirect-api=false, port-defined-argument-value{value=DemConf_DemEventParameter_DEM_DTC_DFLASH_ERROR, value-type=Dem_EventIdType}, port=EvtInfo_DEM_DTC_DFLASH_ERROR}
        {enable-take-address=false, indirect-api=false, port-defined-argument-value{value=DemConf_DemEventParameter_DEM_DTC_BCM_Brake_Lamp_Error, value-type=Dem_EventIdType}, port=Event_DEM_DTC_BCM_Brake_Lamp_Error}
        {enable-take-address=false, indirect-api=false, port-defined-argument-value{value=DemConf_DemEventParameter_DEM_DTC_BCM_Brake_Lamp_Error, value-type=Dem_EventIdType}, port=EvtInfo_DEM_DTC_BCM_Brake_Lamp_Error}
        enable-take-address=true, indirect-api=false, port=CBStatusEvt_DEM_DTC_BCM_Brake_Lamp_Error_1
        {enable-take-address=false, indirect-api=false, port-defined-argument-value{value=DemConf_DemEventParameter_DEM_DTC_Esp_Ebd_Failr, value-type=Dem_EventIdType}, port=Event_DEM_DTC_Esp_Ebd_Failr}
        {enable-take-address=false, indirect-api=false, port-defined-argument-value{value=DemConf_DemEventParameter_DEM_DTC_Esp_Ebd_Failr, value-type=Dem_EventIdType}, port=EvtInfo_DEM_DTC_Esp_Ebd_Failr}
        enable-take-address=true, indirect-api=false, port=CBStatusEvt_DEM_DTC_Esp_Ebd_Failr_1
        {enable-take-address=false, indirect-api=false, port-defined-argument-value{value=DemConf_DemEventParameter_DEM_DTC_FR_All_Node_Missing, value-type=Dem_EventIdType}, port=Event_DEM_DTC_FR_All_Node_Missing}
        {enable-take-address=false, indirect-api=false, port-defined-argument-value{value=DemConf_DemEventParameter_DEM_DTC_FR_All_Node_Missing, value-type=Dem_EventIdType}, port=EvtInfo_DEM_DTC_FR_All_Node_Missing}
        enable-take-address=true, indirect-api=false, port=CBStatusEvt_DEM_DTC_FR_All_Node_Missing_1
        {enable-take-address=false, indirect-api=false, port-defined-argument-value{value=DemConf_DemEventParameter_DEM_DTC_ADC_All_Node_Missing, value-type=Dem_EventIdType}, port=Event_DEM_DTC_ADC_All_Node_Missing}
        {enable-take-address=false, indirect-api=false, port-defined-argument-value{value=DemConf_DemEventParameter_DEM_DTC_ADC_All_Node_Missing, value-type=Dem_EventIdType}, port=EvtInfo_DEM_DTC_ADC_All_Node_Missing}
        enable-take-address=true, indirect-api=false, port=CBStatusEvt_DEM_DTC_ADC_All_Node_Missing_1
        {enable-take-address=false, indirect-api=false, port-defined-argument-value{value=DemConf_DemEventParameter_DEM_DTC_J3_Time_Sync_Error, value-type=Dem_EventIdType}, port=Event_DEM_DTC_J3_Time_Sync_Error}
        {enable-take-address=false, indirect-api=false, port-defined-argument-value{value=DemConf_DemEventParameter_DEM_DTC_J3_Time_Sync_Error, value-type=Dem_EventIdType}, port=EvtInfo_DEM_DTC_J3_Time_Sync_Error}
        enable-take-address=true, indirect-api=false, port=CBStatusEvt_DEM_DTC_J3_Time_Sync_Error_1
        {enable-take-address=false, indirect-api=false, port-defined-argument-value{value=DemConf_DemEventParameter_NVM_E_INTEGRITY_FAILED, value-type=Dem_EventIdType}, port=EvtInfo_NVM_E_INTEGRITY_FAILED}
        {enable-take-address=false, indirect-api=false, port-defined-argument-value{value=DemConf_DemEventParameter_NVM_E_REQ_FAILED, value-type=Dem_EventIdType}, port=EvtInfo_NVM_E_REQ_FAILED}
        {enable-take-address=false, indirect-api=false, port-defined-argument-value{value=DemConf_DemEventParameter_NVM_E_WRONG_BLOCK_ID, value-type=Dem_EventIdType}, port=EvtInfo_NVM_E_WRONG_BLOCK_ID}
        {enable-take-address=false, indirect-api=false, port-defined-argument-value{value=DemConf_DemEventParameter_NVM_E_VERIFY_FAILED, value-type=Dem_EventIdType}, port=EvtInfo_NVM_E_VERIFY_FAILED}
        {enable-take-address=false, indirect-api=false, port-defined-argument-value{value=DemConf_DemEventParameter_NVM_E_WRITE_PROTECTED, value-type=Dem_EventIdType}, port=EvtInfo_NVM_E_WRITE_PROTECTED}
        {enable-take-address=false, indirect-api=false, port-defined-argument-value{value=DemConf_DemEventParameter_DEM_DTC_MCU_TEMP_INITIAL_HIGH, value-type=Dem_EventIdType}, port=Event_DEM_DTC_MCU_TEMP_INITIAL_HIGH}
        {enable-take-address=false, indirect-api=false, port-defined-argument-value{value=DemConf_DemEventParameter_DEM_DTC_MCU_TEMP_INITIAL_HIGH, value-type=Dem_EventIdType}, port=EvtInfo_DEM_DTC_MCU_TEMP_INITIAL_HIGH}
        enable-take-address=true, indirect-api=false, port=CBStatusEvt_DEM_DTC_MCU_TEMP_INITIAL_HIGH_1
        {enable-take-address=false, indirect-api=false, port-defined-argument-value{value=DemConf_DemEventParameter_DEM_DTC_ESP_Message_Alive_Counter_Error_100ms, value-type=Dem_EventIdType}, port=Event_DEM_DTC_ESP_Message_Alive_Counter_Error_100ms}
        {enable-take-address=false, indirect-api=false, port-defined-argument-value{value=DemConf_DemEventParameter_DEM_DTC_ESP_Message_Alive_Counter_Error_100ms, value-type=Dem_EventIdType}, port=EvtInfo_DEM_DTC_ESP_Message_Alive_Counter_Error_100ms}
        enable-take-address=true, indirect-api=false, port=CBStatusEvt_DEM_DTC_ESP_Message_Alive_Counter_Error_100ms_1
        {enable-take-address=false, indirect-api=false, port-defined-argument-value{value=DemConf_DemEventParameter_WDG_E_DISABLE_REJECTED, value-type=Dem_EventIdType}, port=EvtInfo_WDG_E_DISABLE_REJECTED}
        {enable-take-address=false, indirect-api=false, port-defined-argument-value{value=DemConf_DemEventParameter_WDG_E_MODE_FAILED, value-type=Dem_EventIdType}, port=EvtInfo_WDG_E_MODE_FAILED}
        {enable-take-address=false, indirect-api=false, port-defined-argument-value{value=DemConf_DemEventParameter_SmuActivateRunStateFailureNotification, value-type=Dem_EventIdType}, port=EvtInfo_SmuActivateRunStateFailureNotification}
        {enable-take-address=false, indirect-api=false, port-defined-argument-value{value=DemConf_DemEventParameter_SmuClearAlarmStatusFailureNotification, value-type=Dem_EventIdType}, port=EvtInfo_SmuClearAlarmStatusFailureNotification}
        {enable-take-address=false, indirect-api=false, port-defined-argument-value{value=DemConf_DemEventParameter_SmuReleaseFSPFailureNotification, value-type=Dem_EventIdType}, port=EvtInfo_SmuReleaseFSPFailureNotification}
        {enable-take-address=false, indirect-api=false, port-defined-argument-value{value=DemConf_DemEventParameter_SmuCoreAliveFailureNotification, value-type=Dem_EventIdType}, port=EvtInfo_SmuCoreAliveFailureNotification}
        {enable-take-address=false, indirect-api=false, port-defined-argument-value{value=DemConf_DemEventParameter_SmuRTStopFailureNotification, value-type=Dem_EventIdType}, port=EvtInfo_SmuRTStopFailureNotification}
        {enable-take-address=false, indirect-api=false, port-defined-argument-value{value=DemConf_DemEventParameter_SmuActivatePESFailureNotification, value-type=Dem_EventIdType}, port=EvtInfo_SmuActivatePESFailureNotification}
        {enable-take-address=false, indirect-api=false, port-defined-argument-value{value=DemConf_DemEventParameter_SmuActivateFSPFailureNotification, value-type=Dem_EventIdType}, port=EvtInfo_SmuActivateFSPFailureNotification}
        {enable-take-address=false, indirect-api=false, port-defined-argument-value{value=DemConf_DemEventParameter_SmuSetAlarmStatusFailureNotification, value-type=Dem_EventIdType}, port=EvtInfo_SmuSetAlarmStatusFailureNotification}
        {enable-take-address=false, indirect-api=false, port-defined-argument-value{value=DemConf_DemEventParameter_SmuSffFailureNotification, value-type=Dem_EventIdType}, port=EvtInfo_SmuSffFailureNotification}
        {enable-take-address=false, indirect-api=false, port-defined-argument-value{value=DEM_OPCYC_POWER, value-type=Dem_OperationCycleIdType}, port=OpCycle_DEM_OPCYC_POWER}
        {enable-take-address=false, indirect-api=false, port-defined-argument-value{value=DEM_OPCYC_IGN, value-type=Dem_OperationCycleIdType}, port=OpCycle_DEM_OPCYC_IGN}
        {enable-take-address=false, indirect-api=false, port-defined-argument-value{value=0, value-type=uint8}, port=EnableCond_CONDITION_Voltage_Normal}
        {enable-take-address=false, indirect-api=false, port-defined-argument-value{value=1, value-type=uint8}, port=EnableCond_CONDITION_PowerON_3000ms}
        {enable-take-address=false, indirect-api=false, port-defined-argument-value{value=2, value-type=uint8}, port=EnableCond_CONDITION_Voltage_InRange}
        {enable-take-address=false, indirect-api=false, port-defined-argument-value{value=3, value-type=uint8}, port=EnableCond_CONDITION_NO_BUSOFF_PublicCAN}
        {enable-take-address=false, indirect-api=false, port-defined-argument-value{value=4, value-type=uint8}, port=EnableCond_CONDITION_NO_BUSOFF_PrivateCAN}
        {enable-take-address=false, indirect-api=false, port-defined-argument-value{value=5, value-type=uint8}, port=EnableCond_CONDITION_BcmPwrStsFbON}
        {enable-take-address=false, indirect-api=false, port-defined-argument-value{value=6, value-type=uint8}, port=EnableCond_CONDITION_EspVehSpd}
        {enable-take-address=false, indirect-api=false, port-defined-argument-value{value=DEM_DTC_ORIGIN_PRIMARY_MEMORY, value-type=Dem_DTCOriginType}, port=OverflowIndPrimaryMemory}
        enable-take-address=true, indirect-api=false, port=CBReadData_DemDataElementClass_Odometer
        enable-take-address=true, indirect-api=false, port=CBReadData_DemDataElementClass_Voltage
        enable-take-address=true, indirect-api=false, port=CBReadData_DemDataElementClass_VehicleSpeed
        enable-take-address=true, indirect-api=false, port=CBReadData_DemDataElementClass_LocalTime
        enable-take-address=true, indirect-api=false, port=CBReadData_DemDataElementClass_ECUTemperature
        enable-take-address=true, indirect-api=false, port=CBReadData_DemDataElementClass_Yawrate
        enable-take-address=true, indirect-api=false, port=CBReadData_DemDataElementClass_EngineSpeed
        enable-take-address=true, indirect-api=false, port=CBReadData_DemDataElementClass_GearPosition
        enable-take-address=true, indirect-api=false, port=CBReadData_DemDataElementClass_SteeringAngle
        enable-take-address=true, indirect-api=false, port=CBReadData_DemDataElementClass_Extended_SystemKernelErrMap
      18 x runnable:
        RE_GetDTCOfEvent: arguments=[symbol=EventId, symbol=DTCFormat, symbol=DTCOfEvent], can-be-invoked-concurrently=true, symbol=Dem_GetDTCOfEvent
        RE_GetEventFreezeFrameData: arguments=[symbol=EventId, symbol=RecordNumber, symbol=ReportTotalRecord, symbol=DataId, symbol=DestBuffer], can-be-invoked-concurrently=true, symbol=Dem_GetEventFreezeFrameData
        RE_SetEventStatus: arguments=[symbol=EventId, symbol=EventStatus], can-be-invoked-concurrently=true, symbol=Dem_SetEventStatus
          84 x sync call, all with timeout=0.0:
            sscp_CBStEvtSPI_E_HARDWARE_ERROR_1: operation=CBStatusEvt_SPI_E_HARDWARE_ERROR_1.EventStatusChanged
            sscp_CBStEvtDEM_VMON_BATT_HIGH_1: operation=CBStatusEvt_DEM_VMON_BATT_HIGH_1.EventStatusChanged
            sscp_CBStEvtDEM_VMON_BATT_LOW_1: operation=CBStatusEvt_DEM_VMON_BATT_LOW_1.EventStatusChanged
            sscp_CBStEvtDEM_MCU_TEMP_EXT_HIGH_1: operation=CBStatusEvt_DEM_MCU_TEMP_EXT_HIGH_1.EventStatusChanged
            sscp_CBStEvtDEM_MCU_TEMP_EXT_LOW_1: operation=CBStatusEvt_DEM_MCU_TEMP_EXT_LOW_1.EventStatusChanged
            sscp_CBStEvtDEM_SOCJ3_TEMP_EXT_HIGH_1: operation=CBStatusEvt_DEM_SOCJ3_TEMP_EXT_HIGH_1.EventStatusChanged
            sscp_CBStEvtDEM_J3_SYS_KERNEL_SW_1: operation=CBStatusEvt_DEM_J3_SYS_KERNEL_SW_1.EventStatusChanged
            sscp_CBStEvtDEM_CAMERA_CALIBRATION_FAILURE_1: operation=CBStatusEvt_DEM_CAMERA_CALIBRATION_FAILURE_1.EventStatusChanged
            sscp_CBStEvtDEM_CAMERA_ONLINE_CALIBRATION_FAILURE_1: operation=CBStatusEvt_DEM_CAMERA_ONLINE_CALIBRATION_FAILURE_1.EventStatusChanged
            sscp_CBStEvtDEM_DTC_VCU_Accr_Pedl_Posn_Invld_1: operation=CBStatusEvt_DEM_DTC_VCU_Accr_Pedl_Posn_Invld_1.EventStatusChanged
            sscp_CBStEvtDEM_DTC_VCU_Gear_Posn_Invld_1: operation=CBStatusEvt_DEM_DTC_VCU_Gear_Posn_Invld_1.EventStatusChanged
            sscp_CBStEvtDEM_DTC_BCM_Turn_Indcr_Light_Fault_1: operation=CBStatusEvt_DEM_DTC_BCM_Turn_Indcr_Light_Fault_1.EventStatusChanged
            sscp_CBStEvtDEM_DTC_BCM_Frnt_Wiper_Sts_Fault_1: operation=CBStatusEvt_DEM_DTC_BCM_Frnt_Wiper_Sts_Fault_1.EventStatusChanged
            sscp_CBStEvtDEM_DTC_ESP_Veh_Spd_Invld_1: operation=CBStatusEvt_DEM_DTC_ESP_Veh_Spd_Invld_1.EventStatusChanged
            sscp_CBStEvtDEM_DTC_Whl_Spd_Pls_Invld_1: operation=CBStatusEvt_DEM_DTC_Whl_Spd_Pls_Invld_1.EventStatusChanged
            sscp_CBStEvtDEM_DTC_Whl_Spd_Dir_Invld_1: operation=CBStatusEvt_DEM_DTC_Whl_Spd_Dir_Invld_1.EventStatusChanged
            sscp_CBStEvtDEM_DTC_Whl_Spd_Data_Invld_1: operation=CBStatusEvt_DEM_DTC_Whl_Spd_Data_Invld_1.EventStatusChanged
            sscp_CBStEvtDEM_DTC_EPS_Sas_NOT_Cal_1: operation=CBStatusEvt_DEM_DTC_EPS_Sas_NOT_Cal_1.EventStatusChanged
            sscp_CBStEvtDEM_DTC_EPS_Actual_Motor_Torq_Invld_1: operation=CBStatusEvt_DEM_DTC_EPS_Actual_Motor_Torq_Invld_1.EventStatusChanged
            sscp_CBStEvtDEM_DTC_ESP_Lat_Accel_Invld_1: operation=CBStatusEvt_DEM_DTC_ESP_Lat_Accel_Invld_1.EventStatusChanged
            sscp_CBStEvtDEM_DTC_ESP_Long_Accel_Invld_1: operation=CBStatusEvt_DEM_DTC_ESP_Long_Accel_Invld_1.EventStatusChanged
            sscp_CBStEvtDEM_DTC_ESP_Yaw_Rate_Invld_1: operation=CBStatusEvt_DEM_DTC_ESP_Yaw_Rate_Invld_1.EventStatusChanged
            sscp_CBStEvtDEM_DTC_EPS_Fault_1: operation=CBStatusEvt_DEM_DTC_EPS_Fault_1.EventStatusChanged
            sscp_CBStEvtDEM_DTC_VCU_All_Node_Missing_1: operation=CBStatusEvt_DEM_DTC_VCU_All_Node_Missing_1.EventStatusChanged
            sscp_CBStEvtDEM_DTC_ESP_All_Node_Missing_1: operation=CBStatusEvt_DEM_DTC_ESP_All_Node_Missing_1.EventStatusChanged
            sscp_CBStEvtDEM_DTC_EPS_All_Node_Missing_1: operation=CBStatusEvt_DEM_DTC_EPS_All_Node_Missing_1.EventStatusChanged
            sscp_CBStEvtDEM_DTC_VCU_Message_Alive_Counter_Error_1: operation=CBStatusEvt_DEM_DTC_VCU_Message_Alive_Counter_Error_1.EventStatusChanged
            sscp_CBStEvtDEM_DTC_ESP_Message_Alive_Counter_Error_1: operation=CBStatusEvt_DEM_DTC_ESP_Message_Alive_Counter_Error_1.EventStatusChanged
            sscp_CBStEvtDEM_DTC_EPS_Message_Alive_Counter_Error_10ms_1: operation=CBStatusEvt_DEM_DTC_EPS_Message_Alive_Counter_Error_10ms_1.EventStatusChanged
            sscp_CBStEvtDEM_DTC_Front_Radar_Alive_Counter_Error_1: operation=CBStatusEvt_DEM_DTC_Front_Radar_Alive_Counter_Error_1.EventStatusChanged
            sscp_CBStEvtDEM_DTC_ESP_ABS_Fault_1: operation=CBStatusEvt_DEM_DTC_ESP_ABS_Fault_1.EventStatusChanged
            sscp_CBStEvtDEM_DTC_ESP_TCS_Fault_1: operation=CBStatusEvt_DEM_DTC_ESP_TCS_Fault_1.EventStatusChanged
            sscp_CBStEvtDEM_DTC_ESP_ABA_NOT_Available_1: operation=CBStatusEvt_DEM_DTC_ESP_ABA_NOT_Available_1.EventStatusChanged
            sscp_CBStEvtDEM_DTC_ESP_AEB_NOT_Available_1: operation=CBStatusEvt_DEM_DTC_ESP_AEB_NOT_Available_1.EventStatusChanged
            sscp_CBStEvtDEM_DTC_ESP_AWB_NOT_Available_1: operation=CBStatusEvt_DEM_DTC_ESP_AWB_NOT_Available_1.EventStatusChanged
            sscp_CBStEvtDEM_DTC_IB_Brk_Pedl_Invld_1: operation=CBStatusEvt_DEM_DTC_IB_Brk_Pedl_Invld_1.EventStatusChanged
            sscp_CBStEvtDEM_DTC_EPS_Actual_Torsion_Torq_Invld_1: operation=CBStatusEvt_DEM_DTC_EPS_Actual_Torsion_Torq_Invld_1.EventStatusChanged
            sscp_CBStEvtDEM_DTC_EPS_Actual_Motor_Invld_1: operation=CBStatusEvt_DEM_DTC_EPS_Actual_Motor_Invld_1.EventStatusChanged
            sscp_CBStEvtDEM_DTC_EPS_Steer_AgSens_Fault_1: operation=CBStatusEvt_DEM_DTC_EPS_Steer_AgSens_Fault_1.EventStatusChanged
            sscp_CBStEvtDEM_DTC_SRS_Drvr_BucSwt_Invld_1: operation=CBStatusEvt_DEM_DTC_SRS_Drvr_BucSwt_Invld_1.EventStatusChanged
            sscp_CBStEvtDEM_DTC_EPS_Pinionang_Invld_1: operation=CBStatusEvt_DEM_DTC_EPS_Pinionang_Invld_1.EventStatusChanged
            sscp_CBStEvtDEM_DTC_EPS_Pinionang_Fault_1: operation=CBStatusEvt_DEM_DTC_EPS_Pinionang_Fault_1.EventStatusChanged
            sscp_CBStEvtDEM_DTC_EPS_APA_Epas_Fault_1: operation=CBStatusEvt_DEM_DTC_EPS_APA_Epas_Fault_1.EventStatusChanged
            sscp_CBStEvtDEM_DTC_BCM_EmgyLi_Fault_1: operation=CBStatusEvt_DEM_DTC_BCM_EmgyLi_Fault_1.EventStatusChanged
            sscp_CBStEvtDEM_DTC_BCM_All_Node_Missing_1: operation=CBStatusEvt_DEM_DTC_BCM_All_Node_Missing_1.EventStatusChanged
            sscp_CBStEvtDEM_DTC_BCM_Message_Alive_Counter_Error_40ms_1: operation=CBStatusEvt_DEM_DTC_BCM_Message_Alive_Counter_Error_40ms_1.EventStatusChanged
            sscp_CBStEvtDEM_DTC_J3_Camera_Blockage_1: operation=CBStatusEvt_DEM_DTC_J3_Camera_Blockage_1.EventStatusChanged
            sscp_CBStEvtDEM_DTC_Private_CAN_Bus_Off_1: operation=CBStatusEvt_DEM_DTC_Private_CAN_Bus_Off_1.EventStatusChanged
            sscp_CBStEvtDEM_DTC_Public_CAN_Bus_Off_1: operation=CBStatusEvt_DEM_DTC_Public_CAN_Bus_Off_1.EventStatusChanged
            sscp_CBStEvtDEM_DTC_J3_SOC_Safetylib_Error_1: operation=CBStatusEvt_DEM_DTC_J3_SOC_Safetylib_Error_1.EventStatusChanged
            sscp_CBStEvtDEM_DTC_EPS_Steering_wheel_vibration_failure_1: operation=CBStatusEvt_DEM_DTC_EPS_Steering_wheel_vibration_failure_1.EventStatusChanged
            sscp_CBStEvtDEM_DTC_EPS_Driver_hand_torque_invalid_1: operation=CBStatusEvt_DEM_DTC_EPS_Driver_hand_torque_invalid_1.EventStatusChanged
            sscp_CBStEvtDEM_DTC_IP_warning_invalid_1: operation=CBStatusEvt_DEM_DTC_IP_warning_invalid_1.EventStatusChanged
            sscp_CBStEvtDEM_DTC_IP_node_missing_1: operation=CBStatusEvt_DEM_DTC_IP_node_missing_1.EventStatusChanged
            sscp_CBStEvtDEM_DTC_IP_message_alive_counter_error_1: operation=CBStatusEvt_DEM_DTC_IP_message_alive_counter_error_1.EventStatusChanged
            sscp_CBStEvtDEM_DTC_Fradar_not_calibration_or_blockage_1: operation=CBStatusEvt_DEM_DTC_Fradar_not_calibration_or_blockage_1.EventStatusChanged
            sscp_CBStEvtDEM_DTC_Fradar_hardware_error_1: operation=CBStatusEvt_DEM_DTC_Fradar_hardware_error_1.EventStatusChanged
            sscp_CBStEvtDEM_DTC_SRS_All_Node_Missing_1: operation=CBStatusEvt_DEM_DTC_SRS_All_Node_Missing_1.EventStatusChanged
            sscp_CBStEvtDEM_DTC_ADC_Message_Alive_Counter_Error_1: operation=CBStatusEvt_DEM_DTC_ADC_Message_Alive_Counter_Error_1.EventStatusChanged
            sscp_CBStEvtDEM_DTC_RLR_Message_Alive_Counter_Error_1: operation=CBStatusEvt_DEM_DTC_RLR_Message_Alive_Counter_Error_1.EventStatusChanged
            sscp_CBStEvtDEM_DTC_SRS_Message_Alive_Counter_Error_1: operation=CBStatusEvt_DEM_DTC_SRS_Message_Alive_Counter_Error_1.EventStatusChanged
            sscp_CBStEvtDEM_DTC_EPS_Message_Alive_Counter_Error_20ms_1: operation=CBStatusEvt_DEM_DTC_EPS_Message_Alive_Counter_Error_20ms_1.EventStatusChanged
            sscp_CBStEvtDEM_DTC_J3_SOC_System_Service_Error_1: operation=CBStatusEvt_DEM_DTC_J3_SOC_System_Service_Error_1.EventStatusChanged
            sscp_CBStEvtDEM_DTC_J3_Camera_Error_1: operation=CBStatusEvt_DEM_DTC_J3_Camera_Error_1.EventStatusChanged
            sscp_CBStEvtDEM_DTC_J3_SOC_CPU_Error_PWM_Missing_1: operation=CBStatusEvt_DEM_DTC_J3_SOC_CPU_Error_PWM_Missing_1.EventStatusChanged
            sscp_CBStEvtDEM_DTC_J3_SOC_Perception_Error_1: operation=CBStatusEvt_DEM_DTC_J3_SOC_Perception_Error_1.EventStatusChanged
            sscp_CBStEvtDEM_DTC_BCM_Brake_Lamp_Error_1: operation=CBStatusEvt_DEM_DTC_BCM_Brake_Lamp_Error_1.EventStatusChanged
            sscp_CBStEvtDEM_DTC_Esp_Ebd_Failr_1: operation=CBStatusEvt_DEM_DTC_Esp_Ebd_Failr_1.EventStatusChanged
            sscp_CBStEvtDEM_DTC_FR_All_Node_Missing_1: operation=CBStatusEvt_DEM_DTC_FR_All_Node_Missing_1.EventStatusChanged
            sscp_CBStEvtDEM_DTC_ADC_All_Node_Missing_1: operation=CBStatusEvt_DEM_DTC_ADC_All_Node_Missing_1.EventStatusChanged
            sscp_CBStEvtDEM_DTC_J3_Time_Sync_Error_1: operation=CBStatusEvt_DEM_DTC_J3_Time_Sync_Error_1.EventStatusChanged
            sscp_CBStEvtDEM_DTC_MCU_TEMP_INITIAL_HIGH_1: operation=CBStatusEvt_DEM_DTC_MCU_TEMP_INITIAL_HIGH_1.EventStatusChanged
            sscp_CBStEvtDEM_DTC_ESP_Message_Alive_Counter_Error_100ms_1: operation=CBStatusEvt_DEM_DTC_ESP_Message_Alive_Counter_Error_100ms_1.EventStatusChanged
            sscp_GeneralCBStatusEvt: operation=GeneralCBStatusEvt.EventStatusChanged
            sscp_CBReadDataDemDataElementClass_Odometer: operation=CBReadData_DemDataElementClass_Odometer.ReadData
            sscp_CBReadDataDemDataElementClass_Voltage: operation=CBReadData_DemDataElementClass_Voltage.ReadData
            sscp_CBReadDataDemDataElementClass_VehicleSpeed: operation=CBReadData_DemDataElementClass_VehicleSpeed.ReadData
            sscp_CBReadDataDemDataElementClass_LocalTime: operation=CBReadData_DemDataElementClass_LocalTime.ReadData
            sscp_CBReadDataDemDataElementClass_ECUTemperature: operation=CBReadData_DemDataElementClass_ECUTemperature.ReadData
            sscp_CBReadDataDemDataElementClass_Yawrate: operation=CBReadData_DemDataElementClass_Yawrate.ReadData
            sscp_CBReadDataDemDataElementClass_EngineSpeed: operation=CBReadData_DemDataElementClass_EngineSpeed.ReadData
            sscp_CBReadDataDemDataElementClass_GearPosition: operation=CBReadData_DemDataElementClass_GearPosition.ReadData
            sscp_CBReadDataDemDataElementClass_SteeringAngle: operation=CBReadData_DemDataElementClass_SteeringAngle.ReadData
            sscp_CBReadDataDemDataElementClass_Extended_SystemKernelErrMap: operation=CBReadData_DemDataElementClass_Extended_SystemKernelErrMap.ReadData
        RE_ResetEventStatus: runnable-entity-argument=symbol=EventId, can-be-invoked-concurrently=true, symbol=Dem_ResetEventStatus
          74 x sync call, all with timeout=0.0:
            sscp_CBStEvtSPI_E_HARDWARE_ERROR_1: operation=CBStatusEvt_SPI_E_HARDWARE_ERROR_1.EventStatusChanged
            sscp_CBStEvtDEM_VMON_BATT_HIGH_1: operation=CBStatusEvt_DEM_VMON_BATT_HIGH_1.EventStatusChanged
            sscp_CBStEvtDEM_VMON_BATT_LOW_1: operation=CBStatusEvt_DEM_VMON_BATT_LOW_1.EventStatusChanged
            sscp_CBStEvtDEM_MCU_TEMP_EXT_HIGH_1: operation=CBStatusEvt_DEM_MCU_TEMP_EXT_HIGH_1.EventStatusChanged
            sscp_CBStEvtDEM_MCU_TEMP_EXT_LOW_1: operation=CBStatusEvt_DEM_MCU_TEMP_EXT_LOW_1.EventStatusChanged
            sscp_CBStEvtDEM_SOCJ3_TEMP_EXT_HIGH_1: operation=CBStatusEvt_DEM_SOCJ3_TEMP_EXT_HIGH_1.EventStatusChanged
            sscp_CBStEvtDEM_J3_SYS_KERNEL_SW_1: operation=CBStatusEvt_DEM_J3_SYS_KERNEL_SW_1.EventStatusChanged
            sscp_CBStEvtDEM_CAMERA_CALIBRATION_FAILURE_1: operation=CBStatusEvt_DEM_CAMERA_CALIBRATION_FAILURE_1.EventStatusChanged
            sscp_CBStEvtDEM_CAMERA_ONLINE_CALIBRATION_FAILURE_1: operation=CBStatusEvt_DEM_CAMERA_ONLINE_CALIBRATION_FAILURE_1.EventStatusChanged
            sscp_CBStEvtDEM_DTC_VCU_Accr_Pedl_Posn_Invld_1: operation=CBStatusEvt_DEM_DTC_VCU_Accr_Pedl_Posn_Invld_1.EventStatusChanged
            sscp_CBStEvtDEM_DTC_VCU_Gear_Posn_Invld_1: operation=CBStatusEvt_DEM_DTC_VCU_Gear_Posn_Invld_1.EventStatusChanged
            sscp_CBStEvtDEM_DTC_BCM_Turn_Indcr_Light_Fault_1: operation=CBStatusEvt_DEM_DTC_BCM_Turn_Indcr_Light_Fault_1.EventStatusChanged
            sscp_CBStEvtDEM_DTC_BCM_Frnt_Wiper_Sts_Fault_1: operation=CBStatusEvt_DEM_DTC_BCM_Frnt_Wiper_Sts_Fault_1.EventStatusChanged
            sscp_CBStEvtDEM_DTC_ESP_Veh_Spd_Invld_1: operation=CBStatusEvt_DEM_DTC_ESP_Veh_Spd_Invld_1.EventStatusChanged
            sscp_CBStEvtDEM_DTC_Whl_Spd_Pls_Invld_1: operation=CBStatusEvt_DEM_DTC_Whl_Spd_Pls_Invld_1.EventStatusChanged
            sscp_CBStEvtDEM_DTC_Whl_Spd_Dir_Invld_1: operation=CBStatusEvt_DEM_DTC_Whl_Spd_Dir_Invld_1.EventStatusChanged
            sscp_CBStEvtDEM_DTC_Whl_Spd_Data_Invld_1: operation=CBStatusEvt_DEM_DTC_Whl_Spd_Data_Invld_1.EventStatusChanged
            sscp_CBStEvtDEM_DTC_EPS_Sas_NOT_Cal_1: operation=CBStatusEvt_DEM_DTC_EPS_Sas_NOT_Cal_1.EventStatusChanged
            sscp_CBStEvtDEM_DTC_EPS_Actual_Motor_Torq_Invld_1: operation=CBStatusEvt_DEM_DTC_EPS_Actual_Motor_Torq_Invld_1.EventStatusChanged
            sscp_CBStEvtDEM_DTC_ESP_Lat_Accel_Invld_1: operation=CBStatusEvt_DEM_DTC_ESP_Lat_Accel_Invld_1.EventStatusChanged
            sscp_CBStEvtDEM_DTC_ESP_Long_Accel_Invld_1: operation=CBStatusEvt_DEM_DTC_ESP_Long_Accel_Invld_1.EventStatusChanged
            sscp_CBStEvtDEM_DTC_ESP_Yaw_Rate_Invld_1: operation=CBStatusEvt_DEM_DTC_ESP_Yaw_Rate_Invld_1.EventStatusChanged
            sscp_CBStEvtDEM_DTC_EPS_Fault_1: operation=CBStatusEvt_DEM_DTC_EPS_Fault_1.EventStatusChanged
            sscp_CBStEvtDEM_DTC_VCU_All_Node_Missing_1: operation=CBStatusEvt_DEM_DTC_VCU_All_Node_Missing_1.EventStatusChanged
            sscp_CBStEvtDEM_DTC_ESP_All_Node_Missing_1: operation=CBStatusEvt_DEM_DTC_ESP_All_Node_Missing_1.EventStatusChanged
            sscp_CBStEvtDEM_DTC_EPS_All_Node_Missing_1: operation=CBStatusEvt_DEM_DTC_EPS_All_Node_Missing_1.EventStatusChanged
            sscp_CBStEvtDEM_DTC_VCU_Message_Alive_Counter_Error_1: operation=CBStatusEvt_DEM_DTC_VCU_Message_Alive_Counter_Error_1.EventStatusChanged
            sscp_CBStEvtDEM_DTC_ESP_Message_Alive_Counter_Error_1: operation=CBStatusEvt_DEM_DTC_ESP_Message_Alive_Counter_Error_1.EventStatusChanged
            sscp_CBStEvtDEM_DTC_EPS_Message_Alive_Counter_Error_10ms_1: operation=CBStatusEvt_DEM_DTC_EPS_Message_Alive_Counter_Error_10ms_1.EventStatusChanged
            sscp_CBStEvtDEM_DTC_Front_Radar_Alive_Counter_Error_1: operation=CBStatusEvt_DEM_DTC_Front_Radar_Alive_Counter_Error_1.EventStatusChanged
            sscp_CBStEvtDEM_DTC_ESP_ABS_Fault_1: operation=CBStatusEvt_DEM_DTC_ESP_ABS_Fault_1.EventStatusChanged
            sscp_CBStEvtDEM_DTC_ESP_TCS_Fault_1: operation=CBStatusEvt_DEM_DTC_ESP_TCS_Fault_1.EventStatusChanged
            sscp_CBStEvtDEM_DTC_ESP_ABA_NOT_Available_1: operation=CBStatusEvt_DEM_DTC_ESP_ABA_NOT_Available_1.EventStatusChanged
            sscp_CBStEvtDEM_DTC_ESP_AEB_NOT_Available_1: operation=CBStatusEvt_DEM_DTC_ESP_AEB_NOT_Available_1.EventStatusChanged
            sscp_CBStEvtDEM_DTC_ESP_AWB_NOT_Available_1: operation=CBStatusEvt_DEM_DTC_ESP_AWB_NOT_Available_1.EventStatusChanged
            sscp_CBStEvtDEM_DTC_IB_Brk_Pedl_Invld_1: operation=CBStatusEvt_DEM_DTC_IB_Brk_Pedl_Invld_1.EventStatusChanged
            sscp_CBStEvtDEM_DTC_EPS_Actual_Torsion_Torq_Invld_1: operation=CBStatusEvt_DEM_DTC_EPS_Actual_Torsion_Torq_Invld_1.EventStatusChanged
            sscp_CBStEvtDEM_DTC_EPS_Actual_Motor_Invld_1: operation=CBStatusEvt_DEM_DTC_EPS_Actual_Motor_Invld_1.EventStatusChanged
            sscp_CBStEvtDEM_DTC_EPS_Steer_AgSens_Fault_1: operation=CBStatusEvt_DEM_DTC_EPS_Steer_AgSens_Fault_1.EventStatusChanged
            sscp_CBStEvtDEM_DTC_SRS_Drvr_BucSwt_Invld_1: operation=CBStatusEvt_DEM_DTC_SRS_Drvr_BucSwt_Invld_1.EventStatusChanged
            sscp_CBStEvtDEM_DTC_EPS_Pinionang_Invld_1: operation=CBStatusEvt_DEM_DTC_EPS_Pinionang_Invld_1.EventStatusChanged
            sscp_CBStEvtDEM_DTC_EPS_Pinionang_Fault_1: operation=CBStatusEvt_DEM_DTC_EPS_Pinionang_Fault_1.EventStatusChanged
            sscp_CBStEvtDEM_DTC_EPS_APA_Epas_Fault_1: operation=CBStatusEvt_DEM_DTC_EPS_APA_Epas_Fault_1.EventStatusChanged
            sscp_CBStEvtDEM_DTC_BCM_EmgyLi_Fault_1: operation=CBStatusEvt_DEM_DTC_BCM_EmgyLi_Fault_1.EventStatusChanged
            sscp_CBStEvtDEM_DTC_BCM_All_Node_Missing_1: operation=CBStatusEvt_DEM_DTC_BCM_All_Node_Missing_1.EventStatusChanged
            sscp_CBStEvtDEM_DTC_BCM_Message_Alive_Counter_Error_40ms_1: operation=CBStatusEvt_DEM_DTC_BCM_Message_Alive_Counter_Error_40ms_1.EventStatusChanged
            sscp_CBStEvtDEM_DTC_J3_Camera_Blockage_1: operation=CBStatusEvt_DEM_DTC_J3_Camera_Blockage_1.EventStatusChanged
            sscp_CBStEvtDEM_DTC_Private_CAN_Bus_Off_1: operation=CBStatusEvt_DEM_DTC_Private_CAN_Bus_Off_1.EventStatusChanged
            sscp_CBStEvtDEM_DTC_Public_CAN_Bus_Off_1: operation=CBStatusEvt_DEM_DTC_Public_CAN_Bus_Off_1.EventStatusChanged
            sscp_CBStEvtDEM_DTC_J3_SOC_Safetylib_Error_1: operation=CBStatusEvt_DEM_DTC_J3_SOC_Safetylib_Error_1.EventStatusChanged
            sscp_CBStEvtDEM_DTC_EPS_Steering_wheel_vibration_failure_1: operation=CBStatusEvt_DEM_DTC_EPS_Steering_wheel_vibration_failure_1.EventStatusChanged
            sscp_CBStEvtDEM_DTC_EPS_Driver_hand_torque_invalid_1: operation=CBStatusEvt_DEM_DTC_EPS_Driver_hand_torque_invalid_1.EventStatusChanged
            sscp_CBStEvtDEM_DTC_IP_warning_invalid_1: operation=CBStatusEvt_DEM_DTC_IP_warning_invalid_1.EventStatusChanged
            sscp_CBStEvtDEM_DTC_IP_node_missing_1: operation=CBStatusEvt_DEM_DTC_IP_node_missing_1.EventStatusChanged
            sscp_CBStEvtDEM_DTC_IP_message_alive_counter_error_1: operation=CBStatusEvt_DEM_DTC_IP_message_alive_counter_error_1.EventStatusChanged
            sscp_CBStEvtDEM_DTC_Fradar_not_calibration_or_blockage_1: operation=CBStatusEvt_DEM_DTC_Fradar_not_calibration_or_blockage_1.EventStatusChanged
            sscp_CBStEvtDEM_DTC_Fradar_hardware_error_1: operation=CBStatusEvt_DEM_DTC_Fradar_hardware_error_1.EventStatusChanged
            sscp_CBStEvtDEM_DTC_SRS_All_Node_Missing_1: operation=CBStatusEvt_DEM_DTC_SRS_All_Node_Missing_1.EventStatusChanged
            sscp_CBStEvtDEM_DTC_ADC_Message_Alive_Counter_Error_1: operation=CBStatusEvt_DEM_DTC_ADC_Message_Alive_Counter_Error_1.EventStatusChanged
            sscp_CBStEvtDEM_DTC_RLR_Message_Alive_Counter_Error_1: operation=CBStatusEvt_DEM_DTC_RLR_Message_Alive_Counter_Error_1.EventStatusChanged
            sscp_CBStEvtDEM_DTC_SRS_Message_Alive_Counter_Error_1: operation=CBStatusEvt_DEM_DTC_SRS_Message_Alive_Counter_Error_1.EventStatusChanged
            sscp_CBStEvtDEM_DTC_EPS_Message_Alive_Counter_Error_20ms_1: operation=CBStatusEvt_DEM_DTC_EPS_Message_Alive_Counter_Error_20ms_1.EventStatusChanged
            sscp_CBStEvtDEM_DTC_J3_SOC_System_Service_Error_1: operation=CBStatusEvt_DEM_DTC_J3_SOC_System_Service_Error_1.EventStatusChanged
            sscp_CBStEvtDEM_DTC_J3_Camera_Error_1: operation=CBStatusEvt_DEM_DTC_J3_Camera_Error_1.EventStatusChanged
            sscp_CBStEvtDEM_DTC_J3_SOC_CPU_Error_PWM_Missing_1: operation=CBStatusEvt_DEM_DTC_J3_SOC_CPU_Error_PWM_Missing_1.EventStatusChanged
            sscp_CBStEvtDEM_DTC_J3_SOC_Perception_Error_1: operation=CBStatusEvt_DEM_DTC_J3_SOC_Perception_Error_1.EventStatusChanged
            sscp_CBStEvtDEM_DTC_BCM_Brake_Lamp_Error_1: operation=CBStatusEvt_DEM_DTC_BCM_Brake_Lamp_Error_1.EventStatusChanged
            sscp_CBStEvtDEM_DTC_Esp_Ebd_Failr_1: operation=CBStatusEvt_DEM_DTC_Esp_Ebd_Failr_1.EventStatusChanged
            sscp_CBStEvtDEM_DTC_FR_All_Node_Missing_1: operation=CBStatusEvt_DEM_DTC_FR_All_Node_Missing_1.EventStatusChanged
            sscp_CBStEvtDEM_DTC_ADC_All_Node_Missing_1: operation=CBStatusEvt_DEM_DTC_ADC_All_Node_Missing_1.EventStatusChanged
            sscp_CBStEvtDEM_DTC_J3_Time_Sync_Error_1: operation=CBStatusEvt_DEM_DTC_J3_Time_Sync_Error_1.EventStatusChanged
            sscp_CBStEvtDEM_DTC_MCU_TEMP_INITIAL_HIGH_1: operation=CBStatusEvt_DEM_DTC_MCU_TEMP_INITIAL_HIGH_1.EventStatusChanged
            sscp_CBStEvtDEM_DTC_ESP_Message_Alive_Counter_Error_100ms_1: operation=CBStatusEvt_DEM_DTC_ESP_Message_Alive_Counter_Error_100ms_1.EventStatusChanged
            sscp_GeneralCBStatusEvt: operation=GeneralCBStatusEvt.EventStatusChanged
        RE_PrestoreFreezeFrame: runnable-entity-argument=symbol=EventId, can-be-invoked-concurrently=true, symbol=Dem_PrestoreFreezeFrame
          10 x sync call, all with timeout=0.0:
            sscp_CBReadDataDemDataElementClass_Odometer: operation=CBReadData_DemDataElementClass_Odometer.ReadData
            sscp_CBReadDataDemDataElementClass_Voltage: operation=CBReadData_DemDataElementClass_Voltage.ReadData
            sscp_CBReadDataDemDataElementClass_VehicleSpeed: operation=CBReadData_DemDataElementClass_VehicleSpeed.ReadData
            sscp_CBReadDataDemDataElementClass_LocalTime: operation=CBReadData_DemDataElementClass_LocalTime.ReadData
            sscp_CBReadDataDemDataElementClass_ECUTemperature: operation=CBReadData_DemDataElementClass_ECUTemperature.ReadData
            sscp_CBReadDataDemDataElementClass_Yawrate: operation=CBReadData_DemDataElementClass_Yawrate.ReadData
            sscp_CBReadDataDemDataElementClass_EngineSpeed: operation=CBReadData_DemDataElementClass_EngineSpeed.ReadData
            sscp_CBReadDataDemDataElementClass_GearPosition: operation=CBReadData_DemDataElementClass_GearPosition.ReadData
            sscp_CBReadDataDemDataElementClass_SteeringAngle: operation=CBReadData_DemDataElementClass_SteeringAngle.ReadData
            sscp_CBReadDataDemDataElementClass_Extended_SystemKernelErrMap: operation=CBReadData_DemDataElementClass_Extended_SystemKernelErrMap.ReadData
        RE_ClearPrestoredFreezeFrame: runnable-entity-argument=symbol=EventId, can-be-invoked-concurrently=true, symbol=Dem_ClearPrestoredFreezeFrame
        RE_ResetEventDebounceStatus: arguments=[symbol=EventId, symbol=DebounceResetStatus], can-be-invoked-concurrently=true, symbol=Dem_ResetEventDebounceStatus
          74 x sync call, all with timeout=0.0:
            sscp_CBStEvtSPI_E_HARDWARE_ERROR_1: operation=CBStatusEvt_SPI_E_HARDWARE_ERROR_1.EventStatusChanged
            sscp_CBStEvtDEM_VMON_BATT_HIGH_1: operation=CBStatusEvt_DEM_VMON_BATT_HIGH_1.EventStatusChanged
            sscp_CBStEvtDEM_VMON_BATT_LOW_1: operation=CBStatusEvt_DEM_VMON_BATT_LOW_1.EventStatusChanged
            sscp_CBStEvtDEM_MCU_TEMP_EXT_HIGH_1: operation=CBStatusEvt_DEM_MCU_TEMP_EXT_HIGH_1.EventStatusChanged
            sscp_CBStEvtDEM_MCU_TEMP_EXT_LOW_1: operation=CBStatusEvt_DEM_MCU_TEMP_EXT_LOW_1.EventStatusChanged
            sscp_CBStEvtDEM_SOCJ3_TEMP_EXT_HIGH_1: operation=CBStatusEvt_DEM_SOCJ3_TEMP_EXT_HIGH_1.EventStatusChanged
            sscp_CBStEvtDEM_J3_SYS_KERNEL_SW_1: operation=CBStatusEvt_DEM_J3_SYS_KERNEL_SW_1.EventStatusChanged
            sscp_CBStEvtDEM_CAMERA_CALIBRATION_FAILURE_1: operation=CBStatusEvt_DEM_CAMERA_CALIBRATION_FAILURE_1.EventStatusChanged
            sscp_CBStEvtDEM_CAMERA_ONLINE_CALIBRATION_FAILURE_1: operation=CBStatusEvt_DEM_CAMERA_ONLINE_CALIBRATION_FAILURE_1.EventStatusChanged
            sscp_CBStEvtDEM_DTC_VCU_Accr_Pedl_Posn_Invld_1: operation=CBStatusEvt_DEM_DTC_VCU_Accr_Pedl_Posn_Invld_1.EventStatusChanged
            sscp_CBStEvtDEM_DTC_VCU_Gear_Posn_Invld_1: operation=CBStatusEvt_DEM_DTC_VCU_Gear_Posn_Invld_1.EventStatusChanged
            sscp_CBStEvtDEM_DTC_BCM_Turn_Indcr_Light_Fault_1: operation=CBStatusEvt_DEM_DTC_BCM_Turn_Indcr_Light_Fault_1.EventStatusChanged
            sscp_CBStEvtDEM_DTC_BCM_Frnt_Wiper_Sts_Fault_1: operation=CBStatusEvt_DEM_DTC_BCM_Frnt_Wiper_Sts_Fault_1.EventStatusChanged
            sscp_CBStEvtDEM_DTC_ESP_Veh_Spd_Invld_1: operation=CBStatusEvt_DEM_DTC_ESP_Veh_Spd_Invld_1.EventStatusChanged
            sscp_CBStEvtDEM_DTC_Whl_Spd_Pls_Invld_1: operation=CBStatusEvt_DEM_DTC_Whl_Spd_Pls_Invld_1.EventStatusChanged
            sscp_CBStEvtDEM_DTC_Whl_Spd_Dir_Invld_1: operation=CBStatusEvt_DEM_DTC_Whl_Spd_Dir_Invld_1.EventStatusChanged
            sscp_CBStEvtDEM_DTC_Whl_Spd_Data_Invld_1: operation=CBStatusEvt_DEM_DTC_Whl_Spd_Data_Invld_1.EventStatusChanged
            sscp_CBStEvtDEM_DTC_EPS_Sas_NOT_Cal_1: operation=CBStatusEvt_DEM_DTC_EPS_Sas_NOT_Cal_1.EventStatusChanged
            sscp_CBStEvtDEM_DTC_EPS_Actual_Motor_Torq_Invld_1: operation=CBStatusEvt_DEM_DTC_EPS_Actual_Motor_Torq_Invld_1.EventStatusChanged
            sscp_CBStEvtDEM_DTC_ESP_Lat_Accel_Invld_1: operation=CBStatusEvt_DEM_DTC_ESP_Lat_Accel_Invld_1.EventStatusChanged
            sscp_CBStEvtDEM_DTC_ESP_Long_Accel_Invld_1: operation=CBStatusEvt_DEM_DTC_ESP_Long_Accel_Invld_1.EventStatusChanged
            sscp_CBStEvtDEM_DTC_ESP_Yaw_Rate_Invld_1: operation=CBStatusEvt_DEM_DTC_ESP_Yaw_Rate_Invld_1.EventStatusChanged
            sscp_CBStEvtDEM_DTC_EPS_Fault_1: operation=CBStatusEvt_DEM_DTC_EPS_Fault_1.EventStatusChanged
            sscp_CBStEvtDEM_DTC_VCU_All_Node_Missing_1: operation=CBStatusEvt_DEM_DTC_VCU_All_Node_Missing_1.EventStatusChanged
            sscp_CBStEvtDEM_DTC_ESP_All_Node_Missing_1: operation=CBStatusEvt_DEM_DTC_ESP_All_Node_Missing_1.EventStatusChanged
            sscp_CBStEvtDEM_DTC_EPS_All_Node_Missing_1: operation=CBStatusEvt_DEM_DTC_EPS_All_Node_Missing_1.EventStatusChanged
            sscp_CBStEvtDEM_DTC_VCU_Message_Alive_Counter_Error_1: operation=CBStatusEvt_DEM_DTC_VCU_Message_Alive_Counter_Error_1.EventStatusChanged
            sscp_CBStEvtDEM_DTC_ESP_Message_Alive_Counter_Error_1: operation=CBStatusEvt_DEM_DTC_ESP_Message_Alive_Counter_Error_1.EventStatusChanged
            sscp_CBStEvtDEM_DTC_EPS_Message_Alive_Counter_Error_10ms_1: operation=CBStatusEvt_DEM_DTC_EPS_Message_Alive_Counter_Error_10ms_1.EventStatusChanged
            sscp_CBStEvtDEM_DTC_Front_Radar_Alive_Counter_Error_1: operation=CBStatusEvt_DEM_DTC_Front_Radar_Alive_Counter_Error_1.EventStatusChanged
            sscp_CBStEvtDEM_DTC_ESP_ABS_Fault_1: operation=CBStatusEvt_DEM_DTC_ESP_ABS_Fault_1.EventStatusChanged
            sscp_CBStEvtDEM_DTC_ESP_TCS_Fault_1: operation=CBStatusEvt_DEM_DTC_ESP_TCS_Fault_1.EventStatusChanged
            sscp_CBStEvtDEM_DTC_ESP_ABA_NOT_Available_1: operation=CBStatusEvt_DEM_DTC_ESP_ABA_NOT_Available_1.EventStatusChanged
            sscp_CBStEvtDEM_DTC_ESP_AEB_NOT_Available_1: operation=CBStatusEvt_DEM_DTC_ESP_AEB_NOT_Available_1.EventStatusChanged
            sscp_CBStEvtDEM_DTC_ESP_AWB_NOT_Available_1: operation=CBStatusEvt_DEM_DTC_ESP_AWB_NOT_Available_1.EventStatusChanged
            sscp_CBStEvtDEM_DTC_IB_Brk_Pedl_Invld_1: operation=CBStatusEvt_DEM_DTC_IB_Brk_Pedl_Invld_1.EventStatusChanged
            sscp_CBStEvtDEM_DTC_EPS_Actual_Torsion_Torq_Invld_1: operation=CBStatusEvt_DEM_DTC_EPS_Actual_Torsion_Torq_Invld_1.EventStatusChanged
            sscp_CBStEvtDEM_DTC_EPS_Actual_Motor_Invld_1: operation=CBStatusEvt_DEM_DTC_EPS_Actual_Motor_Invld_1.EventStatusChanged
            sscp_CBStEvtDEM_DTC_EPS_Steer_AgSens_Fault_1: operation=CBStatusEvt_DEM_DTC_EPS_Steer_AgSens_Fault_1.EventStatusChanged
            sscp_CBStEvtDEM_DTC_SRS_Drvr_BucSwt_Invld_1: operation=CBStatusEvt_DEM_DTC_SRS_Drvr_BucSwt_Invld_1.EventStatusChanged
            sscp_CBStEvtDEM_DTC_EPS_Pinionang_Invld_1: operation=CBStatusEvt_DEM_DTC_EPS_Pinionang_Invld_1.EventStatusChanged
            sscp_CBStEvtDEM_DTC_EPS_Pinionang_Fault_1: operation=CBStatusEvt_DEM_DTC_EPS_Pinionang_Fault_1.EventStatusChanged
            sscp_CBStEvtDEM_DTC_EPS_APA_Epas_Fault_1: operation=CBStatusEvt_DEM_DTC_EPS_APA_Epas_Fault_1.EventStatusChanged
            sscp_CBStEvtDEM_DTC_BCM_EmgyLi_Fault_1: operation=CBStatusEvt_DEM_DTC_BCM_EmgyLi_Fault_1.EventStatusChanged
            sscp_CBStEvtDEM_DTC_BCM_All_Node_Missing_1: operation=CBStatusEvt_DEM_DTC_BCM_All_Node_Missing_1.EventStatusChanged
            sscp_CBStEvtDEM_DTC_BCM_Message_Alive_Counter_Error_40ms_1: operation=CBStatusEvt_DEM_DTC_BCM_Message_Alive_Counter_Error_40ms_1.EventStatusChanged
            sscp_CBStEvtDEM_DTC_J3_Camera_Blockage_1: operation=CBStatusEvt_DEM_DTC_J3_Camera_Blockage_1.EventStatusChanged
            sscp_CBStEvtDEM_DTC_Private_CAN_Bus_Off_1: operation=CBStatusEvt_DEM_DTC_Private_CAN_Bus_Off_1.EventStatusChanged
            sscp_CBStEvtDEM_DTC_Public_CAN_Bus_Off_1: operation=CBStatusEvt_DEM_DTC_Public_CAN_Bus_Off_1.EventStatusChanged
            sscp_CBStEvtDEM_DTC_J3_SOC_Safetylib_Error_1: operation=CBStatusEvt_DEM_DTC_J3_SOC_Safetylib_Error_1.EventStatusChanged
            sscp_CBStEvtDEM_DTC_EPS_Steering_wheel_vibration_failure_1: operation=CBStatusEvt_DEM_DTC_EPS_Steering_wheel_vibration_failure_1.EventStatusChanged
            sscp_CBStEvtDEM_DTC_EPS_Driver_hand_torque_invalid_1: operation=CBStatusEvt_DEM_DTC_EPS_Driver_hand_torque_invalid_1.EventStatusChanged
            sscp_CBStEvtDEM_DTC_IP_warning_invalid_1: operation=CBStatusEvt_DEM_DTC_IP_warning_invalid_1.EventStatusChanged
            sscp_CBStEvtDEM_DTC_IP_node_missing_1: operation=CBStatusEvt_DEM_DTC_IP_node_missing_1.EventStatusChanged
            sscp_CBStEvtDEM_DTC_IP_message_alive_counter_error_1: operation=CBStatusEvt_DEM_DTC_IP_message_alive_counter_error_1.EventStatusChanged
            sscp_CBStEvtDEM_DTC_Fradar_not_calibration_or_blockage_1: operation=CBStatusEvt_DEM_DTC_Fradar_not_calibration_or_blockage_1.EventStatusChanged
            sscp_CBStEvtDEM_DTC_Fradar_hardware_error_1: operation=CBStatusEvt_DEM_DTC_Fradar_hardware_error_1.EventStatusChanged
            sscp_CBStEvtDEM_DTC_SRS_All_Node_Missing_1: operation=CBStatusEvt_DEM_DTC_SRS_All_Node_Missing_1.EventStatusChanged
            sscp_CBStEvtDEM_DTC_ADC_Message_Alive_Counter_Error_1: operation=CBStatusEvt_DEM_DTC_ADC_Message_Alive_Counter_Error_1.EventStatusChanged
            sscp_CBStEvtDEM_DTC_RLR_Message_Alive_Counter_Error_1: operation=CBStatusEvt_DEM_DTC_RLR_Message_Alive_Counter_Error_1.EventStatusChanged
            sscp_CBStEvtDEM_DTC_SRS_Message_Alive_Counter_Error_1: operation=CBStatusEvt_DEM_DTC_SRS_Message_Alive_Counter_Error_1.EventStatusChanged
            sscp_CBStEvtDEM_DTC_EPS_Message_Alive_Counter_Error_20ms_1: operation=CBStatusEvt_DEM_DTC_EPS_Message_Alive_Counter_Error_20ms_1.EventStatusChanged
            sscp_CBStEvtDEM_DTC_J3_SOC_System_Service_Error_1: operation=CBStatusEvt_DEM_DTC_J3_SOC_System_Service_Error_1.EventStatusChanged
            sscp_CBStEvtDEM_DTC_J3_Camera_Error_1: operation=CBStatusEvt_DEM_DTC_J3_Camera_Error_1.EventStatusChanged
            sscp_CBStEvtDEM_DTC_J3_SOC_CPU_Error_PWM_Missing_1: operation=CBStatusEvt_DEM_DTC_J3_SOC_CPU_Error_PWM_Missing_1.EventStatusChanged
            sscp_CBStEvtDEM_DTC_J3_SOC_Perception_Error_1: operation=CBStatusEvt_DEM_DTC_J3_SOC_Perception_Error_1.EventStatusChanged
            sscp_CBStEvtDEM_DTC_BCM_Brake_Lamp_Error_1: operation=CBStatusEvt_DEM_DTC_BCM_Brake_Lamp_Error_1.EventStatusChanged
            sscp_CBStEvtDEM_DTC_Esp_Ebd_Failr_1: operation=CBStatusEvt_DEM_DTC_Esp_Ebd_Failr_1.EventStatusChanged
            sscp_CBStEvtDEM_DTC_FR_All_Node_Missing_1: operation=CBStatusEvt_DEM_DTC_FR_All_Node_Missing_1.EventStatusChanged
            sscp_CBStEvtDEM_DTC_ADC_All_Node_Missing_1: operation=CBStatusEvt_DEM_DTC_ADC_All_Node_Missing_1.EventStatusChanged
            sscp_CBStEvtDEM_DTC_J3_Time_Sync_Error_1: operation=CBStatusEvt_DEM_DTC_J3_Time_Sync_Error_1.EventStatusChanged
            sscp_CBStEvtDEM_DTC_MCU_TEMP_INITIAL_HIGH_1: operation=CBStatusEvt_DEM_DTC_MCU_TEMP_INITIAL_HIGH_1.EventStatusChanged
            sscp_CBStEvtDEM_DTC_ESP_Message_Alive_Counter_Error_100ms_1: operation=CBStatusEvt_DEM_DTC_ESP_Message_Alive_Counter_Error_100ms_1.EventStatusChanged
            sscp_GeneralCBStatusEvt: operation=GeneralCBStatusEvt.EventStatusChanged
        RE_GetEventStatus: arguments=[symbol=EventId, symbol=EventStatusExtended], can-be-invoked-concurrently=true, symbol=Dem_GetEventStatus
        RE_GetEventFailed: arguments=[symbol=EventId, symbol=EventFailed], can-be-invoked-concurrently=true, symbol=Dem_GetEventFailed
        RE_GetEventTested: arguments=[symbol=EventId, symbol=EventTested], can-be-invoked-concurrently=true, symbol=Dem_GetEventTested
        RE_GetFaultDetectionCounter: arguments=[symbol=EventId, symbol=FaultDetectionCounter], can-be-invoked-concurrently=true, symbol=Dem_GetFaultDetectionCounter
        RE_GetEventExtendedDataRecord: arguments=[symbol=EventId, symbol=RecordNumber, symbol=DestBuffer], can-be-invoked-concurrently=true, symbol=Dem_GetEventExtendedDataRecord
        RE_SetOperationCycleState: arguments=[symbol=OperationCycleId, symbol=CycleState], can-be-invoked-concurrently=true, symbol=Dem_SetOperationCycleState
          74 x sync call, all with timeout=0.0:
            sscp_CBStEvtSPI_E_HARDWARE_ERROR_1: operation=CBStatusEvt_SPI_E_HARDWARE_ERROR_1.EventStatusChanged
            sscp_CBStEvtDEM_VMON_BATT_HIGH_1: operation=CBStatusEvt_DEM_VMON_BATT_HIGH_1.EventStatusChanged
            sscp_CBStEvtDEM_VMON_BATT_LOW_1: operation=CBStatusEvt_DEM_VMON_BATT_LOW_1.EventStatusChanged
            sscp_CBStEvtDEM_MCU_TEMP_EXT_HIGH_1: operation=CBStatusEvt_DEM_MCU_TEMP_EXT_HIGH_1.EventStatusChanged
            sscp_CBStEvtDEM_MCU_TEMP_EXT_LOW_1: operation=CBStatusEvt_DEM_MCU_TEMP_EXT_LOW_1.EventStatusChanged
            sscp_CBStEvtDEM_SOCJ3_TEMP_EXT_HIGH_1: operation=CBStatusEvt_DEM_SOCJ3_TEMP_EXT_HIGH_1.EventStatusChanged
            sscp_CBStEvtDEM_J3_SYS_KERNEL_SW_1: operation=CBStatusEvt_DEM_J3_SYS_KERNEL_SW_1.EventStatusChanged
            sscp_CBStEvtDEM_CAMERA_CALIBRATION_FAILURE_1: operation=CBStatusEvt_DEM_CAMERA_CALIBRATION_FAILURE_1.EventStatusChanged
            sscp_CBStEvtDEM_CAMERA_ONLINE_CALIBRATION_FAILURE_1: operation=CBStatusEvt_DEM_CAMERA_ONLINE_CALIBRATION_FAILURE_1.EventStatusChanged
            sscp_CBStEvtDEM_DTC_VCU_Accr_Pedl_Posn_Invld_1: operation=CBStatusEvt_DEM_DTC_VCU_Accr_Pedl_Posn_Invld_1.EventStatusChanged
            sscp_CBStEvtDEM_DTC_VCU_Gear_Posn_Invld_1: operation=CBStatusEvt_DEM_DTC_VCU_Gear_Posn_Invld_1.EventStatusChanged
            sscp_CBStEvtDEM_DTC_BCM_Turn_Indcr_Light_Fault_1: operation=CBStatusEvt_DEM_DTC_BCM_Turn_Indcr_Light_Fault_1.EventStatusChanged
            sscp_CBStEvtDEM_DTC_BCM_Frnt_Wiper_Sts_Fault_1: operation=CBStatusEvt_DEM_DTC_BCM_Frnt_Wiper_Sts_Fault_1.EventStatusChanged
            sscp_CBStEvtDEM_DTC_ESP_Veh_Spd_Invld_1: operation=CBStatusEvt_DEM_DTC_ESP_Veh_Spd_Invld_1.EventStatusChanged
            sscp_CBStEvtDEM_DTC_Whl_Spd_Pls_Invld_1: operation=CBStatusEvt_DEM_DTC_Whl_Spd_Pls_Invld_1.EventStatusChanged
            sscp_CBStEvtDEM_DTC_Whl_Spd_Dir_Invld_1: operation=CBStatusEvt_DEM_DTC_Whl_Spd_Dir_Invld_1.EventStatusChanged
            sscp_CBStEvtDEM_DTC_Whl_Spd_Data_Invld_1: operation=CBStatusEvt_DEM_DTC_Whl_Spd_Data_Invld_1.EventStatusChanged
            sscp_CBStEvtDEM_DTC_EPS_Sas_NOT_Cal_1: operation=CBStatusEvt_DEM_DTC_EPS_Sas_NOT_Cal_1.EventStatusChanged
            sscp_CBStEvtDEM_DTC_EPS_Actual_Motor_Torq_Invld_1: operation=CBStatusEvt_DEM_DTC_EPS_Actual_Motor_Torq_Invld_1.EventStatusChanged
            sscp_CBStEvtDEM_DTC_ESP_Lat_Accel_Invld_1: operation=CBStatusEvt_DEM_DTC_ESP_Lat_Accel_Invld_1.EventStatusChanged
            sscp_CBStEvtDEM_DTC_ESP_Long_Accel_Invld_1: operation=CBStatusEvt_DEM_DTC_ESP_Long_Accel_Invld_1.EventStatusChanged
            sscp_CBStEvtDEM_DTC_ESP_Yaw_Rate_Invld_1: operation=CBStatusEvt_DEM_DTC_ESP_Yaw_Rate_Invld_1.EventStatusChanged
            sscp_CBStEvtDEM_DTC_EPS_Fault_1: operation=CBStatusEvt_DEM_DTC_EPS_Fault_1.EventStatusChanged
            sscp_CBStEvtDEM_DTC_VCU_All_Node_Missing_1: operation=CBStatusEvt_DEM_DTC_VCU_All_Node_Missing_1.EventStatusChanged
            sscp_CBStEvtDEM_DTC_ESP_All_Node_Missing_1: operation=CBStatusEvt_DEM_DTC_ESP_All_Node_Missing_1.EventStatusChanged
            sscp_CBStEvtDEM_DTC_EPS_All_Node_Missing_1: operation=CBStatusEvt_DEM_DTC_EPS_All_Node_Missing_1.EventStatusChanged
            sscp_CBStEvtDEM_DTC_VCU_Message_Alive_Counter_Error_1: operation=CBStatusEvt_DEM_DTC_VCU_Message_Alive_Counter_Error_1.EventStatusChanged
            sscp_CBStEvtDEM_DTC_ESP_Message_Alive_Counter_Error_1: operation=CBStatusEvt_DEM_DTC_ESP_Message_Alive_Counter_Error_1.EventStatusChanged
            sscp_CBStEvtDEM_DTC_EPS_Message_Alive_Counter_Error_10ms_1: operation=CBStatusEvt_DEM_DTC_EPS_Message_Alive_Counter_Error_10ms_1.EventStatusChanged
            sscp_CBStEvtDEM_DTC_Front_Radar_Alive_Counter_Error_1: operation=CBStatusEvt_DEM_DTC_Front_Radar_Alive_Counter_Error_1.EventStatusChanged
            sscp_CBStEvtDEM_DTC_ESP_ABS_Fault_1: operation=CBStatusEvt_DEM_DTC_ESP_ABS_Fault_1.EventStatusChanged
            sscp_CBStEvtDEM_DTC_ESP_TCS_Fault_1: operation=CBStatusEvt_DEM_DTC_ESP_TCS_Fault_1.EventStatusChanged
            sscp_CBStEvtDEM_DTC_ESP_ABA_NOT_Available_1: operation=CBStatusEvt_DEM_DTC_ESP_ABA_NOT_Available_1.EventStatusChanged
            sscp_CBStEvtDEM_DTC_ESP_AEB_NOT_Available_1: operation=CBStatusEvt_DEM_DTC_ESP_AEB_NOT_Available_1.EventStatusChanged
            sscp_CBStEvtDEM_DTC_ESP_AWB_NOT_Available_1: operation=CBStatusEvt_DEM_DTC_ESP_AWB_NOT_Available_1.EventStatusChanged
            sscp_CBStEvtDEM_DTC_IB_Brk_Pedl_Invld_1: operation=CBStatusEvt_DEM_DTC_IB_Brk_Pedl_Invld_1.EventStatusChanged
            sscp_CBStEvtDEM_DTC_EPS_Actual_Torsion_Torq_Invld_1: operation=CBStatusEvt_DEM_DTC_EPS_Actual_Torsion_Torq_Invld_1.EventStatusChanged
            sscp_CBStEvtDEM_DTC_EPS_Actual_Motor_Invld_1: operation=CBStatusEvt_DEM_DTC_EPS_Actual_Motor_Invld_1.EventStatusChanged
            sscp_CBStEvtDEM_DTC_EPS_Steer_AgSens_Fault_1: operation=CBStatusEvt_DEM_DTC_EPS_Steer_AgSens_Fault_1.EventStatusChanged
            sscp_CBStEvtDEM_DTC_SRS_Drvr_BucSwt_Invld_1: operation=CBStatusEvt_DEM_DTC_SRS_Drvr_BucSwt_Invld_1.EventStatusChanged
            sscp_CBStEvtDEM_DTC_EPS_Pinionang_Invld_1: operation=CBStatusEvt_DEM_DTC_EPS_Pinionang_Invld_1.EventStatusChanged
            sscp_CBStEvtDEM_DTC_EPS_Pinionang_Fault_1: operation=CBStatusEvt_DEM_DTC_EPS_Pinionang_Fault_1.EventStatusChanged
            sscp_CBStEvtDEM_DTC_EPS_APA_Epas_Fault_1: operation=CBStatusEvt_DEM_DTC_EPS_APA_Epas_Fault_1.EventStatusChanged
            sscp_CBStEvtDEM_DTC_BCM_EmgyLi_Fault_1: operation=CBStatusEvt_DEM_DTC_BCM_EmgyLi_Fault_1.EventStatusChanged
            sscp_CBStEvtDEM_DTC_BCM_All_Node_Missing_1: operation=CBStatusEvt_DEM_DTC_BCM_All_Node_Missing_1.EventStatusChanged
            sscp_CBStEvtDEM_DTC_BCM_Message_Alive_Counter_Error_40ms_1: operation=CBStatusEvt_DEM_DTC_BCM_Message_Alive_Counter_Error_40ms_1.EventStatusChanged
            sscp_CBStEvtDEM_DTC_J3_Camera_Blockage_1: operation=CBStatusEvt_DEM_DTC_J3_Camera_Blockage_1.EventStatusChanged
            sscp_CBStEvtDEM_DTC_Private_CAN_Bus_Off_1: operation=CBStatusEvt_DEM_DTC_Private_CAN_Bus_Off_1.EventStatusChanged
            sscp_CBStEvtDEM_DTC_Public_CAN_Bus_Off_1: operation=CBStatusEvt_DEM_DTC_Public_CAN_Bus_Off_1.EventStatusChanged
            sscp_CBStEvtDEM_DTC_J3_SOC_Safetylib_Error_1: operation=CBStatusEvt_DEM_DTC_J3_SOC_Safetylib_Error_1.EventStatusChanged
            sscp_CBStEvtDEM_DTC_EPS_Steering_wheel_vibration_failure_1: operation=CBStatusEvt_DEM_DTC_EPS_Steering_wheel_vibration_failure_1.EventStatusChanged
            sscp_CBStEvtDEM_DTC_EPS_Driver_hand_torque_invalid_1: operation=CBStatusEvt_DEM_DTC_EPS_Driver_hand_torque_invalid_1.EventStatusChanged
            sscp_CBStEvtDEM_DTC_IP_warning_invalid_1: operation=CBStatusEvt_DEM_DTC_IP_warning_invalid_1.EventStatusChanged
            sscp_CBStEvtDEM_DTC_IP_node_missing_1: operation=CBStatusEvt_DEM_DTC_IP_node_missing_1.EventStatusChanged
            sscp_CBStEvtDEM_DTC_IP_message_alive_counter_error_1: operation=CBStatusEvt_DEM_DTC_IP_message_alive_counter_error_1.EventStatusChanged
            sscp_CBStEvtDEM_DTC_Fradar_not_calibration_or_blockage_1: operation=CBStatusEvt_DEM_DTC_Fradar_not_calibration_or_blockage_1.EventStatusChanged
            sscp_CBStEvtDEM_DTC_Fradar_hardware_error_1: operation=CBStatusEvt_DEM_DTC_Fradar_hardware_error_1.EventStatusChanged
            sscp_CBStEvtDEM_DTC_SRS_All_Node_Missing_1: operation=CBStatusEvt_DEM_DTC_SRS_All_Node_Missing_1.EventStatusChanged
            sscp_CBStEvtDEM_DTC_ADC_Message_Alive_Counter_Error_1: operation=CBStatusEvt_DEM_DTC_ADC_Message_Alive_Counter_Error_1.EventStatusChanged
            sscp_CBStEvtDEM_DTC_RLR_Message_Alive_Counter_Error_1: operation=CBStatusEvt_DEM_DTC_RLR_Message_Alive_Counter_Error_1.EventStatusChanged
            sscp_CBStEvtDEM_DTC_SRS_Message_Alive_Counter_Error_1: operation=CBStatusEvt_DEM_DTC_SRS_Message_Alive_Counter_Error_1.EventStatusChanged
            sscp_CBStEvtDEM_DTC_EPS_Message_Alive_Counter_Error_20ms_1: operation=CBStatusEvt_DEM_DTC_EPS_Message_Alive_Counter_Error_20ms_1.EventStatusChanged
            sscp_CBStEvtDEM_DTC_J3_SOC_System_Service_Error_1: operation=CBStatusEvt_DEM_DTC_J3_SOC_System_Service_Error_1.EventStatusChanged
            sscp_CBStEvtDEM_DTC_J3_Camera_Error_1: operation=CBStatusEvt_DEM_DTC_J3_Camera_Error_1.EventStatusChanged
            sscp_CBStEvtDEM_DTC_J3_SOC_CPU_Error_PWM_Missing_1: operation=CBStatusEvt_DEM_DTC_J3_SOC_CPU_Error_PWM_Missing_1.EventStatusChanged
            sscp_CBStEvtDEM_DTC_J3_SOC_Perception_Error_1: operation=CBStatusEvt_DEM_DTC_J3_SOC_Perception_Error_1.EventStatusChanged
            sscp_CBStEvtDEM_DTC_BCM_Brake_Lamp_Error_1: operation=CBStatusEvt_DEM_DTC_BCM_Brake_Lamp_Error_1.EventStatusChanged
            sscp_CBStEvtDEM_DTC_Esp_Ebd_Failr_1: operation=CBStatusEvt_DEM_DTC_Esp_Ebd_Failr_1.EventStatusChanged
            sscp_CBStEvtDEM_DTC_FR_All_Node_Missing_1: operation=CBStatusEvt_DEM_DTC_FR_All_Node_Missing_1.EventStatusChanged
            sscp_CBStEvtDEM_DTC_ADC_All_Node_Missing_1: operation=CBStatusEvt_DEM_DTC_ADC_All_Node_Missing_1.EventStatusChanged
            sscp_CBStEvtDEM_DTC_J3_Time_Sync_Error_1: operation=CBStatusEvt_DEM_DTC_J3_Time_Sync_Error_1.EventStatusChanged
            sscp_CBStEvtDEM_DTC_MCU_TEMP_INITIAL_HIGH_1: operation=CBStatusEvt_DEM_DTC_MCU_TEMP_INITIAL_HIGH_1.EventStatusChanged
            sscp_CBStEvtDEM_DTC_ESP_Message_Alive_Counter_Error_100ms_1: operation=CBStatusEvt_DEM_DTC_ESP_Message_Alive_Counter_Error_100ms_1.EventStatusChanged
            sscp_GeneralCBStatusEvt: operation=GeneralCBStatusEvt.EventStatusChanged
        RE_SetCycleQualified: runnable-entity-argument=symbol=OperationCycleId, can-be-invoked-concurrently=true, symbol=Dem_SetCycleQualified
          74 x sync call, all with timeout=0.0:
            sscp_CBStEvtSPI_E_HARDWARE_ERROR_1: operation=CBStatusEvt_SPI_E_HARDWARE_ERROR_1.EventStatusChanged
            sscp_CBStEvtDEM_VMON_BATT_HIGH_1: operation=CBStatusEvt_DEM_VMON_BATT_HIGH_1.EventStatusChanged
            sscp_CBStEvtDEM_VMON_BATT_LOW_1: operation=CBStatusEvt_DEM_VMON_BATT_LOW_1.EventStatusChanged
            sscp_CBStEvtDEM_MCU_TEMP_EXT_HIGH_1: operation=CBStatusEvt_DEM_MCU_TEMP_EXT_HIGH_1.EventStatusChanged
            sscp_CBStEvtDEM_MCU_TEMP_EXT_LOW_1: operation=CBStatusEvt_DEM_MCU_TEMP_EXT_LOW_1.EventStatusChanged
            sscp_CBStEvtDEM_SOCJ3_TEMP_EXT_HIGH_1: operation=CBStatusEvt_DEM_SOCJ3_TEMP_EXT_HIGH_1.EventStatusChanged
            sscp_CBStEvtDEM_J3_SYS_KERNEL_SW_1: operation=CBStatusEvt_DEM_J3_SYS_KERNEL_SW_1.EventStatusChanged
            sscp_CBStEvtDEM_CAMERA_CALIBRATION_FAILURE_1: operation=CBStatusEvt_DEM_CAMERA_CALIBRATION_FAILURE_1.EventStatusChanged
            sscp_CBStEvtDEM_CAMERA_ONLINE_CALIBRATION_FAILURE_1: operation=CBStatusEvt_DEM_CAMERA_ONLINE_CALIBRATION_FAILURE_1.EventStatusChanged
            sscp_CBStEvtDEM_DTC_VCU_Accr_Pedl_Posn_Invld_1: operation=CBStatusEvt_DEM_DTC_VCU_Accr_Pedl_Posn_Invld_1.EventStatusChanged
            sscp_CBStEvtDEM_DTC_VCU_Gear_Posn_Invld_1: operation=CBStatusEvt_DEM_DTC_VCU_Gear_Posn_Invld_1.EventStatusChanged
            sscp_CBStEvtDEM_DTC_BCM_Turn_Indcr_Light_Fault_1: operation=CBStatusEvt_DEM_DTC_BCM_Turn_Indcr_Light_Fault_1.EventStatusChanged
            sscp_CBStEvtDEM_DTC_BCM_Frnt_Wiper_Sts_Fault_1: operation=CBStatusEvt_DEM_DTC_BCM_Frnt_Wiper_Sts_Fault_1.EventStatusChanged
            sscp_CBStEvtDEM_DTC_ESP_Veh_Spd_Invld_1: operation=CBStatusEvt_DEM_DTC_ESP_Veh_Spd_Invld_1.EventStatusChanged
            sscp_CBStEvtDEM_DTC_Whl_Spd_Pls_Invld_1: operation=CBStatusEvt_DEM_DTC_Whl_Spd_Pls_Invld_1.EventStatusChanged
            sscp_CBStEvtDEM_DTC_Whl_Spd_Dir_Invld_1: operation=CBStatusEvt_DEM_DTC_Whl_Spd_Dir_Invld_1.EventStatusChanged
            sscp_CBStEvtDEM_DTC_Whl_Spd_Data_Invld_1: operation=CBStatusEvt_DEM_DTC_Whl_Spd_Data_Invld_1.EventStatusChanged
            sscp_CBStEvtDEM_DTC_EPS_Sas_NOT_Cal_1: operation=CBStatusEvt_DEM_DTC_EPS_Sas_NOT_Cal_1.EventStatusChanged
            sscp_CBStEvtDEM_DTC_EPS_Actual_Motor_Torq_Invld_1: operation=CBStatusEvt_DEM_DTC_EPS_Actual_Motor_Torq_Invld_1.EventStatusChanged
            sscp_CBStEvtDEM_DTC_ESP_Lat_Accel_Invld_1: operation=CBStatusEvt_DEM_DTC_ESP_Lat_Accel_Invld_1.EventStatusChanged
            sscp_CBStEvtDEM_DTC_ESP_Long_Accel_Invld_1: operation=CBStatusEvt_DEM_DTC_ESP_Long_Accel_Invld_1.EventStatusChanged
            sscp_CBStEvtDEM_DTC_ESP_Yaw_Rate_Invld_1: operation=CBStatusEvt_DEM_DTC_ESP_Yaw_Rate_Invld_1.EventStatusChanged
            sscp_CBStEvtDEM_DTC_EPS_Fault_1: operation=CBStatusEvt_DEM_DTC_EPS_Fault_1.EventStatusChanged
            sscp_CBStEvtDEM_DTC_VCU_All_Node_Missing_1: operation=CBStatusEvt_DEM_DTC_VCU_All_Node_Missing_1.EventStatusChanged
            sscp_CBStEvtDEM_DTC_ESP_All_Node_Missing_1: operation=CBStatusEvt_DEM_DTC_ESP_All_Node_Missing_1.EventStatusChanged
            sscp_CBStEvtDEM_DTC_EPS_All_Node_Missing_1: operation=CBStatusEvt_DEM_DTC_EPS_All_Node_Missing_1.EventStatusChanged
            sscp_CBStEvtDEM_DTC_VCU_Message_Alive_Counter_Error_1: operation=CBStatusEvt_DEM_DTC_VCU_Message_Alive_Counter_Error_1.EventStatusChanged
            sscp_CBStEvtDEM_DTC_ESP_Message_Alive_Counter_Error_1: operation=CBStatusEvt_DEM_DTC_ESP_Message_Alive_Counter_Error_1.EventStatusChanged
            sscp_CBStEvtDEM_DTC_EPS_Message_Alive_Counter_Error_10ms_1: operation=CBStatusEvt_DEM_DTC_EPS_Message_Alive_Counter_Error_10ms_1.EventStatusChanged
            sscp_CBStEvtDEM_DTC_Front_Radar_Alive_Counter_Error_1: operation=CBStatusEvt_DEM_DTC_Front_Radar_Alive_Counter_Error_1.EventStatusChanged
            sscp_CBStEvtDEM_DTC_ESP_ABS_Fault_1: operation=CBStatusEvt_DEM_DTC_ESP_ABS_Fault_1.EventStatusChanged
            sscp_CBStEvtDEM_DTC_ESP_TCS_Fault_1: operation=CBStatusEvt_DEM_DTC_ESP_TCS_Fault_1.EventStatusChanged
            sscp_CBStEvtDEM_DTC_ESP_ABA_NOT_Available_1: operation=CBStatusEvt_DEM_DTC_ESP_ABA_NOT_Available_1.EventStatusChanged
            sscp_CBStEvtDEM_DTC_ESP_AEB_NOT_Available_1: operation=CBStatusEvt_DEM_DTC_ESP_AEB_NOT_Available_1.EventStatusChanged
            sscp_CBStEvtDEM_DTC_ESP_AWB_NOT_Available_1: operation=CBStatusEvt_DEM_DTC_ESP_AWB_NOT_Available_1.EventStatusChanged
            sscp_CBStEvtDEM_DTC_IB_Brk_Pedl_Invld_1: operation=CBStatusEvt_DEM_DTC_IB_Brk_Pedl_Invld_1.EventStatusChanged
            sscp_CBStEvtDEM_DTC_EPS_Actual_Torsion_Torq_Invld_1: operation=CBStatusEvt_DEM_DTC_EPS_Actual_Torsion_Torq_Invld_1.EventStatusChanged
            sscp_CBStEvtDEM_DTC_EPS_Actual_Motor_Invld_1: operation=CBStatusEvt_DEM_DTC_EPS_Actual_Motor_Invld_1.EventStatusChanged
            sscp_CBStEvtDEM_DTC_EPS_Steer_AgSens_Fault_1: operation=CBStatusEvt_DEM_DTC_EPS_Steer_AgSens_Fault_1.EventStatusChanged
            sscp_CBStEvtDEM_DTC_SRS_Drvr_BucSwt_Invld_1: operation=CBStatusEvt_DEM_DTC_SRS_Drvr_BucSwt_Invld_1.EventStatusChanged
            sscp_CBStEvtDEM_DTC_EPS_Pinionang_Invld_1: operation=CBStatusEvt_DEM_DTC_EPS_Pinionang_Invld_1.EventStatusChanged
            sscp_CBStEvtDEM_DTC_EPS_Pinionang_Fault_1: operation=CBStatusEvt_DEM_DTC_EPS_Pinionang_Fault_1.EventStatusChanged
            sscp_CBStEvtDEM_DTC_EPS_APA_Epas_Fault_1: operation=CBStatusEvt_DEM_DTC_EPS_APA_Epas_Fault_1.EventStatusChanged
            sscp_CBStEvtDEM_DTC_BCM_EmgyLi_Fault_1: operation=CBStatusEvt_DEM_DTC_BCM_EmgyLi_Fault_1.EventStatusChanged
            sscp_CBStEvtDEM_DTC_BCM_All_Node_Missing_1: operation=CBStatusEvt_DEM_DTC_BCM_All_Node_Missing_1.EventStatusChanged
            sscp_CBStEvtDEM_DTC_BCM_Message_Alive_Counter_Error_40ms_1: operation=CBStatusEvt_DEM_DTC_BCM_Message_Alive_Counter_Error_40ms_1.EventStatusChanged
            sscp_CBStEvtDEM_DTC_J3_Camera_Blockage_1: operation=CBStatusEvt_DEM_DTC_J3_Camera_Blockage_1.EventStatusChanged
            sscp_CBStEvtDEM_DTC_Private_CAN_Bus_Off_1: operation=CBStatusEvt_DEM_DTC_Private_CAN_Bus_Off_1.EventStatusChanged
            sscp_CBStEvtDEM_DTC_Public_CAN_Bus_Off_1: operation=CBStatusEvt_DEM_DTC_Public_CAN_Bus_Off_1.EventStatusChanged
            sscp_CBStEvtDEM_DTC_J3_SOC_Safetylib_Error_1: operation=CBStatusEvt_DEM_DTC_J3_SOC_Safetylib_Error_1.EventStatusChanged
            sscp_CBStEvtDEM_DTC_EPS_Steering_wheel_vibration_failure_1: operation=CBStatusEvt_DEM_DTC_EPS_Steering_wheel_vibration_failure_1.EventStatusChanged
            sscp_CBStEvtDEM_DTC_EPS_Driver_hand_torque_invalid_1: operation=CBStatusEvt_DEM_DTC_EPS_Driver_hand_torque_invalid_1.EventStatusChanged
            sscp_CBStEvtDEM_DTC_IP_warning_invalid_1: operation=CBStatusEvt_DEM_DTC_IP_warning_invalid_1.EventStatusChanged
            sscp_CBStEvtDEM_DTC_IP_node_missing_1: operation=CBStatusEvt_DEM_DTC_IP_node_missing_1.EventStatusChanged
            sscp_CBStEvtDEM_DTC_IP_message_alive_counter_error_1: operation=CBStatusEvt_DEM_DTC_IP_message_alive_counter_error_1.EventStatusChanged
            sscp_CBStEvtDEM_DTC_Fradar_not_calibration_or_blockage_1: operation=CBStatusEvt_DEM_DTC_Fradar_not_calibration_or_blockage_1.EventStatusChanged
            sscp_CBStEvtDEM_DTC_Fradar_hardware_error_1: operation=CBStatusEvt_DEM_DTC_Fradar_hardware_error_1.EventStatusChanged
            sscp_CBStEvtDEM_DTC_SRS_All_Node_Missing_1: operation=CBStatusEvt_DEM_DTC_SRS_All_Node_Missing_1.EventStatusChanged
            sscp_CBStEvtDEM_DTC_ADC_Message_Alive_Counter_Error_1: operation=CBStatusEvt_DEM_DTC_ADC_Message_Alive_Counter_Error_1.EventStatusChanged
            sscp_CBStEvtDEM_DTC_RLR_Message_Alive_Counter_Error_1: operation=CBStatusEvt_DEM_DTC_RLR_Message_Alive_Counter_Error_1.EventStatusChanged
            sscp_CBStEvtDEM_DTC_SRS_Message_Alive_Counter_Error_1: operation=CBStatusEvt_DEM_DTC_SRS_Message_Alive_Counter_Error_1.EventStatusChanged
            sscp_CBStEvtDEM_DTC_EPS_Message_Alive_Counter_Error_20ms_1: operation=CBStatusEvt_DEM_DTC_EPS_Message_Alive_Counter_Error_20ms_1.EventStatusChanged
            sscp_CBStEvtDEM_DTC_J3_SOC_System_Service_Error_1: operation=CBStatusEvt_DEM_DTC_J3_SOC_System_Service_Error_1.EventStatusChanged
            sscp_CBStEvtDEM_DTC_J3_Camera_Error_1: operation=CBStatusEvt_DEM_DTC_J3_Camera_Error_1.EventStatusChanged
            sscp_CBStEvtDEM_DTC_J3_SOC_CPU_Error_PWM_Missing_1: operation=CBStatusEvt_DEM_DTC_J3_SOC_CPU_Error_PWM_Missing_1.EventStatusChanged
            sscp_CBStEvtDEM_DTC_J3_SOC_Perception_Error_1: operation=CBStatusEvt_DEM_DTC_J3_SOC_Perception_Error_1.EventStatusChanged
            sscp_CBStEvtDEM_DTC_BCM_Brake_Lamp_Error_1: operation=CBStatusEvt_DEM_DTC_BCM_Brake_Lamp_Error_1.EventStatusChanged
            sscp_CBStEvtDEM_DTC_Esp_Ebd_Failr_1: operation=CBStatusEvt_DEM_DTC_Esp_Ebd_Failr_1.EventStatusChanged
            sscp_CBStEvtDEM_DTC_FR_All_Node_Missing_1: operation=CBStatusEvt_DEM_DTC_FR_All_Node_Missing_1.EventStatusChanged
            sscp_CBStEvtDEM_DTC_ADC_All_Node_Missing_1: operation=CBStatusEvt_DEM_DTC_ADC_All_Node_Missing_1.EventStatusChanged
            sscp_CBStEvtDEM_DTC_J3_Time_Sync_Error_1: operation=CBStatusEvt_DEM_DTC_J3_Time_Sync_Error_1.EventStatusChanged
            sscp_CBStEvtDEM_DTC_MCU_TEMP_INITIAL_HIGH_1: operation=CBStatusEvt_DEM_DTC_MCU_TEMP_INITIAL_HIGH_1.EventStatusChanged
            sscp_CBStEvtDEM_DTC_ESP_Message_Alive_Counter_Error_100ms_1: operation=CBStatusEvt_DEM_DTC_ESP_Message_Alive_Counter_Error_100ms_1.EventStatusChanged
            sscp_GeneralCBStatusEvt: operation=GeneralCBStatusEvt.EventStatusChanged
        RE_SetEnableCondition: arguments=[symbol=EnableConditionID, symbol=ConditionFulfilled], can-be-invoked-concurrently=true, symbol=Dem_SetEnableCondition
        RE_GetEventMemoryOverflow: arguments=[symbol=DTCOrigin, symbol=OverflowIndication], can-be-invoked-concurrently=true, symbol=Dem_GetEventMemoryOverflow
        RE_GetNumberOfEventMemoryEntries: arguments=[symbol=DTCOrigin, symbol=NumberOfEventMemoryEntries], can-be-invoked-concurrently=true, symbol=Dem_GetNumberOfEventMemoryEntries
        RE_MainFunction: symbol=Dem_MainFunction
          84 x sync call, all with timeout=0.0:
            sscp_CBStEvtSPI_E_HARDWARE_ERROR_1: operation=CBStatusEvt_SPI_E_HARDWARE_ERROR_1.EventStatusChanged
            sscp_CBStEvtDEM_VMON_BATT_HIGH_1: operation=CBStatusEvt_DEM_VMON_BATT_HIGH_1.EventStatusChanged
            sscp_CBStEvtDEM_VMON_BATT_LOW_1: operation=CBStatusEvt_DEM_VMON_BATT_LOW_1.EventStatusChanged
            sscp_CBStEvtDEM_MCU_TEMP_EXT_HIGH_1: operation=CBStatusEvt_DEM_MCU_TEMP_EXT_HIGH_1.EventStatusChanged
            sscp_CBStEvtDEM_MCU_TEMP_EXT_LOW_1: operation=CBStatusEvt_DEM_MCU_TEMP_EXT_LOW_1.EventStatusChanged
            sscp_CBStEvtDEM_SOCJ3_TEMP_EXT_HIGH_1: operation=CBStatusEvt_DEM_SOCJ3_TEMP_EXT_HIGH_1.EventStatusChanged
            sscp_CBStEvtDEM_J3_SYS_KERNEL_SW_1: operation=CBStatusEvt_DEM_J3_SYS_KERNEL_SW_1.EventStatusChanged
            sscp_CBStEvtDEM_CAMERA_CALIBRATION_FAILURE_1: operation=CBStatusEvt_DEM_CAMERA_CALIBRATION_FAILURE_1.EventStatusChanged
            sscp_CBStEvtDEM_CAMERA_ONLINE_CALIBRATION_FAILURE_1: operation=CBStatusEvt_DEM_CAMERA_ONLINE_CALIBRATION_FAILURE_1.EventStatusChanged
            sscp_CBStEvtDEM_DTC_VCU_Accr_Pedl_Posn_Invld_1: operation=CBStatusEvt_DEM_DTC_VCU_Accr_Pedl_Posn_Invld_1.EventStatusChanged
            sscp_CBStEvtDEM_DTC_VCU_Gear_Posn_Invld_1: operation=CBStatusEvt_DEM_DTC_VCU_Gear_Posn_Invld_1.EventStatusChanged
            sscp_CBStEvtDEM_DTC_BCM_Turn_Indcr_Light_Fault_1: operation=CBStatusEvt_DEM_DTC_BCM_Turn_Indcr_Light_Fault_1.EventStatusChanged
            sscp_CBStEvtDEM_DTC_BCM_Frnt_Wiper_Sts_Fault_1: operation=CBStatusEvt_DEM_DTC_BCM_Frnt_Wiper_Sts_Fault_1.EventStatusChanged
            sscp_CBStEvtDEM_DTC_ESP_Veh_Spd_Invld_1: operation=CBStatusEvt_DEM_DTC_ESP_Veh_Spd_Invld_1.EventStatusChanged
            sscp_CBStEvtDEM_DTC_Whl_Spd_Pls_Invld_1: operation=CBStatusEvt_DEM_DTC_Whl_Spd_Pls_Invld_1.EventStatusChanged
            sscp_CBStEvtDEM_DTC_Whl_Spd_Dir_Invld_1: operation=CBStatusEvt_DEM_DTC_Whl_Spd_Dir_Invld_1.EventStatusChanged
            sscp_CBStEvtDEM_DTC_Whl_Spd_Data_Invld_1: operation=CBStatusEvt_DEM_DTC_Whl_Spd_Data_Invld_1.EventStatusChanged
            sscp_CBStEvtDEM_DTC_EPS_Sas_NOT_Cal_1: operation=CBStatusEvt_DEM_DTC_EPS_Sas_NOT_Cal_1.EventStatusChanged
            sscp_CBStEvtDEM_DTC_EPS_Actual_Motor_Torq_Invld_1: operation=CBStatusEvt_DEM_DTC_EPS_Actual_Motor_Torq_Invld_1.EventStatusChanged
            sscp_CBStEvtDEM_DTC_ESP_Lat_Accel_Invld_1: operation=CBStatusEvt_DEM_DTC_ESP_Lat_Accel_Invld_1.EventStatusChanged
            sscp_CBStEvtDEM_DTC_ESP_Long_Accel_Invld_1: operation=CBStatusEvt_DEM_DTC_ESP_Long_Accel_Invld_1.EventStatusChanged
            sscp_CBStEvtDEM_DTC_ESP_Yaw_Rate_Invld_1: operation=CBStatusEvt_DEM_DTC_ESP_Yaw_Rate_Invld_1.EventStatusChanged
            sscp_CBStEvtDEM_DTC_EPS_Fault_1: operation=CBStatusEvt_DEM_DTC_EPS_Fault_1.EventStatusChanged
            sscp_CBStEvtDEM_DTC_VCU_All_Node_Missing_1: operation=CBStatusEvt_DEM_DTC_VCU_All_Node_Missing_1.EventStatusChanged
            sscp_CBStEvtDEM_DTC_ESP_All_Node_Missing_1: operation=CBStatusEvt_DEM_DTC_ESP_All_Node_Missing_1.EventStatusChanged
            sscp_CBStEvtDEM_DTC_EPS_All_Node_Missing_1: operation=CBStatusEvt_DEM_DTC_EPS_All_Node_Missing_1.EventStatusChanged
            sscp_CBStEvtDEM_DTC_VCU_Message_Alive_Counter_Error_1: operation=CBStatusEvt_DEM_DTC_VCU_Message_Alive_Counter_Error_1.EventStatusChanged
            sscp_CBStEvtDEM_DTC_ESP_Message_Alive_Counter_Error_1: operation=CBStatusEvt_DEM_DTC_ESP_Message_Alive_Counter_Error_1.EventStatusChanged
            sscp_CBStEvtDEM_DTC_EPS_Message_Alive_Counter_Error_10ms_1: operation=CBStatusEvt_DEM_DTC_EPS_Message_Alive_Counter_Error_10ms_1.EventStatusChanged
            sscp_CBStEvtDEM_DTC_Front_Radar_Alive_Counter_Error_1: operation=CBStatusEvt_DEM_DTC_Front_Radar_Alive_Counter_Error_1.EventStatusChanged
            sscp_CBStEvtDEM_DTC_ESP_ABS_Fault_1: operation=CBStatusEvt_DEM_DTC_ESP_ABS_Fault_1.EventStatusChanged
            sscp_CBStEvtDEM_DTC_ESP_TCS_Fault_1: operation=CBStatusEvt_DEM_DTC_ESP_TCS_Fault_1.EventStatusChanged
            sscp_CBStEvtDEM_DTC_ESP_ABA_NOT_Available_1: operation=CBStatusEvt_DEM_DTC_ESP_ABA_NOT_Available_1.EventStatusChanged
            sscp_CBStEvtDEM_DTC_ESP_AEB_NOT_Available_1: operation=CBStatusEvt_DEM_DTC_ESP_AEB_NOT_Available_1.EventStatusChanged
            sscp_CBStEvtDEM_DTC_ESP_AWB_NOT_Available_1: operation=CBStatusEvt_DEM_DTC_ESP_AWB_NOT_Available_1.EventStatusChanged
            sscp_CBStEvtDEM_DTC_IB_Brk_Pedl_Invld_1: operation=CBStatusEvt_DEM_DTC_IB_Brk_Pedl_Invld_1.EventStatusChanged
            sscp_CBStEvtDEM_DTC_EPS_Actual_Torsion_Torq_Invld_1: operation=CBStatusEvt_DEM_DTC_EPS_Actual_Torsion_Torq_Invld_1.EventStatusChanged
            sscp_CBStEvtDEM_DTC_EPS_Actual_Motor_Invld_1: operation=CBStatusEvt_DEM_DTC_EPS_Actual_Motor_Invld_1.EventStatusChanged
            sscp_CBStEvtDEM_DTC_EPS_Steer_AgSens_Fault_1: operation=CBStatusEvt_DEM_DTC_EPS_Steer_AgSens_Fault_1.EventStatusChanged
            sscp_CBStEvtDEM_DTC_SRS_Drvr_BucSwt_Invld_1: operation=CBStatusEvt_DEM_DTC_SRS_Drvr_BucSwt_Invld_1.EventStatusChanged
            sscp_CBStEvtDEM_DTC_EPS_Pinionang_Invld_1: operation=CBStatusEvt_DEM_DTC_EPS_Pinionang_Invld_1.EventStatusChanged
            sscp_CBStEvtDEM_DTC_EPS_Pinionang_Fault_1: operation=CBStatusEvt_DEM_DTC_EPS_Pinionang_Fault_1.EventStatusChanged
            sscp_CBStEvtDEM_DTC_EPS_APA_Epas_Fault_1: operation=CBStatusEvt_DEM_DTC_EPS_APA_Epas_Fault_1.EventStatusChanged
            sscp_CBStEvtDEM_DTC_BCM_EmgyLi_Fault_1: operation=CBStatusEvt_DEM_DTC_BCM_EmgyLi_Fault_1.EventStatusChanged
            sscp_CBStEvtDEM_DTC_BCM_All_Node_Missing_1: operation=CBStatusEvt_DEM_DTC_BCM_All_Node_Missing_1.EventStatusChanged
            sscp_CBStEvtDEM_DTC_BCM_Message_Alive_Counter_Error_40ms_1: operation=CBStatusEvt_DEM_DTC_BCM_Message_Alive_Counter_Error_40ms_1.EventStatusChanged
            sscp_CBStEvtDEM_DTC_J3_Camera_Blockage_1: operation=CBStatusEvt_DEM_DTC_J3_Camera_Blockage_1.EventStatusChanged
            sscp_CBStEvtDEM_DTC_Private_CAN_Bus_Off_1: operation=CBStatusEvt_DEM_DTC_Private_CAN_Bus_Off_1.EventStatusChanged
            sscp_CBStEvtDEM_DTC_Public_CAN_Bus_Off_1: operation=CBStatusEvt_DEM_DTC_Public_CAN_Bus_Off_1.EventStatusChanged
            sscp_CBStEvtDEM_DTC_J3_SOC_Safetylib_Error_1: operation=CBStatusEvt_DEM_DTC_J3_SOC_Safetylib_Error_1.EventStatusChanged
            sscp_CBStEvtDEM_DTC_EPS_Steering_wheel_vibration_failure_1: operation=CBStatusEvt_DEM_DTC_EPS_Steering_wheel_vibration_failure_1.EventStatusChanged
            sscp_CBStEvtDEM_DTC_EPS_Driver_hand_torque_invalid_1: operation=CBStatusEvt_DEM_DTC_EPS_Driver_hand_torque_invalid_1.EventStatusChanged
            sscp_CBStEvtDEM_DTC_IP_warning_invalid_1: operation=CBStatusEvt_DEM_DTC_IP_warning_invalid_1.EventStatusChanged
            sscp_CBStEvtDEM_DTC_IP_node_missing_1: operation=CBStatusEvt_DEM_DTC_IP_node_missing_1.EventStatusChanged
            sscp_CBStEvtDEM_DTC_IP_message_alive_counter_error_1: operation=CBStatusEvt_DEM_DTC_IP_message_alive_counter_error_1.EventStatusChanged
            sscp_CBStEvtDEM_DTC_Fradar_not_calibration_or_blockage_1: operation=CBStatusEvt_DEM_DTC_Fradar_not_calibration_or_blockage_1.EventStatusChanged
            sscp_CBStEvtDEM_DTC_Fradar_hardware_error_1: operation=CBStatusEvt_DEM_DTC_Fradar_hardware_error_1.EventStatusChanged
            sscp_CBStEvtDEM_DTC_SRS_All_Node_Missing_1: operation=CBStatusEvt_DEM_DTC_SRS_All_Node_Missing_1.EventStatusChanged
            sscp_CBStEvtDEM_DTC_ADC_Message_Alive_Counter_Error_1: operation=CBStatusEvt_DEM_DTC_ADC_Message_Alive_Counter_Error_1.EventStatusChanged
            sscp_CBStEvtDEM_DTC_RLR_Message_Alive_Counter_Error_1: operation=CBStatusEvt_DEM_DTC_RLR_Message_Alive_Counter_Error_1.EventStatusChanged
            sscp_CBStEvtDEM_DTC_SRS_Message_Alive_Counter_Error_1: operation=CBStatusEvt_DEM_DTC_SRS_Message_Alive_Counter_Error_1.EventStatusChanged
            sscp_CBStEvtDEM_DTC_EPS_Message_Alive_Counter_Error_20ms_1: operation=CBStatusEvt_DEM_DTC_EPS_Message_Alive_Counter_Error_20ms_1.EventStatusChanged
            sscp_CBStEvtDEM_DTC_J3_SOC_System_Service_Error_1: operation=CBStatusEvt_DEM_DTC_J3_SOC_System_Service_Error_1.EventStatusChanged
            sscp_CBStEvtDEM_DTC_J3_Camera_Error_1: operation=CBStatusEvt_DEM_DTC_J3_Camera_Error_1.EventStatusChanged
            sscp_CBStEvtDEM_DTC_J3_SOC_CPU_Error_PWM_Missing_1: operation=CBStatusEvt_DEM_DTC_J3_SOC_CPU_Error_PWM_Missing_1.EventStatusChanged
            sscp_CBStEvtDEM_DTC_J3_SOC_Perception_Error_1: operation=CBStatusEvt_DEM_DTC_J3_SOC_Perception_Error_1.EventStatusChanged
            sscp_CBStEvtDEM_DTC_BCM_Brake_Lamp_Error_1: operation=CBStatusEvt_DEM_DTC_BCM_Brake_Lamp_Error_1.EventStatusChanged
            sscp_CBStEvtDEM_DTC_Esp_Ebd_Failr_1: operation=CBStatusEvt_DEM_DTC_Esp_Ebd_Failr_1.EventStatusChanged
            sscp_CBStEvtDEM_DTC_FR_All_Node_Missing_1: operation=CBStatusEvt_DEM_DTC_FR_All_Node_Missing_1.EventStatusChanged
            sscp_CBStEvtDEM_DTC_ADC_All_Node_Missing_1: operation=CBStatusEvt_DEM_DTC_ADC_All_Node_Missing_1.EventStatusChanged
            sscp_CBStEvtDEM_DTC_J3_Time_Sync_Error_1: operation=CBStatusEvt_DEM_DTC_J3_Time_Sync_Error_1.EventStatusChanged
            sscp_CBStEvtDEM_DTC_MCU_TEMP_INITIAL_HIGH_1: operation=CBStatusEvt_DEM_DTC_MCU_TEMP_INITIAL_HIGH_1.EventStatusChanged
            sscp_CBStEvtDEM_DTC_ESP_Message_Alive_Counter_Error_100ms_1: operation=CBStatusEvt_DEM_DTC_ESP_Message_Alive_Counter_Error_100ms_1.EventStatusChanged
            sscp_GeneralCBStatusEvt: operation=GeneralCBStatusEvt.EventStatusChanged
            sscp_CBReadDataDemDataElementClass_Odometer: operation=CBReadData_DemDataElementClass_Odometer.ReadData
            sscp_CBReadDataDemDataElementClass_Voltage: operation=CBReadData_DemDataElementClass_Voltage.ReadData
            sscp_CBReadDataDemDataElementClass_VehicleSpeed: operation=CBReadData_DemDataElementClass_VehicleSpeed.ReadData
            sscp_CBReadDataDemDataElementClass_LocalTime: operation=CBReadData_DemDataElementClass_LocalTime.ReadData
            sscp_CBReadDataDemDataElementClass_ECUTemperature: operation=CBReadData_DemDataElementClass_ECUTemperature.ReadData
            sscp_CBReadDataDemDataElementClass_Yawrate: operation=CBReadData_DemDataElementClass_Yawrate.ReadData
            sscp_CBReadDataDemDataElementClass_EngineSpeed: operation=CBReadData_DemDataElementClass_EngineSpeed.ReadData
            sscp_CBReadDataDemDataElementClass_GearPosition: operation=CBReadData_DemDataElementClass_GearPosition.ReadData
            sscp_CBReadDataDemDataElementClass_SteeringAngle: operation=CBReadData_DemDataElementClass_SteeringAngle.ReadData
            sscp_CBReadDataDemDataElementClass_Extended_SystemKernelErrMap: operation=CBReadData_DemDataElementClass_Extended_SystemKernelErrMap.ReadData
package /EB_Dem/SwcImplementations
  swc implementation DemImpl: programming-language=C, sw-version=6.4.3, vendor-id=1, behavior=DemIntBeh
    code-descriptors:
      code DemCode: artifact-descriptors=autosar-engineering-object={short-label=EngObject, category=SWSRC}
    resource consumption Resources
      memory section CODE: sw-addrmethod=CODE
