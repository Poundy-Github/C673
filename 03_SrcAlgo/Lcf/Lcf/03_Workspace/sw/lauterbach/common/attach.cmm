; Check if project variant is available

; Default command for "attach"
sys.attach
