AUTOSAR XML (schema 4-2-1)
package /AUTOSAR_EcuM/ImplementationDataTypes
  impl type EcuM_ShutdownCauseType: compu {0=ECUM_CAUSE_UNKNOWN, 1=ECUM_CAUSE_ECU_STATE, 2=ECUM_CAUSE_WDGM, 3=ECUM_CAUSE_DCM}, implementation-data-type=uint8
  impl type EcuM_BootTargetType: compu {0=ECUM_BOOT_TARGET_APP, 1=ECUM_BOOT_TARGET_OEM_BOOTLOADER, 2=ECUM_BOOT_TARGET_SYS_BOOTLOADER}, implementation-data-type=uint8
package /AUTOSAR_EcuM/PortInterfaces
  client server interface EcuM_ShutdownTarget: is-service=true
    7 x operation, all with possible-error=EcuM_ShutdownTarget/E_NOT_OK:
      SelectShutdownTarget
        arg target: type=EcuM_StateType, direction=IN
        arg mode: type=uint8, direction=IN
      GetShutdownTarget
        arg target: type=EcuM_StateType, direction=OUT
        arg mode: type=uint8, direction=OUT
      GetLastShutdownTarget
        arg target: type=EcuM_StateType, direction=OUT
        arg mode: type=uint8, direction=OUT
      SelectShutdownCause
        arg target: type=EcuM_ShutdownCauseType, direction=IN
      GetShutdownCause
        arg target: type=EcuM_ShutdownCauseType, direction=OUT
      GetMostRecentShutdown
        4 x arg, all with direction=OUT:
          target: type=EcuM_StateType
          mode: type=uint8
          cause: type=EcuM_ShutdownCauseType
          time: type=uint32
      GetNextRecentShutdown
        4 x arg, all with direction=OUT:
          target: type=EcuM_StateType
          mode: type=uint8
          cause: type=EcuM_ShutdownCauseType
          time: type=uint32
    error E_NOT_OK: error-code=1
  client server interface EcuM_BootTarget: is-service=true
    operation SelectBootTarget: possible-error=EcuM_BootTarget/E_NOT_OK
      arg target: type=EcuM_BootTargetType, direction=IN
    operation GetBootTarget: possible-error=EcuM_BootTarget/E_NOT_OK
      arg target: type=EcuM_BootTargetType, direction=OUT
    error E_NOT_OK: error-code=1
