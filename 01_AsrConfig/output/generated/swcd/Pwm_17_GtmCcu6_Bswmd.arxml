AUTOSAR XML (schema 4-0-3)
package /AUTOSAR_Pwm/BswModuleDescriptions
  bsw module description Pwm_17_GtmCcu6: module-id=121, provided-entrys=Pwm_17_GtmCcu6_Init
    bsw internal behavior InternalBehavior_0
      exclusive area HandleNotification
      exclusive area PeriodAndDutyUpdate
      bsw called entity Pwm_17_GtmCcu6_Init: can-enter-exclusive-area=[HandleNotification, PeriodAndDutyUpdate], implemented-entry=Pwm_17_GtmCcu6_Init
package /AUTOSAR_Pwm/BswModuleEntrys
  bsw module entry Pwm_17_GtmCcu6_Init: service-id=1000, is-reentrant=false, is-synchronous=true, call-type=REGULAR, execution-context=UNSPECIFIED, sw-service-impl-policy=STANDARD
package /Pwm_Aurix2GAS422/Implementations
  bsw implementation BswImplementation_0: programming-language=C, sw-version=20.0.2, vendor-id=17, ar-release-version=4.2.2, behavior=InternalBehavior_0, vendor-specific-module-def=Pwm
    code-descriptors:
      code Files: artifact-descriptors=[{short-label=make::Pwm_defs.mak, category=SWMAKE}, {short-label=make::Pwm_rules.mak, category=SWMAKE}]
    resource consumption ResourceConsumption
      17 x memory section, all with options=safetyAsilB, prefix=PWM_17_GTMCCU6:
        VAR_CLEARED_ASIL_B_GLOBAL_32: alignment=32, sw-addrmethod=VAR_CLEARED_ASIL_B
        CODE_ASIL_B_GLOBAL: alignment=UNSPECIFIED, sw-addrmethod=CODE_ASIL_B
        VAR_CLEARED_ASIL_B_CORE{0..5}_UNSPECIFIED: alignment=UNSPECIFIED, sw-addrmethod=VAR_CLEARED_ASIL_B
        CONST_ASIL_B_GLOBAL_UNSPECIFIED: alignment=UNSPECIFIED, sw-addrmethod=CONST_ASIL_B
        CONFIG_DATA_ASIL_B_GLOBAL_UNSPECIFIED: alignment=UNSPECIFIED, sw-addrmethod=CONFIG_DATA_ASIL_B
        CONFIG_DATA_ASIL_B_CORE{0..5}_UNSPECIFIED: alignment=UNSPECIFIED, sw-addrmethod=CONFIG_DATA_ASIL_B
        CODE_FAST_ASIL_B_GLOBAL: alignment=UNSPECIFIED, sw-addrmethod=CODE_ASIL_B
      section name prefix PWM_17_GTMCCU6
