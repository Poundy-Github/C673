AUTOSAR XML (schema 4-1-1)
package /EthSystem
  system EthSystem: system-version=1.0.0
    system mapping SystemMapping
      data-mappings:
        data-element=TopLevelComposition.P_CounterOut.CounterValue, system-signal=CounterOut
        data-element=TopLevelComposition.R_CounterIn.CounterValue, system-signal=CounterIn
      sw-mappings:
        swc to ecu mapping EcuTestNodeMapping: ecu-instance=EcuTestNode
          component:
            TopLevelComposition.SWC_ModifyEcho
            TopLevelComposition.SWC_CyclicCounter
            TopLevelComposition.SWC_IoHwAbs
    root-software-compositions:
      root sw composition prototype TopLevelComposition: software-composition=TopLevelComposition
package /EthSystem/CLUSTERS
  ethernet cluster EthNetwork: speed=10000
    ethernet physical channel EthChannel: comm-connectors=[Conn_DebugNode, Conn_EcuTestNode]
      pdu triggering PT_Pdu_CounterIn: pdu=Pdu_CounterIn, from DebugNode, to EcuTestNode
      pdu triggering PT_Pdu_DummyIn: pdu=Pdu_DummyIn, from EcuTestNode, to DebugNode
      pdu triggering PT_Pdu_CounterOut: pdu=Pdu_CounterOut, from EcuTestNode, to DebugNode
      pdu triggering PT_Pdu_DummyOut: pdu=Pdu_DummyOut, from DebugNode, to EcuTestNode
      network endpoint SocketAddress_DebugNode_NEP: network-endpoint-addresses=ipv-4-configuration={default-gateway=192.168.88.1, ipv-4-address=192.168.88.77, ipv-4-address-source=FIXED, network-mask=255.255.255.0}
      network endpoint SocketAddress_TestNode_NEP: network-endpoint-addresses=ipv-4-configuration={default-gateway=192.168.88.1, ipv-4-address=192.168.88.73, ipv-4-address-source=FIXED, network-mask=255.255.255.0}
      so-ad-config:
        socket connection bundle SocketConnectionBundleUDP: socket-connection{client-port=SocketAddress_DebugNode_UDP, pdus=[{header-id=10, pdu=Pdu_CounterOut}, {header-id=11, pdu=Pdu_DummyOut}], short-label=SocketConnectionTestToDebugNode}, server-port=SocketAddress_TestNode_UDP
        socket connection bundle SocketConnectionBundleTCP: socket-connection{client-port=SocketAddress_DebugNode_TCP, pdus=[{header-id=20, pdu=Pdu_CounterIn}, {header-id=21, pdu=Pdu_DummyIn}], short-label=SocketConnectionDebugToTestNode}, server-port=SocketAddress_TestNode_TCP
        4 x socket address:
          SocketAddress_DebugNode_TCP: connector=Conn_DebugNode
            application endpoint SocketAddress_DebugNode_TCP_AEP: network-endpoint=SocketAddress_DebugNode_NEP, tp-configuration=tcp-tp=tcp-tp-port=port-number=60020
          SocketAddress_DebugNode_UDP: connector=Conn_DebugNode
            application endpoint SocketAddress_DebugNode_UDP_AEP: network-endpoint=SocketAddress_DebugNode_NEP, tp-configuration=udp-tp=udp-tp-port=port-number=60000
          SocketAddress_TestNode_TCP: connector=Conn_EcuTestNode
            application endpoint SocketAddress_TestNode_TCP_AEP: network-endpoint=SocketAddress_TestNode_NEP, tp-configuration=tcp-tp=tcp-tp-port=port-number=50020
          SocketAddress_TestNode_UDP: connector=Conn_EcuTestNode
            application endpoint SocketAddress_TestNode_UDP_AEP: network-endpoint=SocketAddress_TestNode_NEP, tp-configuration=udp-tp=udp-tp-port=port-number=50000
package /EthSystem/ECUINSTANCES
  ecu instance DebugNode: com-configuration-gw-time-base=0.005, com-configuration-rx-time-base=0.005, com-configuration-tx-time-base=0.005, sleep-mode-supported=false, wake-up-over-bus-supported=false
    ethernet communication controller DebugNode: maximum-receive-buffer-length=1500, maximum-transmit-buffer-length=1500
    ethernet communication connector Conn_DebugNode: comm-controller=DebugNode, network-endpoint=SocketAddress_DebugNode_NEP
  ecu instance EcuTestNode: com-configuration-gw-time-base=0.005, com-configuration-rx-time-base=0.005, com-configuration-tx-time-base=0.005, sleep-mode-supported=false, wake-up-over-bus-supported=false
    ethernet communication controller EcuTestNode: maximum-receive-buffer-length=1500, maximum-transmit-buffer-length=1500
    ethernet communication connector Conn_EcuTestNode: comm-controller=EcuTestNode, network-endpoint=SocketAddress_TestNode_NEP
package /EthSystem/FRAMES
  ethernet frame Pdu_CounterIn: frame-length=1
    pdu to frame mapping PduToFrame_Pdu_CounterIn_0: packing-byte-order=little-endian, pdu=Pdu_CounterIn, start-position=0
  ethernet frame Pdu_CounterOut: frame-length=1
    pdu to frame mapping PduToFrame_Pdu_CounterOut_0: packing-byte-order=little-endian, pdu=Pdu_CounterOut, start-position=0
package /EthSystem/PDUS
  pdu Pdu_CounterIn: length=1, transmission-mode-condition{data-filter=data-filter-type=ALWAYS, i-signal-in-i-pdu=CounterIn}, transmission-mode-true-timing=event-controlled-timing={number-of-repetitions=1, repetition-period=1.0}, unused-bit-pattern=0
    signal CounterIn: start 0, 8 bit, little-endian, data-type-policy=PORT-INTERFACE-DEFINITION, implementation-data-type=uint8, to EcuTestNode
  pdu Pdu_DummyIn: length=1, transmission-mode-condition{data-filter=data-filter-type=ALWAYS, i-signal-in-i-pdu=DummyIn}, transmission-mode-true-timing=event-controlled-timing={number-of-repetitions=1, repetition-period=1.0}, unused-bit-pattern=0
    signal DummyIn: start 0, 16 bit, little-endian, data-type-policy=PORT-INTERFACE-DEFINITION, implementation-data-type=uint16, to DebugNode
  pdu Pdu_CounterOut: length=1, transmission-mode-condition{data-filter=data-filter-type=ALWAYS, i-signal-in-i-pdu=CounterOut}, transmission-mode-true-timing=event-controlled-timing={number-of-repetitions=1, repetition-period=1.0}, unused-bit-pattern=0
    signal CounterOut: start 0, 8 bit, little-endian, data-type-policy=PORT-INTERFACE-DEFINITION, implementation-data-type=uint8, to DebugNode
  pdu Pdu_DummyOut: length=1, transmission-mode-condition{data-filter=data-filter-type=ALWAYS, i-signal-in-i-pdu=DummyOut}, transmission-mode-true-timing=event-controlled-timing={number-of-repetitions=1, repetition-period=1.0}, unused-bit-pattern=0
    signal DummyOut: start 0, 16 bit, little-endian, data-type-policy=PORT-INTERFACE-DEFINITION, implementation-data-type=uint16, to EcuTestNode
  n pdu Pdu_DummyNPDU: length=1
