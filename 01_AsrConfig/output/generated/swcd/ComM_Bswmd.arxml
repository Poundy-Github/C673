AUTOSAR XML (schema 4-2-1)
package /AUTOSAR_ComM/BswModuleDescriptions
  bsw module description ComM: module-id=12, provided-entrys=[ComM_MainFunction_0, ComM_MainFunction_1]
    bsw internal behavior InternalBehavior_0
      exclusive area SCHM_COMM_EXCLUSIVE_AREA_0
      bsw schedulable entity ComM_MainFunction_0: can-enter-exclusive-area=SCHM_COMM_EXCLUSIVE_AREA_0, implemented-entry=ComM_MainFunction_0
      bsw schedulable entity ComM_MainFunction_1: can-enter-exclusive-area=SCHM_COMM_EXCLUSIVE_AREA_0, implemented-entry=ComM_MainFunction_1
      bsw timing event TimingEvent_MainFunction_0: starts-on-event=ComM_MainFunction_0, period=0.02
      bsw timing event TimingEvent_MainFunction_1: starts-on-event=ComM_MainFunction_1, period=0.02
package /AUTOSAR_ComM/BswModuleEntrys
  bsw module entry ComM_MainFunction_0: service-id=96, is-reentrant=false, is-synchronous=true, call-type=SCHEDULED, execution-context=TASK, sw-service-impl-policy=STANDARD
  bsw module entry ComM_MainFunction_1: service-id=96, is-reentrant=false, is-synchronous=true, call-type=SCHEDULED, execution-context=TASK, sw-service-impl-policy=STANDARD
package /AUTOSAR_ComM/SwcBswMappings
  swc bsw mapping SwcBswMapping_0: bsw-behavior=InternalBehavior_0, swc-behavior=SwcInternalBehavior_0
    runnable-mappings:
      bsw-entity=ComM_MainFunction_0, swc-runnable=RE_Main_0
      bsw-entity=ComM_MainFunction_1, swc-runnable=RE_Main_1
package /EB_ComM/Implementations
  bsw implementation BswImplementation_0: programming-language=C, sw-version=5.19.8, swc-bsw-mapping=SwcBswMapping_0, vendor-id=1, ar-release-version=4.1.3, behavior=InternalBehavior_0, vendor-specific-module-def=ComM
    code-descriptors:
      code Files
        artifact-descriptors:
          short-label=Autosar::include::ComM.h, category=SWHDR
          short-label=Autosar::include::ComM_BSW.h, category=SWHDR
          short-label=Autosar::include::ComM_BSW_Cfg.h, category=SWHDR
          short-label=Autosar::include::ComM_BSW_Types.h, category=SWHDR
          short-label=Autosar::include::ComM_BusSm.h, category=SWHDR
          short-label=Autosar::include::ComM_Dcm.h, category=SWHDR
          short-label=Autosar::include::ComM_EcuMBswM.h, category=SWHDR
          short-label=Autosar::include::ComM_Hsm.h, category=SWHDR
          short-label=Autosar::include::ComM_HsmCfg.h, category=SWHDR
          short-label=Autosar::include::ComM_HsmComM.h, category=SWHDR
          short-label=Autosar::include::ComM_HsmComMInt.h, category=SWHDR
          short-label=Autosar::include::ComM_HsmComMPnc.h, category=SWHDR
          short-label=Autosar::include::ComM_HsmComMPncInt.h, category=SWHDR
          short-label=Autosar::include::ComM_Int.h, category=SWHDR
          short-label=Autosar::include::ComM_Nm.h, category=SWHDR
          short-label=Autosar::include::ComM_Trace.h, category=SWHDR
          short-label=Autosar::include::ComM_Trace_Internal.h, category=SWHDR
          short-label=Autosar::include::ComM_Types.h, category=SWHDR
          short-label=Autosar::include::ComM_Version.h, category=SWHDR
          short-label=Autosar::src::ComM.c, category=SWSRC
          short-label=Autosar::src::ComM_ASR32_Rte.c, category=SWSRC
          short-label=Autosar::src::ComM_ASR40_Rte.c, category=SWSRC
          short-label=Autosar::src::ComM_Hsm.c, category=SWSRC
          short-label=Autosar::src::ComM_HsmComMData.c, category=SWSRC
          short-label=Autosar::src::ComM_HsmComMFnct.c, category=SWSRC
          short-label=Autosar::src::ComM_HsmComMPncData.c, category=SWSRC
          short-label=Autosar::src::ComM_HsmComMPncFnct.c, category=SWSRC
          short-label=Autosar::src::ComM_Rte.c, category=SWSRC
    resource consumption ResourceConsumption
      13 x memory section:
        VAR_CLEARED_16: alignment=16, sw-addrmethod=VAR_CLEARED
        VAR_INIT_16: alignment=16, sw-addrmethod=VAR
        VAR_INIT_8: alignment=8, sw-addrmethod=VAR
        CONST_32: alignment=32, sw-addrmethod=CONST
        CONST_16: alignment=16, sw-addrmethod=CONST
        CONST_8: alignment=8, sw-addrmethod=CONST
        VAR_CLEARED_8: alignment=8, sw-addrmethod=VAR_CLEARED
        VAR_CLEARED_UNSPECIFIED: alignment=UNSPECIFIED, sw-addrmethod=VAR_CLEARED
        VAR_INIT_UNSPECIFIED: alignment=UNSPECIFIED, sw-addrmethod=VAR
        VAR_POWER_ON_CLEARED_UNSPECIFIED: alignment=UNSPECIFIED, sw-addrmethod=VAR_POWER_ON_CLEARED
        CONFIG_DATA_UNSPECIFIED: alignment=UNSPECIFIED, sw-addrmethod=CONFIG_DATA
        CONST_UNSPECIFIED: alignment=UNSPECIFIED, sw-addrmethod=CONST
        CODE: sw-addrmethod=CODE
