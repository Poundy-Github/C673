entry &CORENAME &HAS_CORE_R7
global &gCORENAME &gBASEPATH &gPROJECTNAME &gPLATFORM &gHAS_CORE_R7

&gCORENAME="&CORENAME"
&gBASEPATH="../.."
&gPROJECTNAME="mfc520"
&gPLATFORM="rcar_v3m"
&gHAS_CORE_R7="&HAS_CORE_R7"

do &(gBASEPATH)\common\init.cmm
