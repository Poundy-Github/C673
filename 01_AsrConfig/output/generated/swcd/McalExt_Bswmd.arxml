AUTOSAR XML (schema 4-0-3)
package /AUTOSAR_McalExt/BswModuleDescriptions
  bsw module description McalExt: module-id=1000, provided-entrys=McalExt_Init
    bsw internal behavior InternalBehavior_0
      bsw called entity McalExt_Init: implemented-entry=McalExt_Init
package /AUTOSAR_McalExt/SwAddrMethods_McalExt
  9 x sw addr method, all with memory-allocation-keyword-policy=ADDR-METHOD-SHORT-NAME:
    CODE_QM_LOCAL: options=coreLocal, section-type=CODE
    CONFIG_DATA_ASIL_B_LOCAL: options=[safetyAsilB, coreLocal], section-initialization-policy=INIT, section-type=VAR
    CONST_LOCAL: options=coreLocal, section-initialization-policy=INIT, section-type=VAR
    CONFIG_DATA_LOCAL: options=coreLocal, section-initialization-policy=INIT, section-type=VAR
    CONST_ASIL_B_LOCAL: options=[safetyAsilB, coreLocal], section-initialization-policy=INIT, section-type=VAR
    CONST_QM_LOCAL: options=coreLocal, section-initialization-policy=INIT, section-type=VAR
    WRITEERASE_CODE_QM_LOCAL: options=coreLocal, section-initialization-policy=INIT, section-type=CODE
    CONST_QM_LOCAL_8: options=coreLocal, section-initialization-policy=INIT, section-type=VAR
    CONST_QM_LOCAL_32: options=coreLocal, section-initialization-policy=INIT, section-type=VAR
package /AUTOSAR_McalExt/BswModuleEntrys
  bsw module entry McalExt_Init: service-id=1000, is-reentrant=false, is-synchronous=true, call-type=REGULAR, execution-context=UNSPECIFIED, sw-service-impl-policy=STANDARD
package /McalExt_TS_T16D27M1I0R0/Implementations
  bsw implementation BswImplementation_0: programming-language=C, sw-version=1.0.0, vendor-id=1, ar-release-version=4.0.3, behavior=InternalBehavior_0, vendor-specific-module-def=McalExt
    code-descriptors:
      code Files
        artifact-descriptors:
          short-label=make::McalExt_defs.mak, category=SWMAKE
          short-label=make::McalExt_rules.mak, category=SWMAKE
    resource consumption ResourceConsumption
      memory section RESOURCEM_CODE: prefix=RESOURCEM, sw-addrmethod=CODE, symbol=CODE
      section name prefix RESOURCEM
