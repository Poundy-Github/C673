AUTOSAR XML (schema 4-0-3)
package /AUTOSAR_Wdg/BswModuleDescriptions
  bsw module description Wdg_17_Scu: module-id=102, provided-entrys=Wdg_17_Scu_Init
    bsw internal behavior InternalBehavior_0
      exclusive area CpuEndInit
      exclusive area TimerHandling
      bsw called entity Wdg_17_Scu_Init: can-enter-exclusive-area=[CpuEndInit, TimerHandling], implemented-entry=Wdg_17_Scu_Init
package /AUTOSAR_Wdg/BswModuleEntrys
  bsw module entry Wdg_17_Scu_Init: service-id=1000, is-reentrant=false, is-synchronous=true, call-type=REGULAR, execution-context=UNSPECIFIED, sw-service-impl-policy=STANDARD
package /Wdg_Aurix2GAS422/Implementations
  bsw implementation BswImplementation_0: programming-language=C, sw-version=20.0.1, vendor-id=17, ar-release-version=4.2.2, behavior=InternalBehavior_0, vendor-specific-module-def=Wdg
    code-descriptors:
      code Files: artifact-descriptors=[{short-label=make::Wdg_defs.mak, category=SWMAKE}, {short-label=make::Wdg_rules.mak, category=SWMAKE}]
    resource consumption ResourceConsumption
      16 x memory section, all with options=safetyAsilB, prefix=WDG_17_SCU:
        VAR_CLEARED_ASIL_B_GLOBAL_32: alignment=32, sw-addrmethod=VAR_CLEARED_ASIL_B
        CONST_ASIL_B_GLOBAL_UNSPECIFIED: alignment=UNSPECIFIED, sw-addrmethod=CONST_ASIL_B
        CONFIG_DATA_ASIL_B_CORE{0..5}_UNSPECIFIED: alignment=UNSPECIFIED, sw-addrmethod=CONFIG_DATA_ASIL_B
        VAR_CLEARED_ASIL_B_CORE{0..5}_UNSPECIFIED: alignment=UNSPECIFIED, sw-addrmethod=VAR_CLEARED_ASIL_B
        CODE_ASIL_B_GLOBAL: alignment=UNSPECIFIED, sw-addrmethod=CODE_ASIL_B
        CODE_FAST_ASIL_B_GLOBAL: alignment=UNSPECIFIED, sw-addrmethod=CODE_ASIL_B
      section name prefix WDG_17_SCU
