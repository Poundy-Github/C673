AUTOSAR XML (schema 00045)
package /Swc_PortInterface
  mode switch interface BswMMode: is-service=true
    mode group CurrentMode: type=BswMModeGroup
  mode switch interface BswM_Cross_Core: is-service=true
    mode group proto_BSWM_ModeGroupCrossCore: type=BSWM_ModeGroupCrossCore
  14 x client server interface:
    CDD_MTSI_Cbk_IF
      operation CDD_MTSI_Callback: fire-and-forget=false
    CSI_CdmBlockOp
      operation Cdm_GetErrorStatus: fire-and-forget=false
        arg BlockId: type=uint16, direction=IN, server-argument-impl-policy=USE-ARGUMENT-TYPE
        arg RequestResultPtr: type=NvM_RequestResultType, direction=OUT, server-argument-impl-policy=USE-ARGUMENT-TYPE
      operation Cdm_ReadBlock: fire-and-forget=false, possible-error=CSI_CdmBlockOp/E_NOT_OK
        arg BlockId: type=uint16, direction=IN, server-argument-impl-policy=USE-ARGUMENT-TYPE
        arg NvM_DstPtr: type=VoidPtr, direction=IN, server-argument-impl-policy=USE-ARGUMENT-TYPE
      operation Cdm_WriteBlock: fire-and-forget=false, possible-error=CSI_CdmBlockOp/E_NOT_OK
        arg BlockId: type=uint16, direction=IN, server-argument-impl-policy=USE-ARGUMENT-TYPE
        arg DstPtr: type=ConstVoidPtr, direction=IN, server-argument-impl-policy=USE-ARGUMENT-TYPE
      error E_NOT_OK: error-code=1
    CSI_Cpr_RxMessageState
      operation Get_RxMsgStatus: fire-and-forget=false, possible-error=[CSI_Cpr_RxMessageState/E_NOT_OK, CSI_Cpr_RxMessageState/E_OK]
        arg Cpr_RxMessageId: type=Cpr_RxMsg_ID, direction=IN, server-argument-impl-policy=USE-ARGUMENT-TYPE
        arg Cpr_MessageStatus: type=Cpr_Msg_State, direction=OUT, server-argument-impl-policy=USE-ARGUMENT-TYPE
      error E_NOT_OK: error-code=1
      error E_OK: error-code=0
    CSI_EvAdc_GetValue
      operation GetPhyValue: fire-and-forget=false, possible-error=[E_NOK, CSI_EvAdc_GetValue/E_OK]
        arg value: type=float32_t, direction=INOUT, server-argument-impl-policy=USE-ARGUMENT-TYPE
      operation GetRegValue: fire-and-forget=false, possible-error=[E_NOK, CSI_EvAdc_GetValue/E_OK]
        arg value: type=uint16_t, direction=INOUT, server-argument-impl-policy=USE-ARGUMENT-TYPE
      error E_NOK: error-code=1
      error E_OK: error-code=0
    CSI_IoLevelOp
      15 x operation, all with fire-and-forget=false, possible-error=CSI_IoLevelOp/E_NOT_OK:
        GetIoLevel_Om_PWR_2V9_PG
          arg level: type=boolean, direction=INOUT, server-argument-impl-policy=USE-ARGUMENT-TYPE
        GetIoLevel_Om_RST_B
          arg level: type=boolean, direction=INOUT, server-argument-impl-policy=USE-ARGUMENT-TYPE
        GetIoLevel_Om_VMERRB
          arg level: type=boolean, direction=INOUT, server-argument-impl-policy=USE-ARGUMENT-TYPE
        GetIoLevel_Pmic_FS84_FS0B
          arg level: type=boolean, direction=INOUT, server-argument-impl-policy=USE-ARGUMENT-TYPE
        GetIoLevel_Pmic_FS84_INTB
          arg level: type=boolean, direction=INOUT, server-argument-impl-policy=USE-ARGUMENT-TYPE
        GetIoLevel_Pmic_FS84_PG
          arg level: type=boolean, direction=INOUT, server-argument-impl-policy=USE-ARGUMENT-TYPE
        GetIoLevel_Pmic_PF5024_RST
          arg level: type=boolean, direction=INOUT, server-argument-impl-policy=USE-ARGUMENT-TYPE
        GetIoLevel_Pmic_PF5204_PG
          arg level: type=boolean, direction=INOUT, server-argument-impl-policy=USE-ARGUMENT-TYPE
        GetIoLevel_Pmic_PF5204_PG1
          arg level: type=boolean, direction=INOUT, server-argument-impl-policy=USE-ARGUMENT-TYPE
        GetIoLevel_Pmic_PF5204_PG3
          arg level: type=boolean, direction=INOUT, server-argument-impl-policy=USE-ARGUMENT-TYPE
        GetIoLevel_Pmic_PF8200_EWARN
          arg level: type=boolean, direction=INOUT, server-argument-impl-policy=USE-ARGUMENT-TYPE
        GetIoLevel_Pmic_PF8200_FS0B
          arg level: type=boolean, direction=INOUT, server-argument-impl-policy=USE-ARGUMENT-TYPE
        GetIoLevel_Pmic_PF8200_INTB
          arg level: type=boolean, direction=INOUT, server-argument-impl-policy=USE-ARGUMENT-TYPE
        GetIoLevel_Pmic_PF8200_PG
          arg level: type=boolean, direction=INOUT, server-argument-impl-policy=USE-ARGUMENT-TYPE
        GetIoLevel_Pmic_PF8200_RST
          arg level: type=boolean, direction=INOUT, server-argument-impl-policy=USE-ARGUMENT-TYPE
      error E_NOT_OK: error-code=1
      error E_OK: error-code=0
    CSI_Mtsi_MeasFreezeData
      operation MeasFreezeData: fire-and-forget=false, possible-error=CSI_Mtsi_MeasFreezeData/E_NOT_OK
        4 x arg, all with direction=IN, server-argument-impl-policy=USE-ARGUMENT-TYPE:
          VirtualAddress: type=uint32_t
          FunctionId: type=uint32_t
          Data: type=VoidPtr_t
          Length: type=uint32_t
      error E_NOT_OK: error-code=1
    CSI_Mtsi_UpdateTaskCycle
      operation UpdateTaskCycle: fire-and-forget=false
        arg TaskId: type=uint16_t, direction=IN, server-argument-impl-policy=USE-ARGUMENT-TYPE
    CSI_QsmBlockOp
      operation Qsm_GetErrorStatues: fire-and-forget=false, possible-error=CSI_QsmBlockOp/E_NOT_OK
      operation Qsm_ReadBlock: fire-and-forget=false, possible-error=CSI_QsmBlockOp/E_NOT_OK
        arg QsmDstPtr: type=VoidPtr, direction=IN, server-argument-impl-policy=USE-ARGUMENT-TYPE
        arg Offset: type=uint16, direction=IN, server-argument-impl-policy=USE-ARGUMENT-TYPE
        arg Length: type=uint16, direction=IN, server-argument-impl-policy=USE-ARGUMENT-TYPE
      operation Qsm_WriteBlock: fire-and-forget=false, possible-error=CSI_QsmBlockOp/E_NOT_OK
        arg QsmDstPtr: type=ConstVoidPtr, direction=IN, server-argument-impl-policy=USE-ARGUMENT-TYPE
      error E_NOT_OK: error-code=1
    CSI_Sdc_SendInterface_Calibration
      7 x operation, all with fire-and-forget=false, possible-error=CSI_Sdc_SendInterface_Calibration/E_OK:
        CalibrationFlag_Read
          arg data: type=uint8_t, direction=OUT, server-argument-impl-policy=USE-ARGUMENT-TYPE
          arg length: type=uint16_t, direction=IN, server-argument-impl-policy=USE-ARGUMENT-TYPE
        CameraCaliresultDetails_Read
          arg data: type=uint8_t, direction=OUT, server-argument-impl-policy=USE-ARGUMENT-TYPE
          arg length: type=uint16_t, direction=IN, server-argument-impl-policy=USE-ARGUMENT-TYPE
        CameraValue_Read
          arg data: type=void_t, direction=OUT, server-argument-impl-policy=USE-ARGUMENT-TYPE
          arg length: type=uint16_t, direction=IN, server-argument-impl-policy=USE-ARGUMENT-TYPE
        EOLCalResult_Read
        RequestCalibrationValue
        RequestEOLCalibration
        RequestSDACalibration
      error E_OK: error-code=0
    CSI_Sdc_SendInterface_Diag
      operation SocDiagInfo_Read: fire-and-forget=false, possible-error=CSI_Sdc_SendInterface_Diag/E_OK
        arg group_id: type=uint8_t, direction=IN, server-argument-impl-policy=USE-ARGUMENT-TYPE
        arg socDiagInfo: type=void_t, direction=OUT, server-argument-impl-policy=USE-ARGUMENT-TYPE
      operation SocSysState_Read: fire-and-forget=false, possible-error=CSI_Sdc_SendInterface_Diag/E_OK
        arg data: type=uint8_t, direction=OUT, server-argument-impl-policy=USE-ARGUMENT-TYPE
        arg length: type=uint16_t, direction=IN, server-argument-impl-policy=USE-ARGUMENT-TYPE
      operation UdsRequest: fire-and-forget=false, possible-error=CSI_Sdc_SendInterface_Diag/E_OK
        6 x arg, all with server-argument-impl-policy=USE-ARGUMENT-TYPE:
          serverType: type=uint8_t, direction=IN
          did: type=uint16_t, direction=IN
          inParameter: type=void_t, direction=INOUT
          length_In: type=uint8_t, direction=IN
          OutParam1: type=void_t, direction=OUT
          length_Out: type=uint8_t, direction=IN
      error E_OK: error-code=0
    CSI_Sdc_SendInterface_Eth
      24 x operation, all with fire-and-forget=false, possible-error=CSI_Sdc_SendInterface_Eth/E_OK:
        EthCableDiagnosticInfo_Read
          arg data: type=uint8_t, direction=OUT, server-argument-impl-policy=USE-ARGUMENT-TYPE
          arg length: type=uint16_t, direction=IN, server-argument-impl-policy=USE-ARGUMENT-TYPE
        EthCableDiagnostic_StartRoutine
          arg u_InputData: type=uint8_t, direction=IN, server-argument-impl-policy=USE-ARGUMENT-TYPE
        EthCableFault_Read
          arg data: type=uint8_t, direction=OUT, server-argument-impl-policy=USE-ARGUMENT-TYPE
          arg length: type=uint16_t, direction=IN, server-argument-impl-policy=USE-ARGUMENT-TYPE
        EthCableLengthDiagnosticInfo_Read
          arg data: type=uint8_t, direction=OUT, server-argument-impl-policy=USE-ARGUMENT-TYPE
          arg length: type=uint16_t, direction=IN, server-argument-impl-policy=USE-ARGUMENT-TYPE
        EthCableLengthDiagnostic_StartRoutine
          arg u_InputData: type=uint8_t, direction=IN, server-argument-impl-policy=USE-ARGUMENT-TYPE
        EthCrcError_Read
          arg data: type=uint8_t, direction=OUT, server-argument-impl-policy=USE-ARGUMENT-TYPE
          arg length: type=uint16_t, direction=IN, server-argument-impl-policy=USE-ARGUMENT-TYPE
        EthEnableTestModeInfo_Read
          arg data: type=uint8_t, direction=OUT, server-argument-impl-policy=USE-ARGUMENT-TYPE
          arg length: type=uint16_t, direction=IN, server-argument-impl-policy=USE-ARGUMENT-TYPE
        EthEnableTestMode_StartRoutine
          arg data: type=uint8_t, direction=OUT, server-argument-impl-policy=USE-ARGUMENT-TYPE
          arg length: type=uint16_t, direction=IN, server-argument-impl-policy=USE-ARGUMENT-TYPE
        EthEnableTestMode_StopRoutine
        EthIcmpError_Read
          arg data: type=uint8_t, direction=OUT, server-argument-impl-policy=USE-ARGUMENT-TYPE
          arg length: type=uint16_t, direction=IN, server-argument-impl-policy=USE-ARGUMENT-TYPE
        EthPhyLoopBackTestInfo_Read
          arg data: type=uint8_t, direction=OUT, server-argument-impl-policy=USE-ARGUMENT-TYPE
          arg length: type=uint16_t, direction=IN, server-argument-impl-policy=USE-ARGUMENT-TYPE
        EthPhyLoopBackTest_StartRoutine
          arg data: type=uint8_t, direction=OUT, server-argument-impl-policy=USE-ARGUMENT-TYPE
          arg length: type=uint16_t, direction=IN, server-argument-impl-policy=USE-ARGUMENT-TYPE
        EthPhyLoopBackTest_StopRoutine
        EthReadPhyRegisterInfo_Read
          arg data: type=uint8_t, direction=OUT, server-argument-impl-policy=USE-ARGUMENT-TYPE
          arg length: type=uint16_t, direction=IN, server-argument-impl-policy=USE-ARGUMENT-TYPE
        EthReadPhyRegister_StartRoutine
          arg data: type=uint8_t, direction=OUT, server-argument-impl-policy=USE-ARGUMENT-TYPE
          arg length: type=uint16_t, direction=IN, server-argument-impl-policy=USE-ARGUMENT-TYPE
        EthResetMACAddressInfo_Read
          arg data: type=uint8_t, direction=OUT, server-argument-impl-policy=USE-ARGUMENT-TYPE
          arg length: type=uint16_t, direction=IN, server-argument-impl-policy=USE-ARGUMENT-TYPE
        EthResetMACAddress_StartRoutine
          arg u_InputData: type=uint8_t, direction=IN, server-argument-impl-policy=USE-ARGUMENT-TYPE
        EthResetMACLayerStatisticInfo_Read
          arg data: type=uint8_t, direction=OUT, server-argument-impl-policy=USE-ARGUMENT-TYPE
          arg length: type=uint16_t, direction=IN, server-argument-impl-policy=USE-ARGUMENT-TYPE
        EthResetMACLayerStatistic_StartRoutine
          arg u_InputData: type=uint8_t, direction=IN, server-argument-impl-policy=USE-ARGUMENT-TYPE
        EthResetPortConfigurationInfo_Read
          arg data: type=uint8_t, direction=OUT, server-argument-impl-policy=USE-ARGUMENT-TYPE
          arg length: type=uint16_t, direction=IN, server-argument-impl-policy=USE-ARGUMENT-TYPE
        EthResetPortConfiguration_StartRoutine
        EthSQI_Read
          arg data: type=uint8_t, direction=OUT, server-argument-impl-policy=USE-ARGUMENT-TYPE
          arg length: type=uint16_t, direction=IN, server-argument-impl-policy=USE-ARGUMENT-TYPE
        EthSetPortConfigurationInfo_Read
          arg data: type=uint8_t, direction=OUT, server-argument-impl-policy=USE-ARGUMENT-TYPE
          arg length: type=uint16_t, direction=IN, server-argument-impl-policy=USE-ARGUMENT-TYPE
        EthSetPortConfiguration_StartRoutine
          arg u_InputData: type=uint8_t, direction=IN, server-argument-impl-policy=USE-ARGUMENT-TYPE
      error E_OK: error-code=0
    CSI_Sdc_SendInterface_Perception
      5 x operation, all with fire-and-forget=false, possible-error=CSI_Sdc_SendInterface_Perception/E_OK:
        HostLane_Left_flag_Read
          arg flag: type=uint8_t, direction=OUT, server-argument-impl-policy=USE-ARGUMENT-TYPE
        HostLane_Right_flag_Read
          arg flag: type=uint8_t, direction=OUT, server-argument-impl-policy=USE-ARGUMENT-TYPE
        J3_PerceptionData_Read
          arg perceptionData: type=void_t, direction=OUT, server-argument-impl-policy=USE-ARGUMENT-TYPE
          arg length: type=uint16_t, direction=IN, server-argument-impl-policy=USE-ARGUMENT-TYPE
        Len_to_Left_Lane_Read
          arg wigth: type=sint16_t, direction=OUT, server-argument-impl-policy=USE-ARGUMENT-TYPE
        Len_to_Right_Lane_Read
          arg wigth: type=sint16_t, direction=OUT, server-argument-impl-policy=USE-ARGUMENT-TYPE
      error E_OK: error-code=0
    CSI_Sdc_SendInterface_SocInfo
      7 x operation, all with fire-and-forget=false, possible-error=CSI_Sdc_SendInterface_SocInfo/E_OK:
        PWMState_Read
        RequestBootSensor
        RequestOMSN
        SocBootSensor_Read
          arg data: type=uint8_t, direction=OUT, server-argument-impl-policy=USE-ARGUMENT-TYPE
          arg length: type=uint16_t, direction=IN, server-argument-impl-policy=USE-ARGUMENT-TYPE
        SocCpuInfo_Read
          arg socSystemInfo: type=void_t, direction=INOUT, server-argument-impl-policy=USE-ARGUMENT-TYPE
          arg length: type=uint16_t, direction=IN, server-argument-impl-policy=USE-ARGUMENT-TYPE
        SocOMSN_Read
          arg data: type=uint8_t, direction=OUT, server-argument-impl-policy=USE-ARGUMENT-TYPE
          arg length: type=uint16_t, direction=IN, server-argument-impl-policy=USE-ARGUMENT-TYPE
        SocShutdownReuqest
      error E_OK: error-code=0
    CSI_Sdc_SendInterface_SpiSync
      operation TimeSyncMsg: fire-and-forget=false, possible-error=[CSI_Sdc_SendInterface_SpiSync/E_NOT_OK, CSI_Sdc_SendInterface_SpiSync/E_OK]
        arg data: type=uint8_t, direction=OUT, server-argument-impl-policy=USE-ARGUMENT-TYPE
        arg length: type=uint16_t, direction=IN, server-argument-impl-policy=USE-ARGUMENT-TYPE
      operation TimeSyncUtc: fire-and-forget=false, possible-error=[CSI_Sdc_SendInterface_SpiSync/E_NOT_OK, CSI_Sdc_SendInterface_SpiSync/E_OK]
        arg data: type=uint8_t, direction=OUT, server-argument-impl-policy=USE-ARGUMENT-TYPE
        arg length: type=uint16_t, direction=IN, server-argument-impl-policy=USE-ARGUMENT-TYPE
      error E_NOT_OK: error-code=1
      error E_OK: error-code=0
  mode switch interface CanSM_CurrentMode: is-service=true
    mode group proto_CANSM_ModeGroup: type=CANSM_ModeGroup
  mode switch interface MSI_DiagComControlMode: is-service=true
    mode group proto_DcmCommunicationControl: type=DcmCommunicationControl
  mode switch interface MSI_IPduGroupSwitch: is-service=true
    mode group proto_MDG_IPduGroupSwitch: type=MDG_IPduGroupSwitch
  100 x sender receiver interface:
    SRI_ARSObjectList
      data ARSObjectList: type=EM_t_ARSObjectList
    SRI_AbdOutputData
      data AbdOutputData_t: type=AbdOutputData_t
    SRI_AccLeverData
      data AccLeverData: type=AccLeverInput_t
    SRI_AdcValue
      data AdcValue: sw-calibration-access=READ-ONLY, type=s_AdcValue_t
    SRI_AlgoCompState
      data AlgoCompState: type=AlgoCompState_t
    SRI_BaseCtrlData
      data BaseCtrlData: type=BaseCtrlData_t
    SRI_BcmPwrStsFbON
      data DE_BcmPwrStsFbON: type=uint8
    SRI_BswAlgoParameters
      data BswAlgoParameters: type=BSW_s_AlgoParameters_t
    SRI_CB_t_ProvidedOutputs
      data CB_t_ProvidedOutputs_t: type=CB_t_ProvidedOutputs_t
    SRI_CB_t_ProvidedOutputs_t
      data CB_t_ProvidedOutputs_t: type=CB_t_ProvidedOutputs_t
    SRI_CPAR_HLAF_Parameter
      data CPAR_HLAF_Parameter_t: type=CPAR_HLAF_Parameter_t
    SRI_CPAR_TSA_RTE_parameters
      data CPAR_TSA_RTE_parameters_t: type=CPAR_TSA_RTE_parameters_t
    SRI_CamLaneInputData
      data CamLaneInputData: sw-calibration-access=READ-ONLY, type=t_CamLaneInputData
    SRI_CamSLAInputData
      data CamSlaInputData: type=CamSLAInputData_t
    SRI_CdcTotMilg
      data DE_CdcTotMilg: type=uint32
    SRI_Cpr_Rxsginal_Adas
      86 x data:
        ACCMode: type=Com_Receive_ACCMode, init-value=0
        ACCMode_Status: type=Com_Receive_ACCMode_Status
        FR_RadarFailureStatus: type=Com_Receive_FR_RadarFailureStatus
        FR_RadarFailureStatus_Status: type=Com_Receive_FR_RadarFailureStatus_Status
        FRadarCalibrationStatus: type=Com_Receive_FRadarCalibrationStatus
        FRadarCalibrationStatus_Status: type=Com_Receive_FRadarCalibrationStatus_Status
        RadarObj1_Dx: type=Com_Receive_RadarObj1_Dx, init-value=0
        RadarObj1_Dx_Status: type=Com_SignalSts_t, init-value=E_SIG_STATUS_NONE
        RadarObj1_Dy: type=Com_Receive_RadarObj1_Dy, init-value=0
        RadarObj1_Dy_Status: type=Com_SignalSts_t
        RadarObj1_ExistProb: type=Com_Receive_RadarObj1_ExistProb, init-value=0
        RadarObj1_ExistProb_Status: type=Com_SignalSts_t, init-value=E_SIG_STATUS_NONE
        RadarObj1_Length: type=Com_Receive_RadarObj1_Length, init-value=0
        RadarObj1_Length_Status: type=Com_SignalSts_t, init-value=E_SIG_STATUS_NONE
        RadarObj1_Location: type=Com_Receive_RadarObj1_Location, init-value=0
        RadarObj1_Location_Status: type=Com_SignalSts_t, init-value=E_SIG_STATUS_NONE
        RadarObj1_Measured: type=Com_Receive_RadarObj1_Measured, init-value=0
        RadarObj1_Measured_Status: type=Com_SignalSts_t, init-value=E_SIG_STATUS_NONE
        RadarObj1_RelAx: type=Com_Receive_RadarObj1_RelAx, init-value=0
        RadarObj1_RelAx_Status: type=Com_SignalSts_t, init-value=E_SIG_STATUS_NONE
        RadarObj1_RelVx: type=Com_Receive_RadarObj1_RelVx, init-value=0
        RadarObj1_RelVx_Status: type=Com_SignalSts_t, init-value=E_SIG_STATUS_NONE
        RadarObj1_RelVy: type=Com_Receive_RadarObj1_RelVy, init-value=0
        RadarObj1_RelVy_Status: type=Com_SignalSts_t, init-value=E_SIG_STATUS_NONE
        RadarObj1_Width: type=Com_Receive_RadarObj1_Width
        RadarObj1_Width_Status: type=Com_Receive_RadarObj1_Width_Status
        RadarObj2_Dx: type=Com_Receive_RadarObj2_Dx, init-value=0
        RadarObj2_Dx_Status: type=Com_SignalSts_t, init-value=E_SIG_STATUS_NONE
        RadarObj2_Dy: type=Com_Receive_RadarObj2_Dy, init-value=0
        RadarObj2_Dy_Status: type=Com_SignalSts_t, init-value=E_SIG_STATUS_NONE
        RadarObj2_ExistProb: type=Com_Receive_RadarObj2_ExistProb, init-value=0
        RadarObj2_ExistProb_Status: type=Com_SignalSts_t, init-value=E_SIG_STATUS_NONE
        RadarObj2_Length: type=Com_Receive_RadarObj2_Length, init-value=0
        RadarObj2_Length_Status: type=Com_SignalSts_t, init-value=E_SIG_STATUS_NONE
        RadarObj2_Location: type=Com_Receive_RadarObj2_Location, init-value=0
        RadarObj2_Location_Status: type=Com_SignalSts_t, init-value=E_SIG_STATUS_NONE
        RadarObj2_Measured: type=Com_Receive_RadarObj2_Measured, init-value=0
        RadarObj2_Measured_Status: type=Com_SignalSts_t, init-value=E_SIG_STATUS_NONE
        RadarObj2_RelAx: type=Com_Receive_RadarObj2_RelAx, init-value=0
        RadarObj2_RelAx_Status: type=Com_SignalSts_t, init-value=E_SIG_STATUS_NONE
        RadarObj2_RelVx: type=Com_Receive_RadarObj2_RelVx, init-value=0
        RadarObj2_RelVx_Status: type=Com_SignalSts_t, init-value=E_SIG_STATUS_NONE
        RadarObj2_RelVy: type=Com_Receive_RadarObj2_RelVy, init-value=0
        RadarObj2_RelVy_Status: type=Com_SignalSts_t, init-value=E_SIG_STATUS_NONE
        RadarObj2_Width: type=Com_Receive_RadarObj2_Width
        RadarObj2_Width_Status: type=Com_Receive_RadarObj2_Width_Status
        RadarObj3_Dx: type=Com_Receive_RadarObj3_Dx, init-value=0
        RadarObj3_Dx_Status: type=Com_SignalSts_t, init-value=E_SIG_STATUS_NONE
        RadarObj3_Dy: type=Com_Receive_RadarObj3_Dy, init-value=0
        RadarObj3_Dy_Status: type=Com_SignalSts_t, init-value=E_SIG_STATUS_NONE
        RadarObj3_ExistProb: type=Com_Receive_RadarObj3_ExistProb, init-value=0
        RadarObj3_ExistProb_Status: type=Com_SignalSts_t, init-value=E_SIG_STATUS_NONE
        RadarObj3_Length: type=Com_Receive_RadarObj3_Length, init-value=0
        RadarObj3_Length_Status: type=Com_SignalSts_t, init-value=E_SIG_STATUS_NONE
        RadarObj3_Location: type=Com_Receive_RadarObj3_Location, init-value=0
        RadarObj3_Location_Status: type=Com_SignalSts_t, init-value=E_SIG_STATUS_NONE
        RadarObj3_Measured: type=Com_Receive_RadarObj3_Measured, init-value=0
        RadarObj3_Measured_Status: type=Com_SignalSts_t, init-value=E_SIG_STATUS_NONE
        RadarObj3_RelAx: type=Com_Receive_RadarObj3_RelAx, init-value=0
        RadarObj3_RelAx_Status: type=Com_SignalSts_t, init-value=E_SIG_STATUS_NONE
        RadarObj3_RelVx: type=Com_Receive_RadarObj3_RelVx, init-value=0
        RadarObj3_RelVx_Status: type=Com_SignalSts_t, init-value=E_SIG_STATUS_NONE
        RadarObj3_RelVy: type=Com_Receive_RadarObj3_RelVy, init-value=0
        RadarObj3_RelVy_Status: type=Com_SignalSts_t, init-value=E_SIG_STATUS_NONE
        RadarObj3_Width: type=Com_Receive_RadarObj3_Width
        RadarObj3_Width_Status: type=Com_Receive_RadarObj3_Width_Status
        RadarObj4_Dx: type=Com_Receive_RadarObj4_Dx, init-value=0
        RadarObj4_Dx_Status: type=Com_SignalSts_t, init-value=E_SIG_STATUS_NONE
        RadarObj4_Dy: type=Com_Receive_RadarObj4_Dy, init-value=0
        RadarObj4_Dy_Status: type=Com_SignalSts_t, init-value=E_SIG_STATUS_NONE
        RadarObj4_ExistProb: type=Com_Receive_RadarObj4_ExistProb, init-value=0
        RadarObj4_ExistProb_Status: type=Com_SignalSts_t, init-value=E_SIG_STATUS_NONE
        RadarObj4_Length: type=Com_Receive_RadarObj4_Length, init-value=0
        RadarObj4_Length_Status: type=Com_SignalSts_t, init-value=E_SIG_STATUS_NONE
        RadarObj4_Location: type=Com_Receive_RadarObj4_Location, init-value=0
        RadarObj4_Location_Status: type=Com_SignalSts_t, init-value=E_SIG_STATUS_NONE
        RadarObj4_Measured: type=Com_Receive_RadarObj4_Measured, init-value=0
        RadarObj4_Measured_Status: type=Com_SignalSts_t, init-value=E_SIG_STATUS_NONE
        RadarObj4_RelAx: type=Com_Receive_RadarObj4_RelAx, init-value=0
        RadarObj4_RelAx_Status: type=Com_SignalSts_t, init-value=E_SIG_STATUS_NONE
        RadarObj4_RelVx: type=Com_Receive_RadarObj4_RelVx, init-value=0
        RadarObj4_RelVx_Status: type=Com_SignalSts_t, init-value=E_SIG_STATUS_NONE
        RadarObj4_RelVy: type=Com_Receive_RadarObj4_RelVy, init-value=0
        RadarObj4_RelVy_Status: type=Com_SignalSts_t, init-value=E_SIG_STATUS_NONE
        RadarObj4_Width: type=Com_Receive_RadarObj4_Width
        RadarObj4_Width_Status: type=Com_Receive_RadarObj4_Width_Status
    SRI_Cpr_Rxsginal_Body
      44 x data:
        ACC_HostLaneLeftStatus: type=Com_Receive_ACC_HostLaneLeftStatus, init-value=0
        ACC_HostLaneRightStatus: type=Com_Receive_ACC_HostLaneRightStatus, init-value=0
        AccIaccHWAMode: type=Com_Receive_AccIaccHWAMode, init-value=0
        AccIaccHWAMode_Status: type=Com_SignalSts_t, init-value=E_SIG_STATUS_NONE
        BCM_BrakeLampError: type=Com_Receive_BCM_BrakeLampError
        BCM_BrakeLampError_Status: type=Com_Receive_BCM_BrakeLampError_Status
        BCM_TurnLightSwitchSts: type=Com_Receive_BCM_TurnLightSwitchSts, init-value=0
        BCM_TurnLightSwitchSts_Status: type=Com_SignalSts_t, init-value=E_SIG_STATUS_NONE
        BcmAutHeadLiSts: type=Com_Receive_BcmAutHeadLiSts, init-value=0
        BcmAutHeadLiSts_Status: type=Com_SignalSts_t, init-value=E_SIG_STATUS_NONE
        BcmDrvrDoorSts: type=Com_Receive_BcmDrvrDoorSts, init-value=0
        BcmDrvrDoorSts_Status: type=Com_SignalSts_t, init-value=E_SIG_STATUS_NONE
        BcmEmgyLiSts: type=Com_Receive_BcmEmgyLiSts, init-value=0
        BcmEmgyLiSts_Status: type=Com_Receive_BcmEmgyLiSts_Status, init-value=E_SIG_STATUS_NONE
        BcmFrntFogLmpSts: type=Com_Receive_BcmFrntFogLmpSts, init-value=0
        BcmFrntFogLmpSts_Status: type=Com_SignalSts_t, init-value=E_SIG_STATUS_NONE
        BcmFrntWiperSts: type=Com_Receive_BcmFrntWiperSts, init-value=0
        BcmFrntWiperSts_Status: type=Com_SignalSts_t, init-value=E_SIG_STATUS_NONE
        BcmHiBeamSts: type=Com_Receive_BcmHiBeamSts, init-value=0
        BcmHiBeamSts_Status: type=Com_SignalSts_t, init-value=E_SIG_STATUS_NONE
        BcmLeReDoorSts: type=Com_Receive_BcmLeReDoorSts, init-value=0
        BcmLeReDoorSts_Status: type=Com_SignalSts_t, init-value=E_SIG_STATUS_NONE
        BcmLoBeamSts: type=Com_Receive_BcmLoBeamSts, init-value=0
        BcmLoBeamSts_Status: type=Com_SignalSts_t, init-value=E_SIG_STATUS_NONE
        BcmPassDoorSts: type=Com_Receive_BcmPassDoorSts, init-value=0
        BcmPassDoorSts_Status: type=Com_SignalSts_t, init-value=E_SIG_STATUS_NONE
        BcmReFoglmpSts: type=Com_Receive_BcmReFoglmpSts, init-value=0
        BcmReFoglmpSts_Status: type=Com_SignalSts_t, init-value=E_SIG_STATUS_NONE
        BcmRiReDoorSts: type=Com_Receive_BcmRiReDoorSts, init-value=0
        BcmRiReDoorSts_Status: type=Com_SignalSts_t, init-value=E_SIG_STATUS_NONE
        BcmTurnIndcrLe: type=Com_Receive_BcmTurnIndcrLe, init-value=0
        BcmTurnIndcrLe_Status: type=Com_SignalSts_t, init-value=E_SIG_STATUS_NONE
        BcmTurnIndcrRi: type=Com_Receive_BcmTurnIndcrRi, init-value=0
        BcmTurnIndcrRi_Status: type=Com_Receive_BcmTurnIndcrRi, init-value=0
        IP_DISFail: type=Com_Receive_IP_DISFail
        IP_DISFail_Status: type=Com_Receive_IP_DISFail_Status
        IP_QDashACCFail: type=Com_Receive_IP_QDashACCFail, init-value=0
        IP_QDashACCFail_Status: type=Com_SignalSts_t, init-value=E_SIG_STATUS_NONE
        SrsDrvrBucSwtSts: type=Com_Receive_SrsDrvrBucSwtSts, init-value=0
        SrsDrvrBucSwtSts_Status: type=Com_SignalSts_t, init-value=E_SIG_STATUS_NONE
        SrsPassBucSwtSts: type=Com_Receive_SrsPassBucSwtSts, init-value=0
        SrsPassBucSwtSts_Status: type=Com_SignalSts_t, init-value=E_SIG_STATUS_NONE
        TmsFrntBlowMod: type=Com_Receive_TmsFrntBlowMod, init-value=0
        TmsFrntBlowMod_Status: type=Com_SignalSts_t, init-value=E_SIG_STATUS_NONE
    SRI_Cpr_Rxsginal_Chassisd
      94 x data:
        AdsUDLCStatus: type=Com_Receive_AdsUDLCStatus, init-value=0
        AdsUDLCStatus_Status: type=Com_Receive_AdsUDLCStatus_Status, init-value=E_SIG_STATUS_NONE
        BrakePressureSimulator: type=Com_Receive_BrakePressureSimulator, init-value=0
        BrakePressureSimulator_Status: type=Com_Receive_BrakePressureSimulator_Status, init-value=E_SIG_STATUS_NONE
        EPS_APA_EpasFAILED: type=Com_Receive_EPS_APA_EpasFAILED
        EPS_APA_EpasFAILED_Status: type=Com_Receive_EPS_APA_EpasFAILED_Status
        EPS_ActualMotorTorq: type=Com_Receive_EPS_ActualMotorTorq
        EPS_ActualMotorTorq_Status: type=Com_Receive_EPS_ActualMotorTorq_Status
        EPS_ActualTorsionBarTorq: type=Com_Receive_EPS_ActualTorsionBarTorq
        EPS_ActualTorsionBarTorq_Status: type=Com_Receive_EPS_ActualTorsionBarTorq_Status
        EPS_MeasuredTorsionBarTorqValid: type=Com_Receive_EPS_MeasuredTorsionBarTorqValid
        EPS_Pinionang_Valid: type=Com_Receive_EPS_Pinionang_Valid
        EPS_fault_state: type=Com_Receive_EPS_fault_state
        EPS_fault_state_Status: type=Com_Receive_EPS_fault_state_Status
        ESP_LatAccelValid: type=Com_Receive_ESP_LatAccelValid
        ESP_LongAccelValid: type=Com_Receive_ESP_LongAccelValid
        ESP_YawRateValid: type=Com_Receive_ESP_YawRateValid
        EpsConcussAvailabilityStatus: type=Com_Receive_EpsConcussAvailabilityStatus, init-value=0
        EpsConcussAvailabilityStatus_Status: type=Com_Receive_EpsConcussAvailabilityStatus_Status, init-value=E_SIG_STATUS_NONE
        EpsFaild: type=Com_Receive_EpsFaild
        EpsFaild_Status: type=Com_Receive_EpsFaild_Status
        EpsIACCabortreason: type=Com_Receive_EpsIACCabortreason, init-value=0
        EpsIACCabortreason_Status: type=Com_SignalSts_t, init-value=E_SIG_STATUS_NONE
        EpsLatCtrlActive: type=Com_Receive_EpsLatCtrlActive, init-value=0
        EpsLatCtrlActive_Status: type=Com_SignalSts_t, init-value=E_SIG_STATUS_NONE
        EpsLatCtrlAvailabilityStatus: type=Com_SignalSts_t, init-value=E_SIG_STATUS_NONE
        EpsLatCtrlAvailabilityStatus_Status: type=Com_SignalSts_t, init-value=E_SIG_STATUS_NONE
        EpsMeasuredTorsionBarTorq_Status: type=Com_SignalSts_t, init-value=E_SIG_STATUS_NONE
        EpsMeasuredTorsionBarTorque: type=Com_Receive_EpsMeasuredTorsionBarTorque, init-value=0
        EpsMeasuredTorsionBarTorque_Status: type=Com_SignalSts_t, init-value=E_SIG_STATUS_NONE
        EpsPinionang: type=Com_Receive_EpsPinionang, init-value=0
        EpsPinionang_Status: type=Com_SignalSts_t, init-value=E_SIG_STATUS_NONE
        EpsSasCalSts: type=Com_Receive_EpsSasCalSts
        EpsSasCalSts_Status: type=Com_Receive_EpsSasCalSts_Status
        EpsSasSteerAg: type=Com_Recevie_EpsSasSteerAg, init-value=0
        EpsSasSteerAgVld: type=Com_Receive_EpsSasSteerAgVld
        EpsSasSteerAg_Status: type=Com_SignalSts_t, init-value=E_SIG_STATUS_NONE
        EpsSteerAgRate: type=Com_Receive_EpsSteerAgRate, init-value=0
        EpsSteerAgRate_Status: type=Com_SignalSts_t, init-value=E_SIG_STATUS_NONE
        EpsSteerAgSensFilr: type=Com_Receive_EpsSteerAgSensFilr, init-value=0
        EpsSteerAgSensFilr_Status: type=Com_SignalSts_t, init-value=E_SIG_STATUS_NONE
        EspABAactive: type=Com_Receive_EspABAactive, init-value=0
        EspABAactive_Status: type=Com_SignalSts_t, init-value=E_SIG_STATUS_NONE
        EspABAavailable: type=Com_Receive_EspABAavailable, init-value=0
        EspABAavailable_Status: type=Com_SignalSts_t, init-value=E_SIG_STATUS_NONE
        EspAEBAvailable: type=Com_Receive_EspAEBAvailable, init-value=0
        EspAEBAvailable_Status: type=Com_SignalSts_t, init-value=E_SIG_STATUS_NONE
        EspAEBdecActive: type=Com_Receive_EspAEBdecActive, init-value=0
        EspAEBdecActive_Status: type=Com_SignalSts_t, init-value=E_SIG_STATUS_NONE
        EspAWBactive: type=Com_Receive_EspAWBactive, init-value=0
        EspAWBactive_Status: type=Com_SignalSts_t, init-value=E_SIG_STATUS_NONE
        EspAWBavailable: type=Com_Receive_EspAWBavailable, init-value=0
        EspAWBavailable_Status: type=Com_SignalSts_t, init-value=E_SIG_STATUS_NONE
        EspAbsActv: type=Com_Receive_EspAbsActv, init-value=0
        EspAbsActv_Status: type=Com_SignalSts_t, init-value=E_SIG_STATUS_NONE
        EspAbsFailr: type=Com_Receive_EspAbsFailr, init-value=0
        EspAbsFailr_Status: type=Com_SignalSts_t, init-value=E_SIG_STATUS_NONE
        EspActvSts: type=Com_Receive_EspActvSts, init-value=0
        EspActvSts_Status: type=Com_SignalSts_t, init-value=E_SIG_STATUS_NONE
        EspEbdFailr: type=Com_Receive_EspEbdFailr, init-value=0
        EspEbdFailr_Status: type=Com_SignalSts_t, init-value=E_SIG_STATUS_NONE
        EspLatAccel: type=Com_Receive_EspLatAccel, init-value=0
        EspLatAccel_Status: type=Com_SignalSts_t, init-value=E_SIG_STATUS_NONE
        EspLongAccel: type=Com_Receive_EspLongAccel, init-value=0
        EspLongAccel_Status: type=Com_SignalSts_t, init-value=E_SIG_STATUS_NONE
        EspPrefillActive: type=EspPrefillActive, init-value=0
        EspPrefillActive_Status: type=Com_SignalSts_t, init-value=E_SIG_STATUS_NONE
        EspPrefillAvailable: type=Com_Reveice_EspPrefillAvailable, init-value=0
        EspPrefillAvailable_Status: type=Com_SignalSts_t, init-value=E_SIG_STATUS_NONE
        EspTcsActvSts: type=Com_Receive_EspTcsActvSts, init-value=0
        EspTcsActvSts_Status: type=Com_SignalSts_t, init-value=E_SIG_STATUS_NONE
        EspTcsFailr: type=Com_Receive_EspTcsFailr, init-value=0
        EspTcsFailr_Status: type=Com_SignalSts_t, init-value=E_SIG_STATUS_NONE
        EspVdcActvSts: type=Com_Receive_EspVdcActvSts, init-value=E_SIG_STATUS_NONE
        EspVdcActvSts_Status: type=Com_SignalSts_t, init-value=E_SIG_STATUS_NONE
        EspVehSpd: type=Com_Receive_EspVehSpd, init-value=0
        EspVehSpdVld: type=Com_Receive_EspVehSpdVld
        EspVehSpd_Status: type=Com_SignalSts_t, init-value=E_SIG_STATUS_NONE
        EspYawRate: type=Com_Receive_EspYawRate, init-value=0
        EspYawRate_Status: type=Com_SignalSts_t, init-value=E_SIG_STATUS_NONE
        IBCU_PFSBrakePressureValid: type=Com_Receive_IBCU_PFSBrakePressureValid
        IbBrkPedlStsGb: type=Com_Receive_IbBrkPedlStsGb, init-value=0
        IbBrkPedlStsGbVld: type=Com_Receive_IbBrkPedlStsGbVld
        IbBrkPedlStsGb_Status: type=Com_SignalSts_t, init-value=E_SIG_STATUS_NONE
        IbBrkPedlTrvlDrvr: type=Com_Receive_IbBrkPedlTrvlDrvr
        IbBrkPedlTrvlDrvrVld: type=Com_Receive_IbBrkPedlTrvlDrvrVld
        PlungerBrakePressure: type=Com_SignalSts_t, init-value=E_SIG_STATUS_NONE
        PlungerBrakePressure_Status: type=Com_SignalSts_t, init-value=E_SIG_STATUS_NONE
        VcuAccrPedlPosn: type=Com_Receive_VcuAccrPedlPosn, init-value=0
        VcuAccrPedlPosnVld: type=Com_Receive_VcuAccrPedlPosnVld
        VcuAccrPedlPosn_Status: type=Com_SignalSts_t, init-value=E_SIG_STATUS_NONE
        VcuGearPosn: type=Com_Receive_VcuGearPosn, init-value=0
        VcuGearPosn_Status: type=Com_SignalSts_t, init-value=E_SIG_STATUS_NONE
        VcuVehGearPosnVld: type=Com_Receive_VcuVehGearPosnVld
    SRI_Cpr_Rxsginal_Powertrain
      28 x data:
        WhlSpdFrntLePls: type=Com_Receive_WhlSpdFrntLePls
        WhlSpdFrntLePls_Status: type=Com_Receive_WhlSpdFrntLePls_Status
        WhlSpdFrntRiPls: type=Com_Receive_WhlSpdFrntRiPls
        WhlSpdFrntRiPls_Status: type=Com_Receive_WhlSpdFrntRiPls_Status
        WhlSpdLeFrntData: type=Com_Receive_WhlSpdLeFrntData, init-value=0
        WhlSpdLeFrntDataVld: type=Com_Receive_WhlSpdLeFrntDataVld
        WhlSpdLeFrntData_Status: type=Com_SignalSts_t, init-value=E_SIG_STATUS_NONE
        WhlSpdLeFrntDir: type=Com_Receive_WhlSpdLeFrntDir, init-value=0
        WhlSpdLeFrntDir_Status: type=Com_SignalSts_t, init-value=E_SIG_STATUS_NONE
        WhlSpdLeReData: type=Com_Receive_WhlSpdLeReData, init-value=0
        WhlSpdLeReDataVld: type=Com_Receive_WhlSpdLeReDataVld
        WhlSpdLeReData_Status: type=Com_SignalSts_t, init-value=E_SIG_STATUS_NONE
        WhlSpdLeReDir: type=Com_Receive_WhlSpdLeReDir, init-value=0
        WhlSpdLeReDir_Status: type=Com_SignalSts_t, init-value=E_SIG_STATUS_NONE
        WhlSpdReLePls: type=Com_Receive_WhlSpdReLePls
        WhlSpdReLePls_Status: type=Com_Receive_WhlSpdReLePls_Status
        WhlSpdReRiPls: type=Com_Receive_WhlSpdReRiPls
        WhlSpdReRiPls_Status: type=Com_Receive_WhlSpdReRiPls_Status
        WhlSpdRiFrntData: type=Com_Receive_WhlSpdRiFrntData, init-value=0
        WhlSpdRiFrntDataVld: type=Com_Receive_WhlSpdRiFrntDataVld
        WhlSpdRiFrntData_Status: type=Com_SignalSts_t, init-value=E_SIG_STATUS_NONE
        WhlSpdRiFrntDir: type=Com_Receive_WhlSpdRiFrntDir, init-value=0
        WhlSpdRiFrntDir_Status: type=Com_SignalSts_t, init-value=E_SIG_STATUS_NONE
        WhlSpdRiReData: type=Com_Receive_WhlSpdRiReData, init-value=0
        WhlSpdRiReDataVld: type=Com_Receive_WhlSpdRiReDataVld
        WhlSpdRiReData_Status: type=Com_SignalSts_t, init-value=E_SIG_STATUS_NONE
        WhlSpdRiReDir: type=Com_Receive_WhlSpdRiReDir, init-value=0
        WhlSpdRiReDir_Status: type=Com_SignalSts_t, init-value=E_SIG_STATUS_NONE
    SRI_Cps_TxSignal_Acc
      data Cps_SignalPhyData_FC_ACC_temp: type=uint8_least
    SRI_Cps_TxSignal_Aeb
      32 x data:
        Cps_SignalPhyData_FC_ABAActive: type=Com_Send_FC_ABAActive
        Cps_SignalPhyData_FC_ABAlevel: type=Com_Send_FC_ABAlevel
        Cps_SignalPhyData_FC_AEBActive: type=Com_Send_FC_AEBActive
        Cps_SignalPhyData_FC_AEBCtrlType: type=Com_Send_FC_AEBCtrlType
        Cps_SignalPhyData_FC_AEBEnable: type=Com_Send_FC_AEBEnable
        Cps_SignalPhyData_FC_AEBStatus: type=Com_Send_FC_AEBStatus
        Cps_SignalPhyData_FC_AEBTargetAx: type=Com_Send_FC_AEBTargetAx
        Cps_SignalPhyData_FC_AEBTargetAy: type=Com_Send_FC_AEBTargetAy
        Cps_SignalPhyData_FC_AEBTargetDeceleration: type=Com_Send_FC_AEBTargetDeceleration
        Cps_SignalPhyData_FC_AEBTargetDetection: type=Com_Send_FC_AEBTargetDetection
        Cps_SignalPhyData_FC_AEBTargetLatRange: type=Com_Send_FC_AEBTargetLatRange
        Cps_SignalPhyData_FC_AEBTargetLatRelSpeed: type=Com_Send_FC_AEBTargetLatRelSpeed
        Cps_SignalPhyData_FC_AEBTargetLngRange: type=Com_Send_FC_AEBTargetLngRange
        Cps_SignalPhyData_FC_AEBTargetProb: type=Com_Send_FC_AEBTargetProb
        Cps_SignalPhyData_FC_AEBTargetRelSpeed: type=Com_Send_FC_AEBTargetRelSpeed
        Cps_SignalPhyData_FC_AEBTargetType: type=Com_Send_FC_AEBTargetType
        Cps_SignalPhyData_FC_AEBTargetmode: type=Com_Send_FC_AEBTargetmode
        Cps_SignalPhyData_FC_AEBTextInfo: type=Com_Send_FC_AEBTextInfo
        Cps_SignalPhyData_FC_AEBVehilceHoldReq: type=Com_Send_FC_AEBVehilceHoldReq
        Cps_SignalPhyData_FC_AWBActive: type=Com_Send_FC_AWBActive
        Cps_SignalPhyData_FC_AWBlevel: type=Com_Send_FC_AWBlevel
        Cps_SignalPhyData_FC_FCWActive: type=Com_Send_FC_FCWActive
        Cps_SignalPhyData_FC_FCWLatentWarning: type=Com_Send_FC_FCWLatentWarning
        Cps_SignalPhyData_FC_FCWPreWarning: type=Com_Send_FC_FCWPreWarning
        Cps_SignalPhyData_FC_FCWSettingStatus: type=Com_Send_FC_FCWSettingStatus
        Cps_SignalPhyData_FC_FCWStatus: type=Com_Send_FC_FCWStatus
        Cps_SignalPhyData_FC_LLaneDistanceFus: type=Com_Send_FC_LLaneDistanceFus
        Cps_SignalPhyData_FC_LLaneMarkerType: type=Com_Send_FC_LLaneMarkerType
        Cps_SignalPhyData_FC_OBJ_AEB_ID: type=Com_Send_FC_OBJ_AEB_ID
        Cps_SignalPhyData_FC_PrefillActive: type=Com_Send_FC_PrefillActive
        Cps_SignalPhyData_FC_RLaneDistanceFus: type=Com_Send_FC_RLaneDistanceFus
        Cps_SignalPhyData_FC_RLaneMarkerType: type=Com_Send_FC_RLaneMarkerType
    SRI_Cps_TxSignal_Hla
      data Cps_SignalPhyData_FC_HMAEnableStatus: type=Com_Send_FC_HMAEnableStatus
      data Cps_SignalPhyData_FC_HMALightDistribution: type=Com_Send_FC_HMALightDistribution
      data Cps_SignalPhyData_FC_HMAStatus: type=Com_Send_FC_HMAStatus
    SRI_Cps_TxSignal_Lcf
      21 x data:
        Cps_SignalPhyData_ACC_HostLaneLeftStatus: type=Com_Send_ACC_HostLaneLeftStatus
        Cps_SignalPhyData_ACC_HostLaneRightStatus: type=Com_Send_ACC_HostLaneRightStatus
        Cps_SignalPhyData_ACC_LatAngReq: type=Com_Send_ACC_LatAngReq
        Cps_SignalPhyData_ACC_LatAngReqActive: type=Com_Send_ACC_LatAngReqActive
        Cps_SignalPhyData_FC_ELKEnableStatus: type=Com_Send_FC_ELKEnableStatus
        Cps_SignalPhyData_FC_ELKInterventionMode: type=Com_Send_FC_ELKInterventionMode
        Cps_SignalPhyData_FC_ELKMode: type=Com_Send_FC_ELKMode
        Cps_SignalPhyData_FC_HostLaneLeftStatus: type=Com_Send_FC_HostLaneLeftStatus
        Cps_SignalPhyData_FC_HostLaneRightStatus: type=Com_Send_FC_HostLaneRightStatus
        Cps_SignalPhyData_FC_LASModeSelectionStatus: type=Com_Send_FC_LASModeSelectionStatus
        Cps_SignalPhyData_FC_LASWarningModeSelectionSts: type=Com_Send_FC_LASWarningModeSelectionSts
        Cps_SignalPhyData_FC_LDWShakeLevStatus: type=Com_Send_FC_LDWShakeLevStatus
        Cps_SignalPhyData_FC_LDWStatus: type=Com_Send_FC_LDWStatus
        Cps_SignalPhyData_FC_LDWVibrationWarningReq: type=Com_Send_FC_LDWVibrationWarningReq
        Cps_SignalPhyData_FC_LKAStatus: type=Com_Send_FC_LKAStatus
        Cps_SignalPhyData_FC_LKATakeoverReq: type=Com_Send_FC_LKATakeoverReq
        Cps_SignalPhyData_FC_LatAngReq: type=Com_Send_FC_LatAngReq
        Cps_SignalPhyData_FC_LatAngReqActive: type=Com_Send_FC_LatAngReqActive
        Cps_SignalPhyData_FC_MotorTorqueMaxLimitRequest: type=Com_Send_FC_MotorTorqueMaxLimitRequest
        Cps_SignalPhyData_FC_MotorTorqueMinLimitRequest: type=Com_Send_FC_MotorTorqueMinLimitRequest
        Cps_SignalPhyData_FC_Voiceinfo: type=Com_Send_FC_Voiceinfo
    SRI_DIMOutputCustom
      data DIMOutputCustom_t: type=DIMOutputCustom_t
    SRI_DimInputCustomData
      data DimInputCustomData: type=DIMInputCustom_t
    SRI_DimInputGenericData
      data DimInputGenericData: type=DIMInputGeneric_t
    SRI_EM_t_CamObjectList
      data EM_t_CamObjectList: type=EM_t_CamObjectList
    SRI_EM_t_ObjectList_Custom
      data EM_t_ObjectList_Custom: type=EM_t_ObjectList_Custom
    SRI_ESP_YawRate
      data DE_ESP_YawRate: type=uint16
    SRI_EmFctCycleMode
      data EmFctCycleMode: type=EmFctCycleMode_t
    SRI_EpsSasSteerAg
      data DE_EpsSasSteerAg: type=sint16
    SRI_EspVehSpd
      data DE_EspVehSpd: type=uint16
    SRI_EspVehSpdVld
      data DE_EspVehSpdVld: type=uint8
    SRI_FCTCDOutputCustom
      data FCTCDOutputCustom_t: type=FCTCDOutputCustom_t
    SRI_FCTCustomOutput
      data FCTCustomOutput_t: type=FCTCustomOutput_t
    SRI_FCTSenAccOOI
      data FCTSenAccOOI_t: type=FCTSenAccOOI_t
    SRI_FCTVehErrorOut
      data FCTVehErrorOut_t: type=FCTVehErrorOut_t
    SRI_FC_AEBStatus
      data DE_FC_AEBStatus: type=uint8
    SRI_FC_ELKMode
      data DE_FC_ELKMode: type=uint8
    SRI_FC_FCWStatus
      data DE_FC_FCWStatus: type=uint8
    SRI_FC_HMAStatus
      data DE_FC_HMAStatus: type=uint8
    SRI_FC_LDWStatus
      data DE_FC_LDWStatus: type=uint8
    SRI_FC_LKAStatus
      data DE_FC_LKAStatus: type=uint8
    SRI_FctCodingParameters
      data FctCodingParameters: type=CPAR_FCT_Parameters_t
    SRI_FctCtrlData
      data FctCtrlData: type=FCTCtrlData_t
    SRI_FctCustomInputData
      data FctCustomInputData: type=FCTCustomInput_t
    SRI_FctPublicObjectData
      data FctPublicObjectData: type=AssessedObjList_t
    SRI_FctSenErrorStates
      data FctSenErrorStates: type=FCTSenErrorOut_t
    SRI_FctVehCustomInputData
      data FctVehCustomInputData: type=FCTVehCustomInput_t
    SRI_FctVehLongOutputData
      data FctVehLongOutputData: sw-calibration-access=READ-ONLY, type=FctVeh2SenInfo_t
    SRI_FusionObjectList
      data FusionObjectList: sw-calibration-access=READ-ONLY, type=EM_t_FusionObjectList
    SRI_GenObjectList
      data GenObjectList: sw-calibration-access=READ-ONLY, type=EM_t_GenObjectList
    SRI_HLA_BusInputSignals
      data HLA_BusInputSignals_t: type=HLA_BusInputSignals_t
    SRI_HLA_RadarObjectList
      data HLA_RadarObjectList_t: type=HLA_RadarObjectList_t
    SRI_HeadInputCustomData
      data HeadInputCustomData: type=HEADInputCustom_t
    SRI_HeadInputGenericData
      data HeadInputGenericData: type=HEADInputGeneric_t
    SRI_HeadOutputCustomData
      data HeadOutputCustomData: sw-calibration-access=READ-ONLY, type=HEADOutputCustom_t
    SRI_Hla_InputSignals_t
      data Hla_InputSignals_t: type=Hla_InputSignals_t
    SRI_Hla_OutputSignals_t
      data Hla_OutputSignals_t: type=Hla_OutputSignals_t
    SRI_HypothesisIntf
      data HypothesisIntf_t: type=HypothesisIntf_t
    SRI_LSD_EnvironmentData
      data LSD_EnvironmentData_t: type=LSD_EnvironmentData_t
    SRI_LSD_LightList
      data LSD_LightList_t: type=LSD_LightList_t
    SRI_LSD_LightObjectList
      data LSD_LightObjectList_t: type=LSD_LightObjectList_t
    SRI_LcfGenericInputData
      data LcfGenericInputData: type=LCF_GenericInputs_t
    SRI_LcfSenGenericOutputData
      data LcfSenGenericOutputData: sw-calibration-access=READ-ONLY, type=LCF_SenGenericOutputs_t
    SRI_LcfVehGenricOutputData
      data LcfVehGenricOutputData: type=LCF_VehGenericOutputs_t
    SRI_LodmcOutputData
      data LodmcOutputData: type=Lodmc_output_t
    SRI_LongCtrlInputData
      data LongCtrlInputData: type=LongCtrlInput_t
    SRI_LongCtrlOutput
      data LongCtrlOutput_t: type=LongCtrlOutput_t
    SRI_MonoCalibration
      data MonoCalibration_t: type=MonoCalibration_t
    SRI_NvmTsaRteState
      data NvmTsaRteState_t: type=NvmTsaRteState_t
    SRI_PerfDegr
      data PerfDegr_t: type=PerfDegr_t
    SRI_PerfDegrExtInput
      data PerfDegrExtInput_t: type=PerfDegrExtInput_t
    SRI_RTE_HLAF_HeadlightControl
      data RTE_HLAF_HeadlightControl_t: type=RTE_HLAF_HeadlightControl_t
    SRI_RoadData
      data RoadData: type=Road_t
    SRI_RteInputGPS
      data RteInputGPS_t: type=RteInputGPS_t
    SRI_SR_RTE_Output
      data SR_RTE_Output_t: type=SR_RTE_Output_t
    SRI_SysPerfMonStates
      data SysPerfMonStates: type=SysPerfMonStates_t
    SRI_TboxLocalTiDate
      data DE_TboxLocalTiDate: type=uint8
    SRI_TboxLocalTiHr
      data DE_TboxLocalTiHr: type=uint8
    SRI_TboxLocalTiMins
      data DE_TboxLocalTiMins: type=uint8
    SRI_TboxLocalTiMth
      data DE_TboxLocalTiMth: type=uint8
    SRI_TboxLocalTiSec
      data DE_TboxLocalTiSec: type=uint8
    SRI_TboxLocalTiYear
      data DE_TboxLocalTiYear: type=uint8
    SRI_TjaTargetObjectData
      data TjaTargetObjectData: type=TJATargetObj_t
    SRI_TsaRteCustomInput
      data TsaRteCustomInput_t: type=TsaRteCustomInput_t
    SRI_TsaRteCustomOutput
      data TsaRteCustomOutput_t: type=TsaRteCustomOutput_t
    SRI_TsaRteInputNavigation
      data TsaRteInputNavigation_t: type=TsaRteInputNavigation_t
    SRI_TsaRteOutputResults
      data TsaRteOutputResults_t: type=TsaRteOutputResults_t
    SRI_TsaSlateInputData
      data TsaSlateInputData: type=TSA_SLATE_Input_t
    SRI_VcuGearPosn
      data DE_VcuGearPosn: type=uint8
    SRI_VdyErrors
      data VdyErrors: sw-calibration-access=READ-ONLY, type=VDYErrors_t
    SRI_VdyEstCurves
      data VdyEstCurves: sw-calibration-access=READ-ONLY, type=VDYEstCurves_t
    SRI_VdyNvMInOutData
      data VdyNvMInOutData: type=VDYNvIoData_t
    SRI_VdyOffsets
      data VdyOffsets: sw-calibration-access=READ-ONLY, type=VDYOffsets_t
    SRI_VehDyn
      data VehDyn: sw-calibration-access=READ-ONLY, type=VehDyn_t
    SRI_VehPar
      data VehPar: sw-calibration-access=READ-ONLY, type=VehPar_t
    SRI_VehSig
      data VehSig: sw-calibration-access=READ-ONLY, type=VehSig_t
    SRI_acc_object
      data acc_object_t: type=acc_object_t
    SRI_acc_output_data
      data acc_output_data_t: type=acc_output_data_t
