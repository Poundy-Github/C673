AUTOSAR XML (schema 4-0-3)
package /CanSystem
  system CanSystem: system-version=1.0.0
    system mapping CanSystem
      sw-impl-mappings:
        49 x swc to impl mapping:
          AebDs_ImplMapping: component-implementation=AbsDsImpl, component=TopLevelComposition.AebDs
          BswM_OsApplication_C{0..3}_Prototype_ImplMapping: component-implementation=BswMImplementation_OsApplication_C{0..3}, component=TopLevelComposition.BswM_OsApplication_C{0..3}_Prototype
          Cdd_EvAdc_ImplMapping: component-implementation=EvAdcImpl, component=TopLevelComposition.Cdd_EvAdc
          Cdm_Prototype_ImplMapping: component-implementation=CdmImpl, component=TopLevelComposition.Cdm_Prototype
          ComM_Prototype_ImplMapping: component-implementation=SwcImplementation_0, component=TopLevelComposition.ComM_Prototype
          Comco_ImplMapping: component-implementation=Comco_Impl, component=TopLevelComposition.Comco
          Cpr_Prototype_ImplMapping: component-implementation=CprImpl, component=TopLevelComposition.Cpr_Prototype
          Cps_Prototype_ImplMapping: component-implementation=CpsImpl, component=TopLevelComposition.Cps_Prototype
          CtCdSPI_ImplMapping: component-implementation=Impl_CtCdSPI, component=TopLevelComposition.CtCdSPI
          Dcm_Prototype_ImplMapping: component-implementation=DcmImpl, component=TopLevelComposition.Dcm_Prototype
          Dem_Prototype_ImplMapping: component-implementation=DemImpl, component=TopLevelComposition.Dem_Prototype
          DevelopmentErrorTracer_Prototype_ImplMapping: component-implementation=Implementation, component=TopLevelComposition.DevelopmentErrorTracer_Prototype
          Dsm_Prototype_ImplMapping: component-implementation=DsmImpl, component=TopLevelComposition.Dsm_Prototype
          EcuM_Prototype_ImplMapping: component-implementation=EcuMImpl, component=TopLevelComposition.EcuM_Prototype
          Esh_ImplMapping: component-implementation=Esh_Impl, component=TopLevelComposition.Esh
          Esm_Core{1..3}_Prototype_ImplMapping: component-implementation=EsmImpl_Core{1..3}, component=TopLevelComposition.Esm_Core{1..3}_Prototype
          Esm_Prototype_ImplMapping: component-implementation=EsmImpl, component=TopLevelComposition.Esm_Prototype
          FSMonitor_Prototype_ImplMapping: component-implementation=FSMonitor_Impl, component=TopLevelComposition.FSMonitor_Prototype
          FctAdapter_Prototype_ImplMapping: component-implementation=FctAdapterImpl, component=TopLevelComposition.FctAdapter_Prototype
          Fcu_Prototype_ImplMapping: component-implementation=FcuImpl, component=TopLevelComposition.Fcu_Prototype
          FiM_Prototype_ImplMapping: component-implementation=SwcImplementation_0, component=TopLevelComposition.FiM_Prototype
          HeartbeatDetImplMapping: component-implementation=HeartbeatDetImplementation, component=TopLevelComposition.HeartbeatDet
          HlaAdapter_Prototype_ImplMapping: component-implementation=HlaAdapterImpl, component=TopLevelComposition.HlaAdapter_Prototype
          LcfAdapter_Prototype_ImplMapping: component-implementation=LcfAdapterImpl, component=TopLevelComposition.LcfAdapter_Prototype
          Logging_Prototype_ImplMapping: component-implementation=Logging_Impl, component=TopLevelComposition.Logging
          Med_Prototype_ImplMapping: component-implementation=MedImplementation, component=TopLevelComposition.Med_Prototype
          ModM_ImplMapping: component-implementation=ModM_Impl, component=TopLevelComposition.ModM
          MtsiAdapter_Prototype_ImplMapping: component-implementation=MtsiAdapterImpl, component=TopLevelComposition.MtsiAdapter_Prototype
          Nvm_Prototype_ImplMapping: component-implementation=NvMImpl, component=TopLevelComposition.Nvm_Prototype
          Qsm_Prototype_ImplMapping: component-implementation=QsmImpl, component=TopLevelComposition.Qsm_Prototype
          RtaAdapter_C{0..3}_ImplMapping: component-implementation=RtaAdapter_C{0..3}_Impl, component=TopLevelComposition.RtaAdapter_C{0..3}
          Sdc_Prototype_ImplMapping: component-implementation=SdcImpl, component=TopLevelComposition.Sdc_Prototype
          Sed_Prototype_ImplMapping: component-implementation=SedImplementation, component=TopLevelComposition.Sed_Prototype
          SpiSync_Prototype_ImplMapping: component-implementation=SpiSyncImpl, component=TopLevelComposition.SpiSync_Prototype
          StbM_Prototype_ImplMapping: component-implementation=StbMImpl, component=TopLevelComposition.StbM_Prototype
          Time_Prototype_ImplMapping: component-implementation=TimeImpl, component=TopLevelComposition.Time_Prototype
          TsaAdapter_Prototype_ImplMapping: component-implementation=TsaAdapterImpl, component=TopLevelComposition.TsaAdapter_Prototype
          VdyAdapter_Prototype_ImplMapping: component-implementation=VdyAdapterImpl, component=TopLevelComposition.VdyAdapter_Prototype
          VoltMonI_ImplMapping: component-implementation=VoltageMonitor_Impl, component=TopLevelComposition.VoltMonI
          WdgM_CORE_0_Prototype_ImplMapping: component-implementation=SwcImplementation_CORE_0, component=TopLevelComposition.WdgM_CORE_0_Prototype
          WdgM_CORE_1_Prototype_ImplMapping: component-implementation=SwcImplementation_CORE_1, component=TopLevelComposition.WdgM_CORE_1_Prototype
      sw-mappings:
        swc to ecu mapping EcuTestNodeMapping: ecu-instance=EcuTestNode
          component:
            TopLevelComposition.StbM_Prototype
            TopLevelComposition.SpiSync_Prototype
            TopLevelComposition.Time_Prototype
            TopLevelComposition.TsaAdapter_Prototype
            TopLevelComposition.Fcu_Prototype
            TopLevelComposition.HlaAdapter_Prototype
            TopLevelComposition.EcuM_Prototype
            TopLevelComposition.MtsiAdapter_Prototype
            TopLevelComposition.BswM_OsApplication_C2_Prototype
            TopLevelComposition.FiM_Prototype
            TopLevelComposition.Med_Prototype
            TopLevelComposition.BswM_OsApplication_C1_Prototype
            TopLevelComposition.BswM_OsApplication_C3_Prototype
            TopLevelComposition.CtCdSPI
            TopLevelComposition.FSMonitor_Prototype
            TopLevelComposition.Dem_Prototype
            TopLevelComposition.ComM_Prototype
            TopLevelComposition.Sdc_Prototype
            TopLevelComposition.DevelopmentErrorTracer_Prototype
            TopLevelComposition.Esm_Core3_Prototype
            TopLevelComposition.Cdm_Prototype
            TopLevelComposition.LcfAdapter_Prototype
            TopLevelComposition.VdyAdapter_Prototype
            TopLevelComposition.Cpr_Prototype
            TopLevelComposition.Esm_Prototype
            TopLevelComposition.Dsm_Prototype
            TopLevelComposition.Esm_Core1_Prototype
            TopLevelComposition.Esm_Core2_Prototype
            TopLevelComposition.BswM_OsApplication_C0_Prototype
            TopLevelComposition.Sed_Prototype
            TopLevelComposition.FctAdapter_Prototype
            TopLevelComposition.Dcm_Prototype
            TopLevelComposition.Cps_Prototype
            TopLevelComposition.RtaAdapter_C3
            TopLevelComposition.RtaAdapter_C{0..2}
            TopLevelComposition.VoltMonI
            TopLevelComposition.Comco
            TopLevelComposition.Esh
            TopLevelComposition.Cdd_EvAdc
            TopLevelComposition.Qsm_Prototype
            TopLevelComposition.Nvm_Prototype
            TopLevelComposition.HeartbeatDet
            TopLevelComposition.ModM
            TopLevelComposition.WdgM_CORE_1_Prototype
            TopLevelComposition.WdgM_CORE_0_Prototype
            TopLevelComposition.Logging
            TopLevelComposition.AebDs
    root-software-compositions:
      root sw composition prototype TopLevelComposition: software-composition=TopLevelComposition
  22 x system signal:
    sig_RP_Cpr_Chassis_Data_AdsUDLCStatus
    sig_RP_Cpr_Chassis_Data_AdsUDLCStatus_Status
    sig_RP_Cpr_Chassis_Data_BrakePressureSimulator
    sig_RP_Cpr_Chassis_Data_BrakePressureSimulator_Status
    sig_RP_Cpr_Chassis_Data_EPS_APA_EpasFAILED
    sig_RP_Cpr_Chassis_Data_EPS_APA_EpasFAILED_Status
    sig_RP_Cpr_Chassis_Data_EPS_ActualMotorTorq
    sig_RP_Cpr_Chassis_Data_EPS_ActualMotorTorq_Status
    sig_RP_Cpr_Chassis_Data_EPS_ActualTorsionBarTorq
    sig_RP_Cpr_Chassis_Data_EPS_ActualTorsionBarTorq_Status
    sig_RP_Cpr_Chassis_Data_EPS_MeasuredTorsionBarTorqValid
    sig_RP_Cpr_Chassis_Data_EPS_Pinionang_Valid
    sig_RP_Cpr_Chassis_Data_EPS_fault_state
    sig_RP_Cpr_Chassis_Data_EPS_fault_state_Status
    sig_RP_Cpr_Chassis_Data_ESP_LatAccelValid
    sig_RP_Cpr_Chassis_Data_ESP_LongAccelValid
    sig_RP_Cpr_Chassis_Data_ESP_YawRateValid
    sig_RP_Cpr_Chassis_Data_EpsConcussAvailabilityStatus
    sig_RP_Cpr_Chassis_Data_EpsConcussAvailabilityStatus_Status
    sig_RP_Cpr_Chassis_Data_EpsFaild
    sig_RP_Cpr_Chassis_Data_EpsFaild_Status
    sig_RP_Cpr_Chassis_Data_EpsIACCabortreason
package /CanSystem/CLUSTERS
  can cluster CanNetwork: speed=100
    can physical channel CanChannel: comm-connectors=[Conn_DebugNode, Conn_EcuTestNode]
      frame Pdu_CounterIn: id 0x100, from DebugNode, to EcuTestNode, frame-length=1, can-addressing-mode=STANDARD
        pdu Pdu_CounterIn: length=1, transmission-mode-condition{data-filter=data-filter-type=ALWAYS, i-signal-in-i-pdu=CounterIn}, transmission-mode-true-timing=event-controlled-timing={number-of-repetitions=1, repetition-period=1.0}, unused-bit-pattern=0
          signal CounterIn: start 0, 8 bit, little-endian, data-type-policy=PORT-INTERFACE-DEFINITION, implementation-data-type=uint8, to EcuTestNode
      frame Pdu_CounterOut: id 0x110, from EcuTestNode, to DebugNode, frame-length=1, can-addressing-mode=STANDARD
        pdu Pdu_CounterOut: length=1, transmission-mode-condition{data-filter=data-filter-type=ALWAYS, i-signal-in-i-pdu=CounterOut}, transmission-mode-true-timing=event-controlled-timing={number-of-repetitions=1, repetition-period=1.0}, unused-bit-pattern=0
          signal CounterOut: start 0, 8 bit, little-endian, data-type-policy=PORT-INTERFACE-DEFINITION, implementation-data-type=uint8, to DebugNode
package /CanSystem/ECUINSTANCES
  ecu instance DebugNode: com-configuration-gw-time-base=0.005, com-configuration-rx-time-base=0.005, com-configuration-tx-time-base=0.005, com-enable-mdt-for-cyclic-transmission=false, sleep-mode-supported=false, wake-up-over-bus-supported=false
    can communication controller DebugNode
    can communication connector Conn_DebugNode: comm-controller=DebugNode
  ecu instance EcuTestNode: com-configuration-gw-time-base=0.005, com-configuration-rx-time-base=0.005, com-configuration-tx-time-base=0.005, com-enable-mdt-for-cyclic-transmission=true, sleep-mode-supported=false, wake-up-over-bus-supported=false
    can communication controller EcuTestNode
    can communication connector Conn_EcuTestNode: comm-controller=EcuTestNode
