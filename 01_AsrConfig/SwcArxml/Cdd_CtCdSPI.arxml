AUTOSAR XML (schema 00045)
package /CtCdSPI
  complex device driver sw component type CtCdSPI
    behavior CtCdSPI_IB: handle-termination-and-restart=NO-SUPPORT
      timing event CtCdSPI_5ms_Event: start-on-event=CtCdSPI_5ms, period=0.005
      runnable CtCdSPI_5ms
      runnable CtCdSPI_Init
  swc implementation Impl_CtCdSPI: programming-language=C, sw-version=1.0.0, vendor-id=0, behavior=CtCdSPI_IB
    code-descriptors:
      code SRC: artifact-descriptors=autosar-engineering-object={short-label=EngObject, category=SWSRC}
    resource consumption Resource
      memory section CODE: sw-addrmethod=CODE
