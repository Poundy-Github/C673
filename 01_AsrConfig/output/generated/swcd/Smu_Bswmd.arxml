AUTOSAR XML (schema 4-0-3)
package /AUTOSAR_Smu/BswModuleDescriptions
  bsw module description Smu: module-id=255, provided-entrys=Smu_Init
    bsw internal behavior InternalBehavior_0
      exclusive area CmdAccess
      exclusive area DriverAccess
      bsw called entity Smu_Init: can-enter-exclusive-area=[CmdAccess, DriverAccess], implemented-entry=Smu_Init
package /AUTOSAR_Smu/BswModuleEntrys
  bsw module entry Smu_Init: service-id=1000, is-reentrant=false, is-synchronous=true, call-type=REGULAR, execution-context=UNSPECIFIED, sw-service-impl-policy=STANDARD
package /Smu_Aurix2GAS422/Implementations
  bsw implementation BswImplementation_0: programming-language=C, sw-version=20.0.2, vendor-id=17, ar-release-version=4.2.2, behavior=InternalBehavior_0, vendor-specific-module-def=Smu
    code-descriptors:
      code Files: artifact-descriptors=[{short-label=make::Smu_defs.mak, category=SWMAKE}, {short-label=make::Smu_rules.mak, category=SWMAKE}]
    resource consumption ResourceConsumption
      memory section CONFIG_DATA_ASIL_B_GLOBAL_UNSPECIFIED: alignment=UNSPECIFIED, options=safetyAsilB, sw-addrmethod=CONFIG_DATA_ASIL_B
      memory section VAR_INIT_ASIL_B_GLOBAL_32: alignment=32, options=safetyAsilB, sw-addrmethod=VAR_INIT_ASIL_B
      memory section CODE_ASIL_B_GLOBAL: alignment=UNSPECIFIED, options=safetyAsilB, sw-addrmethod=CODE_ASIL_B
      section name prefix SMU
