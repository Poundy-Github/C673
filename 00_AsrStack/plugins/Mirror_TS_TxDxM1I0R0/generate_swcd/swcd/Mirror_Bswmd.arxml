<?xml version="1.0" encoding="ISO-8859-1"?>
[!AUTOSPACING!][!//
[!VAR "CanTrcvCfg" = "0"!][!//
[!VAR "LinTrcvCfg" = "0"!][!//
[!LOOP "as:modconf('Mirror')[1]/MirrorConfigSet/MirrorSourceNetwork/*"!][!//
    [!VAR "ComMChannel" = "node:path(node:ref(./MirrorComMNetworkHandleRef))"!][!//
    [!IF "node:name(.) = 'MirrorSourceNetworkCan'"!][!//
        [!LOOP "as:modconf('CanSM')[1]/CanSMConfiguration/*[1]/CanSMManagerNetwork/*"!][!//
            [!IF "(node:path(node:ref(./CanSMComMNetworkHandleRef))) = $ComMChannel"!][!//
                [!IF "node:exists(./CanSMTransceiverId)"!][!//
                    [!VAR "CanTrcvCfg" = "1"!][!//
                [!ENDIF!][!//
            [!ENDIF!][!//
        [!ENDLOOP!][!//
    [!ELSEIF "node:name(.) = 'MirrorSourceNetworkLin'"!][!//
        [!LOOP "as:modconf('LinIf')[1]/LinIfGlobalConfig/*[1]/LinIfChannel/*"!][!//
            [!IF "(node:path(node:ref(./LinIfComMNetworkHandleRef))) = $ComMChannel"!][!//
                [!IF "node:exists(./LinIfTransceiverDrvConfig)"!][!//
                    [!VAR "LinTrcvCfg" = "1"!][!//
                [!ENDIF!][!//
            [!ENDIF!][!//
        [!ENDLOOP!][!//
    [!ENDIF!][!//
[!ENDLOOP!][!//
<AUTOSAR xmlns="http://autosar.org/schema/r4.0"
  xmlns:xsi="http://www.w3.org/2001/XMLSchema-instance"
  xsi:schemaLocation="http://autosar.org/schema/r4.0 AUTOSAR_4-2-1_STRICT_COMPACT.xsd">
  <AR-PACKAGES>
    <AR-PACKAGE>
      <SHORT-NAME>AUTOSAR_Mirror</SHORT-NAME>
      <AR-PACKAGES>
        <AR-PACKAGE>
          <SHORT-NAME>BswModuleDescriptions</SHORT-NAME>
          <ELEMENTS>
            <BSW-MODULE-DESCRIPTION>
              <SHORT-NAME>Mirror</SHORT-NAME>
              <MODULE-ID>48</MODULE-ID>
              <PROVIDED-ENTRYS>
                <BSW-MODULE-ENTRY-REF-CONDITIONAL>
                  <BSW-MODULE-ENTRY-REF DEST="BSW-MODULE-ENTRY">/AUTOSAR_Mirror/BswModuleEntrys/Mirror_MainFunction</BSW-MODULE-ENTRY-REF>
                </BSW-MODULE-ENTRY-REF-CONDITIONAL>
              </PROVIDED-ENTRYS>
              <REQUIRED-CLIENT-SERVER-ENTRYS>
                <!-- required Lin client server entries -->
[!IF "node:exists(as:modconf('Mirror')[1]/MirrorGeneral/MirrorLinFramesPerSecond)"!][!//
[!IF "as:modconf('Mirror')[1]/MirrorGeneral/MirrorUseLinIfIPC = 'true'"!][!//
                <BSW-MODULE-CLIENT-SERVER-ENTRY>
                  <SHORT-NAME>LinIf_EnableBusMirroring</SHORT-NAME>
                  <ENCAPSULATED-ENTRY-REF DEST="BSW-MODULE-ENTRY">/AUTOSAR_Mirror/BswModuleEntrys/Mirror_MainFunction</ENCAPSULATED-ENTRY-REF>
                  <IS-SYNCHRONOUS>true</IS-SYNCHRONOUS>
                </BSW-MODULE-CLIENT-SERVER-ENTRY>
[!IF "$LinTrcvCfg = 1"!][!//
                <BSW-MODULE-CLIENT-SERVER-ENTRY>
                  <SHORT-NAME>LinIf_GetTrcvMode</SHORT-NAME>
                  <ENCAPSULATED-ENTRY-REF DEST="BSW-MODULE-ENTRY">/AUTOSAR_Mirror/BswModuleEntrys/Mirror_MainFunction</ENCAPSULATED-ENTRY-REF>
                  <IS-SYNCHRONOUS>true</IS-SYNCHRONOUS>
                </BSW-MODULE-CLIENT-SERVER-ENTRY>
[!ENDIF!][!//
[!ENDIF!][!//
[!ENDIF!][!//
                <!-- required Can client server entries -->
[!IF "node:exists(as:modconf('Mirror')[1]/MirrorGeneral/MirrorCanFramesPerSecond)"!][!//
[!IF "as:modconf('Mirror')[1]/MirrorGeneral/MirrorUseCanIfIPC = 'true'"!][!//
                <BSW-MODULE-CLIENT-SERVER-ENTRY>
                  <SHORT-NAME>CanIf_EnableBusMirroring</SHORT-NAME>
                  <ENCAPSULATED-ENTRY-REF DEST="BSW-MODULE-ENTRY">/AUTOSAR_Mirror/BswModuleEntrys/Mirror_MainFunction</ENCAPSULATED-ENTRY-REF>
                  <IS-SYNCHRONOUS>true</IS-SYNCHRONOUS>
                </BSW-MODULE-CLIENT-SERVER-ENTRY>
                <BSW-MODULE-CLIENT-SERVER-ENTRY>
                  <SHORT-NAME>CanIf_GetControllerErrorState</SHORT-NAME>
                  <ENCAPSULATED-ENTRY-REF DEST="BSW-MODULE-ENTRY">/AUTOSAR_Mirror/BswModuleEntrys/Mirror_MainFunction</ENCAPSULATED-ENTRY-REF>
                  <IS-SYNCHRONOUS>true</IS-SYNCHRONOUS>
                </BSW-MODULE-CLIENT-SERVER-ENTRY>
                <BSW-MODULE-CLIENT-SERVER-ENTRY>
                  <SHORT-NAME>CanIf_GetControllerMode</SHORT-NAME>
                  <ENCAPSULATED-ENTRY-REF DEST="BSW-MODULE-ENTRY">/AUTOSAR_Mirror/BswModuleEntrys/Mirror_MainFunction</ENCAPSULATED-ENTRY-REF>
                  <IS-SYNCHRONOUS>true</IS-SYNCHRONOUS>
                </BSW-MODULE-CLIENT-SERVER-ENTRY>
                <BSW-MODULE-CLIENT-SERVER-ENTRY>
                  <SHORT-NAME>CanIf_GetControllerTxErrorCounter</SHORT-NAME>
                  <ENCAPSULATED-ENTRY-REF DEST="BSW-MODULE-ENTRY">/AUTOSAR_Mirror/BswModuleEntrys/Mirror_MainFunction</ENCAPSULATED-ENTRY-REF>
                  <IS-SYNCHRONOUS>true</IS-SYNCHRONOUS>
                </BSW-MODULE-CLIENT-SERVER-ENTRY>
[!IF "$CanTrcvCfg = 1"!][!//
                <BSW-MODULE-CLIENT-SERVER-ENTRY>
                  <SHORT-NAME>CanIf_GetTrcvMode</SHORT-NAME>
                  <ENCAPSULATED-ENTRY-REF DEST="BSW-MODULE-ENTRY">/AUTOSAR_Mirror/BswModuleEntrys/Mirror_MainFunction</ENCAPSULATED-ENTRY-REF>
                  <IS-SYNCHRONOUS>true</IS-SYNCHRONOUS>
                </BSW-MODULE-CLIENT-SERVER-ENTRY>
[!ENDIF!][!//
[!ENDIF!][!//
[!ENDIF!][!//
                <!-- required FlexRay client server entries -->
[!IF "node:exists(as:modconf('Mirror')[1]/MirrorGeneral/MirrorFrFramesPerSecond)"!][!//
[!IF "as:modconf('Mirror')[1]/MirrorGeneral/MirrorUseFrIfIPC = 'true'"!][!//
                <BSW-MODULE-CLIENT-SERVER-ENTRY>
                  <SHORT-NAME>FrIf_EnableBusMirroring</SHORT-NAME>
                  <ENCAPSULATED-ENTRY-REF DEST="BSW-MODULE-ENTRY">/AUTOSAR_Mirror/BswModuleEntrys/Mirror_MainFunction</ENCAPSULATED-ENTRY-REF>
                  <IS-SYNCHRONOUS>true</IS-SYNCHRONOUS>
                </BSW-MODULE-CLIENT-SERVER-ENTRY>
                <BSW-MODULE-CLIENT-SERVER-ENTRY>
                  <SHORT-NAME>FrIf_GetState</SHORT-NAME>
                  <ENCAPSULATED-ENTRY-REF DEST="BSW-MODULE-ENTRY">/AUTOSAR_Mirror/BswModuleEntrys/Mirror_MainFunction</ENCAPSULATED-ENTRY-REF>
                  <IS-SYNCHRONOUS>true</IS-SYNCHRONOUS>
                </BSW-MODULE-CLIENT-SERVER-ENTRY>
                <BSW-MODULE-CLIENT-SERVER-ENTRY>
                  <SHORT-NAME>FrIf_GetPOCStatus</SHORT-NAME>
                  <ENCAPSULATED-ENTRY-REF DEST="BSW-MODULE-ENTRY">/AUTOSAR_Mirror/BswModuleEntrys/Mirror_MainFunction</ENCAPSULATED-ENTRY-REF>
                  <IS-SYNCHRONOUS>true</IS-SYNCHRONOUS>
                </BSW-MODULE-CLIENT-SERVER-ENTRY>
[!ENDIF!][!//
[!ENDIF!][!//
              </REQUIRED-CLIENT-SERVER-ENTRYS>
              <INTERNAL-BEHAVIORS>
                <BSW-INTERNAL-BEHAVIOR>
                  <SHORT-NAME>InternalBehavior_0</SHORT-NAME>
                  <ENTITYS>
                    <BSW-SCHEDULABLE-ENTITY>
                      <SHORT-NAME>Mirror_MainFunction</SHORT-NAME>
                      <MINIMUM-START-INTERVAL>0.0</MINIMUM-START-INTERVAL>
                      <CALL-POINTS>
                        <!-- Lin call points -->
[!IF "node:exists(as:modconf('Mirror')[1]/MirrorGeneral/MirrorLinFramesPerSecond)"!][!//
[!IF "as:modconf('Mirror')[1]/MirrorGeneral/MirrorUseLinIfIPC = 'true'"!][!//
                        <BSW-SYNCHRONOUS-SERVER-CALL-POINT>
                          <SHORT-NAME>LinIf_EnableBusMirroring</SHORT-NAME>
                          <CALLED-ENTRY-REF DEST="BSW-MODULE-CLIENT-SERVER-ENTRY">/AUTOSAR_Mirror/BswModuleDescriptions/Mirror/LinIf_EnableBusMirroring</CALLED-ENTRY-REF>
                        </BSW-SYNCHRONOUS-SERVER-CALL-POINT>
[!IF "$LinTrcvCfg = 1"!][!//
                        <BSW-SYNCHRONOUS-SERVER-CALL-POINT>
                          <SHORT-NAME>LinIf_GetTrcvMode</SHORT-NAME>
                          <CALLED-ENTRY-REF DEST="BSW-MODULE-CLIENT-SERVER-ENTRY">/AUTOSAR_Mirror/BswModuleDescriptions/Mirror/LinIf_GetTrcvMode</CALLED-ENTRY-REF>
                        </BSW-SYNCHRONOUS-SERVER-CALL-POINT>
[!ENDIF!][!//
[!ENDIF!][!//
[!ENDIF!][!//
                        <!-- Can call points -->
[!IF "node:exists(as:modconf('Mirror')[1]/MirrorGeneral/MirrorCanFramesPerSecond)"!][!//
[!IF "as:modconf('Mirror')[1]/MirrorGeneral/MirrorUseCanIfIPC = 'true'"!][!//
                        <BSW-SYNCHRONOUS-SERVER-CALL-POINT>
                          <SHORT-NAME>CanIf_EnableBusMirroring</SHORT-NAME>
                          <CALLED-ENTRY-REF DEST="BSW-MODULE-CLIENT-SERVER-ENTRY">/AUTOSAR_Mirror/BswModuleDescriptions/Mirror/CanIf_EnableBusMirroring</CALLED-ENTRY-REF>
                        </BSW-SYNCHRONOUS-SERVER-CALL-POINT>
                        <BSW-SYNCHRONOUS-SERVER-CALL-POINT>
                          <SHORT-NAME>CanIf_GetControllerErrorState</SHORT-NAME>
                          <CALLED-ENTRY-REF DEST="BSW-MODULE-CLIENT-SERVER-ENTRY">/AUTOSAR_Mirror/BswModuleDescriptions/Mirror/CanIf_GetControllerErrorState</CALLED-ENTRY-REF>
                        </BSW-SYNCHRONOUS-SERVER-CALL-POINT>
                        <BSW-SYNCHRONOUS-SERVER-CALL-POINT>
                          <SHORT-NAME>CanIf_GetControllerMode</SHORT-NAME>
                          <CALLED-ENTRY-REF DEST="BSW-MODULE-CLIENT-SERVER-ENTRY">/AUTOSAR_Mirror/BswModuleDescriptions/Mirror/CanIf_GetControllerMode</CALLED-ENTRY-REF>
                        </BSW-SYNCHRONOUS-SERVER-CALL-POINT>
                        <BSW-SYNCHRONOUS-SERVER-CALL-POINT>
                          <SHORT-NAME>CanIf_GetControllerTxErrorCounter</SHORT-NAME>
                          <CALLED-ENTRY-REF DEST="BSW-MODULE-CLIENT-SERVER-ENTRY">/AUTOSAR_Mirror/BswModuleDescriptions/Mirror/CanIf_GetControllerTxErrorCounter</CALLED-ENTRY-REF>
                        </BSW-SYNCHRONOUS-SERVER-CALL-POINT>
[!IF "$CanTrcvCfg = 1"!][!//
                        <BSW-SYNCHRONOUS-SERVER-CALL-POINT>
                          <SHORT-NAME>CanIf_GetTrcvMode</SHORT-NAME>
                          <CALLED-ENTRY-REF DEST="BSW-MODULE-CLIENT-SERVER-ENTRY">/AUTOSAR_Mirror/BswModuleDescriptions/Mirror/CanIf_GetTrcvMode</CALLED-ENTRY-REF>
                        </BSW-SYNCHRONOUS-SERVER-CALL-POINT>
[!ENDIF!][!//
[!ENDIF!][!//
[!ENDIF!][!//
                        <!-- FlexRay call points -->
[!IF "node:exists(as:modconf('Mirror')[1]/MirrorGeneral/MirrorFrFramesPerSecond)"!][!//
[!IF "as:modconf('Mirror')[1]/MirrorGeneral/MirrorUseFrIfIPC = 'true'"!][!//
                        <BSW-SYNCHRONOUS-SERVER-CALL-POINT>
                          <SHORT-NAME>FrIf_EnableBusMirroring</SHORT-NAME>
                          <CALLED-ENTRY-REF DEST="BSW-MODULE-CLIENT-SERVER-ENTRY">/AUTOSAR_Mirror/BswModuleDescriptions/Mirror/FrIf_EnableBusMirroring</CALLED-ENTRY-REF>
                        </BSW-SYNCHRONOUS-SERVER-CALL-POINT>
                        <BSW-SYNCHRONOUS-SERVER-CALL-POINT>
                          <SHORT-NAME>FrIf_GetState</SHORT-NAME>
                          <CALLED-ENTRY-REF DEST="BSW-MODULE-CLIENT-SERVER-ENTRY">/AUTOSAR_Mirror/BswModuleDescriptions/Mirror/FrIf_GetState</CALLED-ENTRY-REF>
                        </BSW-SYNCHRONOUS-SERVER-CALL-POINT>
                        <BSW-SYNCHRONOUS-SERVER-CALL-POINT>
                          <SHORT-NAME>FrIf_GetPOCStatus</SHORT-NAME>
                          <CALLED-ENTRY-REF DEST="BSW-MODULE-CLIENT-SERVER-ENTRY">/AUTOSAR_Mirror/BswModuleDescriptions/Mirror/FrIf_GetPOCStatus</CALLED-ENTRY-REF>
                        </BSW-SYNCHRONOUS-SERVER-CALL-POINT>
[!ENDIF!][!//
[!ENDIF!][!//
                      </CALL-POINTS>
                      <IMPLEMENTED-ENTRY-REF DEST="BSW-MODULE-ENTRY">/AUTOSAR_Mirror/BswModuleEntrys/Mirror_MainFunction</IMPLEMENTED-ENTRY-REF>
                    </BSW-SCHEDULABLE-ENTITY>
                  </ENTITYS>
                  <EVENTS>
                    <BSW-TIMING-EVENT>
                      <SHORT-NAME>TimingEvent_MainFunction</SHORT-NAME>
                      <STARTS-ON-EVENT-REF DEST="BSW-SCHEDULABLE-ENTITY">/AUTOSAR_Mirror/BswModuleDescriptions/Mirror/InternalBehavior_0/Mirror_MainFunction</STARTS-ON-EVENT-REF>
                      <PERIOD>[!"MirrorGeneral/MirrorMainFunctionPeriod"!]</PERIOD>
                    </BSW-TIMING-EVENT>
                  </EVENTS>
                </BSW-INTERNAL-BEHAVIOR>
              </INTERNAL-BEHAVIORS>
            </BSW-MODULE-DESCRIPTION>
          </ELEMENTS>
        </AR-PACKAGE>
        <AR-PACKAGE>
          <SHORT-NAME>BswModuleEntrys</SHORT-NAME>
          <ELEMENTS>
            <BSW-MODULE-ENTRY>
              <SHORT-NAME>Mirror_MainFunction</SHORT-NAME>
              <SERVICE-ID>0x04</SERVICE-ID>
              <IS-REENTRANT>false</IS-REENTRANT>
              <IS-SYNCHRONOUS>true</IS-SYNCHRONOUS>
              <CALL-TYPE>SCHEDULED</CALL-TYPE>
              <EXECUTION-CONTEXT>TASK</EXECUTION-CONTEXT>
              <SW-SERVICE-IMPL-POLICY>STANDARD</SW-SERVICE-IMPL-POLICY>
            </BSW-MODULE-ENTRY>
          </ELEMENTS>
        </AR-PACKAGE>
      </AR-PACKAGES>
    </AR-PACKAGE>

    <AR-PACKAGE>
      <SHORT-NAME>EB_Mirror</SHORT-NAME>
      <AR-PACKAGES>
        <AR-PACKAGE>
          <SHORT-NAME>Implementations</SHORT-NAME>
          <ELEMENTS>
            <BSW-IMPLEMENTATION>
              <SHORT-NAME>BswImplementation_0</SHORT-NAME>
              <CODE-DESCRIPTORS>
                <CODE>
                  <SHORT-NAME>Files</SHORT-NAME>
                  <ARTIFACT-DESCRIPTORS>
                    <AUTOSAR-ENGINEERING-OBJECT>
                      <SHORT-LABEL>Autosar::include::Mirror.h</SHORT-LABEL>
                      <CATEGORY>SWHDR</CATEGORY>
                    </AUTOSAR-ENGINEERING-OBJECT>
                    <AUTOSAR-ENGINEERING-OBJECT>
                      <SHORT-LABEL>Autosar::include::Mirror_Cbk.h</SHORT-LABEL>
                      <CATEGORY>SWHDR</CATEGORY>
                    </AUTOSAR-ENGINEERING-OBJECT>
                    <AUTOSAR-ENGINEERING-OBJECT>
                      <SHORT-LABEL>Autosar::include::Mirror_Int.h</SHORT-LABEL>
                      <CATEGORY>SWHDR</CATEGORY>
                    </AUTOSAR-ENGINEERING-OBJECT>
                    <AUTOSAR-ENGINEERING-OBJECT>
                      <SHORT-LABEL>Autosar::include::Mirror_Trace.h</SHORT-LABEL>
                      <CATEGORY>SWHDR</CATEGORY>
                    </AUTOSAR-ENGINEERING-OBJECT>
                    <AUTOSAR-ENGINEERING-OBJECT>
                      <SHORT-LABEL>Autosar::include::Mirror_Version.h</SHORT-LABEL>
                      <CATEGORY>SWHDR</CATEGORY>
                    </AUTOSAR-ENGINEERING-OBJECT>
                    <AUTOSAR-ENGINEERING-OBJECT>
                      <SHORT-LABEL>Autosar::src::Mirror.c</SHORT-LABEL>
                      <CATEGORY>SWSRC</CATEGORY>
                    </AUTOSAR-ENGINEERING-OBJECT>
                    <AUTOSAR-ENGINEERING-OBJECT>
                      <SHORT-LABEL>Autosar::src::Mirror_Operations.c</SHORT-LABEL>
                      <CATEGORY>SWSRC</CATEGORY>
                    </AUTOSAR-ENGINEERING-OBJECT>
                    <AUTOSAR-ENGINEERING-OBJECT>
                      <SHORT-LABEL>make::Mirror_defs.mak</SHORT-LABEL>
                      <CATEGORY>SWMAKE</CATEGORY>
                    </AUTOSAR-ENGINEERING-OBJECT>
                    <AUTOSAR-ENGINEERING-OBJECT>
                      <SHORT-LABEL>make::Mirror_rules.mak</SHORT-LABEL>
                      <CATEGORY>SWMAKE</CATEGORY>
                    </AUTOSAR-ENGINEERING-OBJECT>
                  </ARTIFACT-DESCRIPTORS>
                </CODE>
              </CODE-DESCRIPTORS>
              <PROGRAMMING-LANGUAGE>C</PROGRAMMING-LANGUAGE>
              <RESOURCE-CONSUMPTION>
                <SHORT-NAME>ResourceConsumption</SHORT-NAME>
                <MEMORY-SECTIONS>
                  <MEMORY-SECTION>
                    <SHORT-NAME>CONFIG_DATA_UNSPECIFIED</SHORT-NAME>
                    <ALIGNMENT>UNSPECIFIED</ALIGNMENT>
                    <SW-ADDRMETHOD-REF DEST="SW-ADDR-METHOD">/AUTOSAR_MemMap/SwAddrMethods/CONFIG_DATA</SW-ADDRMETHOD-REF>
                  </MEMORY-SECTION>
                  <MEMORY-SECTION>
                    <SHORT-NAME>CONFIG_DATA_8</SHORT-NAME>
                    <ALIGNMENT>8</ALIGNMENT>
                    <SW-ADDRMETHOD-REF DEST="SW-ADDR-METHOD">/AUTOSAR_MemMap/SwAddrMethods/CONFIG_DATA</SW-ADDRMETHOD-REF>
                  </MEMORY-SECTION>
                  <MEMORY-SECTION>
                    <SHORT-NAME>CONST_UNSPECIFIED</SHORT-NAME>
                    <ALIGNMENT>UNSPECIFIED</ALIGNMENT>
                    <SW-ADDRMETHOD-REF DEST="SW-ADDR-METHOD">/AUTOSAR_MemMap/SwAddrMethods/CONST</SW-ADDRMETHOD-REF>
                  </MEMORY-SECTION>
                  <MEMORY-SECTION>
                    <SHORT-NAME>VAR_CLEARED_GLOBAL_64</SHORT-NAME>
                    <ALIGNMENT>64</ALIGNMENT>
                    <SW-ADDRMETHOD-REF DEST="SW-ADDR-METHOD">/AUTOSAR_MemMap/SwAddrMethods/VAR_CLEARED</SW-ADDRMETHOD-REF>
                  </MEMORY-SECTION>
                  <MEMORY-SECTION>
                    <SHORT-NAME>VAR_CLEARED_GLOBAL_32</SHORT-NAME>
                    <ALIGNMENT>32</ALIGNMENT>
                    <SW-ADDRMETHOD-REF DEST="SW-ADDR-METHOD">/AUTOSAR_MemMap/SwAddrMethods/VAR_CLEARED</SW-ADDRMETHOD-REF>
                  </MEMORY-SECTION>
                  <MEMORY-SECTION>
                    <SHORT-NAME>VAR_CLEARED_GLOBAL_16</SHORT-NAME>
                    <ALIGNMENT>16</ALIGNMENT>
                    <SW-ADDRMETHOD-REF DEST="SW-ADDR-METHOD">/AUTOSAR_MemMap/SwAddrMethods/VAR_CLEARED</SW-ADDRMETHOD-REF>
                  </MEMORY-SECTION>
                  <MEMORY-SECTION>
                    <SHORT-NAME>VAR_INIT_GLOBAL_8</SHORT-NAME>
                    <ALIGNMENT>8</ALIGNMENT>
                    <SW-ADDRMETHOD-REF DEST="SW-ADDR-METHOD">/AUTOSAR_MemMap/SwAddrMethods/VAR</SW-ADDRMETHOD-REF>
                  </MEMORY-SECTION>
                  <MEMORY-SECTION>
                    <SHORT-NAME>VAR_CLEARED_LOCAL_UNSPECIFIED</SHORT-NAME>
                    <ALIGNMENT>UNSPECIFIED</ALIGNMENT>
                    <OPTIONS>
                      <OPTION>coreLocal</OPTION>
                    </OPTIONS>
                    <SW-ADDRMETHOD-REF DEST="SW-ADDR-METHOD">/AUTOSAR_MemMap/SwAddrMethods/VAR_CLEARED_LOCAL</SW-ADDRMETHOD-REF>
                  </MEMORY-SECTION>
[!IF "node:exists(as:modconf('Mirror')[1]/MirrorGeneral/MirrorLinFramesPerSecond)"!][!//
                  <MEMORY-SECTION>
                    <SHORT-NAME>LIN_VAR_CLEARED_GLOBAL_UNSPECIFIED</SHORT-NAME>
                    <ALIGNMENT>UNSPECIFIED</ALIGNMENT>
                    <SW-ADDRMETHOD-REF DEST="SW-ADDR-METHOD">/AUTOSAR_MemMap/SwAddrMethods/VAR_CLEARED</SW-ADDRMETHOD-REF>
                  </MEMORY-SECTION>
[!ENDIF!][!//
[!IF "node:exists(as:modconf('Mirror')[1]/MirrorGeneral/MirrorCanFramesPerSecond)"!][!//
                  <MEMORY-SECTION>
                    <SHORT-NAME>CAN_VAR_CLEARED_GLOBAL_UNSPECIFIED</SHORT-NAME>
                    <ALIGNMENT>UNSPECIFIED</ALIGNMENT>
                    <SW-ADDRMETHOD-REF DEST="SW-ADDR-METHOD">/AUTOSAR_MemMap/SwAddrMethods/VAR_CLEARED</SW-ADDRMETHOD-REF>
                  </MEMORY-SECTION>
[!ENDIF!][!//
[!IF "node:exists(as:modconf('Mirror')[1]/MirrorGeneral/MirrorFrFramesPerSecond)"!][!//
                  <MEMORY-SECTION>
                    <SHORT-NAME>FR_VAR_CLEARED_GLOBAL_UNSPECIFIED</SHORT-NAME>
                    <ALIGNMENT>UNSPECIFIED</ALIGNMENT>
                    <SW-ADDRMETHOD-REF DEST="SW-ADDR-METHOD">/AUTOSAR_MemMap/SwAddrMethods/VAR_CLEARED</SW-ADDRMETHOD-REF>
                  </MEMORY-SECTION>
[!ENDIF!][!//
                  <MEMORY-SECTION>
                    <SHORT-NAME>VAR_CLEARED_LOCAL_8</SHORT-NAME>
                    <ALIGNMENT>8</ALIGNMENT>
                    <OPTIONS>
                      <OPTION>coreLocal</OPTION>
                    </OPTIONS>
                    <SW-ADDRMETHOD-REF DEST="SW-ADDR-METHOD">/AUTOSAR_MemMap/SwAddrMethods/VAR_CLEARED_LOCAL</SW-ADDRMETHOD-REF>
                  </MEMORY-SECTION>
                  <MEMORY-SECTION>
                    <SHORT-NAME>VAR_CLEARED_LOCAL_16</SHORT-NAME>
                    <ALIGNMENT>16</ALIGNMENT>
                    <OPTIONS>
                      <OPTION>coreLocal</OPTION>
                    </OPTIONS>
                    <SW-ADDRMETHOD-REF DEST="SW-ADDR-METHOD">/AUTOSAR_MemMap/SwAddrMethods/VAR_CLEARED_LOCAL</SW-ADDRMETHOD-REF>
                  </MEMORY-SECTION>
                  <MEMORY-SECTION>
                    <SHORT-NAME>VAR_CLEARED_LOCAL_32</SHORT-NAME>
                    <ALIGNMENT>32</ALIGNMENT>
                    <OPTIONS>
                      <OPTION>coreLocal</OPTION>
                    </OPTIONS>
                    <SW-ADDRMETHOD-REF DEST="SW-ADDR-METHOD">/AUTOSAR_MemMap/SwAddrMethods/VAR_CLEARED_LOCAL</SW-ADDRMETHOD-REF>
                  </MEMORY-SECTION>
                  <MEMORY-SECTION>
                    <SHORT-NAME>CODE</SHORT-NAME>
                    <SW-ADDRMETHOD-REF DEST="SW-ADDR-METHOD">/AUTOSAR_MemMap/SwAddrMethods/CODE</SW-ADDRMETHOD-REF>
                  </MEMORY-SECTION>
[!IF "node:exists(as:modconf('Mirror')[1]/MirrorGeneral/MirrorCanFramesPerSecond)"!][!//
                  <MEMORY-SECTION>
                  <SHORT-NAME>CAN_CODE</SHORT-NAME>
                  <SW-ADDRMETHOD-REF DEST="SW-ADDR-METHOD">/AUTOSAR_MemMap/SwAddrMethods/CODE</SW-ADDRMETHOD-REF>
                  </MEMORY-SECTION>
[!ENDIF!][!//
[!IF "node:exists(as:modconf('Mirror')[1]/MirrorGeneral/MirrorFrFramesPerSecond)"!][!//
                  <MEMORY-SECTION>
                  <SHORT-NAME>FLEXRAY_CODE</SHORT-NAME>
                  <SW-ADDRMETHOD-REF DEST="SW-ADDR-METHOD">/AUTOSAR_MemMap/SwAddrMethods/CODE</SW-ADDRMETHOD-REF>
                  </MEMORY-SECTION>
[!ENDIF!][!//
[!IF "node:exists(as:modconf('Mirror')[1]/MirrorGeneral/MirrorLinFramesPerSecond)"!][!//
                  <MEMORY-SECTION>
                    <SHORT-NAME>LIN_CODE</SHORT-NAME>
                    <SW-ADDRMETHOD-REF DEST="SW-ADDR-METHOD">/AUTOSAR_MemMap/SwAddrMethods/CODE</SW-ADDRMETHOD-REF>
                  </MEMORY-SECTION>
[!ENDIF!][!//
                </MEMORY-SECTIONS>
              </RESOURCE-CONSUMPTION>
              <SW-VERSION>1.0.18</SW-VERSION>
              <VENDOR-ID>1</VENDOR-ID>
              <AR-RELEASE-VERSION>4.3.1</AR-RELEASE-VERSION>
              <BEHAVIOR-REF DEST="BSW-INTERNAL-BEHAVIOR">/AUTOSAR_Mirror/BswModuleDescriptions/Mirror/InternalBehavior_0</BEHAVIOR-REF>
              <VENDOR-SPECIFIC-MODULE-DEF-REFS>
                <VENDOR-SPECIFIC-MODULE-DEF-REF DEST="ECUC-MODULE-DEF">/TS_TxDxM1I0R0/Mirror</VENDOR-SPECIFIC-MODULE-DEF-REF>
              </VENDOR-SPECIFIC-MODULE-DEF-REFS>
            </BSW-IMPLEMENTATION>
          </ELEMENTS>
        </AR-PACKAGE>
      </AR-PACKAGES>
    </AR-PACKAGE>
  </AR-PACKAGES>
</AUTOSAR>
