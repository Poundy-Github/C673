AUTOSAR XML (schema 4-0-3)
package /AUTOSAR_Mcu/BswModuleDescriptions
  bsw module description Mcu: module-id=101, provided-entrys=Mcu_Init
    bsw internal behavior InternalBehavior_0
      exclusive area AtomAgcReg
      exclusive area TomTgcReg
      bsw called entity Mcu_Init: can-enter-exclusive-area=[AtomAgcReg, TomTgcReg], implemented-entry=Mcu_Init
package /AUTOSAR_Mcu/BswModuleEntrys
  bsw module entry Mcu_Init: service-id=1000, is-reentrant=false, is-synchronous=true, call-type=REGULAR, execution-context=UNSPECIFIED, sw-service-impl-policy=STANDARD
package /Mcu_Aurix2GAS422/Implementations
  bsw implementation BswImplementation_0: programming-language=C, sw-version=20.0.2, vendor-id=17, ar-release-version=4.2.2, behavior=InternalBehavior_0, vendor-specific-module-def=Mcu
    code-descriptors:
      code Files: artifact-descriptors=[{short-label=make::Mcu_defs.mak, category=SWMAKE}, {short-label=make::Mcu_rules.mak, category=SWMAKE}]
    resource consumption ResourceConsumption
      11 x memory section, all with options=safetyAsilB:
        CONFIG_DATA_ASIL_B_GLOBAL_UNSPECIFIED: alignment=UNSPECIFIED, sw-addrmethod=CONFIG_DATA_ASIL_B
        VAR_CLEARED_ASIL_B_GLOBAL_32: alignment=32, sw-addrmethod=VAR_CLEARED_ASIL_B
        MCU_CODE_ASIL_B_GLOBAL: alignment=UNSPECIFIED, sw-addrmethod=CODE_ASIL_B, symbol=CODE_ASIL_B_GLOBAL
        CONFIG_DATA_ASIL_B_GLOBAL_8: alignment=8, prefix=MCU_17_TIMERIP, sw-addrmethod=CONFIG_DATA_ASIL_B
        CONST_ASIL_B_GLOBAL_UNSPECIFIED: alignment=UNSPECIFIED, prefix=MCU_17_TIMERIP, sw-addrmethod=CONST_ASIL_B
        CONFIG_DATA_ASIL_B_GLOBAL_16: alignment=16, prefix=MCU_17_TIMERIP, sw-addrmethod=CONFIG_DATA_ASIL_B
        VAR_INIT_ASIL_B_GLOBAL_32: alignment=32, prefix=MCU_17_TIMERIP, sw-addrmethod=VAR_INIT_ASIL_B
        VAR_INIT_ASIL_B_GLOBAL_UNSPECIFIED: alignment=UNSPECIFIED, prefix=MCU_17_TIMERIP, sw-addrmethod=VAR_INIT_ASIL_B
        CODE_ASIL_B_GLOBAL: alignment=UNSPECIFIED, prefix=MCU_17_TIMERIP, sw-addrmethod=CODE_ASIL_B
        CODE_FAST_ASIL_B_GLOBAL: alignment=UNSPECIFIED, prefix=MCU_17_TIMERIP, sw-addrmethod=CODE_ASIL_B
        CONFIG_DATA_ASIL_B_GLOBAL_32: alignment=32, prefix=MCU_17_TIMERIP, sw-addrmethod=CONFIG_DATA_ASIL_B
      section name prefix MCU_17_TIMERIP
