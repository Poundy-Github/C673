AUTOSAR XML (schema 4-2-1)
package /AUTOSAR_Xcp/BswModuleDescriptions
  bsw module description Xcp: module-id=212, provided-entrys=[Xcp_SetEvent, Xcp_MainFunction]
    bsw internal behavior InternalBehavior_0
      exclusive area SCHM_XCP_EXCLUSIVE_AREA_XCP_INTERNALS
      bsw schedulable entity Xcp_MainFunction: can-enter-exclusive-area=SCHM_XCP_EXCLUSIVE_AREA_XCP_INTERNALS, implemented-entry=Xcp_MainFunction
      bsw timing event TimingEvent_MainFunction: starts-on-event=Xcp_MainFunction, period=0.02
package /AUTOSAR_Xcp/BswModuleEntrys
  bsw module entry Xcp_SetEvent: service-id=128, is-reentrant=true, is-synchronous=true, call-type=REGULAR, execution-context=TASK, sw-service-impl-policy=STANDARD
  bsw module entry Xcp_MainFunction: service-id=4, is-reentrant=false, is-synchronous=true, call-type=SCHEDULED, execution-context=TASK, sw-service-impl-policy=STANDARD
package /EB_Xcp/Implementations
  bsw implementation BswImplementation_0: programming-language=C, sw-version=2.11.6, vendor-id=1, ar-release-version=4.0.3, behavior=InternalBehavior_0, vendor-specific-module-def=Xcp
    code-descriptors:
      code Files
        artifact-descriptors:
          short-label=Autosar::include::Xcp.h, category=SWHDR
          short-label=Autosar::include::XcpOnCan_Cbk.h, category=SWHDR
          short-label=Autosar::include::XcpOnCdd_Cbk.h, category=SWHDR
          short-label=Autosar::include::XcpOnEth_Cbk.h, category=SWHDR
          short-label=Autosar::include::XcpOnFr_Cbk.h, category=SWHDR
          short-label=Autosar::include::Xcp_Cbk.h, category=SWHDR
          short-label=Autosar::include::Xcp_Int.h, category=SWHDR
          short-label=Autosar::include::Xcp_Int_Stc.h, category=SWHDR
          short-label=Autosar::include::Xcp_MemoryProxy.h, category=SWHDR
          short-label=Autosar::include::Xcp_Types.h, category=SWHDR
          short-label=Autosar::include::Xcp_Version.h, category=SWHDR
          short-label=Autosar::src::Xcp.c, category=SWSRC
          short-label=Autosar::src::Xcp_CommandProcessor.c, category=SWSRC
          short-label=Autosar::src::Xcp_EventProcessor.c, category=SWSRC
          short-label=Autosar::src::Xcp_EventReceiver.c, category=SWSRC
          short-label=Autosar::src::Xcp_MemoryProxy.c, category=SWSRC
          short-label=Autosar::src::Xcp_ReceiveProcessor.c, category=SWSRC
          short-label=Autosar::src::Xcp_StimProcessor.c, category=SWSRC
          short-label=Autosar::src::Xcp_TransmitProcessor.c, category=SWSRC
          short-label=make::Xcp_defs.mak, category=SWMAKE
          short-label=make::Xcp_rules.mak, category=SWMAKE
    resource consumption ResourceConsumption
      15 x memory section:
        CONST_16: alignment=16, sw-addrmethod=CONST
        CONST_8: alignment=8, sw-addrmethod=CONST
        CONST_UNSPECIFIED: alignment=UNSPECIFIED, sw-addrmethod=CONST
        VAR_16: alignment=16, sw-addrmethod=VAR
        VAR_8: alignment=8, sw-addrmethod=VAR
        VAR_CONTROL_API_8: alignment=8, sw-addrmethod=VAR
        VAR_UNSPECIFIED: alignment=UNSPECIFIED, sw-addrmethod=VAR
        VAR_CLEARED_16: alignment=16, sw-addrmethod=VAR_CLEARED
        VAR_CLEARED_8: alignment=8, sw-addrmethod=VAR_CLEARED
        VAR_CLEARED_UNSPECIFIED: alignment=UNSPECIFIED, sw-addrmethod=VAR_CLEARED
        CODE: sw-addrmethod=CODE
        APPL_CODE: sw-addrmethod=CODE
        VAR_SAVED_ZONE_UNSPECIFIED: alignment=UNSPECIFIED, sw-addrmethod=VAR_POWER_ON_CLEARED
        VAR_SAVED_ZONE_UNSPECIFIED_8: alignment=8, sw-addrmethod=VAR_POWER_ON_CLEARED
        WRAPPER_CODE: prefix=XCP_WRAPPER, sw-addrmethod=CODE
      section name prefix XCP_WRAPPER
