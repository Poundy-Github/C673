AUTOSAR XML (schema 4-0-3)
package /AUTOSAR_StbM/ImplementationDataTypes
  14 x impl type:
    StbM_TimeBaseStatusType: compu {mask 0b00001000: 0b00000000=no (GLOBAL_TIME_BASE_no), mask 0b00001000: 0b00001000=yes (GLOBAL_TIME_BASE_yes), mask 0b00000100: 0b00000000=no (SYNC_TO_GATEWAY_no), mask 0b00000100: 0b00000100=yes (SYNC_TO_GATEWAY_yes), mask 0b00010000: 0b00000000=no (TIMELEAP_FUTURE_no), mask 0b00010000: 0b00010000=yes (TIMELEAP_FUTURE_yes), mask 0b00100000: 0b00000000=no (TIMELEAP_PAST_no), mask 0b00100000: 0b00100000=yes (TIMELEAP_PAST_yes), mask 0b00000001: 0b00000000=no (TIMEOUT_no), mask 0b00000001: 0b00000001=yes (TIMEOUT_yes)}, implementation-data-type=uint8
    StbM_MasterConfigType: implementation-data-type=uint8
    StbM_SynchronizedTimeBaseType: implementation-data-type=uint16
    StbM_TimeBaseNotificationType: compu {mask 0b00000000000000000000000000000001: 0b00000000000000000000000000000000=no (EV_GLOBAL_TIME_no), mask 0b00000000000000000000000000000001: 0b00000000000000000000000000000001=yes (EV_GLOBAL_TIME_yes), mask 0b00000000000000000000000000000010: 0b00000000000000000000000000000000=no (EV_TIMEOUT_OCCURRED_no), mask 0b00000000000000000000000000000010: 0b00000000000000000000000000000010=yes (EV_TIMEOUT_OCCURRED_yes), mask 0b00000000000000000000000000000100: 0b00000000000000000000000000000000=no (EV_TIMEOUT_REMOVED_no), mask 0b00000000000000000000000000000100: 0b00000000000000000000000000000100=yes (EV_TIMEOUT_REMOVED_yes), mask 0b00000000000000000000000000001000: 0b00000000000000000000000000000000=no (EV_TIMELEAP_FUTURE_no), mask 0b00000000000000000000000000001000: 0b00000000000000000000000000001000=yes (EV_TIMELEAP_FUTURE_yes), mask 0b00000000000000000000000000010000: 0b00000000000000000000000000000000=no (EV_TIMELEAP_FUTURE_REMOVED_no), mask 0b00000000000000000000000000010000: 0b00000000000000000000000000010000=yes (EV_TIMELEAP_FUTURE_REMOVED_yes), mask 0b00000000000000000000000000100000: 0b00000000000000000000000000000000=no (EV_TIMELEAP_PAST_no), mask 0b00000000000000000000000000100000: 0b00000000000000000000000000100000=yes (EV_TIMELEAP_PAST_yes), mask 0b00000000000000000000000001000000: 0b00000000000000000000000000000000=no (EV_TIMELEAP_PAST_REMOVED_no), mask 0b00000000000000000000000001000000: 0b00000000000000000000000001000000=yes (EV_TIMELEAP_PAST_REMOVED_yes), mask 0b00000000000000000000000010000000: 0b00000000000000000000000000000000=no (EV_SYNC_TO_SUBDOMAIN_no), mask 0b00000000000000000000000010000000: 0b00000000000000000000000010000000=yes (EV_SYNC_TO_SUBDOMAIN_yes), mask 0b00000000000000000000000100000000: 0b00000000000000000000000000000000=no (EV_SYNC_TO_GLOBAL_MASTER_no), mask 0b00000000000000000000000100000000: 0b00000000000000000000000100000000=yes (EV_SYNC_TO_GLOBAL_MASTER_yes), mask 0b00000000000000000000001000000000: 0b00000000000000000000000000000000=no (EV_RESYNC_no), mask 0b00000000000000000000001000000000: 0b00000000000000000000001000000000=yes (EV_RESYNC_yes), mask 0b00000000000000000000010000000000: 0b00000000000000000000000000000000=no (EV_RATECORRECTION_no), mask 0b00000000000000000000010000000000: 0b00000000000000000000010000000000=yes (EV_RATECORRECTION_yes)}, implementation-data-type=uint32
    StbM_TimeStampType: category=STRUCTURE
      4 x element, all with category=TYPE_REFERENCE:
        timeBaseStatus: implementation-data-type=StbM_TimeBaseStatusType
        nanoseconds: implementation-data-type=uint32
        seconds: implementation-data-type=uint32
        secondsHi: implementation-data-type=uint16
    StbM_TimeDiffType: implementation-data-type=sint32
    StbM_UserDataType: category=STRUCTURE
      4 x element, all with category=TYPE_REFERENCE, implementation-data-type=uint8:
        userDataLength
        userByte{0..2}
    StbM_RateDeviationType: implementation-data-type=sint16
    StbM_SyncRecordTableHeadType: category=STRUCTURE
      element SynchronizedTimeDomain: implementation-data-type=uint8
      element HWfrequency: implementation-data-type=uint32
      element HWprescaler: implementation-data-type=uint32
    StbM_SyncRecordTableBlockType: category=STRUCTURE
      8 x element, all with category=TYPE_REFERENCE:
        GlbSeconds: implementation-data-type=uint32
        GlbNanoSeconds: implementation-data-type=uint32
        TimeBaseStatus: implementation-data-type=StbM_TimeBaseStatusType
        VirtualLocalTimeLow: implementation-data-type=uint32
        RateDeviation: implementation-data-type=StbM_RateDeviationType
        LocSeconds: implementation-data-type=uint32
        LocNanoSeconds: implementation-data-type=uint32
        PathDelay: implementation-data-type=uint32
    StbM_OffsetRecordTableHeadType: category=STRUCTURE
      element OffsetTimeDomain: implementation-data-type=uint8
    StbM_OffsetRecordTableBlockType: category=STRUCTURE
      element GlbSeconds: implementation-data-type=uint32
      element GlbNanoSeconds: implementation-data-type=uint32
      element TimeBaseStatus: implementation-data-type=StbM_TimeBaseStatusType
    StbM_VirtualLocalTimeType: category=STRUCTURE
      element nanosecondsLo: implementation-data-type=uint32
      element nanosecondsHi: implementation-data-type=uint32
    StbM_CustomerIdType: implementation-data-type=uint16
package /AUTOSAR_StbM/ConstantSpecifications
  constant specification StbM_InitConst_EventNotification: value-spec=0
package /AUTOSAR_StbM/SwcBswMappings
  swc bsw mapping SwcBswMapping: bsw-behavior=InternalBehavior_0, swc-bsw-runnable-mapping{bsw-entity=StbM_MainFunction, swc-runnable=RE_MainFunction}, swc-behavior=StbMIntBeh
package /AUTOSAR_StbM/BswModuleDescriptions
  bsw module description StbM: module-id=160, provided-entrys=StbM_MainFunction
    bsw internal behavior InternalBehavior_0
      exclusive area SCHM_STBM_EXCLUSIVE_AREA_0
      bsw schedulable entity StbM_MainFunction: can-enter-exclusive-area=SCHM_STBM_EXCLUSIVE_AREA_0, implemented-entry=StbM_MainFunction
      bsw timing event TimingEvent_MainFunction: starts-on-event=StbM_MainFunction, period=0.005
package /AUTOSAR_StbM/BswModuleEntrys
  bsw module entry StbM_MainFunction: service-id=4, is-reentrant=false, is-synchronous=true, call-type=SCHEDULED, execution-context=TASK, sw-service-impl-policy=STANDARD
package /EB_StbM/Implementations
  bsw implementation BswImplementation: programming-language=C, sw-version=4.0.0, swc-bsw-mapping=SwcBswMapping, vendor-id=1, ar-release-version=4.6.0, behavior=InternalBehavior_0, vendor-specific-module-def=StbM
    code-descriptors:
      code Files
        artifact-descriptors:
          short-label=Autosar::include::StbM.h, category=SWHDR
          short-label=Autosar::include::StbM_CanTSyn.h, category=SWHDR
          short-label=Autosar::include::StbM_EthTSyn.h, category=SWHDR
          short-label=Autosar::include::StbM_FrTSyn.h, category=SWHDR
          short-label=Autosar::include::StbM_Int.h, category=SWHDR
          short-label=Autosar::include::StbM_Int_Os.h, category=SWHDR
          short-label=Autosar::include::StbM_Int_Stc.h, category=SWHDR
          short-label=Autosar::include::StbM_TimeConversionMacros.h, category=SWHDR
          short-label=Autosar::include::StbM_Types.h, category=SWHDR
          short-label=Autosar::include::StbM_Version.h, category=SWHDR
          short-label=Autosar::src::StbM.c, category=SWSRC
          short-label=make::StbM_defs.mak, category=SWMAKE
          short-label=make::StbM_rules.mak, category=SWMAKE
    resource consumption ResourceConsumption
      9 x memory section:
        CODE: sw-addrmethod=CODE
        VAR_INIT_8: alignment=8, sw-addrmethod=VAR
        VAR_CLEARED_32: alignment=32, sw-addrmethod=VAR_CLEARED
        VAR_CLEARED_8: alignment=8, sw-addrmethod=VAR_CLEARED
        VAR_CLEARED_UNSPECIFIED: alignment=UNSPECIFIED, sw-addrmethod=VAR_CLEARED
        CONST_UNSPECIFIED: alignment=UNSPECIFIED, sw-addrmethod=CONST
        CONFIG_DATA_8: alignment=8, sw-addrmethod=CONFIG_DATA
        CONFIG_DATA_UNSPECIFIED: alignment=UNSPECIFIED, sw-addrmethod=CONFIG_DATA
        VAR_SHARED_TIME_DATA: alignment=UNSPECIFIED, sw-addrmethod=VAR_CLEARED
