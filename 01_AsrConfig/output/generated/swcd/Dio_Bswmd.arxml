AUTOSAR XML (schema 4-0-3)
package /AUTOSAR_Dio/BswModuleDescriptions
  bsw module description Dio: module-id=120, provided-entrys=Dio_Init
    bsw internal behavior InternalBehavior_0
      bsw called entity Dio_Init: implemented-entry=Dio_Init
package /AUTOSAR_Dio/BswModuleEntrys
  bsw module entry Dio_Init: service-id=16, is-reentrant=false, is-synchronous=true, call-type=REGULAR, execution-context=UNSPECIFIED, sw-service-impl-policy=STANDARD
package /Dio_Aurix2GAS422/Implementations
  bsw implementation BswImplementation_0: programming-language=C, sw-version=20.0.1, vendor-id=17, ar-release-version=4.2.2, behavior=InternalBehavior_0, vendor-specific-module-def=Dio
    code-descriptors:
      code Files: artifact-descriptors=[{short-label=make::Dio_defs.mak, category=SWMAKE}, {short-label=make::Dio_rules.mak, category=SWMAKE}]
    resource consumption ResourceConsumption
      4 x memory section, all with options=safetyAsilB:
        CONST_ASIL_B_GLOBAL_16: alignment=16, sw-addrmethod=CONST_ASIL_B
        CONST_ASIL_B_GLOBAL_32: alignment=32, sw-addrmethod=CONST_ASIL_B
        CONFIG_DATA_ASIL_B_GLOBAL_UNSPECIFIED: alignment=UNSPECIFIED, sw-addrmethod=CONFIG_DATA_ASIL_B
        CODE_ASIL_B_GLOBAL: alignment=UNSPECIFIED, sw-addrmethod=CODE_ASIL_B
      section name prefix DIO
