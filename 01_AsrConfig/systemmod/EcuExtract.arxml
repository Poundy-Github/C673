[part 4 of 4: package /EcuExtract]
AUTOSAR XML (schema 00046)
package /EcuExtract  (continued)
  flat map FlatMap  (continued)
    2430 x flat instance descriptor:  (continued)
      RadarObj1_RelVy_1804: upstream-reference=TopLevelComposition.Med_Prototype.RP_Cpr_Adas_Data_SRI_Cpr_RxSignal_Adas.RadarObj1_RelVy, ecu-extract-reference=TopLevelCompositionPrototype.Med_Prototype.RP_Cpr_Adas_Data_SRI_Cpr_RxSignal_Adas.RadarObj1_RelVy
      RadarObj1_RelVy_Status_1805: upstream-reference=TopLevelComposition.Med_Prototype.RP_Cpr_Adas_Data_SRI_Cpr_RxSignal_Adas.RadarObj1_RelVy_Status, ecu-extract-reference=TopLevelCompositionPrototype.Med_Prototype.RP_Cpr_Adas_Data_SRI_Cpr_RxSignal_Adas.RadarObj1_RelVy_Status
      RadarObj1_Width_1806: upstream-reference=TopLevelComposition.Med_Prototype.RP_Cpr_Adas_Data_SRI_Cpr_RxSignal_Adas.RadarObj1_Width, ecu-extract-reference=TopLevelCompositionPrototype.Med_Prototype.RP_Cpr_Adas_Data_SRI_Cpr_RxSignal_Adas.RadarObj1_Width
      RadarObj1_Width_Status_1807: upstream-reference=TopLevelComposition.Med_Prototype.RP_Cpr_Adas_Data_SRI_Cpr_RxSignal_Adas.RadarObj1_Width_Status, ecu-extract-reference=TopLevelCompositionPrototype.Med_Prototype.RP_Cpr_Adas_Data_SRI_Cpr_RxSignal_Adas.RadarObj1_Width_Status
      RadarObj2_Dx_1808: upstream-reference=TopLevelComposition.Med_Prototype.RP_Cpr_Adas_Data_SRI_Cpr_RxSignal_Adas.RadarObj2_Dx, ecu-extract-reference=TopLevelCompositionPrototype.Med_Prototype.RP_Cpr_Adas_Data_SRI_Cpr_RxSignal_Adas.RadarObj2_Dx
      RadarObj2_Dx_Status_1809: upstream-reference=TopLevelComposition.Med_Prototype.RP_Cpr_Adas_Data_SRI_Cpr_RxSignal_Adas.RadarObj2_Dx_Status, ecu-extract-reference=TopLevelCompositionPrototype.Med_Prototype.RP_Cpr_Adas_Data_SRI_Cpr_RxSignal_Adas.RadarObj2_Dx_Status
      RadarObj2_Dy_1810: upstream-reference=TopLevelComposition.Med_Prototype.RP_Cpr_Adas_Data_SRI_Cpr_RxSignal_Adas.RadarObj2_Dy, ecu-extract-reference=TopLevelCompositionPrototype.Med_Prototype.RP_Cpr_Adas_Data_SRI_Cpr_RxSignal_Adas.RadarObj2_Dy
      RadarObj2_Dy_Status_1811: upstream-reference=TopLevelComposition.Med_Prototype.RP_Cpr_Adas_Data_SRI_Cpr_RxSignal_Adas.RadarObj2_Dy_Status, ecu-extract-reference=TopLevelCompositionPrototype.Med_Prototype.RP_Cpr_Adas_Data_SRI_Cpr_RxSignal_Adas.RadarObj2_Dy_Status
      RadarObj2_ExistProb_1812: upstream-reference=TopLevelComposition.Med_Prototype.RP_Cpr_Adas_Data_SRI_Cpr_RxSignal_Adas.RadarObj2_ExistProb, ecu-extract-reference=TopLevelCompositionPrototype.Med_Prototype.RP_Cpr_Adas_Data_SRI_Cpr_RxSignal_Adas.RadarObj2_ExistProb
      RadarObj2_ExistProb_Status_1813: upstream-reference=TopLevelComposition.Med_Prototype.RP_Cpr_Adas_Data_SRI_Cpr_RxSignal_Adas.RadarObj2_ExistProb_Status, ecu-extract-reference=TopLevelCompositionPrototype.Med_Prototype.RP_Cpr_Adas_Data_SRI_Cpr_RxSignal_Adas.RadarObj2_ExistProb_Status
      RadarObj2_Length_1814: upstream-reference=TopLevelComposition.Med_Prototype.RP_Cpr_Adas_Data_SRI_Cpr_RxSignal_Adas.RadarObj2_Length, ecu-extract-reference=TopLevelCompositionPrototype.Med_Prototype.RP_Cpr_Adas_Data_SRI_Cpr_RxSignal_Adas.RadarObj2_Length
      RadarObj2_Length_Status_1815: upstream-reference=TopLevelComposition.Med_Prototype.RP_Cpr_Adas_Data_SRI_Cpr_RxSignal_Adas.RadarObj2_Length_Status, ecu-extract-reference=TopLevelCompositionPrototype.Med_Prototype.RP_Cpr_Adas_Data_SRI_Cpr_RxSignal_Adas.RadarObj2_Length_Status
      RadarObj2_Location_1816: upstream-reference=TopLevelComposition.Med_Prototype.RP_Cpr_Adas_Data_SRI_Cpr_RxSignal_Adas.RadarObj2_Location, ecu-extract-reference=TopLevelCompositionPrototype.Med_Prototype.RP_Cpr_Adas_Data_SRI_Cpr_RxSignal_Adas.RadarObj2_Location
      RadarObj2_Location_Status_1817: upstream-reference=TopLevelComposition.Med_Prototype.RP_Cpr_Adas_Data_SRI_Cpr_RxSignal_Adas.RadarObj2_Location_Status, ecu-extract-reference=TopLevelCompositionPrototype.Med_Prototype.RP_Cpr_Adas_Data_SRI_Cpr_RxSignal_Adas.RadarObj2_Location_Status
      RadarObj2_Measured_1818: upstream-reference=TopLevelComposition.Med_Prototype.RP_Cpr_Adas_Data_SRI_Cpr_RxSignal_Adas.RadarObj2_Measured, ecu-extract-reference=TopLevelCompositionPrototype.Med_Prototype.RP_Cpr_Adas_Data_SRI_Cpr_RxSignal_Adas.RadarObj2_Measured
      RadarObj2_Measured_Status_1819: upstream-reference=TopLevelComposition.Med_Prototype.RP_Cpr_Adas_Data_SRI_Cpr_RxSignal_Adas.RadarObj2_Measured_Status, ecu-extract-reference=TopLevelCompositionPrototype.Med_Prototype.RP_Cpr_Adas_Data_SRI_Cpr_RxSignal_Adas.RadarObj2_Measured_Status
      RadarObj2_RelAx_1820: upstream-reference=TopLevelComposition.Med_Prototype.RP_Cpr_Adas_Data_SRI_Cpr_RxSignal_Adas.RadarObj2_RelAx, ecu-extract-reference=TopLevelCompositionPrototype.Med_Prototype.RP_Cpr_Adas_Data_SRI_Cpr_RxSignal_Adas.RadarObj2_RelAx
      RadarObj2_RelAx_Status_1821: upstream-reference=TopLevelComposition.Med_Prototype.RP_Cpr_Adas_Data_SRI_Cpr_RxSignal_Adas.RadarObj2_RelAx_Status, ecu-extract-reference=TopLevelCompositionPrototype.Med_Prototype.RP_Cpr_Adas_Data_SRI_Cpr_RxSignal_Adas.RadarObj2_RelAx_Status
      RadarObj2_RelVx_1822: upstream-reference=TopLevelComposition.Med_Prototype.RP_Cpr_Adas_Data_SRI_Cpr_RxSignal_Adas.RadarObj2_RelVx, ecu-extract-reference=TopLevelCompositionPrototype.Med_Prototype.RP_Cpr_Adas_Data_SRI_Cpr_RxSignal_Adas.RadarObj2_RelVx
      RadarObj2_RelVx_Status_1823: upstream-reference=TopLevelComposition.Med_Prototype.RP_Cpr_Adas_Data_SRI_Cpr_RxSignal_Adas.RadarObj2_RelVx_Status, ecu-extract-reference=TopLevelCompositionPrototype.Med_Prototype.RP_Cpr_Adas_Data_SRI_Cpr_RxSignal_Adas.RadarObj2_RelVx_Status
      RadarObj2_RelVy_1824: upstream-reference=TopLevelComposition.Med_Prototype.RP_Cpr_Adas_Data_SRI_Cpr_RxSignal_Adas.RadarObj2_RelVy, ecu-extract-reference=TopLevelCompositionPrototype.Med_Prototype.RP_Cpr_Adas_Data_SRI_Cpr_RxSignal_Adas.RadarObj2_RelVy
      RadarObj2_RelVy_Status_1825: upstream-reference=TopLevelComposition.Med_Prototype.RP_Cpr_Adas_Data_SRI_Cpr_RxSignal_Adas.RadarObj2_RelVy_Status, ecu-extract-reference=TopLevelCompositionPrototype.Med_Prototype.RP_Cpr_Adas_Data_SRI_Cpr_RxSignal_Adas.RadarObj2_RelVy_Status
      RadarObj2_Width_1826: upstream-reference=TopLevelComposition.Med_Prototype.RP_Cpr_Adas_Data_SRI_Cpr_RxSignal_Adas.RadarObj2_Width, ecu-extract-reference=TopLevelCompositionPrototype.Med_Prototype.RP_Cpr_Adas_Data_SRI_Cpr_RxSignal_Adas.RadarObj2_Width
      RadarObj2_Width_Status_1827: upstream-reference=TopLevelComposition.Med_Prototype.RP_Cpr_Adas_Data_SRI_Cpr_RxSignal_Adas.RadarObj2_Width_Status, ecu-extract-reference=TopLevelCompositionPrototype.Med_Prototype.RP_Cpr_Adas_Data_SRI_Cpr_RxSignal_Adas.RadarObj2_Width_Status
      RadarObj3_Dx_1828: upstream-reference=TopLevelComposition.Med_Prototype.RP_Cpr_Adas_Data_SRI_Cpr_RxSignal_Adas.RadarObj3_Dx, ecu-extract-reference=TopLevelCompositionPrototype.Med_Prototype.RP_Cpr_Adas_Data_SRI_Cpr_RxSignal_Adas.RadarObj3_Dx
      RadarObj3_Dx_Status_1829: upstream-reference=TopLevelComposition.Med_Prototype.RP_Cpr_Adas_Data_SRI_Cpr_RxSignal_Adas.RadarObj3_Dx_Status, ecu-extract-reference=TopLevelCompositionPrototype.Med_Prototype.RP_Cpr_Adas_Data_SRI_Cpr_RxSignal_Adas.RadarObj3_Dx_Status
      RadarObj3_Dy_1830: upstream-reference=TopLevelComposition.Med_Prototype.RP_Cpr_Adas_Data_SRI_Cpr_RxSignal_Adas.RadarObj3_Dy, ecu-extract-reference=TopLevelCompositionPrototype.Med_Prototype.RP_Cpr_Adas_Data_SRI_Cpr_RxSignal_Adas.RadarObj3_Dy
      RadarObj3_Dy_Status_1831: upstream-reference=TopLevelComposition.Med_Prototype.RP_Cpr_Adas_Data_SRI_Cpr_RxSignal_Adas.RadarObj3_Dy_Status, ecu-extract-reference=TopLevelCompositionPrototype.Med_Prototype.RP_Cpr_Adas_Data_SRI_Cpr_RxSignal_Adas.RadarObj3_Dy_Status
      RadarObj3_ExistProb_1832: upstream-reference=TopLevelComposition.Med_Prototype.RP_Cpr_Adas_Data_SRI_Cpr_RxSignal_Adas.RadarObj3_ExistProb, ecu-extract-reference=TopLevelCompositionPrototype.Med_Prototype.RP_Cpr_Adas_Data_SRI_Cpr_RxSignal_Adas.RadarObj3_ExistProb
      RadarObj3_ExistProb_Status_1833: upstream-reference=TopLevelComposition.Med_Prototype.RP_Cpr_Adas_Data_SRI_Cpr_RxSignal_Adas.RadarObj3_ExistProb_Status, ecu-extract-reference=TopLevelCompositionPrototype.Med_Prototype.RP_Cpr_Adas_Data_SRI_Cpr_RxSignal_Adas.RadarObj3_ExistProb_Status
      RadarObj3_Length_1834: upstream-reference=TopLevelComposition.Med_Prototype.RP_Cpr_Adas_Data_SRI_Cpr_RxSignal_Adas.RadarObj3_Length, ecu-extract-reference=TopLevelCompositionPrototype.Med_Prototype.RP_Cpr_Adas_Data_SRI_Cpr_RxSignal_Adas.RadarObj3_Length
      RadarObj3_Length_Status_1835: upstream-reference=TopLevelComposition.Med_Prototype.RP_Cpr_Adas_Data_SRI_Cpr_RxSignal_Adas.RadarObj3_Length_Status, ecu-extract-reference=TopLevelCompositionPrototype.Med_Prototype.RP_Cpr_Adas_Data_SRI_Cpr_RxSignal_Adas.RadarObj3_Length_Status
      RadarObj3_Location_1836: upstream-reference=TopLevelComposition.Med_Prototype.RP_Cpr_Adas_Data_SRI_Cpr_RxSignal_Adas.RadarObj3_Location, ecu-extract-reference=TopLevelCompositionPrototype.Med_Prototype.RP_Cpr_Adas_Data_SRI_Cpr_RxSignal_Adas.RadarObj3_Location
      RadarObj3_Location_Status_1837: upstream-reference=TopLevelComposition.Med_Prototype.RP_Cpr_Adas_Data_SRI_Cpr_RxSignal_Adas.RadarObj3_Location_Status, ecu-extract-reference=TopLevelCompositionPrototype.Med_Prototype.RP_Cpr_Adas_Data_SRI_Cpr_RxSignal_Adas.RadarObj3_Location_Status
      RadarObj3_Measured_1838: upstream-reference=TopLevelComposition.Med_Prototype.RP_Cpr_Adas_Data_SRI_Cpr_RxSignal_Adas.RadarObj3_Measured, ecu-extract-reference=TopLevelCompositionPrototype.Med_Prototype.RP_Cpr_Adas_Data_SRI_Cpr_RxSignal_Adas.RadarObj3_Measured
      RadarObj3_Measured_Status_1839: upstream-reference=TopLevelComposition.Med_Prototype.RP_Cpr_Adas_Data_SRI_Cpr_RxSignal_Adas.RadarObj3_Measured_Status, ecu-extract-reference=TopLevelCompositionPrototype.Med_Prototype.RP_Cpr_Adas_Data_SRI_Cpr_RxSignal_Adas.RadarObj3_Measured_Status
      RadarObj3_RelAx_1840: upstream-reference=TopLevelComposition.Med_Prototype.RP_Cpr_Adas_Data_SRI_Cpr_RxSignal_Adas.RadarObj3_RelAx, ecu-extract-reference=TopLevelCompositionPrototype.Med_Prototype.RP_Cpr_Adas_Data_SRI_Cpr_RxSignal_Adas.RadarObj3_RelAx
      RadarObj3_RelAx_Status_1841: upstream-reference=TopLevelComposition.Med_Prototype.RP_Cpr_Adas_Data_SRI_Cpr_RxSignal_Adas.RadarObj3_RelAx_Status, ecu-extract-reference=TopLevelCompositionPrototype.Med_Prototype.RP_Cpr_Adas_Data_SRI_Cpr_RxSignal_Adas.RadarObj3_RelAx_Status
      RadarObj3_RelVx_1842: upstream-reference=TopLevelComposition.Med_Prototype.RP_Cpr_Adas_Data_SRI_Cpr_RxSignal_Adas.RadarObj3_RelVx, ecu-extract-reference=TopLevelCompositionPrototype.Med_Prototype.RP_Cpr_Adas_Data_SRI_Cpr_RxSignal_Adas.RadarObj3_RelVx
      RadarObj3_RelVx_Status_1843: upstream-reference=TopLevelComposition.Med_Prototype.RP_Cpr_Adas_Data_SRI_Cpr_RxSignal_Adas.RadarObj3_RelVx_Status, ecu-extract-reference=TopLevelCompositionPrototype.Med_Prototype.RP_Cpr_Adas_Data_SRI_Cpr_RxSignal_Adas.RadarObj3_RelVx_Status
      RadarObj3_RelVy_1844: upstream-reference=TopLevelComposition.Med_Prototype.RP_Cpr_Adas_Data_SRI_Cpr_RxSignal_Adas.RadarObj3_RelVy, ecu-extract-reference=TopLevelCompositionPrototype.Med_Prototype.RP_Cpr_Adas_Data_SRI_Cpr_RxSignal_Adas.RadarObj3_RelVy
      RadarObj3_RelVy_Status_1845: upstream-reference=TopLevelComposition.Med_Prototype.RP_Cpr_Adas_Data_SRI_Cpr_RxSignal_Adas.RadarObj3_RelVy_Status, ecu-extract-reference=TopLevelCompositionPrototype.Med_Prototype.RP_Cpr_Adas_Data_SRI_Cpr_RxSignal_Adas.RadarObj3_RelVy_Status
      RadarObj3_Width_1846: upstream-reference=TopLevelComposition.Med_Prototype.RP_Cpr_Adas_Data_SRI_Cpr_RxSignal_Adas.RadarObj3_Width, ecu-extract-reference=TopLevelCompositionPrototype.Med_Prototype.RP_Cpr_Adas_Data_SRI_Cpr_RxSignal_Adas.RadarObj3_Width
      RadarObj3_Width_Status_1847: upstream-reference=TopLevelComposition.Med_Prototype.RP_Cpr_Adas_Data_SRI_Cpr_RxSignal_Adas.RadarObj3_Width_Status, ecu-extract-reference=TopLevelCompositionPrototype.Med_Prototype.RP_Cpr_Adas_Data_SRI_Cpr_RxSignal_Adas.RadarObj3_Width_Status
      RadarObj4_Dx_1848: upstream-reference=TopLevelComposition.Med_Prototype.RP_Cpr_Adas_Data_SRI_Cpr_RxSignal_Adas.RadarObj4_Dx, ecu-extract-reference=TopLevelCompositionPrototype.Med_Prototype.RP_Cpr_Adas_Data_SRI_Cpr_RxSignal_Adas.RadarObj4_Dx
      RadarObj4_Dx_Status_1849: upstream-reference=TopLevelComposition.Med_Prototype.RP_Cpr_Adas_Data_SRI_Cpr_RxSignal_Adas.RadarObj4_Dx_Status, ecu-extract-reference=TopLevelCompositionPrototype.Med_Prototype.RP_Cpr_Adas_Data_SRI_Cpr_RxSignal_Adas.RadarObj4_Dx_Status
      RadarObj4_Dy_1850: upstream-reference=TopLevelComposition.Med_Prototype.RP_Cpr_Adas_Data_SRI_Cpr_RxSignal_Adas.RadarObj4_Dy, ecu-extract-reference=TopLevelCompositionPrototype.Med_Prototype.RP_Cpr_Adas_Data_SRI_Cpr_RxSignal_Adas.RadarObj4_Dy
      RadarObj4_Dy_Status_1851: upstream-reference=TopLevelComposition.Med_Prototype.RP_Cpr_Adas_Data_SRI_Cpr_RxSignal_Adas.RadarObj4_Dy_Status, ecu-extract-reference=TopLevelCompositionPrototype.Med_Prototype.RP_Cpr_Adas_Data_SRI_Cpr_RxSignal_Adas.RadarObj4_Dy_Status
      RadarObj4_ExistProb_1852: upstream-reference=TopLevelComposition.Med_Prototype.RP_Cpr_Adas_Data_SRI_Cpr_RxSignal_Adas.RadarObj4_ExistProb, ecu-extract-reference=TopLevelCompositionPrototype.Med_Prototype.RP_Cpr_Adas_Data_SRI_Cpr_RxSignal_Adas.RadarObj4_ExistProb
      RadarObj4_ExistProb_Status_1853: upstream-reference=TopLevelComposition.Med_Prototype.RP_Cpr_Adas_Data_SRI_Cpr_RxSignal_Adas.RadarObj4_ExistProb_Status, ecu-extract-reference=TopLevelCompositionPrototype.Med_Prototype.RP_Cpr_Adas_Data_SRI_Cpr_RxSignal_Adas.RadarObj4_ExistProb_Status
      RadarObj4_Length_1854: upstream-reference=TopLevelComposition.Med_Prototype.RP_Cpr_Adas_Data_SRI_Cpr_RxSignal_Adas.RadarObj4_Length, ecu-extract-reference=TopLevelCompositionPrototype.Med_Prototype.RP_Cpr_Adas_Data_SRI_Cpr_RxSignal_Adas.RadarObj4_Length
      RadarObj4_Length_Status_1855: upstream-reference=TopLevelComposition.Med_Prototype.RP_Cpr_Adas_Data_SRI_Cpr_RxSignal_Adas.RadarObj4_Length_Status, ecu-extract-reference=TopLevelCompositionPrototype.Med_Prototype.RP_Cpr_Adas_Data_SRI_Cpr_RxSignal_Adas.RadarObj4_Length_Status
      RadarObj4_Location_1856: upstream-reference=TopLevelComposition.Med_Prototype.RP_Cpr_Adas_Data_SRI_Cpr_RxSignal_Adas.RadarObj4_Location, ecu-extract-reference=TopLevelCompositionPrototype.Med_Prototype.RP_Cpr_Adas_Data_SRI_Cpr_RxSignal_Adas.RadarObj4_Location
      RadarObj4_Location_Status_1857: upstream-reference=TopLevelComposition.Med_Prototype.RP_Cpr_Adas_Data_SRI_Cpr_RxSignal_Adas.RadarObj4_Location_Status, ecu-extract-reference=TopLevelCompositionPrototype.Med_Prototype.RP_Cpr_Adas_Data_SRI_Cpr_RxSignal_Adas.RadarObj4_Location_Status
      RadarObj4_Measured_1858: upstream-reference=TopLevelComposition.Med_Prototype.RP_Cpr_Adas_Data_SRI_Cpr_RxSignal_Adas.RadarObj4_Measured, ecu-extract-reference=TopLevelCompositionPrototype.Med_Prototype.RP_Cpr_Adas_Data_SRI_Cpr_RxSignal_Adas.RadarObj4_Measured
      RadarObj4_Measured_Status_1859: upstream-reference=TopLevelComposition.Med_Prototype.RP_Cpr_Adas_Data_SRI_Cpr_RxSignal_Adas.RadarObj4_Measured_Status, ecu-extract-reference=TopLevelCompositionPrototype.Med_Prototype.RP_Cpr_Adas_Data_SRI_Cpr_RxSignal_Adas.RadarObj4_Measured_Status
      RadarObj4_RelAx_1860: upstream-reference=TopLevelComposition.Med_Prototype.RP_Cpr_Adas_Data_SRI_Cpr_RxSignal_Adas.RadarObj4_RelAx, ecu-extract-reference=TopLevelCompositionPrototype.Med_Prototype.RP_Cpr_Adas_Data_SRI_Cpr_RxSignal_Adas.RadarObj4_RelAx
      RadarObj4_RelAx_Status_1861: upstream-reference=TopLevelComposition.Med_Prototype.RP_Cpr_Adas_Data_SRI_Cpr_RxSignal_Adas.RadarObj4_RelAx_Status, ecu-extract-reference=TopLevelCompositionPrototype.Med_Prototype.RP_Cpr_Adas_Data_SRI_Cpr_RxSignal_Adas.RadarObj4_RelAx_Status
      RadarObj4_RelVx_1862: upstream-reference=TopLevelComposition.Med_Prototype.RP_Cpr_Adas_Data_SRI_Cpr_RxSignal_Adas.RadarObj4_RelVx, ecu-extract-reference=TopLevelCompositionPrototype.Med_Prototype.RP_Cpr_Adas_Data_SRI_Cpr_RxSignal_Adas.RadarObj4_RelVx
      RadarObj4_RelVx_Status_1863: upstream-reference=TopLevelComposition.Med_Prototype.RP_Cpr_Adas_Data_SRI_Cpr_RxSignal_Adas.RadarObj4_RelVx_Status, ecu-extract-reference=TopLevelCompositionPrototype.Med_Prototype.RP_Cpr_Adas_Data_SRI_Cpr_RxSignal_Adas.RadarObj4_RelVx_Status
      RadarObj4_RelVy_1864: upstream-reference=TopLevelComposition.Med_Prototype.RP_Cpr_Adas_Data_SRI_Cpr_RxSignal_Adas.RadarObj4_RelVy, ecu-extract-reference=TopLevelCompositionPrototype.Med_Prototype.RP_Cpr_Adas_Data_SRI_Cpr_RxSignal_Adas.RadarObj4_RelVy
      RadarObj4_RelVy_Status_1865: upstream-reference=TopLevelComposition.Med_Prototype.RP_Cpr_Adas_Data_SRI_Cpr_RxSignal_Adas.RadarObj4_RelVy_Status, ecu-extract-reference=TopLevelCompositionPrototype.Med_Prototype.RP_Cpr_Adas_Data_SRI_Cpr_RxSignal_Adas.RadarObj4_RelVy_Status
      RadarObj4_Width_1866: upstream-reference=TopLevelComposition.Med_Prototype.RP_Cpr_Adas_Data_SRI_Cpr_RxSignal_Adas.RadarObj4_Width, ecu-extract-reference=TopLevelCompositionPrototype.Med_Prototype.RP_Cpr_Adas_Data_SRI_Cpr_RxSignal_Adas.RadarObj4_Width
      RadarObj4_Width_Status_1867: upstream-reference=TopLevelComposition.Med_Prototype.RP_Cpr_Adas_Data_SRI_Cpr_RxSignal_Adas.RadarObj4_Width_Status, ecu-extract-reference=TopLevelCompositionPrototype.Med_Prototype.RP_Cpr_Adas_Data_SRI_Cpr_RxSignal_Adas.RadarObj4_Width_Status
      RP_Cpr_Body_Data_SRI_Cpr_Rxsignal_Body_1868: upstream-reference=TopLevelComposition.Med_Prototype.RP_Cpr_Body_Data_SRI_Cpr_Rxsignal_Body, ecu-extract-reference=TopLevelCompositionPrototype.Med_Prototype.RP_Cpr_Body_Data_SRI_Cpr_Rxsignal_Body
      ACC_HostLaneLeftStatus_1869: upstream-reference=TopLevelComposition.Med_Prototype.RP_Cpr_Body_Data_SRI_Cpr_Rxsignal_Body.ACC_HostLaneLeftStatus, ecu-extract-reference=TopLevelCompositionPrototype.Med_Prototype.RP_Cpr_Body_Data_SRI_Cpr_Rxsignal_Body.ACC_HostLaneLeftStatus
      ACC_HostLaneRightStatus_1870: upstream-reference=TopLevelComposition.Med_Prototype.RP_Cpr_Body_Data_SRI_Cpr_Rxsignal_Body.ACC_HostLaneRightStatus, ecu-extract-reference=TopLevelCompositionPrototype.Med_Prototype.RP_Cpr_Body_Data_SRI_Cpr_Rxsignal_Body.ACC_HostLaneRightStatus
      AccIaccHWAMode_1871: upstream-reference=TopLevelComposition.Med_Prototype.RP_Cpr_Body_Data_SRI_Cpr_Rxsignal_Body.AccIaccHWAMode, ecu-extract-reference=TopLevelCompositionPrototype.Med_Prototype.RP_Cpr_Body_Data_SRI_Cpr_Rxsignal_Body.AccIaccHWAMode
      AccIaccHWAMode_Status_1872: upstream-reference=TopLevelComposition.Med_Prototype.RP_Cpr_Body_Data_SRI_Cpr_Rxsignal_Body.AccIaccHWAMode_Status, ecu-extract-reference=TopLevelCompositionPrototype.Med_Prototype.RP_Cpr_Body_Data_SRI_Cpr_Rxsignal_Body.AccIaccHWAMode_Status
      BCM_BrakeLampError_1873: upstream-reference=TopLevelComposition.Med_Prototype.RP_Cpr_Body_Data_SRI_Cpr_Rxsignal_Body.BCM_BrakeLampError, ecu-extract-reference=TopLevelCompositionPrototype.Med_Prototype.RP_Cpr_Body_Data_SRI_Cpr_Rxsignal_Body.BCM_BrakeLampError
      BCM_BrakeLampError_Status_1874: upstream-reference=TopLevelComposition.Med_Prototype.RP_Cpr_Body_Data_SRI_Cpr_Rxsignal_Body.BCM_BrakeLampError_Status, ecu-extract-reference=TopLevelCompositionPrototype.Med_Prototype.RP_Cpr_Body_Data_SRI_Cpr_Rxsignal_Body.BCM_BrakeLampError_Status
      BCM_TurnLightSwitchSts_1875: upstream-reference=TopLevelComposition.Med_Prototype.RP_Cpr_Body_Data_SRI_Cpr_Rxsignal_Body.BCM_TurnLightSwitchSts, ecu-extract-reference=TopLevelCompositionPrototype.Med_Prototype.RP_Cpr_Body_Data_SRI_Cpr_Rxsignal_Body.BCM_TurnLightSwitchSts
      BCM_TurnLightSwitchSts_Status_1876: upstream-reference=TopLevelComposition.Med_Prototype.RP_Cpr_Body_Data_SRI_Cpr_Rxsignal_Body.BCM_TurnLightSwitchSts_Status, ecu-extract-reference=TopLevelCompositionPrototype.Med_Prototype.RP_Cpr_Body_Data_SRI_Cpr_Rxsignal_Body.BCM_TurnLightSwitchSts_Status
      BcmAutHeadLiSts_1877: upstream-reference=TopLevelComposition.Med_Prototype.RP_Cpr_Body_Data_SRI_Cpr_Rxsignal_Body.BcmAutHeadLiSts, ecu-extract-reference=TopLevelCompositionPrototype.Med_Prototype.RP_Cpr_Body_Data_SRI_Cpr_Rxsignal_Body.BcmAutHeadLiSts
      BcmAutHeadLiSts_Status_1878: upstream-reference=TopLevelComposition.Med_Prototype.RP_Cpr_Body_Data_SRI_Cpr_Rxsignal_Body.BcmAutHeadLiSts_Status, ecu-extract-reference=TopLevelCompositionPrototype.Med_Prototype.RP_Cpr_Body_Data_SRI_Cpr_Rxsignal_Body.BcmAutHeadLiSts_Status
      BcmDrvrDoorSts_1879: upstream-reference=TopLevelComposition.Med_Prototype.RP_Cpr_Body_Data_SRI_Cpr_Rxsignal_Body.BcmDrvrDoorSts, ecu-extract-reference=TopLevelCompositionPrototype.Med_Prototype.RP_Cpr_Body_Data_SRI_Cpr_Rxsignal_Body.BcmDrvrDoorSts
      BcmDrvrDoorSts_Status_1880: upstream-reference=TopLevelComposition.Med_Prototype.RP_Cpr_Body_Data_SRI_Cpr_Rxsignal_Body.BcmDrvrDoorSts_Status, ecu-extract-reference=TopLevelCompositionPrototype.Med_Prototype.RP_Cpr_Body_Data_SRI_Cpr_Rxsignal_Body.BcmDrvrDoorSts_Status
      BcmEmgyLiSts_1881: upstream-reference=TopLevelComposition.Med_Prototype.RP_Cpr_Body_Data_SRI_Cpr_Rxsignal_Body.BcmEmgyLiSts, ecu-extract-reference=TopLevelCompositionPrototype.Med_Prototype.RP_Cpr_Body_Data_SRI_Cpr_Rxsignal_Body.BcmEmgyLiSts
      BcmEmgyLiSts_Status_1882: upstream-reference=TopLevelComposition.Med_Prototype.RP_Cpr_Body_Data_SRI_Cpr_Rxsignal_Body.BcmEmgyLiSts_Status, ecu-extract-reference=TopLevelCompositionPrototype.Med_Prototype.RP_Cpr_Body_Data_SRI_Cpr_Rxsignal_Body.BcmEmgyLiSts_Status
      BcmFrntFogLmpSts_1883: upstream-reference=TopLevelComposition.Med_Prototype.RP_Cpr_Body_Data_SRI_Cpr_Rxsignal_Body.BcmFrntFogLmpSts, ecu-extract-reference=TopLevelCompositionPrototype.Med_Prototype.RP_Cpr_Body_Data_SRI_Cpr_Rxsignal_Body.BcmFrntFogLmpSts
      BcmFrntFogLmpSts_Status_1884: upstream-reference=TopLevelComposition.Med_Prototype.RP_Cpr_Body_Data_SRI_Cpr_Rxsignal_Body.BcmFrntFogLmpSts_Status, ecu-extract-reference=TopLevelCompositionPrototype.Med_Prototype.RP_Cpr_Body_Data_SRI_Cpr_Rxsignal_Body.BcmFrntFogLmpSts_Status
      BcmFrntWiperSts_1885: upstream-reference=TopLevelComposition.Med_Prototype.RP_Cpr_Body_Data_SRI_Cpr_Rxsignal_Body.BcmFrntWiperSts, ecu-extract-reference=TopLevelCompositionPrototype.Med_Prototype.RP_Cpr_Body_Data_SRI_Cpr_Rxsignal_Body.BcmFrntWiperSts
      BcmFrntWiperSts_Status_1886: upstream-reference=TopLevelComposition.Med_Prototype.RP_Cpr_Body_Data_SRI_Cpr_Rxsignal_Body.BcmFrntWiperSts_Status, ecu-extract-reference=TopLevelCompositionPrototype.Med_Prototype.RP_Cpr_Body_Data_SRI_Cpr_Rxsignal_Body.BcmFrntWiperSts_Status
      BcmHiBeamSts_1887: upstream-reference=TopLevelComposition.Med_Prototype.RP_Cpr_Body_Data_SRI_Cpr_Rxsignal_Body.BcmHiBeamSts, ecu-extract-reference=TopLevelCompositionPrototype.Med_Prototype.RP_Cpr_Body_Data_SRI_Cpr_Rxsignal_Body.BcmHiBeamSts
      BcmHiBeamSts_Status_1888: upstream-reference=TopLevelComposition.Med_Prototype.RP_Cpr_Body_Data_SRI_Cpr_Rxsignal_Body.BcmHiBeamSts_Status, ecu-extract-reference=TopLevelCompositionPrototype.Med_Prototype.RP_Cpr_Body_Data_SRI_Cpr_Rxsignal_Body.BcmHiBeamSts_Status
      BcmLeReDoorSts_1889: upstream-reference=TopLevelComposition.Med_Prototype.RP_Cpr_Body_Data_SRI_Cpr_Rxsignal_Body.BcmLeReDoorSts, ecu-extract-reference=TopLevelCompositionPrototype.Med_Prototype.RP_Cpr_Body_Data_SRI_Cpr_Rxsignal_Body.BcmLeReDoorSts
      BcmLeReDoorSts_Status_1890: upstream-reference=TopLevelComposition.Med_Prototype.RP_Cpr_Body_Data_SRI_Cpr_Rxsignal_Body.BcmLeReDoorSts_Status, ecu-extract-reference=TopLevelCompositionPrototype.Med_Prototype.RP_Cpr_Body_Data_SRI_Cpr_Rxsignal_Body.BcmLeReDoorSts_Status
      BcmLoBeamSts_1891: upstream-reference=TopLevelComposition.Med_Prototype.RP_Cpr_Body_Data_SRI_Cpr_Rxsignal_Body.BcmLoBeamSts, ecu-extract-reference=TopLevelCompositionPrototype.Med_Prototype.RP_Cpr_Body_Data_SRI_Cpr_Rxsignal_Body.BcmLoBeamSts
      BcmLoBeamSts_Status_1892: upstream-reference=TopLevelComposition.Med_Prototype.RP_Cpr_Body_Data_SRI_Cpr_Rxsignal_Body.BcmLoBeamSts_Status, ecu-extract-reference=TopLevelCompositionPrototype.Med_Prototype.RP_Cpr_Body_Data_SRI_Cpr_Rxsignal_Body.BcmLoBeamSts_Status
      BcmPassDoorSts_1893: upstream-reference=TopLevelComposition.Med_Prototype.RP_Cpr_Body_Data_SRI_Cpr_Rxsignal_Body.BcmPassDoorSts, ecu-extract-reference=TopLevelCompositionPrototype.Med_Prototype.RP_Cpr_Body_Data_SRI_Cpr_Rxsignal_Body.BcmPassDoorSts
      BcmPassDoorSts_Status_1894: upstream-reference=TopLevelComposition.Med_Prototype.RP_Cpr_Body_Data_SRI_Cpr_Rxsignal_Body.BcmPassDoorSts_Status, ecu-extract-reference=TopLevelCompositionPrototype.Med_Prototype.RP_Cpr_Body_Data_SRI_Cpr_Rxsignal_Body.BcmPassDoorSts_Status
      BcmReFoglmpSts_1895: upstream-reference=TopLevelComposition.Med_Prototype.RP_Cpr_Body_Data_SRI_Cpr_Rxsignal_Body.BcmReFoglmpSts, ecu-extract-reference=TopLevelCompositionPrototype.Med_Prototype.RP_Cpr_Body_Data_SRI_Cpr_Rxsignal_Body.BcmReFoglmpSts
      BcmReFoglmpSts_Status_1896: upstream-reference=TopLevelComposition.Med_Prototype.RP_Cpr_Body_Data_SRI_Cpr_Rxsignal_Body.BcmReFoglmpSts_Status, ecu-extract-reference=TopLevelCompositionPrototype.Med_Prototype.RP_Cpr_Body_Data_SRI_Cpr_Rxsignal_Body.BcmReFoglmpSts_Status
      BcmRiReDoorSts_1897: upstream-reference=TopLevelComposition.Med_Prototype.RP_Cpr_Body_Data_SRI_Cpr_Rxsignal_Body.BcmRiReDoorSts, ecu-extract-reference=TopLevelCompositionPrototype.Med_Prototype.RP_Cpr_Body_Data_SRI_Cpr_Rxsignal_Body.BcmRiReDoorSts
      BcmRiReDoorSts_Status_1898: upstream-reference=TopLevelComposition.Med_Prototype.RP_Cpr_Body_Data_SRI_Cpr_Rxsignal_Body.BcmRiReDoorSts_Status, ecu-extract-reference=TopLevelCompositionPrototype.Med_Prototype.RP_Cpr_Body_Data_SRI_Cpr_Rxsignal_Body.BcmRiReDoorSts_Status
      BcmTurnIndcrLe_1899: upstream-reference=TopLevelComposition.Med_Prototype.RP_Cpr_Body_Data_SRI_Cpr_Rxsignal_Body.BcmTurnIndcrLe, ecu-extract-reference=TopLevelCompositionPrototype.Med_Prototype.RP_Cpr_Body_Data_SRI_Cpr_Rxsignal_Body.BcmTurnIndcrLe
      BcmTurnIndcrLe_Status_1900: upstream-reference=TopLevelComposition.Med_Prototype.RP_Cpr_Body_Data_SRI_Cpr_Rxsignal_Body.BcmTurnIndcrLe_Status, ecu-extract-reference=TopLevelCompositionPrototype.Med_Prototype.RP_Cpr_Body_Data_SRI_Cpr_Rxsignal_Body.BcmTurnIndcrLe_Status
      BcmTurnIndcrRi_1901: upstream-reference=TopLevelComposition.Med_Prototype.RP_Cpr_Body_Data_SRI_Cpr_Rxsignal_Body.BcmTurnIndcrRi, ecu-extract-reference=TopLevelCompositionPrototype.Med_Prototype.RP_Cpr_Body_Data_SRI_Cpr_Rxsignal_Body.BcmTurnIndcrRi
      BcmTurnIndcrRi_Status_1902: upstream-reference=TopLevelComposition.Med_Prototype.RP_Cpr_Body_Data_SRI_Cpr_Rxsignal_Body.BcmTurnIndcrRi_Status, ecu-extract-reference=TopLevelCompositionPrototype.Med_Prototype.RP_Cpr_Body_Data_SRI_Cpr_Rxsignal_Body.BcmTurnIndcrRi_Status
      IP_DISFail_1903: upstream-reference=TopLevelComposition.Med_Prototype.RP_Cpr_Body_Data_SRI_Cpr_Rxsignal_Body.IP_DISFail, ecu-extract-reference=TopLevelCompositionPrototype.Med_Prototype.RP_Cpr_Body_Data_SRI_Cpr_Rxsignal_Body.IP_DISFail
      IP_DISFail_Status_1904: upstream-reference=TopLevelComposition.Med_Prototype.RP_Cpr_Body_Data_SRI_Cpr_Rxsignal_Body.IP_DISFail_Status, ecu-extract-reference=TopLevelCompositionPrototype.Med_Prototype.RP_Cpr_Body_Data_SRI_Cpr_Rxsignal_Body.IP_DISFail_Status
      IP_QDashACCFail_1905: upstream-reference=TopLevelComposition.Med_Prototype.RP_Cpr_Body_Data_SRI_Cpr_Rxsignal_Body.IP_QDashACCFail, ecu-extract-reference=TopLevelCompositionPrototype.Med_Prototype.RP_Cpr_Body_Data_SRI_Cpr_Rxsignal_Body.IP_QDashACCFail
      IP_QDashACCFail_Status_1906: upstream-reference=TopLevelComposition.Med_Prototype.RP_Cpr_Body_Data_SRI_Cpr_Rxsignal_Body.IP_QDashACCFail_Status, ecu-extract-reference=TopLevelCompositionPrototype.Med_Prototype.RP_Cpr_Body_Data_SRI_Cpr_Rxsignal_Body.IP_QDashACCFail_Status
      SrsDrvrBucSwtSts_1907: upstream-reference=TopLevelComposition.Med_Prototype.RP_Cpr_Body_Data_SRI_Cpr_Rxsignal_Body.SrsDrvrBucSwtSts, ecu-extract-reference=TopLevelCompositionPrototype.Med_Prototype.RP_Cpr_Body_Data_SRI_Cpr_Rxsignal_Body.SrsDrvrBucSwtSts
      SrsDrvrBucSwtSts_Status_1908: upstream-reference=TopLevelComposition.Med_Prototype.RP_Cpr_Body_Data_SRI_Cpr_Rxsignal_Body.SrsDrvrBucSwtSts_Status, ecu-extract-reference=TopLevelCompositionPrototype.Med_Prototype.RP_Cpr_Body_Data_SRI_Cpr_Rxsignal_Body.SrsDrvrBucSwtSts_Status
      SrsPassBucSwtSts_1909: upstream-reference=TopLevelComposition.Med_Prototype.RP_Cpr_Body_Data_SRI_Cpr_Rxsignal_Body.SrsPassBucSwtSts, ecu-extract-reference=TopLevelCompositionPrototype.Med_Prototype.RP_Cpr_Body_Data_SRI_Cpr_Rxsignal_Body.SrsPassBucSwtSts
      SrsPassBucSwtSts_Status_1910: upstream-reference=TopLevelComposition.Med_Prototype.RP_Cpr_Body_Data_SRI_Cpr_Rxsignal_Body.SrsPassBucSwtSts_Status, ecu-extract-reference=TopLevelCompositionPrototype.Med_Prototype.RP_Cpr_Body_Data_SRI_Cpr_Rxsignal_Body.SrsPassBucSwtSts_Status
      TmsFrntBlowMod_1911: upstream-reference=TopLevelComposition.Med_Prototype.RP_Cpr_Body_Data_SRI_Cpr_Rxsignal_Body.TmsFrntBlowMod, ecu-extract-reference=TopLevelCompositionPrototype.Med_Prototype.RP_Cpr_Body_Data_SRI_Cpr_Rxsignal_Body.TmsFrntBlowMod
      TmsFrntBlowMod_Status_1912: upstream-reference=TopLevelComposition.Med_Prototype.RP_Cpr_Body_Data_SRI_Cpr_Rxsignal_Body.TmsFrntBlowMod_Status, ecu-extract-reference=TopLevelCompositionPrototype.Med_Prototype.RP_Cpr_Body_Data_SRI_Cpr_Rxsignal_Body.TmsFrntBlowMod_Status
      RP_Cpr_Chassis_Data_SRI_Cpr_RxSignal_Chassisd_1913: upstream-reference=TopLevelComposition.Med_Prototype.RP_Cpr_Chassis_Data_SRI_Cpr_RxSignal_Chassisd, ecu-extract-reference=TopLevelCompositionPrototype.Med_Prototype.RP_Cpr_Chassis_Data_SRI_Cpr_RxSignal_Chassisd
      AdsUDLCStatus_1914: upstream-reference=TopLevelComposition.Med_Prototype.RP_Cpr_Chassis_Data_SRI_Cpr_RxSignal_Chassisd.AdsUDLCStatus, ecu-extract-reference=TopLevelCompositionPrototype.Med_Prototype.RP_Cpr_Chassis_Data_SRI_Cpr_RxSignal_Chassisd.AdsUDLCStatus
      AdsUDLCStatus_Status_1915: upstream-reference=TopLevelComposition.Med_Prototype.RP_Cpr_Chassis_Data_SRI_Cpr_RxSignal_Chassisd.AdsUDLCStatus_Status, ecu-extract-reference=TopLevelCompositionPrototype.Med_Prototype.RP_Cpr_Chassis_Data_SRI_Cpr_RxSignal_Chassisd.AdsUDLCStatus_Status
      BrakePressureSimulator_1916: upstream-reference=TopLevelComposition.Med_Prototype.RP_Cpr_Chassis_Data_SRI_Cpr_RxSignal_Chassisd.BrakePressureSimulator, ecu-extract-reference=TopLevelCompositionPrototype.Med_Prototype.RP_Cpr_Chassis_Data_SRI_Cpr_RxSignal_Chassisd.BrakePressureSimulator
      BrakePressureSimulator_Status_1917: upstream-reference=TopLevelComposition.Med_Prototype.RP_Cpr_Chassis_Data_SRI_Cpr_RxSignal_Chassisd.BrakePressureSimulator_Status, ecu-extract-reference=TopLevelCompositionPrototype.Med_Prototype.RP_Cpr_Chassis_Data_SRI_Cpr_RxSignal_Chassisd.BrakePressureSimulator_Status
      EPS_APA_EpasFAILED_1918: upstream-reference=TopLevelComposition.Med_Prototype.RP_Cpr_Chassis_Data_SRI_Cpr_RxSignal_Chassisd.EPS_APA_EpasFAILED, ecu-extract-reference=TopLevelCompositionPrototype.Med_Prototype.RP_Cpr_Chassis_Data_SRI_Cpr_RxSignal_Chassisd.EPS_APA_EpasFAILED
      EPS_APA_EpasFAILED_Status_1919: upstream-reference=TopLevelComposition.Med_Prototype.RP_Cpr_Chassis_Data_SRI_Cpr_RxSignal_Chassisd.EPS_APA_EpasFAILED_Status, ecu-extract-reference=TopLevelCompositionPrototype.Med_Prototype.RP_Cpr_Chassis_Data_SRI_Cpr_RxSignal_Chassisd.EPS_APA_EpasFAILED_Status
      EPS_ActualMotorTorq_1920: upstream-reference=TopLevelComposition.Med_Prototype.RP_Cpr_Chassis_Data_SRI_Cpr_RxSignal_Chassisd.EPS_ActualMotorTorq, ecu-extract-reference=TopLevelCompositionPrototype.Med_Prototype.RP_Cpr_Chassis_Data_SRI_Cpr_RxSignal_Chassisd.EPS_ActualMotorTorq
      EPS_ActualMotorTorq_Status_1921: upstream-reference=TopLevelComposition.Med_Prototype.RP_Cpr_Chassis_Data_SRI_Cpr_RxSignal_Chassisd.EPS_ActualMotorTorq_Status, ecu-extract-reference=TopLevelCompositionPrototype.Med_Prototype.RP_Cpr_Chassis_Data_SRI_Cpr_RxSignal_Chassisd.EPS_ActualMotorTorq_Status
      EPS_ActualTorsionBarTorq_1922: upstream-reference=TopLevelComposition.Med_Prototype.RP_Cpr_Chassis_Data_SRI_Cpr_RxSignal_Chassisd.EPS_ActualTorsionBarTorq, ecu-extract-reference=TopLevelCompositionPrototype.Med_Prototype.RP_Cpr_Chassis_Data_SRI_Cpr_RxSignal_Chassisd.EPS_ActualTorsionBarTorq
      EPS_ActualTorsionBarTorq_Status_1923: upstream-reference=TopLevelComposition.Med_Prototype.RP_Cpr_Chassis_Data_SRI_Cpr_RxSignal_Chassisd.EPS_ActualTorsionBarTorq_Status, ecu-extract-reference=TopLevelCompositionPrototype.Med_Prototype.RP_Cpr_Chassis_Data_SRI_Cpr_RxSignal_Chassisd.EPS_ActualTorsionBarTorq_Status
      EPS_MeasuredTorsionBarTorqValid_1924: upstream-reference=TopLevelComposition.Med_Prototype.RP_Cpr_Chassis_Data_SRI_Cpr_RxSignal_Chassisd.EPS_MeasuredTorsionBarTorqValid, ecu-extract-reference=TopLevelCompositionPrototype.Med_Prototype.RP_Cpr_Chassis_Data_SRI_Cpr_RxSignal_Chassisd.EPS_MeasuredTorsionBarTorqValid
      EPS_Pinionang_Valid_1925: upstream-reference=TopLevelComposition.Med_Prototype.RP_Cpr_Chassis_Data_SRI_Cpr_RxSignal_Chassisd.EPS_Pinionang_Valid, ecu-extract-reference=TopLevelCompositionPrototype.Med_Prototype.RP_Cpr_Chassis_Data_SRI_Cpr_RxSignal_Chassisd.EPS_Pinionang_Valid
      EPS_fault_state_1926: upstream-reference=TopLevelComposition.Med_Prototype.RP_Cpr_Chassis_Data_SRI_Cpr_RxSignal_Chassisd.EPS_fault_state, ecu-extract-reference=TopLevelCompositionPrototype.Med_Prototype.RP_Cpr_Chassis_Data_SRI_Cpr_RxSignal_Chassisd.EPS_fault_state
      EPS_fault_state_Status_1927: upstream-reference=TopLevelComposition.Med_Prototype.RP_Cpr_Chassis_Data_SRI_Cpr_RxSignal_Chassisd.EPS_fault_state_Status, ecu-extract-reference=TopLevelCompositionPrototype.Med_Prototype.RP_Cpr_Chassis_Data_SRI_Cpr_RxSignal_Chassisd.EPS_fault_state_Status
      ESP_LatAccelValid_1928: upstream-reference=TopLevelComposition.Med_Prototype.RP_Cpr_Chassis_Data_SRI_Cpr_RxSignal_Chassisd.ESP_LatAccelValid, ecu-extract-reference=TopLevelCompositionPrototype.Med_Prototype.RP_Cpr_Chassis_Data_SRI_Cpr_RxSignal_Chassisd.ESP_LatAccelValid
      ESP_LongAccelValid_1929: upstream-reference=TopLevelComposition.Med_Prototype.RP_Cpr_Chassis_Data_SRI_Cpr_RxSignal_Chassisd.ESP_LongAccelValid, ecu-extract-reference=TopLevelCompositionPrototype.Med_Prototype.RP_Cpr_Chassis_Data_SRI_Cpr_RxSignal_Chassisd.ESP_LongAccelValid
      ESP_YawRateValid_1930: upstream-reference=TopLevelComposition.Med_Prototype.RP_Cpr_Chassis_Data_SRI_Cpr_RxSignal_Chassisd.ESP_YawRateValid, ecu-extract-reference=TopLevelCompositionPrototype.Med_Prototype.RP_Cpr_Chassis_Data_SRI_Cpr_RxSignal_Chassisd.ESP_YawRateValid
      EpsConcussAvailabilityStatus_1931: upstream-reference=TopLevelComposition.Med_Prototype.RP_Cpr_Chassis_Data_SRI_Cpr_RxSignal_Chassisd.EpsConcussAvailabilityStatus, ecu-extract-reference=TopLevelCompositionPrototype.Med_Prototype.RP_Cpr_Chassis_Data_SRI_Cpr_RxSignal_Chassisd.EpsConcussAvailabilityStatus
      EpsConcussAvailabilityStatus_Status_1932: upstream-reference=TopLevelComposition.Med_Prototype.RP_Cpr_Chassis_Data_SRI_Cpr_RxSignal_Chassisd.EpsConcussAvailabilityStatus_Status, ecu-extract-reference=TopLevelCompositionPrototype.Med_Prototype.RP_Cpr_Chassis_Data_SRI_Cpr_RxSignal_Chassisd.EpsConcussAvailabilityStatus_Status
      EpsFaild_1933: upstream-reference=TopLevelComposition.Med_Prototype.RP_Cpr_Chassis_Data_SRI_Cpr_RxSignal_Chassisd.EpsFaild, ecu-extract-reference=TopLevelCompositionPrototype.Med_Prototype.RP_Cpr_Chassis_Data_SRI_Cpr_RxSignal_Chassisd.EpsFaild
      EpsFaild_Status_1934: upstream-reference=TopLevelComposition.Med_Prototype.RP_Cpr_Chassis_Data_SRI_Cpr_RxSignal_Chassisd.EpsFaild_Status, ecu-extract-reference=TopLevelCompositionPrototype.Med_Prototype.RP_Cpr_Chassis_Data_SRI_Cpr_RxSignal_Chassisd.EpsFaild_Status
      EpsIACCabortreason_1935: upstream-reference=TopLevelComposition.Med_Prototype.RP_Cpr_Chassis_Data_SRI_Cpr_RxSignal_Chassisd.EpsIACCabortreason, ecu-extract-reference=TopLevelCompositionPrototype.Med_Prototype.RP_Cpr_Chassis_Data_SRI_Cpr_RxSignal_Chassisd.EpsIACCabortreason
      EpsIACCabortreason_Status_1936: upstream-reference=TopLevelComposition.Med_Prototype.RP_Cpr_Chassis_Data_SRI_Cpr_RxSignal_Chassisd.EpsIACCabortreason_Status, ecu-extract-reference=TopLevelCompositionPrototype.Med_Prototype.RP_Cpr_Chassis_Data_SRI_Cpr_RxSignal_Chassisd.EpsIACCabortreason_Status
      EpsLatCtrlActive_1937: upstream-reference=TopLevelComposition.Med_Prototype.RP_Cpr_Chassis_Data_SRI_Cpr_RxSignal_Chassisd.EpsLatCtrlActive, ecu-extract-reference=TopLevelCompositionPrototype.Med_Prototype.RP_Cpr_Chassis_Data_SRI_Cpr_RxSignal_Chassisd.EpsLatCtrlActive
      EpsLatCtrlActive_Status_1938: upstream-reference=TopLevelComposition.Med_Prototype.RP_Cpr_Chassis_Data_SRI_Cpr_RxSignal_Chassisd.EpsLatCtrlActive_Status, ecu-extract-reference=TopLevelCompositionPrototype.Med_Prototype.RP_Cpr_Chassis_Data_SRI_Cpr_RxSignal_Chassisd.EpsLatCtrlActive_Status
      EpsLatCtrlAvailabilityStatus_1939: upstream-reference=TopLevelComposition.Med_Prototype.RP_Cpr_Chassis_Data_SRI_Cpr_RxSignal_Chassisd.EpsLatCtrlAvailabilityStatus, ecu-extract-reference=TopLevelCompositionPrototype.Med_Prototype.RP_Cpr_Chassis_Data_SRI_Cpr_RxSignal_Chassisd.EpsLatCtrlAvailabilityStatus
      EpsLatCtrlAvailabilityStatus_Status_1940: upstream-reference=TopLevelComposition.Med_Prototype.RP_Cpr_Chassis_Data_SRI_Cpr_RxSignal_Chassisd.EpsLatCtrlAvailabilityStatus_Status, ecu-extract-reference=TopLevelCompositionPrototype.Med_Prototype.RP_Cpr_Chassis_Data_SRI_Cpr_RxSignal_Chassisd.EpsLatCtrlAvailabilityStatus_Status
      EpsMeasuredTorsionBarTorq_Status_1941: upstream-reference=TopLevelComposition.Med_Prototype.RP_Cpr_Chassis_Data_SRI_Cpr_RxSignal_Chassisd.EpsMeasuredTorsionBarTorq_Status, ecu-extract-reference=TopLevelCompositionPrototype.Med_Prototype.RP_Cpr_Chassis_Data_SRI_Cpr_RxSignal_Chassisd.EpsMeasuredTorsionBarTorq_Status
      EpsMeasuredTorsionBarTorque_1942: upstream-reference=TopLevelComposition.Med_Prototype.RP_Cpr_Chassis_Data_SRI_Cpr_RxSignal_Chassisd.EpsMeasuredTorsionBarTorque, ecu-extract-reference=TopLevelCompositionPrototype.Med_Prototype.RP_Cpr_Chassis_Data_SRI_Cpr_RxSignal_Chassisd.EpsMeasuredTorsionBarTorque
      EpsMeasuredTorsionBarTorque_Status_1943: upstream-reference=TopLevelComposition.Med_Prototype.RP_Cpr_Chassis_Data_SRI_Cpr_RxSignal_Chassisd.EpsMeasuredTorsionBarTorque_Status, ecu-extract-reference=TopLevelCompositionPrototype.Med_Prototype.RP_Cpr_Chassis_Data_SRI_Cpr_RxSignal_Chassisd.EpsMeasuredTorsionBarTorque_Status
      EpsPinionang_1944: upstream-reference=TopLevelComposition.Med_Prototype.RP_Cpr_Chassis_Data_SRI_Cpr_RxSignal_Chassisd.EpsPinionang, ecu-extract-reference=TopLevelCompositionPrototype.Med_Prototype.RP_Cpr_Chassis_Data_SRI_Cpr_RxSignal_Chassisd.EpsPinionang
      EpsPinionang_Status_1945: upstream-reference=TopLevelComposition.Med_Prototype.RP_Cpr_Chassis_Data_SRI_Cpr_RxSignal_Chassisd.EpsPinionang_Status, ecu-extract-reference=TopLevelCompositionPrototype.Med_Prototype.RP_Cpr_Chassis_Data_SRI_Cpr_RxSignal_Chassisd.EpsPinionang_Status
      EpsSasCalSts_1946: upstream-reference=TopLevelComposition.Med_Prototype.RP_Cpr_Chassis_Data_SRI_Cpr_RxSignal_Chassisd.EpsSasCalSts, ecu-extract-reference=TopLevelCompositionPrototype.Med_Prototype.RP_Cpr_Chassis_Data_SRI_Cpr_RxSignal_Chassisd.EpsSasCalSts
      EpsSasCalSts_Status_1947: upstream-reference=TopLevelComposition.Med_Prototype.RP_Cpr_Chassis_Data_SRI_Cpr_RxSignal_Chassisd.EpsSasCalSts_Status, ecu-extract-reference=TopLevelCompositionPrototype.Med_Prototype.RP_Cpr_Chassis_Data_SRI_Cpr_RxSignal_Chassisd.EpsSasCalSts_Status
      EpsSasSteerAg_1948: upstream-reference=TopLevelComposition.Med_Prototype.RP_Cpr_Chassis_Data_SRI_Cpr_RxSignal_Chassisd.EpsSasSteerAg, ecu-extract-reference=TopLevelCompositionPrototype.Med_Prototype.RP_Cpr_Chassis_Data_SRI_Cpr_RxSignal_Chassisd.EpsSasSteerAg
      EpsSasSteerAgVld_1949: upstream-reference=TopLevelComposition.Med_Prototype.RP_Cpr_Chassis_Data_SRI_Cpr_RxSignal_Chassisd.EpsSasSteerAgVld, ecu-extract-reference=TopLevelCompositionPrototype.Med_Prototype.RP_Cpr_Chassis_Data_SRI_Cpr_RxSignal_Chassisd.EpsSasSteerAgVld
      EpsSasSteerAg_Status_1950: upstream-reference=TopLevelComposition.Med_Prototype.RP_Cpr_Chassis_Data_SRI_Cpr_RxSignal_Chassisd.EpsSasSteerAg_Status, ecu-extract-reference=TopLevelCompositionPrototype.Med_Prototype.RP_Cpr_Chassis_Data_SRI_Cpr_RxSignal_Chassisd.EpsSasSteerAg_Status
      EpsSteerAgRate_1951: upstream-reference=TopLevelComposition.Med_Prototype.RP_Cpr_Chassis_Data_SRI_Cpr_RxSignal_Chassisd.EpsSteerAgRate, ecu-extract-reference=TopLevelCompositionPrototype.Med_Prototype.RP_Cpr_Chassis_Data_SRI_Cpr_RxSignal_Chassisd.EpsSteerAgRate
      EpsSteerAgRate_Status_1952: upstream-reference=TopLevelComposition.Med_Prototype.RP_Cpr_Chassis_Data_SRI_Cpr_RxSignal_Chassisd.EpsSteerAgRate_Status, ecu-extract-reference=TopLevelCompositionPrototype.Med_Prototype.RP_Cpr_Chassis_Data_SRI_Cpr_RxSignal_Chassisd.EpsSteerAgRate_Status
      EpsSteerAgSensFilr_1953: upstream-reference=TopLevelComposition.Med_Prototype.RP_Cpr_Chassis_Data_SRI_Cpr_RxSignal_Chassisd.EpsSteerAgSensFilr, ecu-extract-reference=TopLevelCompositionPrototype.Med_Prototype.RP_Cpr_Chassis_Data_SRI_Cpr_RxSignal_Chassisd.EpsSteerAgSensFilr
      EpsSteerAgSensFilr_Status_1954: upstream-reference=TopLevelComposition.Med_Prototype.RP_Cpr_Chassis_Data_SRI_Cpr_RxSignal_Chassisd.EpsSteerAgSensFilr_Status, ecu-extract-reference=TopLevelCompositionPrototype.Med_Prototype.RP_Cpr_Chassis_Data_SRI_Cpr_RxSignal_Chassisd.EpsSteerAgSensFilr_Status
      EspABAactive_1955: upstream-reference=TopLevelComposition.Med_Prototype.RP_Cpr_Chassis_Data_SRI_Cpr_RxSignal_Chassisd.EspABAactive, ecu-extract-reference=TopLevelCompositionPrototype.Med_Prototype.RP_Cpr_Chassis_Data_SRI_Cpr_RxSignal_Chassisd.EspABAactive
      EspABAactive_Status_1956: upstream-reference=TopLevelComposition.Med_Prototype.RP_Cpr_Chassis_Data_SRI_Cpr_RxSignal_Chassisd.EspABAactive_Status, ecu-extract-reference=TopLevelCompositionPrototype.Med_Prototype.RP_Cpr_Chassis_Data_SRI_Cpr_RxSignal_Chassisd.EspABAactive_Status
      EspABAavailable_1957: upstream-reference=TopLevelComposition.Med_Prototype.RP_Cpr_Chassis_Data_SRI_Cpr_RxSignal_Chassisd.EspABAavailable, ecu-extract-reference=TopLevelCompositionPrototype.Med_Prototype.RP_Cpr_Chassis_Data_SRI_Cpr_RxSignal_Chassisd.EspABAavailable
      EspABAavailable_Status_1958: upstream-reference=TopLevelComposition.Med_Prototype.RP_Cpr_Chassis_Data_SRI_Cpr_RxSignal_Chassisd.EspABAavailable_Status, ecu-extract-reference=TopLevelCompositionPrototype.Med_Prototype.RP_Cpr_Chassis_Data_SRI_Cpr_RxSignal_Chassisd.EspABAavailable_Status
      EspAEBAvailable_1959: upstream-reference=TopLevelComposition.Med_Prototype.RP_Cpr_Chassis_Data_SRI_Cpr_RxSignal_Chassisd.EspAEBAvailable, ecu-extract-reference=TopLevelCompositionPrototype.Med_Prototype.RP_Cpr_Chassis_Data_SRI_Cpr_RxSignal_Chassisd.EspAEBAvailable
      EspAEBAvailable_Status_1960: upstream-reference=TopLevelComposition.Med_Prototype.RP_Cpr_Chassis_Data_SRI_Cpr_RxSignal_Chassisd.EspAEBAvailable_Status, ecu-extract-reference=TopLevelCompositionPrototype.Med_Prototype.RP_Cpr_Chassis_Data_SRI_Cpr_RxSignal_Chassisd.EspAEBAvailable_Status
      EspAEBdecActive_1961: upstream-reference=TopLevelComposition.Med_Prototype.RP_Cpr_Chassis_Data_SRI_Cpr_RxSignal_Chassisd.EspAEBdecActive, ecu-extract-reference=TopLevelCompositionPrototype.Med_Prototype.RP_Cpr_Chassis_Data_SRI_Cpr_RxSignal_Chassisd.EspAEBdecActive
      EspAEBdecActive_Status_1962: upstream-reference=TopLevelComposition.Med_Prototype.RP_Cpr_Chassis_Data_SRI_Cpr_RxSignal_Chassisd.EspAEBdecActive_Status, ecu-extract-reference=TopLevelCompositionPrototype.Med_Prototype.RP_Cpr_Chassis_Data_SRI_Cpr_RxSignal_Chassisd.EspAEBdecActive_Status
      EspAWBactive_1963: upstream-reference=TopLevelComposition.Med_Prototype.RP_Cpr_Chassis_Data_SRI_Cpr_RxSignal_Chassisd.EspAWBactive, ecu-extract-reference=TopLevelCompositionPrototype.Med_Prototype.RP_Cpr_Chassis_Data_SRI_Cpr_RxSignal_Chassisd.EspAWBactive
      EspAWBactive_Status_1964: upstream-reference=TopLevelComposition.Med_Prototype.RP_Cpr_Chassis_Data_SRI_Cpr_RxSignal_Chassisd.EspAWBactive_Status, ecu-extract-reference=TopLevelCompositionPrototype.Med_Prototype.RP_Cpr_Chassis_Data_SRI_Cpr_RxSignal_Chassisd.EspAWBactive_Status
      EspAWBavailable_1965: upstream-reference=TopLevelComposition.Med_Prototype.RP_Cpr_Chassis_Data_SRI_Cpr_RxSignal_Chassisd.EspAWBavailable, ecu-extract-reference=TopLevelCompositionPrototype.Med_Prototype.RP_Cpr_Chassis_Data_SRI_Cpr_RxSignal_Chassisd.EspAWBavailable
      EspAWBavailable_Status_1966: upstream-reference=TopLevelComposition.Med_Prototype.RP_Cpr_Chassis_Data_SRI_Cpr_RxSignal_Chassisd.EspAWBavailable_Status, ecu-extract-reference=TopLevelCompositionPrototype.Med_Prototype.RP_Cpr_Chassis_Data_SRI_Cpr_RxSignal_Chassisd.EspAWBavailable_Status
      EspAbsActv_1967: upstream-reference=TopLevelComposition.Med_Prototype.RP_Cpr_Chassis_Data_SRI_Cpr_RxSignal_Chassisd.EspAbsActv, ecu-extract-reference=TopLevelCompositionPrototype.Med_Prototype.RP_Cpr_Chassis_Data_SRI_Cpr_RxSignal_Chassisd.EspAbsActv
      EspAbsActv_Status_1968: upstream-reference=TopLevelComposition.Med_Prototype.RP_Cpr_Chassis_Data_SRI_Cpr_RxSignal_Chassisd.EspAbsActv_Status, ecu-extract-reference=TopLevelCompositionPrototype.Med_Prototype.RP_Cpr_Chassis_Data_SRI_Cpr_RxSignal_Chassisd.EspAbsActv_Status
      EspAbsFailr_1969: upstream-reference=TopLevelComposition.Med_Prototype.RP_Cpr_Chassis_Data_SRI_Cpr_RxSignal_Chassisd.EspAbsFailr, ecu-extract-reference=TopLevelCompositionPrototype.Med_Prototype.RP_Cpr_Chassis_Data_SRI_Cpr_RxSignal_Chassisd.EspAbsFailr
      EspAbsFailr_Status_1970: upstream-reference=TopLevelComposition.Med_Prototype.RP_Cpr_Chassis_Data_SRI_Cpr_RxSignal_Chassisd.EspAbsFailr_Status, ecu-extract-reference=TopLevelCompositionPrototype.Med_Prototype.RP_Cpr_Chassis_Data_SRI_Cpr_RxSignal_Chassisd.EspAbsFailr_Status
      EspActvSts_1971: upstream-reference=TopLevelComposition.Med_Prototype.RP_Cpr_Chassis_Data_SRI_Cpr_RxSignal_Chassisd.EspActvSts, ecu-extract-reference=TopLevelCompositionPrototype.Med_Prototype.RP_Cpr_Chassis_Data_SRI_Cpr_RxSignal_Chassisd.EspActvSts
      EspActvSts_Status_1972: upstream-reference=TopLevelComposition.Med_Prototype.RP_Cpr_Chassis_Data_SRI_Cpr_RxSignal_Chassisd.EspActvSts_Status, ecu-extract-reference=TopLevelCompositionPrototype.Med_Prototype.RP_Cpr_Chassis_Data_SRI_Cpr_RxSignal_Chassisd.EspActvSts_Status
      EspEbdFailr_1973: upstream-reference=TopLevelComposition.Med_Prototype.RP_Cpr_Chassis_Data_SRI_Cpr_RxSignal_Chassisd.EspEbdFailr, ecu-extract-reference=TopLevelCompositionPrototype.Med_Prototype.RP_Cpr_Chassis_Data_SRI_Cpr_RxSignal_Chassisd.EspEbdFailr
      EspEbdFailr_Status_1974: upstream-reference=TopLevelComposition.Med_Prototype.RP_Cpr_Chassis_Data_SRI_Cpr_RxSignal_Chassisd.EspEbdFailr_Status, ecu-extract-reference=TopLevelCompositionPrototype.Med_Prototype.RP_Cpr_Chassis_Data_SRI_Cpr_RxSignal_Chassisd.EspEbdFailr_Status
      EspLatAccel_1975: upstream-reference=TopLevelComposition.Med_Prototype.RP_Cpr_Chassis_Data_SRI_Cpr_RxSignal_Chassisd.EspLatAccel, ecu-extract-reference=TopLevelCompositionPrototype.Med_Prototype.RP_Cpr_Chassis_Data_SRI_Cpr_RxSignal_Chassisd.EspLatAccel
      EspLatAccel_Status_1976: upstream-reference=TopLevelComposition.Med_Prototype.RP_Cpr_Chassis_Data_SRI_Cpr_RxSignal_Chassisd.EspLatAccel_Status, ecu-extract-reference=TopLevelCompositionPrototype.Med_Prototype.RP_Cpr_Chassis_Data_SRI_Cpr_RxSignal_Chassisd.EspLatAccel_Status
      EspLongAccel_1977: upstream-reference=TopLevelComposition.Med_Prototype.RP_Cpr_Chassis_Data_SRI_Cpr_RxSignal_Chassisd.EspLongAccel, ecu-extract-reference=TopLevelCompositionPrototype.Med_Prototype.RP_Cpr_Chassis_Data_SRI_Cpr_RxSignal_Chassisd.EspLongAccel
      EspLongAccel_Status_1978: upstream-reference=TopLevelComposition.Med_Prototype.RP_Cpr_Chassis_Data_SRI_Cpr_RxSignal_Chassisd.EspLongAccel_Status, ecu-extract-reference=TopLevelCompositionPrototype.Med_Prototype.RP_Cpr_Chassis_Data_SRI_Cpr_RxSignal_Chassisd.EspLongAccel_Status
      EspPrefillActive_1979: upstream-reference=TopLevelComposition.Med_Prototype.RP_Cpr_Chassis_Data_SRI_Cpr_RxSignal_Chassisd.EspPrefillActive, ecu-extract-reference=TopLevelCompositionPrototype.Med_Prototype.RP_Cpr_Chassis_Data_SRI_Cpr_RxSignal_Chassisd.EspPrefillActive
      EspPrefillActive_Status_1980: upstream-reference=TopLevelComposition.Med_Prototype.RP_Cpr_Chassis_Data_SRI_Cpr_RxSignal_Chassisd.EspPrefillActive_Status, ecu-extract-reference=TopLevelCompositionPrototype.Med_Prototype.RP_Cpr_Chassis_Data_SRI_Cpr_RxSignal_Chassisd.EspPrefillActive_Status
      EspPrefillAvailable_1981: upstream-reference=TopLevelComposition.Med_Prototype.RP_Cpr_Chassis_Data_SRI_Cpr_RxSignal_Chassisd.EspPrefillAvailable, ecu-extract-reference=TopLevelCompositionPrototype.Med_Prototype.RP_Cpr_Chassis_Data_SRI_Cpr_RxSignal_Chassisd.EspPrefillAvailable
      EspPrefillAvailable_Status_1982: upstream-reference=TopLevelComposition.Med_Prototype.RP_Cpr_Chassis_Data_SRI_Cpr_RxSignal_Chassisd.EspPrefillAvailable_Status, ecu-extract-reference=TopLevelCompositionPrototype.Med_Prototype.RP_Cpr_Chassis_Data_SRI_Cpr_RxSignal_Chassisd.EspPrefillAvailable_Status
      EspTcsActvSts_1983: upstream-reference=TopLevelComposition.Med_Prototype.RP_Cpr_Chassis_Data_SRI_Cpr_RxSignal_Chassisd.EspTcsActvSts, ecu-extract-reference=TopLevelCompositionPrototype.Med_Prototype.RP_Cpr_Chassis_Data_SRI_Cpr_RxSignal_Chassisd.EspTcsActvSts
      EspTcsActvSts_Status_1984: upstream-reference=TopLevelComposition.Med_Prototype.RP_Cpr_Chassis_Data_SRI_Cpr_RxSignal_Chassisd.EspTcsActvSts_Status, ecu-extract-reference=TopLevelCompositionPrototype.Med_Prototype.RP_Cpr_Chassis_Data_SRI_Cpr_RxSignal_Chassisd.EspTcsActvSts_Status
      EspTcsFailr_1985: upstream-reference=TopLevelComposition.Med_Prototype.RP_Cpr_Chassis_Data_SRI_Cpr_RxSignal_Chassisd.EspTcsFailr, ecu-extract-reference=TopLevelCompositionPrototype.Med_Prototype.RP_Cpr_Chassis_Data_SRI_Cpr_RxSignal_Chassisd.EspTcsFailr
      EspTcsFailr_Status_1986: upstream-reference=TopLevelComposition.Med_Prototype.RP_Cpr_Chassis_Data_SRI_Cpr_RxSignal_Chassisd.EspTcsFailr_Status, ecu-extract-reference=TopLevelCompositionPrototype.Med_Prototype.RP_Cpr_Chassis_Data_SRI_Cpr_RxSignal_Chassisd.EspTcsFailr_Status
      EspVdcActvSts_1987: upstream-reference=TopLevelComposition.Med_Prototype.RP_Cpr_Chassis_Data_SRI_Cpr_RxSignal_Chassisd.EspVdcActvSts, ecu-extract-reference=TopLevelCompositionPrototype.Med_Prototype.RP_Cpr_Chassis_Data_SRI_Cpr_RxSignal_Chassisd.EspVdcActvSts
      EspVdcActvSts_Status_1988: upstream-reference=TopLevelComposition.Med_Prototype.RP_Cpr_Chassis_Data_SRI_Cpr_RxSignal_Chassisd.EspVdcActvSts_Status, ecu-extract-reference=TopLevelCompositionPrototype.Med_Prototype.RP_Cpr_Chassis_Data_SRI_Cpr_RxSignal_Chassisd.EspVdcActvSts_Status
      EspVehSpd_1989: upstream-reference=TopLevelComposition.Med_Prototype.RP_Cpr_Chassis_Data_SRI_Cpr_RxSignal_Chassisd.EspVehSpd, ecu-extract-reference=TopLevelCompositionPrototype.Med_Prototype.RP_Cpr_Chassis_Data_SRI_Cpr_RxSignal_Chassisd.EspVehSpd
      EspVehSpdVld_1990: upstream-reference=TopLevelComposition.Med_Prototype.RP_Cpr_Chassis_Data_SRI_Cpr_RxSignal_Chassisd.EspVehSpdVld, ecu-extract-reference=TopLevelCompositionPrototype.Med_Prototype.RP_Cpr_Chassis_Data_SRI_Cpr_RxSignal_Chassisd.EspVehSpdVld
      EspVehSpd_Status_1991: upstream-reference=TopLevelComposition.Med_Prototype.RP_Cpr_Chassis_Data_SRI_Cpr_RxSignal_Chassisd.EspVehSpd_Status, ecu-extract-reference=TopLevelCompositionPrototype.Med_Prototype.RP_Cpr_Chassis_Data_SRI_Cpr_RxSignal_Chassisd.EspVehSpd_Status
      EspYawRate_1992: upstream-reference=TopLevelComposition.Med_Prototype.RP_Cpr_Chassis_Data_SRI_Cpr_RxSignal_Chassisd.EspYawRate, ecu-extract-reference=TopLevelCompositionPrototype.Med_Prototype.RP_Cpr_Chassis_Data_SRI_Cpr_RxSignal_Chassisd.EspYawRate
      EspYawRate_Status_1993: upstream-reference=TopLevelComposition.Med_Prototype.RP_Cpr_Chassis_Data_SRI_Cpr_RxSignal_Chassisd.EspYawRate_Status, ecu-extract-reference=TopLevelCompositionPrototype.Med_Prototype.RP_Cpr_Chassis_Data_SRI_Cpr_RxSignal_Chassisd.EspYawRate_Status
      IBCU_PFSBrakePressureValid_1994: upstream-reference=TopLevelComposition.Med_Prototype.RP_Cpr_Chassis_Data_SRI_Cpr_RxSignal_Chassisd.IBCU_PFSBrakePressureValid, ecu-extract-reference=TopLevelCompositionPrototype.Med_Prototype.RP_Cpr_Chassis_Data_SRI_Cpr_RxSignal_Chassisd.IBCU_PFSBrakePressureValid
      IbBrkPedlStsGb_1995: upstream-reference=TopLevelComposition.Med_Prototype.RP_Cpr_Chassis_Data_SRI_Cpr_RxSignal_Chassisd.IbBrkPedlStsGb, ecu-extract-reference=TopLevelCompositionPrototype.Med_Prototype.RP_Cpr_Chassis_Data_SRI_Cpr_RxSignal_Chassisd.IbBrkPedlStsGb
      IbBrkPedlStsGbVld_1996: upstream-reference=TopLevelComposition.Med_Prototype.RP_Cpr_Chassis_Data_SRI_Cpr_RxSignal_Chassisd.IbBrkPedlStsGbVld, ecu-extract-reference=TopLevelCompositionPrototype.Med_Prototype.RP_Cpr_Chassis_Data_SRI_Cpr_RxSignal_Chassisd.IbBrkPedlStsGbVld
      IbBrkPedlStsGb_Status_1997: upstream-reference=TopLevelComposition.Med_Prototype.RP_Cpr_Chassis_Data_SRI_Cpr_RxSignal_Chassisd.IbBrkPedlStsGb_Status, ecu-extract-reference=TopLevelCompositionPrototype.Med_Prototype.RP_Cpr_Chassis_Data_SRI_Cpr_RxSignal_Chassisd.IbBrkPedlStsGb_Status
      IbBrkPedlTrvlDrvr_1998: upstream-reference=TopLevelComposition.Med_Prototype.RP_Cpr_Chassis_Data_SRI_Cpr_RxSignal_Chassisd.IbBrkPedlTrvlDrvr, ecu-extract-reference=TopLevelCompositionPrototype.Med_Prototype.RP_Cpr_Chassis_Data_SRI_Cpr_RxSignal_Chassisd.IbBrkPedlTrvlDrvr
      IbBrkPedlTrvlDrvrVld_1999: upstream-reference=TopLevelComposition.Med_Prototype.RP_Cpr_Chassis_Data_SRI_Cpr_RxSignal_Chassisd.IbBrkPedlTrvlDrvrVld, ecu-extract-reference=TopLevelCompositionPrototype.Med_Prototype.RP_Cpr_Chassis_Data_SRI_Cpr_RxSignal_Chassisd.IbBrkPedlTrvlDrvrVld
      PlungerBrakePressure_2000: upstream-reference=TopLevelComposition.Med_Prototype.RP_Cpr_Chassis_Data_SRI_Cpr_RxSignal_Chassisd.PlungerBrakePressure, ecu-extract-reference=TopLevelCompositionPrototype.Med_Prototype.RP_Cpr_Chassis_Data_SRI_Cpr_RxSignal_Chassisd.PlungerBrakePressure
      PlungerBrakePressure_Status_2001: upstream-reference=TopLevelComposition.Med_Prototype.RP_Cpr_Chassis_Data_SRI_Cpr_RxSignal_Chassisd.PlungerBrakePressure_Status, ecu-extract-reference=TopLevelCompositionPrototype.Med_Prototype.RP_Cpr_Chassis_Data_SRI_Cpr_RxSignal_Chassisd.PlungerBrakePressure_Status
      VcuAccrPedlPosn_2002: upstream-reference=TopLevelComposition.Med_Prototype.RP_Cpr_Chassis_Data_SRI_Cpr_RxSignal_Chassisd.VcuAccrPedlPosn, ecu-extract-reference=TopLevelCompositionPrototype.Med_Prototype.RP_Cpr_Chassis_Data_SRI_Cpr_RxSignal_Chassisd.VcuAccrPedlPosn
      VcuAccrPedlPosnVld_2003: upstream-reference=TopLevelComposition.Med_Prototype.RP_Cpr_Chassis_Data_SRI_Cpr_RxSignal_Chassisd.VcuAccrPedlPosnVld, ecu-extract-reference=TopLevelCompositionPrototype.Med_Prototype.RP_Cpr_Chassis_Data_SRI_Cpr_RxSignal_Chassisd.VcuAccrPedlPosnVld
      VcuAccrPedlPosn_Status_2004: upstream-reference=TopLevelComposition.Med_Prototype.RP_Cpr_Chassis_Data_SRI_Cpr_RxSignal_Chassisd.VcuAccrPedlPosn_Status, ecu-extract-reference=TopLevelCompositionPrototype.Med_Prototype.RP_Cpr_Chassis_Data_SRI_Cpr_RxSignal_Chassisd.VcuAccrPedlPosn_Status
      VcuGearPosn_2005: upstream-reference=TopLevelComposition.Med_Prototype.RP_Cpr_Chassis_Data_SRI_Cpr_RxSignal_Chassisd.VcuGearPosn, ecu-extract-reference=TopLevelCompositionPrototype.Med_Prototype.RP_Cpr_Chassis_Data_SRI_Cpr_RxSignal_Chassisd.VcuGearPosn
      VcuGearPosn_Status_2006: upstream-reference=TopLevelComposition.Med_Prototype.RP_Cpr_Chassis_Data_SRI_Cpr_RxSignal_Chassisd.VcuGearPosn_Status, ecu-extract-reference=TopLevelCompositionPrototype.Med_Prototype.RP_Cpr_Chassis_Data_SRI_Cpr_RxSignal_Chassisd.VcuGearPosn_Status
      VcuVehGearPosnVld_2007: upstream-reference=TopLevelComposition.Med_Prototype.RP_Cpr_Chassis_Data_SRI_Cpr_RxSignal_Chassisd.VcuVehGearPosnVld, ecu-extract-reference=TopLevelCompositionPrototype.Med_Prototype.RP_Cpr_Chassis_Data_SRI_Cpr_RxSignal_Chassisd.VcuVehGearPosnVld
      RP_Cpr_GetMsgStatusInfo_CSI_Cpr_RxMessageState_2008: upstream-reference=TopLevelComposition.Med_Prototype.RP_Cpr_GetMsgStatusInfo_CSI_Cpr_RxMessageState, ecu-extract-reference=TopLevelCompositionPrototype.Med_Prototype.RP_Cpr_GetMsgStatusInfo_CSI_Cpr_RxMessageState
      RP_Cpr_Powertrain_Data_SRI_Cpr_RxSignal_Powertrain_2009: upstream-reference=TopLevelComposition.Med_Prototype.RP_Cpr_Powertrain_Data_SRI_Cpr_RxSignal_Powertrain, ecu-extract-reference=TopLevelCompositionPrototype.Med_Prototype.RP_Cpr_Powertrain_Data_SRI_Cpr_RxSignal_Powertrain
      WhlSpdFrntLePls_2010: upstream-reference=TopLevelComposition.Med_Prototype.RP_Cpr_Powertrain_Data_SRI_Cpr_RxSignal_Powertrain.WhlSpdFrntLePls, ecu-extract-reference=TopLevelCompositionPrototype.Med_Prototype.RP_Cpr_Powertrain_Data_SRI_Cpr_RxSignal_Powertrain.WhlSpdFrntLePls
      WhlSpdFrntLePls_Status_2011: upstream-reference=TopLevelComposition.Med_Prototype.RP_Cpr_Powertrain_Data_SRI_Cpr_RxSignal_Powertrain.WhlSpdFrntLePls_Status, ecu-extract-reference=TopLevelCompositionPrototype.Med_Prototype.RP_Cpr_Powertrain_Data_SRI_Cpr_RxSignal_Powertrain.WhlSpdFrntLePls_Status
      WhlSpdFrntRiPls_2012: upstream-reference=TopLevelComposition.Med_Prototype.RP_Cpr_Powertrain_Data_SRI_Cpr_RxSignal_Powertrain.WhlSpdFrntRiPls, ecu-extract-reference=TopLevelCompositionPrototype.Med_Prototype.RP_Cpr_Powertrain_Data_SRI_Cpr_RxSignal_Powertrain.WhlSpdFrntRiPls
      WhlSpdFrntRiPls_Status_2013: upstream-reference=TopLevelComposition.Med_Prototype.RP_Cpr_Powertrain_Data_SRI_Cpr_RxSignal_Powertrain.WhlSpdFrntRiPls_Status, ecu-extract-reference=TopLevelCompositionPrototype.Med_Prototype.RP_Cpr_Powertrain_Data_SRI_Cpr_RxSignal_Powertrain.WhlSpdFrntRiPls_Status
      WhlSpdLeFrntData_2014: upstream-reference=TopLevelComposition.Med_Prototype.RP_Cpr_Powertrain_Data_SRI_Cpr_RxSignal_Powertrain.WhlSpdLeFrntData, ecu-extract-reference=TopLevelCompositionPrototype.Med_Prototype.RP_Cpr_Powertrain_Data_SRI_Cpr_RxSignal_Powertrain.WhlSpdLeFrntData
      WhlSpdLeFrntDataVld_2015: upstream-reference=TopLevelComposition.Med_Prototype.RP_Cpr_Powertrain_Data_SRI_Cpr_RxSignal_Powertrain.WhlSpdLeFrntDataVld, ecu-extract-reference=TopLevelCompositionPrototype.Med_Prototype.RP_Cpr_Powertrain_Data_SRI_Cpr_RxSignal_Powertrain.WhlSpdLeFrntDataVld
      WhlSpdLeFrntData_Status_2016: upstream-reference=TopLevelComposition.Med_Prototype.RP_Cpr_Powertrain_Data_SRI_Cpr_RxSignal_Powertrain.WhlSpdLeFrntData_Status, ecu-extract-reference=TopLevelCompositionPrototype.Med_Prototype.RP_Cpr_Powertrain_Data_SRI_Cpr_RxSignal_Powertrain.WhlSpdLeFrntData_Status
      WhlSpdLeFrntDir_2017: upstream-reference=TopLevelComposition.Med_Prototype.RP_Cpr_Powertrain_Data_SRI_Cpr_RxSignal_Powertrain.WhlSpdLeFrntDir, ecu-extract-reference=TopLevelCompositionPrototype.Med_Prototype.RP_Cpr_Powertrain_Data_SRI_Cpr_RxSignal_Powertrain.WhlSpdLeFrntDir
      WhlSpdLeFrntDir_Status_2018: upstream-reference=TopLevelComposition.Med_Prototype.RP_Cpr_Powertrain_Data_SRI_Cpr_RxSignal_Powertrain.WhlSpdLeFrntDir_Status, ecu-extract-reference=TopLevelCompositionPrototype.Med_Prototype.RP_Cpr_Powertrain_Data_SRI_Cpr_RxSignal_Powertrain.WhlSpdLeFrntDir_Status
      WhlSpdLeReData_2019: upstream-reference=TopLevelComposition.Med_Prototype.RP_Cpr_Powertrain_Data_SRI_Cpr_RxSignal_Powertrain.WhlSpdLeReData, ecu-extract-reference=TopLevelCompositionPrototype.Med_Prototype.RP_Cpr_Powertrain_Data_SRI_Cpr_RxSignal_Powertrain.WhlSpdLeReData
      WhlSpdLeReDataVld_2020: upstream-reference=TopLevelComposition.Med_Prototype.RP_Cpr_Powertrain_Data_SRI_Cpr_RxSignal_Powertrain.WhlSpdLeReDataVld, ecu-extract-reference=TopLevelCompositionPrototype.Med_Prototype.RP_Cpr_Powertrain_Data_SRI_Cpr_RxSignal_Powertrain.WhlSpdLeReDataVld
      WhlSpdLeReData_Status_2021: upstream-reference=TopLevelComposition.Med_Prototype.RP_Cpr_Powertrain_Data_SRI_Cpr_RxSignal_Powertrain.WhlSpdLeReData_Status, ecu-extract-reference=TopLevelCompositionPrototype.Med_Prototype.RP_Cpr_Powertrain_Data_SRI_Cpr_RxSignal_Powertrain.WhlSpdLeReData_Status
      WhlSpdLeReDir_2022: upstream-reference=TopLevelComposition.Med_Prototype.RP_Cpr_Powertrain_Data_SRI_Cpr_RxSignal_Powertrain.WhlSpdLeReDir, ecu-extract-reference=TopLevelCompositionPrototype.Med_Prototype.RP_Cpr_Powertrain_Data_SRI_Cpr_RxSignal_Powertrain.WhlSpdLeReDir
      WhlSpdLeReDir_Status_2023: upstream-reference=TopLevelComposition.Med_Prototype.RP_Cpr_Powertrain_Data_SRI_Cpr_RxSignal_Powertrain.WhlSpdLeReDir_Status, ecu-extract-reference=TopLevelCompositionPrototype.Med_Prototype.RP_Cpr_Powertrain_Data_SRI_Cpr_RxSignal_Powertrain.WhlSpdLeReDir_Status
      WhlSpdReLePls_2024: upstream-reference=TopLevelComposition.Med_Prototype.RP_Cpr_Powertrain_Data_SRI_Cpr_RxSignal_Powertrain.WhlSpdReLePls, ecu-extract-reference=TopLevelCompositionPrototype.Med_Prototype.RP_Cpr_Powertrain_Data_SRI_Cpr_RxSignal_Powertrain.WhlSpdReLePls
      WhlSpdReLePls_Status_2025: upstream-reference=TopLevelComposition.Med_Prototype.RP_Cpr_Powertrain_Data_SRI_Cpr_RxSignal_Powertrain.WhlSpdReLePls_Status, ecu-extract-reference=TopLevelCompositionPrototype.Med_Prototype.RP_Cpr_Powertrain_Data_SRI_Cpr_RxSignal_Powertrain.WhlSpdReLePls_Status
      WhlSpdReRiPls_2026: upstream-reference=TopLevelComposition.Med_Prototype.RP_Cpr_Powertrain_Data_SRI_Cpr_RxSignal_Powertrain.WhlSpdReRiPls, ecu-extract-reference=TopLevelCompositionPrototype.Med_Prototype.RP_Cpr_Powertrain_Data_SRI_Cpr_RxSignal_Powertrain.WhlSpdReRiPls
      WhlSpdReRiPls_Status_2027: upstream-reference=TopLevelComposition.Med_Prototype.RP_Cpr_Powertrain_Data_SRI_Cpr_RxSignal_Powertrain.WhlSpdReRiPls_Status, ecu-extract-reference=TopLevelCompositionPrototype.Med_Prototype.RP_Cpr_Powertrain_Data_SRI_Cpr_RxSignal_Powertrain.WhlSpdReRiPls_Status
      WhlSpdRiFrntData_2028: upstream-reference=TopLevelComposition.Med_Prototype.RP_Cpr_Powertrain_Data_SRI_Cpr_RxSignal_Powertrain.WhlSpdRiFrntData, ecu-extract-reference=TopLevelCompositionPrototype.Med_Prototype.RP_Cpr_Powertrain_Data_SRI_Cpr_RxSignal_Powertrain.WhlSpdRiFrntData
      WhlSpdRiFrntDataVld_2029: upstream-reference=TopLevelComposition.Med_Prototype.RP_Cpr_Powertrain_Data_SRI_Cpr_RxSignal_Powertrain.WhlSpdRiFrntDataVld, ecu-extract-reference=TopLevelCompositionPrototype.Med_Prototype.RP_Cpr_Powertrain_Data_SRI_Cpr_RxSignal_Powertrain.WhlSpdRiFrntDataVld
      WhlSpdRiFrntData_Status_2030: upstream-reference=TopLevelComposition.Med_Prototype.RP_Cpr_Powertrain_Data_SRI_Cpr_RxSignal_Powertrain.WhlSpdRiFrntData_Status, ecu-extract-reference=TopLevelCompositionPrototype.Med_Prototype.RP_Cpr_Powertrain_Data_SRI_Cpr_RxSignal_Powertrain.WhlSpdRiFrntData_Status
      WhlSpdRiFrntDir_2031: upstream-reference=TopLevelComposition.Med_Prototype.RP_Cpr_Powertrain_Data_SRI_Cpr_RxSignal_Powertrain.WhlSpdRiFrntDir, ecu-extract-reference=TopLevelCompositionPrototype.Med_Prototype.RP_Cpr_Powertrain_Data_SRI_Cpr_RxSignal_Powertrain.WhlSpdRiFrntDir
      WhlSpdRiFrntDir_Status_2032: upstream-reference=TopLevelComposition.Med_Prototype.RP_Cpr_Powertrain_Data_SRI_Cpr_RxSignal_Powertrain.WhlSpdRiFrntDir_Status, ecu-extract-reference=TopLevelCompositionPrototype.Med_Prototype.RP_Cpr_Powertrain_Data_SRI_Cpr_RxSignal_Powertrain.WhlSpdRiFrntDir_Status
      WhlSpdRiReData_2033: upstream-reference=TopLevelComposition.Med_Prototype.RP_Cpr_Powertrain_Data_SRI_Cpr_RxSignal_Powertrain.WhlSpdRiReData, ecu-extract-reference=TopLevelCompositionPrototype.Med_Prototype.RP_Cpr_Powertrain_Data_SRI_Cpr_RxSignal_Powertrain.WhlSpdRiReData
      WhlSpdRiReDataVld_2034: upstream-reference=TopLevelComposition.Med_Prototype.RP_Cpr_Powertrain_Data_SRI_Cpr_RxSignal_Powertrain.WhlSpdRiReDataVld, ecu-extract-reference=TopLevelCompositionPrototype.Med_Prototype.RP_Cpr_Powertrain_Data_SRI_Cpr_RxSignal_Powertrain.WhlSpdRiReDataVld
      WhlSpdRiReData_Status_2035: upstream-reference=TopLevelComposition.Med_Prototype.RP_Cpr_Powertrain_Data_SRI_Cpr_RxSignal_Powertrain.WhlSpdRiReData_Status, ecu-extract-reference=TopLevelCompositionPrototype.Med_Prototype.RP_Cpr_Powertrain_Data_SRI_Cpr_RxSignal_Powertrain.WhlSpdRiReData_Status
      WhlSpdRiReDir_2036: upstream-reference=TopLevelComposition.Med_Prototype.RP_Cpr_Powertrain_Data_SRI_Cpr_RxSignal_Powertrain.WhlSpdRiReDir, ecu-extract-reference=TopLevelCompositionPrototype.Med_Prototype.RP_Cpr_Powertrain_Data_SRI_Cpr_RxSignal_Powertrain.WhlSpdRiReDir
      WhlSpdRiReDir_Status_2037: upstream-reference=TopLevelComposition.Med_Prototype.RP_Cpr_Powertrain_Data_SRI_Cpr_RxSignal_Powertrain.WhlSpdRiReDir_Status, ecu-extract-reference=TopLevelCompositionPrototype.Med_Prototype.RP_Cpr_Powertrain_Data_SRI_Cpr_RxSignal_Powertrain.WhlSpdRiReDir_Status
      RP_Dsm_SRI_InternalTestMode_2038: upstream-reference=TopLevelComposition.Med_Prototype.RP_Dsm_SRI_InternalTestMode, ecu-extract-reference=TopLevelCompositionPrototype.Med_Prototype.RP_Dsm_SRI_InternalTestMode
      DE_InternalTestMode_2039: upstream-reference=TopLevelComposition.Med_Prototype.RP_Dsm_SRI_InternalTestMode.DE_InternalTestMode, ecu-extract-reference=TopLevelCompositionPrototype.Med_Prototype.RP_Dsm_SRI_InternalTestMode.DE_InternalTestMode
      RP_Port_Cdd_EvAdc_GetRegValue_J3_PMIC_8200_AMUX_OUT_2040: upstream-reference=TopLevelComposition.Med_Prototype.RP_Port_Cdd_EvAdc_GetRegValue_J3_PMIC_8200_AMUX_OUT, ecu-extract-reference=TopLevelCompositionPrototype.Med_Prototype.RP_Port_Cdd_EvAdc_GetRegValue_J3_PMIC_8200_AMUX_OUT
      RP_Port_Cdd_EvAdc_GetRegValue_PMIC_FS84_AMUX_OUT0_2041: upstream-reference=TopLevelComposition.Med_Prototype.RP_Port_Cdd_EvAdc_GetRegValue_PMIC_FS84_AMUX_OUT0, ecu-extract-reference=TopLevelCompositionPrototype.Med_Prototype.RP_Port_Cdd_EvAdc_GetRegValue_PMIC_FS84_AMUX_OUT0
      RP_Port_Cdd_EvAdc_GetRegValue_TMON_SYS1_2042: upstream-reference=TopLevelComposition.Med_Prototype.RP_Port_Cdd_EvAdc_GetRegValue_TMON_SYS1, ecu-extract-reference=TopLevelCompositionPrototype.Med_Prototype.RP_Port_Cdd_EvAdc_GetRegValue_TMON_SYS1
      RP_Port_Cdd_EvAdc_GetRegValue_TMON_SYS2_2043: upstream-reference=TopLevelComposition.Med_Prototype.RP_Port_Cdd_EvAdc_GetRegValue_TMON_SYS2, ecu-extract-reference=TopLevelCompositionPrototype.Med_Prototype.RP_Port_Cdd_EvAdc_GetRegValue_TMON_SYS2
      RP_Port_Cdd_EvAdc_GetRegValue_VMON_1V0_GEPHY_2044: upstream-reference=TopLevelComposition.Med_Prototype.RP_Port_Cdd_EvAdc_GetRegValue_VMON_1V0_GEPHY, ecu-extract-reference=TopLevelCompositionPrototype.Med_Prototype.RP_Port_Cdd_EvAdc_GetRegValue_VMON_1V0_GEPHY
      RP_Port_Cdd_EvAdc_GetRegValue_VMON_3V3_GEPHY_2045: upstream-reference=TopLevelComposition.Med_Prototype.RP_Port_Cdd_EvAdc_GetRegValue_VMON_3V3_GEPHY, ecu-extract-reference=TopLevelCompositionPrototype.Med_Prototype.RP_Port_Cdd_EvAdc_GetRegValue_VMON_3V3_GEPHY
      RP_Port_Cdd_EvAdc_GetRegValue_VMON_BATT_2046: upstream-reference=TopLevelComposition.Med_Prototype.RP_Port_Cdd_EvAdc_GetRegValue_VMON_BATT, ecu-extract-reference=TopLevelCompositionPrototype.Med_Prototype.RP_Port_Cdd_EvAdc_GetRegValue_VMON_BATT
      RP_Port_Cdd_EvAdc_GetRegValue_VMON_IGN_2047: upstream-reference=TopLevelComposition.Med_Prototype.RP_Port_Cdd_EvAdc_GetRegValue_VMON_IGN, ecu-extract-reference=TopLevelCompositionPrototype.Med_Prototype.RP_Port_Cdd_EvAdc_GetRegValue_VMON_IGN
      RP_VoltMonI_SRI_VoltState_2048: upstream-reference=TopLevelComposition.Med_Prototype.RP_VoltMonI_SRI_VoltState, ecu-extract-reference=TopLevelCompositionPrototype.Med_Prototype.RP_VoltMonI_SRI_VoltState
      DE_VoltMonI_VoltState_2049: upstream-reference=TopLevelComposition.Med_Prototype.RP_VoltMonI_SRI_VoltState.DE_VoltMonI_VoltState, ecu-extract-reference=TopLevelCompositionPrototype.Med_Prototype.RP_VoltMonI_SRI_VoltState.DE_VoltMonI_VoltState
      ModM_2050: upstream-reference=TopLevelComposition.ModM, ecu-extract-reference=TopLevelCompositionPrototype.ModM
      PPort_OperationMode_2051: upstream-reference=TopLevelComposition.ModM.PPort_OperationMode, ecu-extract-reference=TopLevelCompositionPrototype.ModM.PPort_OperationMode
      MtsiAdapter_Prototype_2052: upstream-reference=TopLevelComposition.MtsiAdapter_Prototype, ecu-extract-reference=TopLevelCompositionPrototype.MtsiAdapter_Prototype
      ppMeasFreezeData_2053: upstream-reference=TopLevelComposition.MtsiAdapter_Prototype.ppMeasFreezeData, ecu-extract-reference=TopLevelCompositionPrototype.MtsiAdapter_Prototype.ppMeasFreezeData
      ppMtsiTxCallback_2054: upstream-reference=TopLevelComposition.MtsiAdapter_Prototype.ppMtsiTxCallback, ecu-extract-reference=TopLevelCompositionPrototype.MtsiAdapter_Prototype.ppMtsiTxCallback
      ppUpdateTaskCycle_2055: upstream-reference=TopLevelComposition.MtsiAdapter_Prototype.ppUpdateTaskCycle, ecu-extract-reference=TopLevelCompositionPrototype.MtsiAdapter_Prototype.ppUpdateTaskCycle
      rpMtsiTxCallback_2056: upstream-reference=TopLevelComposition.MtsiAdapter_Prototype.rpMtsiTxCallback, ecu-extract-reference=TopLevelCompositionPrototype.MtsiAdapter_Prototype.rpMtsiTxCallback
      Nvm_Prototype_2057: upstream-reference=TopLevelComposition.Nvm_Prototype, ecu-extract-reference=TopLevelCompositionPrototype.Nvm_Prototype
      PS_NVM_BLOCK_VINDataIdentifier_2058: upstream-reference=TopLevelComposition.Nvm_Prototype.PS_NVM_BLOCK_VINDataIdentifier, ecu-extract-reference=TopLevelCompositionPrototype.Nvm_Prototype.PS_NVM_BLOCK_VINDataIdentifier
      PS_NVM_BLOCK_ECUHardwareVersion_2059: upstream-reference=TopLevelComposition.Nvm_Prototype.PS_NVM_BLOCK_ECUHardwareVersion, ecu-extract-reference=TopLevelCompositionPrototype.Nvm_Prototype.PS_NVM_BLOCK_ECUHardwareVersion
      PS_NVM_BLOCK_SerialNumberDataId_2060: upstream-reference=TopLevelComposition.Nvm_Prototype.PS_NVM_BLOCK_SerialNumberDataId, ecu-extract-reference=TopLevelCompositionPrototype.Nvm_Prototype.PS_NVM_BLOCK_SerialNumberDataId
      PS_NVM_BLOCK_FAB_switch_2061: upstream-reference=TopLevelComposition.Nvm_Prototype.PS_NVM_BLOCK_FAB_switch, ecu-extract-reference=TopLevelCompositionPrototype.Nvm_Prototype.PS_NVM_BLOCK_FAB_switch
      PS_NVM_BLOCK_TSR_switch_2062: upstream-reference=TopLevelComposition.Nvm_Prototype.PS_NVM_BLOCK_TSR_switch, ecu-extract-reference=TopLevelCompositionPrototype.Nvm_Prototype.PS_NVM_BLOCK_TSR_switch
      PS_NVM_BLOCK_TLA_switch_2063: upstream-reference=TopLevelComposition.Nvm_Prototype.PS_NVM_BLOCK_TLA_switch, ecu-extract-reference=TopLevelCompositionPrototype.Nvm_Prototype.PS_NVM_BLOCK_TLA_switch
      PS_NVM_BLOCK_Security_AttemptCount_2064: upstream-reference=TopLevelComposition.Nvm_Prototype.PS_NVM_BLOCK_Security_AttemptCount, ecu-extract-reference=TopLevelCompositionPrototype.Nvm_Prototype.PS_NVM_BLOCK_Security_AttemptCount
      PS_NVM_BLOCK_EOL_Info_Input_2065: upstream-reference=TopLevelComposition.Nvm_Prototype.PS_NVM_BLOCK_EOL_Info_Input, ecu-extract-reference=TopLevelCompositionPrototype.Nvm_Prototype.PS_NVM_BLOCK_EOL_Info_Input
      PS_NvM_Block_Fingerprint_2066: upstream-reference=TopLevelComposition.Nvm_Prototype.PS_NvM_Block_Fingerprint, ecu-extract-reference=TopLevelCompositionPrototype.Nvm_Prototype.PS_NvM_Block_Fingerprint
      PS_NvM_Block_Vehicletype_2067: upstream-reference=TopLevelComposition.Nvm_Prototype.PS_NvM_Block_Vehicletype, ecu-extract-reference=TopLevelCompositionPrototype.Nvm_Prototype.PS_NvM_Block_Vehicletype
      PS_NvM_Block_PCBASerialNumberDataIdentifier_2068: upstream-reference=TopLevelComposition.Nvm_Prototype.PS_NvM_Block_PCBASerialNumberDataIdentifier, ecu-extract-reference=TopLevelCompositionPrototype.Nvm_Prototype.PS_NvM_Block_PCBASerialNumberDataIdentifier
      PS_NvM_Block_LaneFunctionConfiguration_2069: upstream-reference=TopLevelComposition.Nvm_Prototype.PS_NvM_Block_LaneFunctionConfiguration, ecu-extract-reference=TopLevelCompositionPrototype.Nvm_Prototype.PS_NvM_Block_LaneFunctionConfiguration
      PS_NvM_Block_EOLCalibrationData_2070: upstream-reference=TopLevelComposition.Nvm_Prototype.PS_NvM_Block_EOLCalibrationData, ecu-extract-reference=TopLevelCompositionPrototype.Nvm_Prototype.PS_NvM_Block_EOLCalibrationData
      PS_NvM_Block_SDACalibrationData_2071: upstream-reference=TopLevelComposition.Nvm_Prototype.PS_NvM_Block_SDACalibrationData, ecu-extract-reference=TopLevelCompositionPrototype.Nvm_Prototype.PS_NvM_Block_SDACalibrationData
      PS_NvM_Block_HMISwitchStatus_2072: upstream-reference=TopLevelComposition.Nvm_Prototype.PS_NvM_Block_HMISwitchStatus, ecu-extract-reference=TopLevelCompositionPrototype.Nvm_Prototype.PS_NvM_Block_HMISwitchStatus
      PS_NVM_BLOCK_FCWLastbutoneappearedFD14_2073: upstream-reference=TopLevelComposition.Nvm_Prototype.PS_NVM_BLOCK_FCWLastbutoneappearedFD14, ecu-extract-reference=TopLevelCompositionPrototype.Nvm_Prototype.PS_NVM_BLOCK_FCWLastbutoneappearedFD14
      PS_NVM_BLOCK_AWBLastbutoneappearFD15_2074: upstream-reference=TopLevelComposition.Nvm_Prototype.PS_NVM_BLOCK_AWBLastbutoneappearFD15, ecu-extract-reference=TopLevelCompositionPrototype.Nvm_Prototype.PS_NVM_BLOCK_AWBLastbutoneappearFD15
      PS_NVM_BLOCK_AEBLastbutoneappearFD16_2075: upstream-reference=TopLevelComposition.Nvm_Prototype.PS_NVM_BLOCK_AEBLastbutoneappearFD16, ecu-extract-reference=TopLevelCompositionPrototype.Nvm_Prototype.PS_NVM_BLOCK_AEBLastbutoneappearFD16
      PS_NVM_BLOCK_FCWLastappearFD17_2076: upstream-reference=TopLevelComposition.Nvm_Prototype.PS_NVM_BLOCK_FCWLastappearFD17, ecu-extract-reference=TopLevelCompositionPrototype.Nvm_Prototype.PS_NVM_BLOCK_FCWLastappearFD17
      PS_NVM_BLOCK_AWBLasteappearFD18_2077: upstream-reference=TopLevelComposition.Nvm_Prototype.PS_NVM_BLOCK_AWBLasteappearFD18, ecu-extract-reference=TopLevelCompositionPrototype.Nvm_Prototype.PS_NVM_BLOCK_AWBLasteappearFD18
      PS_NVM_BLOCK_AEBLastappearFD19_2078: upstream-reference=TopLevelComposition.Nvm_Prototype.PS_NVM_BLOCK_AEBLastappearFD19, ecu-extract-reference=TopLevelCompositionPrototype.Nvm_Prototype.PS_NVM_BLOCK_AEBLastappearFD19
      PS_NvM_BLOCK_VDYData_2079: upstream-reference=TopLevelComposition.Nvm_Prototype.PS_NvM_BLOCK_VDYData, ecu-extract-reference=TopLevelCompositionPrototype.Nvm_Prototype.PS_NvM_BLOCK_VDYData
      PS_NvM_BLOCK_FS_Debug_Status_2080: upstream-reference=TopLevelComposition.Nvm_Prototype.PS_NvM_BLOCK_FS_Debug_Status, ecu-extract-reference=TopLevelCompositionPrototype.Nvm_Prototype.PS_NvM_BLOCK_FS_Debug_Status
      PMirror_NvM_BLOCK_VDYData_2081: upstream-reference=TopLevelComposition.Nvm_Prototype.PMirror_NvM_BLOCK_VDYData, ecu-extract-reference=TopLevelCompositionPrototype.Nvm_Prototype.PMirror_NvM_BLOCK_VDYData
      Qsm_Prototype_2082: upstream-reference=TopLevelComposition.Qsm_Prototype, ecu-extract-reference=TopLevelCompositionPrototype.Qsm_Prototype
      PP_QsmDsmBlockStartup_Flag_2083: upstream-reference=TopLevelComposition.Qsm_Prototype.PP_QsmDsmBlockStartup_Flag, ecu-extract-reference=TopLevelCompositionPrototype.Qsm_Prototype.PP_QsmDsmBlockStartup_Flag
      PP_Qsm_DsmBlockPartNumber_Sector_2084: upstream-reference=TopLevelComposition.Qsm_Prototype.PP_Qsm_DsmBlockPartNumber_Sector, ecu-extract-reference=TopLevelCompositionPrototype.Qsm_Prototype.PP_Qsm_DsmBlockPartNumber_Sector
      PP_Qsm_DsmBlock_EOLModeGateOp_2085: upstream-reference=TopLevelComposition.Qsm_Prototype.PP_Qsm_DsmBlock_EOLModeGateOp, ecu-extract-reference=TopLevelCompositionPrototype.Qsm_Prototype.PP_Qsm_DsmBlock_EOLModeGateOp
      PP_Qsm_DsmSecureUpdateLogOp_2086: upstream-reference=TopLevelComposition.Qsm_Prototype.PP_Qsm_DsmSecureUpdateLogOp, ecu-extract-reference=TopLevelCompositionPrototype.Qsm_Prototype.PP_Qsm_DsmSecureUpdateLogOp
      RtaAdapter_C0_2087: upstream-reference=TopLevelComposition.RtaAdapter_C0, ecu-extract-reference=TopLevelCompositionPrototype.RtaAdapter_C0
      RP_MtsiAdapter_UpdateTaskCycle_2088: upstream-reference=TopLevelComposition.RtaAdapter_C0.RP_MtsiAdapter_UpdateTaskCycle, ecu-extract-reference=TopLevelCompositionPrototype.RtaAdapter_C0.RP_MtsiAdapter_UpdateTaskCycle
      RtaAdapter_C1_2089: upstream-reference=TopLevelComposition.RtaAdapter_C1, ecu-extract-reference=TopLevelCompositionPrototype.RtaAdapter_C1
      RP_MtsiAdapter_UpdateTaskCycle_2090: upstream-reference=TopLevelComposition.RtaAdapter_C1.RP_MtsiAdapter_UpdateTaskCycle, ecu-extract-reference=TopLevelCompositionPrototype.RtaAdapter_C1.RP_MtsiAdapter_UpdateTaskCycle
      RtaAdapter_C2_2091: upstream-reference=TopLevelComposition.RtaAdapter_C2, ecu-extract-reference=TopLevelCompositionPrototype.RtaAdapter_C2
      RP_MtsiAdapter_UpdateTaskCycle_2092: upstream-reference=TopLevelComposition.RtaAdapter_C2.RP_MtsiAdapter_UpdateTaskCycle, ecu-extract-reference=TopLevelCompositionPrototype.RtaAdapter_C2.RP_MtsiAdapter_UpdateTaskCycle
      RtaAdapter_C3_2093: upstream-reference=TopLevelComposition.RtaAdapter_C3, ecu-extract-reference=TopLevelCompositionPrototype.RtaAdapter_C3
      RP_MtsiAdapter_UpdateTaskCycle_2094: upstream-reference=TopLevelComposition.RtaAdapter_C3.RP_MtsiAdapter_UpdateTaskCycle, ecu-extract-reference=TopLevelCompositionPrototype.RtaAdapter_C3.RP_MtsiAdapter_UpdateTaskCycle
      Sdc_Prototype_2095: upstream-reference=TopLevelComposition.Sdc_Prototype, ecu-extract-reference=TopLevelCompositionPrototype.Sdc_Prototype
      PP_Sdc_Cem_ARSObjectList_2096: upstream-reference=TopLevelComposition.Sdc_Prototype.PP_Sdc_Cem_ARSObjectList, ecu-extract-reference=TopLevelCompositionPrototype.Sdc_Prototype.PP_Sdc_Cem_ARSObjectList
      ARSObjectList_2097: upstream-reference=TopLevelComposition.Sdc_Prototype.PP_Sdc_Cem_ARSObjectList.ARSObjectList, ecu-extract-reference=TopLevelCompositionPrototype.Sdc_Prototype.PP_Sdc_Cem_ARSObjectList.ARSObjectList
      PP_Sdc_Cem_FusionObjectList_2098: upstream-reference=TopLevelComposition.Sdc_Prototype.PP_Sdc_Cem_FusionObjectList, ecu-extract-reference=TopLevelCompositionPrototype.Sdc_Prototype.PP_Sdc_Cem_FusionObjectList
      FusionObjectList_2099: upstream-reference=TopLevelComposition.Sdc_Prototype.PP_Sdc_Cem_FusionObjectList.FusionObjectList, ecu-extract-reference=TopLevelCompositionPrototype.Sdc_Prototype.PP_Sdc_Cem_FusionObjectList.FusionObjectList
      PP_Sdc_Cem_GenObjectList_2100: upstream-reference=TopLevelComposition.Sdc_Prototype.PP_Sdc_Cem_GenObjectList, ecu-extract-reference=TopLevelCompositionPrototype.Sdc_Prototype.PP_Sdc_Cem_GenObjectList
      GenObjectList_2101: upstream-reference=TopLevelComposition.Sdc_Prototype.PP_Sdc_Cem_GenObjectList.GenObjectList, ecu-extract-reference=TopLevelCompositionPrototype.Sdc_Prototype.PP_Sdc_Cem_GenObjectList.GenObjectList
      PP_Sdc_Perception_AbdOutputData_2102: upstream-reference=TopLevelComposition.Sdc_Prototype.PP_Sdc_Perception_AbdOutputData, ecu-extract-reference=TopLevelCompositionPrototype.Sdc_Prototype.PP_Sdc_Perception_AbdOutputData
      AbdOutputData_t_2103: upstream-reference=TopLevelComposition.Sdc_Prototype.PP_Sdc_Perception_AbdOutputData.AbdOutputData_t, ecu-extract-reference=TopLevelCompositionPrototype.Sdc_Prototype.PP_Sdc_Perception_AbdOutputData.AbdOutputData_t
      PP_Sdc_Perception_CamLaneInputData_2104: upstream-reference=TopLevelComposition.Sdc_Prototype.PP_Sdc_Perception_CamLaneInputData, ecu-extract-reference=TopLevelCompositionPrototype.Sdc_Prototype.PP_Sdc_Perception_CamLaneInputData
      CamLaneInputData_2105: upstream-reference=TopLevelComposition.Sdc_Prototype.PP_Sdc_Perception_CamLaneInputData.CamLaneInputData, ecu-extract-reference=TopLevelCompositionPrototype.Sdc_Prototype.PP_Sdc_Perception_CamLaneInputData.CamLaneInputData
      PP_Sdc_SendInterface_Calibration_2106: upstream-reference=TopLevelComposition.Sdc_Prototype.PP_Sdc_SendInterface_Calibration, ecu-extract-reference=TopLevelCompositionPrototype.Sdc_Prototype.PP_Sdc_SendInterface_Calibration
      PP_Sdc_SendInterface_Diag_2107: upstream-reference=TopLevelComposition.Sdc_Prototype.PP_Sdc_SendInterface_Diag, ecu-extract-reference=TopLevelCompositionPrototype.Sdc_Prototype.PP_Sdc_SendInterface_Diag
      PP_Sdc_SendInterface_Eth_2108: upstream-reference=TopLevelComposition.Sdc_Prototype.PP_Sdc_SendInterface_Eth, ecu-extract-reference=TopLevelCompositionPrototype.Sdc_Prototype.PP_Sdc_SendInterface_Eth
      PP_Sdc_SendInterface_Perception_2109: upstream-reference=TopLevelComposition.Sdc_Prototype.PP_Sdc_SendInterface_Perception, ecu-extract-reference=TopLevelCompositionPrototype.Sdc_Prototype.PP_Sdc_SendInterface_Perception
      PP_Sdc_SendInterface_SocInfo_2110: upstream-reference=TopLevelComposition.Sdc_Prototype.PP_Sdc_SendInterface_SocInfo, ecu-extract-reference=TopLevelCompositionPrototype.Sdc_Prototype.PP_Sdc_SendInterface_SocInfo
      PP_Sdc_SendInterface_TSync_2111: upstream-reference=TopLevelComposition.Sdc_Prototype.PP_Sdc_SendInterface_TSync, ecu-extract-reference=TopLevelCompositionPrototype.Sdc_Prototype.PP_Sdc_SendInterface_TSync
      RP_Dsm_SRI_InternalTestMode_2112: upstream-reference=TopLevelComposition.Sdc_Prototype.RP_Dsm_SRI_InternalTestMode, ecu-extract-reference=TopLevelCompositionPrototype.Sdc_Prototype.RP_Dsm_SRI_InternalTestMode
      DE_InternalTestMode_2113: upstream-reference=TopLevelComposition.Sdc_Prototype.RP_Dsm_SRI_InternalTestMode.DE_InternalTestMode, ecu-extract-reference=TopLevelCompositionPrototype.Sdc_Prototype.RP_Dsm_SRI_InternalTestMode.DE_InternalTestMode
      RP_Sdc_Adas_Data_2114: upstream-reference=TopLevelComposition.Sdc_Prototype.RP_Sdc_Adas_Data, ecu-extract-reference=TopLevelCompositionPrototype.Sdc_Prototype.RP_Sdc_Adas_Data
      ACCMode_2115: upstream-reference=TopLevelComposition.Sdc_Prototype.RP_Sdc_Adas_Data.ACCMode, ecu-extract-reference=TopLevelCompositionPrototype.Sdc_Prototype.RP_Sdc_Adas_Data.ACCMode
      ACCMode_Status_2116: upstream-reference=TopLevelComposition.Sdc_Prototype.RP_Sdc_Adas_Data.ACCMode_Status, ecu-extract-reference=TopLevelCompositionPrototype.Sdc_Prototype.RP_Sdc_Adas_Data.ACCMode_Status
      FR_RadarFailureStatus_2117: upstream-reference=TopLevelComposition.Sdc_Prototype.RP_Sdc_Adas_Data.FR_RadarFailureStatus, ecu-extract-reference=TopLevelCompositionPrototype.Sdc_Prototype.RP_Sdc_Adas_Data.FR_RadarFailureStatus
      FR_RadarFailureStatus_Status_2118: upstream-reference=TopLevelComposition.Sdc_Prototype.RP_Sdc_Adas_Data.FR_RadarFailureStatus_Status, ecu-extract-reference=TopLevelCompositionPrototype.Sdc_Prototype.RP_Sdc_Adas_Data.FR_RadarFailureStatus_Status
      FRadarCalibrationStatus_2119: upstream-reference=TopLevelComposition.Sdc_Prototype.RP_Sdc_Adas_Data.FRadarCalibrationStatus, ecu-extract-reference=TopLevelCompositionPrototype.Sdc_Prototype.RP_Sdc_Adas_Data.FRadarCalibrationStatus
      FRadarCalibrationStatus_Status_2120: upstream-reference=TopLevelComposition.Sdc_Prototype.RP_Sdc_Adas_Data.FRadarCalibrationStatus_Status, ecu-extract-reference=TopLevelCompositionPrototype.Sdc_Prototype.RP_Sdc_Adas_Data.FRadarCalibrationStatus_Status
      RadarObj1_Dx_2121: upstream-reference=TopLevelComposition.Sdc_Prototype.RP_Sdc_Adas_Data.RadarObj1_Dx, ecu-extract-reference=TopLevelCompositionPrototype.Sdc_Prototype.RP_Sdc_Adas_Data.RadarObj1_Dx
      RadarObj1_Dx_Status_2122: upstream-reference=TopLevelComposition.Sdc_Prototype.RP_Sdc_Adas_Data.RadarObj1_Dx_Status, ecu-extract-reference=TopLevelCompositionPrototype.Sdc_Prototype.RP_Sdc_Adas_Data.RadarObj1_Dx_Status
      RadarObj1_Dy_2123: upstream-reference=TopLevelComposition.Sdc_Prototype.RP_Sdc_Adas_Data.RadarObj1_Dy, ecu-extract-reference=TopLevelCompositionPrototype.Sdc_Prototype.RP_Sdc_Adas_Data.RadarObj1_Dy
      RadarObj1_Dy_Status_2124: upstream-reference=TopLevelComposition.Sdc_Prototype.RP_Sdc_Adas_Data.RadarObj1_Dy_Status, ecu-extract-reference=TopLevelCompositionPrototype.Sdc_Prototype.RP_Sdc_Adas_Data.RadarObj1_Dy_Status
      RadarObj1_ExistProb_2125: upstream-reference=TopLevelComposition.Sdc_Prototype.RP_Sdc_Adas_Data.RadarObj1_ExistProb, ecu-extract-reference=TopLevelCompositionPrototype.Sdc_Prototype.RP_Sdc_Adas_Data.RadarObj1_ExistProb
      RadarObj1_ExistProb_Status_2126: upstream-reference=TopLevelComposition.Sdc_Prototype.RP_Sdc_Adas_Data.RadarObj1_ExistProb_Status, ecu-extract-reference=TopLevelCompositionPrototype.Sdc_Prototype.RP_Sdc_Adas_Data.RadarObj1_ExistProb_Status
      RadarObj1_Length_2127: upstream-reference=TopLevelComposition.Sdc_Prototype.RP_Sdc_Adas_Data.RadarObj1_Length, ecu-extract-reference=TopLevelCompositionPrototype.Sdc_Prototype.RP_Sdc_Adas_Data.RadarObj1_Length
      RadarObj1_Length_Status_2128: upstream-reference=TopLevelComposition.Sdc_Prototype.RP_Sdc_Adas_Data.RadarObj1_Length_Status, ecu-extract-reference=TopLevelCompositionPrototype.Sdc_Prototype.RP_Sdc_Adas_Data.RadarObj1_Length_Status
      RadarObj1_Location_2129: upstream-reference=TopLevelComposition.Sdc_Prototype.RP_Sdc_Adas_Data.RadarObj1_Location, ecu-extract-reference=TopLevelCompositionPrototype.Sdc_Prototype.RP_Sdc_Adas_Data.RadarObj1_Location
      RadarObj1_Location_Status_2130: upstream-reference=TopLevelComposition.Sdc_Prototype.RP_Sdc_Adas_Data.RadarObj1_Location_Status, ecu-extract-reference=TopLevelCompositionPrototype.Sdc_Prototype.RP_Sdc_Adas_Data.RadarObj1_Location_Status
      RadarObj1_Measured_2131: upstream-reference=TopLevelComposition.Sdc_Prototype.RP_Sdc_Adas_Data.RadarObj1_Measured, ecu-extract-reference=TopLevelCompositionPrototype.Sdc_Prototype.RP_Sdc_Adas_Data.RadarObj1_Measured
      RadarObj1_Measured_Status_2132: upstream-reference=TopLevelComposition.Sdc_Prototype.RP_Sdc_Adas_Data.RadarObj1_Measured_Status, ecu-extract-reference=TopLevelCompositionPrototype.Sdc_Prototype.RP_Sdc_Adas_Data.RadarObj1_Measured_Status
      RadarObj1_RelAx_2133: upstream-reference=TopLevelComposition.Sdc_Prototype.RP_Sdc_Adas_Data.RadarObj1_RelAx, ecu-extract-reference=TopLevelCompositionPrototype.Sdc_Prototype.RP_Sdc_Adas_Data.RadarObj1_RelAx
      RadarObj1_RelAx_Status_2134: upstream-reference=TopLevelComposition.Sdc_Prototype.RP_Sdc_Adas_Data.RadarObj1_RelAx_Status, ecu-extract-reference=TopLevelCompositionPrototype.Sdc_Prototype.RP_Sdc_Adas_Data.RadarObj1_RelAx_Status
      RadarObj1_RelVx_2135: upstream-reference=TopLevelComposition.Sdc_Prototype.RP_Sdc_Adas_Data.RadarObj1_RelVx, ecu-extract-reference=TopLevelCompositionPrototype.Sdc_Prototype.RP_Sdc_Adas_Data.RadarObj1_RelVx
      RadarObj1_RelVx_Status_2136: upstream-reference=TopLevelComposition.Sdc_Prototype.RP_Sdc_Adas_Data.RadarObj1_RelVx_Status, ecu-extract-reference=TopLevelCompositionPrototype.Sdc_Prototype.RP_Sdc_Adas_Data.RadarObj1_RelVx_Status
      RadarObj1_RelVy_2137: upstream-reference=TopLevelComposition.Sdc_Prototype.RP_Sdc_Adas_Data.RadarObj1_RelVy, ecu-extract-reference=TopLevelCompositionPrototype.Sdc_Prototype.RP_Sdc_Adas_Data.RadarObj1_RelVy
      RadarObj1_RelVy_Status_2138: upstream-reference=TopLevelComposition.Sdc_Prototype.RP_Sdc_Adas_Data.RadarObj1_RelVy_Status, ecu-extract-reference=TopLevelCompositionPrototype.Sdc_Prototype.RP_Sdc_Adas_Data.RadarObj1_RelVy_Status
      RadarObj1_Width_2139: upstream-reference=TopLevelComposition.Sdc_Prototype.RP_Sdc_Adas_Data.RadarObj1_Width, ecu-extract-reference=TopLevelCompositionPrototype.Sdc_Prototype.RP_Sdc_Adas_Data.RadarObj1_Width
      RadarObj1_Width_Status_2140: upstream-reference=TopLevelComposition.Sdc_Prototype.RP_Sdc_Adas_Data.RadarObj1_Width_Status, ecu-extract-reference=TopLevelCompositionPrototype.Sdc_Prototype.RP_Sdc_Adas_Data.RadarObj1_Width_Status
      RadarObj2_Dx_2141: upstream-reference=TopLevelComposition.Sdc_Prototype.RP_Sdc_Adas_Data.RadarObj2_Dx, ecu-extract-reference=TopLevelCompositionPrototype.Sdc_Prototype.RP_Sdc_Adas_Data.RadarObj2_Dx
      RadarObj2_Dx_Status_2142: upstream-reference=TopLevelComposition.Sdc_Prototype.RP_Sdc_Adas_Data.RadarObj2_Dx_Status, ecu-extract-reference=TopLevelCompositionPrototype.Sdc_Prototype.RP_Sdc_Adas_Data.RadarObj2_Dx_Status
      RadarObj2_Dy_2143: upstream-reference=TopLevelComposition.Sdc_Prototype.RP_Sdc_Adas_Data.RadarObj2_Dy, ecu-extract-reference=TopLevelCompositionPrototype.Sdc_Prototype.RP_Sdc_Adas_Data.RadarObj2_Dy
      RadarObj2_Dy_Status_2144: upstream-reference=TopLevelComposition.Sdc_Prototype.RP_Sdc_Adas_Data.RadarObj2_Dy_Status, ecu-extract-reference=TopLevelCompositionPrototype.Sdc_Prototype.RP_Sdc_Adas_Data.RadarObj2_Dy_Status
      RadarObj2_ExistProb_2145: upstream-reference=TopLevelComposition.Sdc_Prototype.RP_Sdc_Adas_Data.RadarObj2_ExistProb, ecu-extract-reference=TopLevelCompositionPrototype.Sdc_Prototype.RP_Sdc_Adas_Data.RadarObj2_ExistProb
      RadarObj2_ExistProb_Status_2146: upstream-reference=TopLevelComposition.Sdc_Prototype.RP_Sdc_Adas_Data.RadarObj2_ExistProb_Status, ecu-extract-reference=TopLevelCompositionPrototype.Sdc_Prototype.RP_Sdc_Adas_Data.RadarObj2_ExistProb_Status
      RadarObj2_Length_2147: upstream-reference=TopLevelComposition.Sdc_Prototype.RP_Sdc_Adas_Data.RadarObj2_Length, ecu-extract-reference=TopLevelCompositionPrototype.Sdc_Prototype.RP_Sdc_Adas_Data.RadarObj2_Length
      RadarObj2_Length_Status_2148: upstream-reference=TopLevelComposition.Sdc_Prototype.RP_Sdc_Adas_Data.RadarObj2_Length_Status, ecu-extract-reference=TopLevelCompositionPrototype.Sdc_Prototype.RP_Sdc_Adas_Data.RadarObj2_Length_Status
      RadarObj2_Location_2149: upstream-reference=TopLevelComposition.Sdc_Prototype.RP_Sdc_Adas_Data.RadarObj2_Location, ecu-extract-reference=TopLevelCompositionPrototype.Sdc_Prototype.RP_Sdc_Adas_Data.RadarObj2_Location
      RadarObj2_Location_Status_2150: upstream-reference=TopLevelComposition.Sdc_Prototype.RP_Sdc_Adas_Data.RadarObj2_Location_Status, ecu-extract-reference=TopLevelCompositionPrototype.Sdc_Prototype.RP_Sdc_Adas_Data.RadarObj2_Location_Status
      RadarObj2_Measured_2151: upstream-reference=TopLevelComposition.Sdc_Prototype.RP_Sdc_Adas_Data.RadarObj2_Measured, ecu-extract-reference=TopLevelCompositionPrototype.Sdc_Prototype.RP_Sdc_Adas_Data.RadarObj2_Measured
      RadarObj2_Measured_Status_2152: upstream-reference=TopLevelComposition.Sdc_Prototype.RP_Sdc_Adas_Data.RadarObj2_Measured_Status, ecu-extract-reference=TopLevelCompositionPrototype.Sdc_Prototype.RP_Sdc_Adas_Data.RadarObj2_Measured_Status
      RadarObj2_RelAx_2153: upstream-reference=TopLevelComposition.Sdc_Prototype.RP_Sdc_Adas_Data.RadarObj2_RelAx, ecu-extract-reference=TopLevelCompositionPrototype.Sdc_Prototype.RP_Sdc_Adas_Data.RadarObj2_RelAx
      RadarObj2_RelAx_Status_2154: upstream-reference=TopLevelComposition.Sdc_Prototype.RP_Sdc_Adas_Data.RadarObj2_RelAx_Status, ecu-extract-reference=TopLevelCompositionPrototype.Sdc_Prototype.RP_Sdc_Adas_Data.RadarObj2_RelAx_Status
      RadarObj2_RelVx_2155: upstream-reference=TopLevelComposition.Sdc_Prototype.RP_Sdc_Adas_Data.RadarObj2_RelVx, ecu-extract-reference=TopLevelCompositionPrototype.Sdc_Prototype.RP_Sdc_Adas_Data.RadarObj2_RelVx
      RadarObj2_RelVx_Status_2156: upstream-reference=TopLevelComposition.Sdc_Prototype.RP_Sdc_Adas_Data.RadarObj2_RelVx_Status, ecu-extract-reference=TopLevelCompositionPrototype.Sdc_Prototype.RP_Sdc_Adas_Data.RadarObj2_RelVx_Status
      RadarObj2_RelVy_2157: upstream-reference=TopLevelComposition.Sdc_Prototype.RP_Sdc_Adas_Data.RadarObj2_RelVy, ecu-extract-reference=TopLevelCompositionPrototype.Sdc_Prototype.RP_Sdc_Adas_Data.RadarObj2_RelVy
      RadarObj2_RelVy_Status_2158: upstream-reference=TopLevelComposition.Sdc_Prototype.RP_Sdc_Adas_Data.RadarObj2_RelVy_Status, ecu-extract-reference=TopLevelCompositionPrototype.Sdc_Prototype.RP_Sdc_Adas_Data.RadarObj2_RelVy_Status
      RadarObj2_Width_2159: upstream-reference=TopLevelComposition.Sdc_Prototype.RP_Sdc_Adas_Data.RadarObj2_Width, ecu-extract-reference=TopLevelCompositionPrototype.Sdc_Prototype.RP_Sdc_Adas_Data.RadarObj2_Width
      RadarObj2_Width_Status_2160: upstream-reference=TopLevelComposition.Sdc_Prototype.RP_Sdc_Adas_Data.RadarObj2_Width_Status, ecu-extract-reference=TopLevelCompositionPrototype.Sdc_Prototype.RP_Sdc_Adas_Data.RadarObj2_Width_Status
      RadarObj3_Dx_2161: upstream-reference=TopLevelComposition.Sdc_Prototype.RP_Sdc_Adas_Data.RadarObj3_Dx, ecu-extract-reference=TopLevelCompositionPrototype.Sdc_Prototype.RP_Sdc_Adas_Data.RadarObj3_Dx
      RadarObj3_Dx_Status_2162: upstream-reference=TopLevelComposition.Sdc_Prototype.RP_Sdc_Adas_Data.RadarObj3_Dx_Status, ecu-extract-reference=TopLevelCompositionPrototype.Sdc_Prototype.RP_Sdc_Adas_Data.RadarObj3_Dx_Status
      RadarObj3_Dy_2163: upstream-reference=TopLevelComposition.Sdc_Prototype.RP_Sdc_Adas_Data.RadarObj3_Dy, ecu-extract-reference=TopLevelCompositionPrototype.Sdc_Prototype.RP_Sdc_Adas_Data.RadarObj3_Dy
      RadarObj3_Dy_Status_2164: upstream-reference=TopLevelComposition.Sdc_Prototype.RP_Sdc_Adas_Data.RadarObj3_Dy_Status, ecu-extract-reference=TopLevelCompositionPrototype.Sdc_Prototype.RP_Sdc_Adas_Data.RadarObj3_Dy_Status
      RadarObj3_ExistProb_2165: upstream-reference=TopLevelComposition.Sdc_Prototype.RP_Sdc_Adas_Data.RadarObj3_ExistProb, ecu-extract-reference=TopLevelCompositionPrototype.Sdc_Prototype.RP_Sdc_Adas_Data.RadarObj3_ExistProb
      RadarObj3_ExistProb_Status_2166: upstream-reference=TopLevelComposition.Sdc_Prototype.RP_Sdc_Adas_Data.RadarObj3_ExistProb_Status, ecu-extract-reference=TopLevelCompositionPrototype.Sdc_Prototype.RP_Sdc_Adas_Data.RadarObj3_ExistProb_Status
      RadarObj3_Length_2167: upstream-reference=TopLevelComposition.Sdc_Prototype.RP_Sdc_Adas_Data.RadarObj3_Length, ecu-extract-reference=TopLevelCompositionPrototype.Sdc_Prototype.RP_Sdc_Adas_Data.RadarObj3_Length
      RadarObj3_Length_Status_2168: upstream-reference=TopLevelComposition.Sdc_Prototype.RP_Sdc_Adas_Data.RadarObj3_Length_Status, ecu-extract-reference=TopLevelCompositionPrototype.Sdc_Prototype.RP_Sdc_Adas_Data.RadarObj3_Length_Status
      RadarObj3_Location_2169: upstream-reference=TopLevelComposition.Sdc_Prototype.RP_Sdc_Adas_Data.RadarObj3_Location, ecu-extract-reference=TopLevelCompositionPrototype.Sdc_Prototype.RP_Sdc_Adas_Data.RadarObj3_Location
      RadarObj3_Location_Status_2170: upstream-reference=TopLevelComposition.Sdc_Prototype.RP_Sdc_Adas_Data.RadarObj3_Location_Status, ecu-extract-reference=TopLevelCompositionPrototype.Sdc_Prototype.RP_Sdc_Adas_Data.RadarObj3_Location_Status
      RadarObj3_Measured_2171: upstream-reference=TopLevelComposition.Sdc_Prototype.RP_Sdc_Adas_Data.RadarObj3_Measured, ecu-extract-reference=TopLevelCompositionPrototype.Sdc_Prototype.RP_Sdc_Adas_Data.RadarObj3_Measured
      RadarObj3_Measured_Status_2172: upstream-reference=TopLevelComposition.Sdc_Prototype.RP_Sdc_Adas_Data.RadarObj3_Measured_Status, ecu-extract-reference=TopLevelCompositionPrototype.Sdc_Prototype.RP_Sdc_Adas_Data.RadarObj3_Measured_Status
      RadarObj3_RelAx_2173: upstream-reference=TopLevelComposition.Sdc_Prototype.RP_Sdc_Adas_Data.RadarObj3_RelAx, ecu-extract-reference=TopLevelCompositionPrototype.Sdc_Prototype.RP_Sdc_Adas_Data.RadarObj3_RelAx
      RadarObj3_RelAx_Status_2174: upstream-reference=TopLevelComposition.Sdc_Prototype.RP_Sdc_Adas_Data.RadarObj3_RelAx_Status, ecu-extract-reference=TopLevelCompositionPrototype.Sdc_Prototype.RP_Sdc_Adas_Data.RadarObj3_RelAx_Status
      RadarObj3_RelVx_2175: upstream-reference=TopLevelComposition.Sdc_Prototype.RP_Sdc_Adas_Data.RadarObj3_RelVx, ecu-extract-reference=TopLevelCompositionPrototype.Sdc_Prototype.RP_Sdc_Adas_Data.RadarObj3_RelVx
      RadarObj3_RelVx_Status_2176: upstream-reference=TopLevelComposition.Sdc_Prototype.RP_Sdc_Adas_Data.RadarObj3_RelVx_Status, ecu-extract-reference=TopLevelCompositionPrototype.Sdc_Prototype.RP_Sdc_Adas_Data.RadarObj3_RelVx_Status
      RadarObj3_RelVy_2177: upstream-reference=TopLevelComposition.Sdc_Prototype.RP_Sdc_Adas_Data.RadarObj3_RelVy, ecu-extract-reference=TopLevelCompositionPrototype.Sdc_Prototype.RP_Sdc_Adas_Data.RadarObj3_RelVy
      RadarObj3_RelVy_Status_2178: upstream-reference=TopLevelComposition.Sdc_Prototype.RP_Sdc_Adas_Data.RadarObj3_RelVy_Status, ecu-extract-reference=TopLevelCompositionPrototype.Sdc_Prototype.RP_Sdc_Adas_Data.RadarObj3_RelVy_Status
      RadarObj3_Width_2179: upstream-reference=TopLevelComposition.Sdc_Prototype.RP_Sdc_Adas_Data.RadarObj3_Width, ecu-extract-reference=TopLevelCompositionPrototype.Sdc_Prototype.RP_Sdc_Adas_Data.RadarObj3_Width
      RadarObj3_Width_Status_2180: upstream-reference=TopLevelComposition.Sdc_Prototype.RP_Sdc_Adas_Data.RadarObj3_Width_Status, ecu-extract-reference=TopLevelCompositionPrototype.Sdc_Prototype.RP_Sdc_Adas_Data.RadarObj3_Width_Status
      RadarObj4_Dx_2181: upstream-reference=TopLevelComposition.Sdc_Prototype.RP_Sdc_Adas_Data.RadarObj4_Dx, ecu-extract-reference=TopLevelCompositionPrototype.Sdc_Prototype.RP_Sdc_Adas_Data.RadarObj4_Dx
      RadarObj4_Dx_Status_2182: upstream-reference=TopLevelComposition.Sdc_Prototype.RP_Sdc_Adas_Data.RadarObj4_Dx_Status, ecu-extract-reference=TopLevelCompositionPrototype.Sdc_Prototype.RP_Sdc_Adas_Data.RadarObj4_Dx_Status
      RadarObj4_Dy_2183: upstream-reference=TopLevelComposition.Sdc_Prototype.RP_Sdc_Adas_Data.RadarObj4_Dy, ecu-extract-reference=TopLevelCompositionPrototype.Sdc_Prototype.RP_Sdc_Adas_Data.RadarObj4_Dy
      RadarObj4_Dy_Status_2184: upstream-reference=TopLevelComposition.Sdc_Prototype.RP_Sdc_Adas_Data.RadarObj4_Dy_Status, ecu-extract-reference=TopLevelCompositionPrototype.Sdc_Prototype.RP_Sdc_Adas_Data.RadarObj4_Dy_Status
      RadarObj4_ExistProb_2185: upstream-reference=TopLevelComposition.Sdc_Prototype.RP_Sdc_Adas_Data.RadarObj4_ExistProb, ecu-extract-reference=TopLevelCompositionPrototype.Sdc_Prototype.RP_Sdc_Adas_Data.RadarObj4_ExistProb
      RadarObj4_ExistProb_Status_2186: upstream-reference=TopLevelComposition.Sdc_Prototype.RP_Sdc_Adas_Data.RadarObj4_ExistProb_Status, ecu-extract-reference=TopLevelCompositionPrototype.Sdc_Prototype.RP_Sdc_Adas_Data.RadarObj4_ExistProb_Status
      RadarObj4_Length_2187: upstream-reference=TopLevelComposition.Sdc_Prototype.RP_Sdc_Adas_Data.RadarObj4_Length, ecu-extract-reference=TopLevelCompositionPrototype.Sdc_Prototype.RP_Sdc_Adas_Data.RadarObj4_Length
      RadarObj4_Length_Status_2188: upstream-reference=TopLevelComposition.Sdc_Prototype.RP_Sdc_Adas_Data.RadarObj4_Length_Status, ecu-extract-reference=TopLevelCompositionPrototype.Sdc_Prototype.RP_Sdc_Adas_Data.RadarObj4_Length_Status
      RadarObj4_Location_2189: upstream-reference=TopLevelComposition.Sdc_Prototype.RP_Sdc_Adas_Data.RadarObj4_Location, ecu-extract-reference=TopLevelCompositionPrototype.Sdc_Prototype.RP_Sdc_Adas_Data.RadarObj4_Location
      RadarObj4_Location_Status_2190: upstream-reference=TopLevelComposition.Sdc_Prototype.RP_Sdc_Adas_Data.RadarObj4_Location_Status, ecu-extract-reference=TopLevelCompositionPrototype.Sdc_Prototype.RP_Sdc_Adas_Data.RadarObj4_Location_Status
      RadarObj4_Measured_2191: upstream-reference=TopLevelComposition.Sdc_Prototype.RP_Sdc_Adas_Data.RadarObj4_Measured, ecu-extract-reference=TopLevelCompositionPrototype.Sdc_Prototype.RP_Sdc_Adas_Data.RadarObj4_Measured
      RadarObj4_Measured_Status_2192: upstream-reference=TopLevelComposition.Sdc_Prototype.RP_Sdc_Adas_Data.RadarObj4_Measured_Status, ecu-extract-reference=TopLevelCompositionPrototype.Sdc_Prototype.RP_Sdc_Adas_Data.RadarObj4_Measured_Status
      RadarObj4_RelAx_2193: upstream-reference=TopLevelComposition.Sdc_Prototype.RP_Sdc_Adas_Data.RadarObj4_RelAx, ecu-extract-reference=TopLevelCompositionPrototype.Sdc_Prototype.RP_Sdc_Adas_Data.RadarObj4_RelAx
      RadarObj4_RelAx_Status_2194: upstream-reference=TopLevelComposition.Sdc_Prototype.RP_Sdc_Adas_Data.RadarObj4_RelAx_Status, ecu-extract-reference=TopLevelCompositionPrototype.Sdc_Prototype.RP_Sdc_Adas_Data.RadarObj4_RelAx_Status
      RadarObj4_RelVx_2195: upstream-reference=TopLevelComposition.Sdc_Prototype.RP_Sdc_Adas_Data.RadarObj4_RelVx, ecu-extract-reference=TopLevelCompositionPrototype.Sdc_Prototype.RP_Sdc_Adas_Data.RadarObj4_RelVx
      RadarObj4_RelVx_Status_2196: upstream-reference=TopLevelComposition.Sdc_Prototype.RP_Sdc_Adas_Data.RadarObj4_RelVx_Status, ecu-extract-reference=TopLevelCompositionPrototype.Sdc_Prototype.RP_Sdc_Adas_Data.RadarObj4_RelVx_Status
      RadarObj4_RelVy_2197: upstream-reference=TopLevelComposition.Sdc_Prototype.RP_Sdc_Adas_Data.RadarObj4_RelVy, ecu-extract-reference=TopLevelCompositionPrototype.Sdc_Prototype.RP_Sdc_Adas_Data.RadarObj4_RelVy
      RadarObj4_RelVy_Status_2198: upstream-reference=TopLevelComposition.Sdc_Prototype.RP_Sdc_Adas_Data.RadarObj4_RelVy_Status, ecu-extract-reference=TopLevelCompositionPrototype.Sdc_Prototype.RP_Sdc_Adas_Data.RadarObj4_RelVy_Status
      RadarObj4_Width_2199: upstream-reference=TopLevelComposition.Sdc_Prototype.RP_Sdc_Adas_Data.RadarObj4_Width, ecu-extract-reference=TopLevelCompositionPrototype.Sdc_Prototype.RP_Sdc_Adas_Data.RadarObj4_Width
      RadarObj4_Width_Status_2200: upstream-reference=TopLevelComposition.Sdc_Prototype.RP_Sdc_Adas_Data.RadarObj4_Width_Status, ecu-extract-reference=TopLevelCompositionPrototype.Sdc_Prototype.RP_Sdc_Adas_Data.RadarObj4_Width_Status
      RP_Sdc_Body_Data_2201: upstream-reference=TopLevelComposition.Sdc_Prototype.RP_Sdc_Body_Data, ecu-extract-reference=TopLevelCompositionPrototype.Sdc_Prototype.RP_Sdc_Body_Data
      ACC_HostLaneLeftStatus_2202: upstream-reference=TopLevelComposition.Sdc_Prototype.RP_Sdc_Body_Data.ACC_HostLaneLeftStatus, ecu-extract-reference=TopLevelCompositionPrototype.Sdc_Prototype.RP_Sdc_Body_Data.ACC_HostLaneLeftStatus
      ACC_HostLaneRightStatus_2203: upstream-reference=TopLevelComposition.Sdc_Prototype.RP_Sdc_Body_Data.ACC_HostLaneRightStatus, ecu-extract-reference=TopLevelCompositionPrototype.Sdc_Prototype.RP_Sdc_Body_Data.ACC_HostLaneRightStatus
      AccIaccHWAMode_2204: upstream-reference=TopLevelComposition.Sdc_Prototype.RP_Sdc_Body_Data.AccIaccHWAMode, ecu-extract-reference=TopLevelCompositionPrototype.Sdc_Prototype.RP_Sdc_Body_Data.AccIaccHWAMode
      AccIaccHWAMode_Status_2205: upstream-reference=TopLevelComposition.Sdc_Prototype.RP_Sdc_Body_Data.AccIaccHWAMode_Status, ecu-extract-reference=TopLevelCompositionPrototype.Sdc_Prototype.RP_Sdc_Body_Data.AccIaccHWAMode_Status
      BCM_BrakeLampError_2206: upstream-reference=TopLevelComposition.Sdc_Prototype.RP_Sdc_Body_Data.BCM_BrakeLampError, ecu-extract-reference=TopLevelCompositionPrototype.Sdc_Prototype.RP_Sdc_Body_Data.BCM_BrakeLampError
      BCM_BrakeLampError_Status_2207: upstream-reference=TopLevelComposition.Sdc_Prototype.RP_Sdc_Body_Data.BCM_BrakeLampError_Status, ecu-extract-reference=TopLevelCompositionPrototype.Sdc_Prototype.RP_Sdc_Body_Data.BCM_BrakeLampError_Status
      BCM_TurnLightSwitchSts_2208: upstream-reference=TopLevelComposition.Sdc_Prototype.RP_Sdc_Body_Data.BCM_TurnLightSwitchSts, ecu-extract-reference=TopLevelCompositionPrototype.Sdc_Prototype.RP_Sdc_Body_Data.BCM_TurnLightSwitchSts
      BCM_TurnLightSwitchSts_Status_2209: upstream-reference=TopLevelComposition.Sdc_Prototype.RP_Sdc_Body_Data.BCM_TurnLightSwitchSts_Status, ecu-extract-reference=TopLevelCompositionPrototype.Sdc_Prototype.RP_Sdc_Body_Data.BCM_TurnLightSwitchSts_Status
      BcmAutHeadLiSts_2210: upstream-reference=TopLevelComposition.Sdc_Prototype.RP_Sdc_Body_Data.BcmAutHeadLiSts, ecu-extract-reference=TopLevelCompositionPrototype.Sdc_Prototype.RP_Sdc_Body_Data.BcmAutHeadLiSts
      BcmAutHeadLiSts_Status_2211: upstream-reference=TopLevelComposition.Sdc_Prototype.RP_Sdc_Body_Data.BcmAutHeadLiSts_Status, ecu-extract-reference=TopLevelCompositionPrototype.Sdc_Prototype.RP_Sdc_Body_Data.BcmAutHeadLiSts_Status
      BcmDrvrDoorSts_2212: upstream-reference=TopLevelComposition.Sdc_Prototype.RP_Sdc_Body_Data.BcmDrvrDoorSts, ecu-extract-reference=TopLevelCompositionPrototype.Sdc_Prototype.RP_Sdc_Body_Data.BcmDrvrDoorSts
      BcmDrvrDoorSts_Status_2213: upstream-reference=TopLevelComposition.Sdc_Prototype.RP_Sdc_Body_Data.BcmDrvrDoorSts_Status, ecu-extract-reference=TopLevelCompositionPrototype.Sdc_Prototype.RP_Sdc_Body_Data.BcmDrvrDoorSts_Status
      BcmEmgyLiSts_2214: upstream-reference=TopLevelComposition.Sdc_Prototype.RP_Sdc_Body_Data.BcmEmgyLiSts, ecu-extract-reference=TopLevelCompositionPrototype.Sdc_Prototype.RP_Sdc_Body_Data.BcmEmgyLiSts
      BcmEmgyLiSts_Status_2215: upstream-reference=TopLevelComposition.Sdc_Prototype.RP_Sdc_Body_Data.BcmEmgyLiSts_Status, ecu-extract-reference=TopLevelCompositionPrototype.Sdc_Prototype.RP_Sdc_Body_Data.BcmEmgyLiSts_Status
      BcmFrntFogLmpSts_2216: upstream-reference=TopLevelComposition.Sdc_Prototype.RP_Sdc_Body_Data.BcmFrntFogLmpSts, ecu-extract-reference=TopLevelCompositionPrototype.Sdc_Prototype.RP_Sdc_Body_Data.BcmFrntFogLmpSts
      BcmFrntFogLmpSts_Status_2217: upstream-reference=TopLevelComposition.Sdc_Prototype.RP_Sdc_Body_Data.BcmFrntFogLmpSts_Status, ecu-extract-reference=TopLevelCompositionPrototype.Sdc_Prototype.RP_Sdc_Body_Data.BcmFrntFogLmpSts_Status
      BcmFrntWiperSts_2218: upstream-reference=TopLevelComposition.Sdc_Prototype.RP_Sdc_Body_Data.BcmFrntWiperSts, ecu-extract-reference=TopLevelCompositionPrototype.Sdc_Prototype.RP_Sdc_Body_Data.BcmFrntWiperSts
      BcmFrntWiperSts_Status_2219: upstream-reference=TopLevelComposition.Sdc_Prototype.RP_Sdc_Body_Data.BcmFrntWiperSts_Status, ecu-extract-reference=TopLevelCompositionPrototype.Sdc_Prototype.RP_Sdc_Body_Data.BcmFrntWiperSts_Status
      BcmHiBeamSts_2220: upstream-reference=TopLevelComposition.Sdc_Prototype.RP_Sdc_Body_Data.BcmHiBeamSts, ecu-extract-reference=TopLevelCompositionPrototype.Sdc_Prototype.RP_Sdc_Body_Data.BcmHiBeamSts
      BcmHiBeamSts_Status_2221: upstream-reference=TopLevelComposition.Sdc_Prototype.RP_Sdc_Body_Data.BcmHiBeamSts_Status, ecu-extract-reference=TopLevelCompositionPrototype.Sdc_Prototype.RP_Sdc_Body_Data.BcmHiBeamSts_Status
      BcmLeReDoorSts_2222: upstream-reference=TopLevelComposition.Sdc_Prototype.RP_Sdc_Body_Data.BcmLeReDoorSts, ecu-extract-reference=TopLevelCompositionPrototype.Sdc_Prototype.RP_Sdc_Body_Data.BcmLeReDoorSts
      BcmLeReDoorSts_Status_2223: upstream-reference=TopLevelComposition.Sdc_Prototype.RP_Sdc_Body_Data.BcmLeReDoorSts_Status, ecu-extract-reference=TopLevelCompositionPrototype.Sdc_Prototype.RP_Sdc_Body_Data.BcmLeReDoorSts_Status
      BcmLoBeamSts_2224: upstream-reference=TopLevelComposition.Sdc_Prototype.RP_Sdc_Body_Data.BcmLoBeamSts, ecu-extract-reference=TopLevelCompositionPrototype.Sdc_Prototype.RP_Sdc_Body_Data.BcmLoBeamSts
      BcmLoBeamSts_Status_2225: upstream-reference=TopLevelComposition.Sdc_Prototype.RP_Sdc_Body_Data.BcmLoBeamSts_Status, ecu-extract-reference=TopLevelCompositionPrototype.Sdc_Prototype.RP_Sdc_Body_Data.BcmLoBeamSts_Status
      BcmPassDoorSts_2226: upstream-reference=TopLevelComposition.Sdc_Prototype.RP_Sdc_Body_Data.BcmPassDoorSts, ecu-extract-reference=TopLevelCompositionPrototype.Sdc_Prototype.RP_Sdc_Body_Data.BcmPassDoorSts
      BcmPassDoorSts_Status_2227: upstream-reference=TopLevelComposition.Sdc_Prototype.RP_Sdc_Body_Data.BcmPassDoorSts_Status, ecu-extract-reference=TopLevelCompositionPrototype.Sdc_Prototype.RP_Sdc_Body_Data.BcmPassDoorSts_Status
      BcmReFoglmpSts_2228: upstream-reference=TopLevelComposition.Sdc_Prototype.RP_Sdc_Body_Data.BcmReFoglmpSts, ecu-extract-reference=TopLevelCompositionPrototype.Sdc_Prototype.RP_Sdc_Body_Data.BcmReFoglmpSts
      BcmReFoglmpSts_Status_2229: upstream-reference=TopLevelComposition.Sdc_Prototype.RP_Sdc_Body_Data.BcmReFoglmpSts_Status, ecu-extract-reference=TopLevelCompositionPrototype.Sdc_Prototype.RP_Sdc_Body_Data.BcmReFoglmpSts_Status
      BcmRiReDoorSts_2230: upstream-reference=TopLevelComposition.Sdc_Prototype.RP_Sdc_Body_Data.BcmRiReDoorSts, ecu-extract-reference=TopLevelCompositionPrototype.Sdc_Prototype.RP_Sdc_Body_Data.BcmRiReDoorSts
      BcmRiReDoorSts_Status_2231: upstream-reference=TopLevelComposition.Sdc_Prototype.RP_Sdc_Body_Data.BcmRiReDoorSts_Status, ecu-extract-reference=TopLevelCompositionPrototype.Sdc_Prototype.RP_Sdc_Body_Data.BcmRiReDoorSts_Status
      BcmTurnIndcrLe_2232: upstream-reference=TopLevelComposition.Sdc_Prototype.RP_Sdc_Body_Data.BcmTurnIndcrLe, ecu-extract-reference=TopLevelCompositionPrototype.Sdc_Prototype.RP_Sdc_Body_Data.BcmTurnIndcrLe
      BcmTurnIndcrLe_Status_2233: upstream-reference=TopLevelComposition.Sdc_Prototype.RP_Sdc_Body_Data.BcmTurnIndcrLe_Status, ecu-extract-reference=TopLevelCompositionPrototype.Sdc_Prototype.RP_Sdc_Body_Data.BcmTurnIndcrLe_Status
      BcmTurnIndcrRi_2234: upstream-reference=TopLevelComposition.Sdc_Prototype.RP_Sdc_Body_Data.BcmTurnIndcrRi, ecu-extract-reference=TopLevelCompositionPrototype.Sdc_Prototype.RP_Sdc_Body_Data.BcmTurnIndcrRi
      BcmTurnIndcrRi_Status_2235: upstream-reference=TopLevelComposition.Sdc_Prototype.RP_Sdc_Body_Data.BcmTurnIndcrRi_Status, ecu-extract-reference=TopLevelCompositionPrototype.Sdc_Prototype.RP_Sdc_Body_Data.BcmTurnIndcrRi_Status
      IP_DISFail_2236: upstream-reference=TopLevelComposition.Sdc_Prototype.RP_Sdc_Body_Data.IP_DISFail, ecu-extract-reference=TopLevelCompositionPrototype.Sdc_Prototype.RP_Sdc_Body_Data.IP_DISFail
      IP_DISFail_Status_2237: upstream-reference=TopLevelComposition.Sdc_Prototype.RP_Sdc_Body_Data.IP_DISFail_Status, ecu-extract-reference=TopLevelCompositionPrototype.Sdc_Prototype.RP_Sdc_Body_Data.IP_DISFail_Status
      IP_QDashACCFail_2238: upstream-reference=TopLevelComposition.Sdc_Prototype.RP_Sdc_Body_Data.IP_QDashACCFail, ecu-extract-reference=TopLevelCompositionPrototype.Sdc_Prototype.RP_Sdc_Body_Data.IP_QDashACCFail
      IP_QDashACCFail_Status_2239: upstream-reference=TopLevelComposition.Sdc_Prototype.RP_Sdc_Body_Data.IP_QDashACCFail_Status, ecu-extract-reference=TopLevelCompositionPrototype.Sdc_Prototype.RP_Sdc_Body_Data.IP_QDashACCFail_Status
      SrsDrvrBucSwtSts_2240: upstream-reference=TopLevelComposition.Sdc_Prototype.RP_Sdc_Body_Data.SrsDrvrBucSwtSts, ecu-extract-reference=TopLevelCompositionPrototype.Sdc_Prototype.RP_Sdc_Body_Data.SrsDrvrBucSwtSts
      SrsDrvrBucSwtSts_Status_2241: upstream-reference=TopLevelComposition.Sdc_Prototype.RP_Sdc_Body_Data.SrsDrvrBucSwtSts_Status, ecu-extract-reference=TopLevelCompositionPrototype.Sdc_Prototype.RP_Sdc_Body_Data.SrsDrvrBucSwtSts_Status
      SrsPassBucSwtSts_2242: upstream-reference=TopLevelComposition.Sdc_Prototype.RP_Sdc_Body_Data.SrsPassBucSwtSts, ecu-extract-reference=TopLevelCompositionPrototype.Sdc_Prototype.RP_Sdc_Body_Data.SrsPassBucSwtSts
      SrsPassBucSwtSts_Status_2243: upstream-reference=TopLevelComposition.Sdc_Prototype.RP_Sdc_Body_Data.SrsPassBucSwtSts_Status, ecu-extract-reference=TopLevelCompositionPrototype.Sdc_Prototype.RP_Sdc_Body_Data.SrsPassBucSwtSts_Status
      TmsFrntBlowMod_2244: upstream-reference=TopLevelComposition.Sdc_Prototype.RP_Sdc_Body_Data.TmsFrntBlowMod, ecu-extract-reference=TopLevelCompositionPrototype.Sdc_Prototype.RP_Sdc_Body_Data.TmsFrntBlowMod
      TmsFrntBlowMod_Status_2245: upstream-reference=TopLevelComposition.Sdc_Prototype.RP_Sdc_Body_Data.TmsFrntBlowMod_Status, ecu-extract-reference=TopLevelCompositionPrototype.Sdc_Prototype.RP_Sdc_Body_Data.TmsFrntBlowMod_Status
      RP_Sdc_Chassis_Data_2246: upstream-reference=TopLevelComposition.Sdc_Prototype.RP_Sdc_Chassis_Data, ecu-extract-reference=TopLevelCompositionPrototype.Sdc_Prototype.RP_Sdc_Chassis_Data
      AdsUDLCStatus_2247: upstream-reference=TopLevelComposition.Sdc_Prototype.RP_Sdc_Chassis_Data.AdsUDLCStatus, ecu-extract-reference=TopLevelCompositionPrototype.Sdc_Prototype.RP_Sdc_Chassis_Data.AdsUDLCStatus
      AdsUDLCStatus_Status_2248: upstream-reference=TopLevelComposition.Sdc_Prototype.RP_Sdc_Chassis_Data.AdsUDLCStatus_Status, ecu-extract-reference=TopLevelCompositionPrototype.Sdc_Prototype.RP_Sdc_Chassis_Data.AdsUDLCStatus_Status
      BrakePressureSimulator_2249: upstream-reference=TopLevelComposition.Sdc_Prototype.RP_Sdc_Chassis_Data.BrakePressureSimulator, ecu-extract-reference=TopLevelCompositionPrototype.Sdc_Prototype.RP_Sdc_Chassis_Data.BrakePressureSimulator
      BrakePressureSimulator_Status_2250: upstream-reference=TopLevelComposition.Sdc_Prototype.RP_Sdc_Chassis_Data.BrakePressureSimulator_Status, ecu-extract-reference=TopLevelCompositionPrototype.Sdc_Prototype.RP_Sdc_Chassis_Data.BrakePressureSimulator_Status
      EPS_APA_EpasFAILED_2251: upstream-reference=TopLevelComposition.Sdc_Prototype.RP_Sdc_Chassis_Data.EPS_APA_EpasFAILED, ecu-extract-reference=TopLevelCompositionPrototype.Sdc_Prototype.RP_Sdc_Chassis_Data.EPS_APA_EpasFAILED
      EPS_APA_EpasFAILED_Status_2252: upstream-reference=TopLevelComposition.Sdc_Prototype.RP_Sdc_Chassis_Data.EPS_APA_EpasFAILED_Status, ecu-extract-reference=TopLevelCompositionPrototype.Sdc_Prototype.RP_Sdc_Chassis_Data.EPS_APA_EpasFAILED_Status
      EPS_ActualMotorTorq_2253: upstream-reference=TopLevelComposition.Sdc_Prototype.RP_Sdc_Chassis_Data.EPS_ActualMotorTorq, ecu-extract-reference=TopLevelCompositionPrototype.Sdc_Prototype.RP_Sdc_Chassis_Data.EPS_ActualMotorTorq
      EPS_ActualMotorTorq_Status_2254: upstream-reference=TopLevelComposition.Sdc_Prototype.RP_Sdc_Chassis_Data.EPS_ActualMotorTorq_Status, ecu-extract-reference=TopLevelCompositionPrototype.Sdc_Prototype.RP_Sdc_Chassis_Data.EPS_ActualMotorTorq_Status
      EPS_ActualTorsionBarTorq_2255: upstream-reference=TopLevelComposition.Sdc_Prototype.RP_Sdc_Chassis_Data.EPS_ActualTorsionBarTorq, ecu-extract-reference=TopLevelCompositionPrototype.Sdc_Prototype.RP_Sdc_Chassis_Data.EPS_ActualTorsionBarTorq
      EPS_ActualTorsionBarTorq_Status_2256: upstream-reference=TopLevelComposition.Sdc_Prototype.RP_Sdc_Chassis_Data.EPS_ActualTorsionBarTorq_Status, ecu-extract-reference=TopLevelCompositionPrototype.Sdc_Prototype.RP_Sdc_Chassis_Data.EPS_ActualTorsionBarTorq_Status
      EPS_MeasuredTorsionBarTorqValid_2257: upstream-reference=TopLevelComposition.Sdc_Prototype.RP_Sdc_Chassis_Data.EPS_MeasuredTorsionBarTorqValid, ecu-extract-reference=TopLevelCompositionPrototype.Sdc_Prototype.RP_Sdc_Chassis_Data.EPS_MeasuredTorsionBarTorqValid
      EPS_Pinionang_Valid_2258: upstream-reference=TopLevelComposition.Sdc_Prototype.RP_Sdc_Chassis_Data.EPS_Pinionang_Valid, ecu-extract-reference=TopLevelCompositionPrototype.Sdc_Prototype.RP_Sdc_Chassis_Data.EPS_Pinionang_Valid
      EPS_fault_state_2259: upstream-reference=TopLevelComposition.Sdc_Prototype.RP_Sdc_Chassis_Data.EPS_fault_state, ecu-extract-reference=TopLevelCompositionPrototype.Sdc_Prototype.RP_Sdc_Chassis_Data.EPS_fault_state
      EPS_fault_state_Status_2260: upstream-reference=TopLevelComposition.Sdc_Prototype.RP_Sdc_Chassis_Data.EPS_fault_state_Status, ecu-extract-reference=TopLevelCompositionPrototype.Sdc_Prototype.RP_Sdc_Chassis_Data.EPS_fault_state_Status
      ESP_LatAccelValid_2261: upstream-reference=TopLevelComposition.Sdc_Prototype.RP_Sdc_Chassis_Data.ESP_LatAccelValid, ecu-extract-reference=TopLevelCompositionPrototype.Sdc_Prototype.RP_Sdc_Chassis_Data.ESP_LatAccelValid
      ESP_LongAccelValid_2262: upstream-reference=TopLevelComposition.Sdc_Prototype.RP_Sdc_Chassis_Data.ESP_LongAccelValid, ecu-extract-reference=TopLevelCompositionPrototype.Sdc_Prototype.RP_Sdc_Chassis_Data.ESP_LongAccelValid
      ESP_YawRateValid_2263: upstream-reference=TopLevelComposition.Sdc_Prototype.RP_Sdc_Chassis_Data.ESP_YawRateValid, ecu-extract-reference=TopLevelCompositionPrototype.Sdc_Prototype.RP_Sdc_Chassis_Data.ESP_YawRateValid
      EpsConcussAvailabilityStatus_2264: upstream-reference=TopLevelComposition.Sdc_Prototype.RP_Sdc_Chassis_Data.EpsConcussAvailabilityStatus, ecu-extract-reference=TopLevelCompositionPrototype.Sdc_Prototype.RP_Sdc_Chassis_Data.EpsConcussAvailabilityStatus
      EpsConcussAvailabilityStatus_Status_2265: upstream-reference=TopLevelComposition.Sdc_Prototype.RP_Sdc_Chassis_Data.EpsConcussAvailabilityStatus_Status, ecu-extract-reference=TopLevelCompositionPrototype.Sdc_Prototype.RP_Sdc_Chassis_Data.EpsConcussAvailabilityStatus_Status
      EpsFaild_2266: upstream-reference=TopLevelComposition.Sdc_Prototype.RP_Sdc_Chassis_Data.EpsFaild, ecu-extract-reference=TopLevelCompositionPrototype.Sdc_Prototype.RP_Sdc_Chassis_Data.EpsFaild
      EpsFaild_Status_2267: upstream-reference=TopLevelComposition.Sdc_Prototype.RP_Sdc_Chassis_Data.EpsFaild_Status, ecu-extract-reference=TopLevelCompositionPrototype.Sdc_Prototype.RP_Sdc_Chassis_Data.EpsFaild_Status
      EpsIACCabortreason_2268: upstream-reference=TopLevelComposition.Sdc_Prototype.RP_Sdc_Chassis_Data.EpsIACCabortreason, ecu-extract-reference=TopLevelCompositionPrototype.Sdc_Prototype.RP_Sdc_Chassis_Data.EpsIACCabortreason
      EpsIACCabortreason_Status_2269: upstream-reference=TopLevelComposition.Sdc_Prototype.RP_Sdc_Chassis_Data.EpsIACCabortreason_Status, ecu-extract-reference=TopLevelCompositionPrototype.Sdc_Prototype.RP_Sdc_Chassis_Data.EpsIACCabortreason_Status
      EpsLatCtrlActive_2270: upstream-reference=TopLevelComposition.Sdc_Prototype.RP_Sdc_Chassis_Data.EpsLatCtrlActive, ecu-extract-reference=TopLevelCompositionPrototype.Sdc_Prototype.RP_Sdc_Chassis_Data.EpsLatCtrlActive
      EpsLatCtrlActive_Status_2271: upstream-reference=TopLevelComposition.Sdc_Prototype.RP_Sdc_Chassis_Data.EpsLatCtrlActive_Status, ecu-extract-reference=TopLevelCompositionPrototype.Sdc_Prototype.RP_Sdc_Chassis_Data.EpsLatCtrlActive_Status
      EpsLatCtrlAvailabilityStatus_2272: upstream-reference=TopLevelComposition.Sdc_Prototype.RP_Sdc_Chassis_Data.EpsLatCtrlAvailabilityStatus, ecu-extract-reference=TopLevelCompositionPrototype.Sdc_Prototype.RP_Sdc_Chassis_Data.EpsLatCtrlAvailabilityStatus
      EpsLatCtrlAvailabilityStatus_Status_2273: upstream-reference=TopLevelComposition.Sdc_Prototype.RP_Sdc_Chassis_Data.EpsLatCtrlAvailabilityStatus_Status, ecu-extract-reference=TopLevelCompositionPrototype.Sdc_Prototype.RP_Sdc_Chassis_Data.EpsLatCtrlAvailabilityStatus_Status
      EpsMeasuredTorsionBarTorq_Status_2274: upstream-reference=TopLevelComposition.Sdc_Prototype.RP_Sdc_Chassis_Data.EpsMeasuredTorsionBarTorq_Status, ecu-extract-reference=TopLevelCompositionPrototype.Sdc_Prototype.RP_Sdc_Chassis_Data.EpsMeasuredTorsionBarTorq_Status
      EpsMeasuredTorsionBarTorque_2275: upstream-reference=TopLevelComposition.Sdc_Prototype.RP_Sdc_Chassis_Data.EpsMeasuredTorsionBarTorque, ecu-extract-reference=TopLevelCompositionPrototype.Sdc_Prototype.RP_Sdc_Chassis_Data.EpsMeasuredTorsionBarTorque
      EpsMeasuredTorsionBarTorque_Status_2276: upstream-reference=TopLevelComposition.Sdc_Prototype.RP_Sdc_Chassis_Data.EpsMeasuredTorsionBarTorque_Status, ecu-extract-reference=TopLevelCompositionPrototype.Sdc_Prototype.RP_Sdc_Chassis_Data.EpsMeasuredTorsionBarTorque_Status
      EpsPinionang_2277: upstream-reference=TopLevelComposition.Sdc_Prototype.RP_Sdc_Chassis_Data.EpsPinionang, ecu-extract-reference=TopLevelCompositionPrototype.Sdc_Prototype.RP_Sdc_Chassis_Data.EpsPinionang
      EpsPinionang_Status_2278: upstream-reference=TopLevelComposition.Sdc_Prototype.RP_Sdc_Chassis_Data.EpsPinionang_Status, ecu-extract-reference=TopLevelCompositionPrototype.Sdc_Prototype.RP_Sdc_Chassis_Data.EpsPinionang_Status
      EpsSasCalSts_2279: upstream-reference=TopLevelComposition.Sdc_Prototype.RP_Sdc_Chassis_Data.EpsSasCalSts, ecu-extract-reference=TopLevelCompositionPrototype.Sdc_Prototype.RP_Sdc_Chassis_Data.EpsSasCalSts
      EpsSasCalSts_Status_2280: upstream-reference=TopLevelComposition.Sdc_Prototype.RP_Sdc_Chassis_Data.EpsSasCalSts_Status, ecu-extract-reference=TopLevelCompositionPrototype.Sdc_Prototype.RP_Sdc_Chassis_Data.EpsSasCalSts_Status
      EpsSasSteerAg_2281: upstream-reference=TopLevelComposition.Sdc_Prototype.RP_Sdc_Chassis_Data.EpsSasSteerAg, ecu-extract-reference=TopLevelCompositionPrototype.Sdc_Prototype.RP_Sdc_Chassis_Data.EpsSasSteerAg
      EpsSasSteerAgVld_2282: upstream-reference=TopLevelComposition.Sdc_Prototype.RP_Sdc_Chassis_Data.EpsSasSteerAgVld, ecu-extract-reference=TopLevelCompositionPrototype.Sdc_Prototype.RP_Sdc_Chassis_Data.EpsSasSteerAgVld
      EpsSasSteerAg_Status_2283: upstream-reference=TopLevelComposition.Sdc_Prototype.RP_Sdc_Chassis_Data.EpsSasSteerAg_Status, ecu-extract-reference=TopLevelCompositionPrototype.Sdc_Prototype.RP_Sdc_Chassis_Data.EpsSasSteerAg_Status
      EpsSteerAgRate_2284: upstream-reference=TopLevelComposition.Sdc_Prototype.RP_Sdc_Chassis_Data.EpsSteerAgRate, ecu-extract-reference=TopLevelCompositionPrototype.Sdc_Prototype.RP_Sdc_Chassis_Data.EpsSteerAgRate
      EpsSteerAgRate_Status_2285: upstream-reference=TopLevelComposition.Sdc_Prototype.RP_Sdc_Chassis_Data.EpsSteerAgRate_Status, ecu-extract-reference=TopLevelCompositionPrototype.Sdc_Prototype.RP_Sdc_Chassis_Data.EpsSteerAgRate_Status
      EpsSteerAgSensFilr_2286: upstream-reference=TopLevelComposition.Sdc_Prototype.RP_Sdc_Chassis_Data.EpsSteerAgSensFilr, ecu-extract-reference=TopLevelCompositionPrototype.Sdc_Prototype.RP_Sdc_Chassis_Data.EpsSteerAgSensFilr
      EpsSteerAgSensFilr_Status_2287: upstream-reference=TopLevelComposition.Sdc_Prototype.RP_Sdc_Chassis_Data.EpsSteerAgSensFilr_Status, ecu-extract-reference=TopLevelCompositionPrototype.Sdc_Prototype.RP_Sdc_Chassis_Data.EpsSteerAgSensFilr_Status
      EspABAactive_2288: upstream-reference=TopLevelComposition.Sdc_Prototype.RP_Sdc_Chassis_Data.EspABAactive, ecu-extract-reference=TopLevelCompositionPrototype.Sdc_Prototype.RP_Sdc_Chassis_Data.EspABAactive
      EspABAactive_Status_2289: upstream-reference=TopLevelComposition.Sdc_Prototype.RP_Sdc_Chassis_Data.EspABAactive_Status, ecu-extract-reference=TopLevelCompositionPrototype.Sdc_Prototype.RP_Sdc_Chassis_Data.EspABAactive_Status
      EspABAavailable_2290: upstream-reference=TopLevelComposition.Sdc_Prototype.RP_Sdc_Chassis_Data.EspABAavailable, ecu-extract-reference=TopLevelCompositionPrototype.Sdc_Prototype.RP_Sdc_Chassis_Data.EspABAavailable
      EspABAavailable_Status_2291: upstream-reference=TopLevelComposition.Sdc_Prototype.RP_Sdc_Chassis_Data.EspABAavailable_Status, ecu-extract-reference=TopLevelCompositionPrototype.Sdc_Prototype.RP_Sdc_Chassis_Data.EspABAavailable_Status
      EspAEBAvailable_2292: upstream-reference=TopLevelComposition.Sdc_Prototype.RP_Sdc_Chassis_Data.EspAEBAvailable, ecu-extract-reference=TopLevelCompositionPrototype.Sdc_Prototype.RP_Sdc_Chassis_Data.EspAEBAvailable
      EspAEBAvailable_Status_2293: upstream-reference=TopLevelComposition.Sdc_Prototype.RP_Sdc_Chassis_Data.EspAEBAvailable_Status, ecu-extract-reference=TopLevelCompositionPrototype.Sdc_Prototype.RP_Sdc_Chassis_Data.EspAEBAvailable_Status
      EspAEBdecActive_2294: upstream-reference=TopLevelComposition.Sdc_Prototype.RP_Sdc_Chassis_Data.EspAEBdecActive, ecu-extract-reference=TopLevelCompositionPrototype.Sdc_Prototype.RP_Sdc_Chassis_Data.EspAEBdecActive
      EspAEBdecActive_Status_2295: upstream-reference=TopLevelComposition.Sdc_Prototype.RP_Sdc_Chassis_Data.EspAEBdecActive_Status, ecu-extract-reference=TopLevelCompositionPrototype.Sdc_Prototype.RP_Sdc_Chassis_Data.EspAEBdecActive_Status
      EspAWBactive_2296: upstream-reference=TopLevelComposition.Sdc_Prototype.RP_Sdc_Chassis_Data.EspAWBactive, ecu-extract-reference=TopLevelCompositionPrototype.Sdc_Prototype.RP_Sdc_Chassis_Data.EspAWBactive
      EspAWBactive_Status_2297: upstream-reference=TopLevelComposition.Sdc_Prototype.RP_Sdc_Chassis_Data.EspAWBactive_Status, ecu-extract-reference=TopLevelCompositionPrototype.Sdc_Prototype.RP_Sdc_Chassis_Data.EspAWBactive_Status
      EspAWBavailable_2298: upstream-reference=TopLevelComposition.Sdc_Prototype.RP_Sdc_Chassis_Data.EspAWBavailable, ecu-extract-reference=TopLevelCompositionPrototype.Sdc_Prototype.RP_Sdc_Chassis_Data.EspAWBavailable
      EspAWBavailable_Status_2299: upstream-reference=TopLevelComposition.Sdc_Prototype.RP_Sdc_Chassis_Data.EspAWBavailable_Status, ecu-extract-reference=TopLevelCompositionPrototype.Sdc_Prototype.RP_Sdc_Chassis_Data.EspAWBavailable_Status
      EspAbsActv_2300: upstream-reference=TopLevelComposition.Sdc_Prototype.RP_Sdc_Chassis_Data.EspAbsActv, ecu-extract-reference=TopLevelCompositionPrototype.Sdc_Prototype.RP_Sdc_Chassis_Data.EspAbsActv
      EspAbsActv_Status_2301: upstream-reference=TopLevelComposition.Sdc_Prototype.RP_Sdc_Chassis_Data.EspAbsActv_Status, ecu-extract-reference=TopLevelCompositionPrototype.Sdc_Prototype.RP_Sdc_Chassis_Data.EspAbsActv_Status
      EspAbsFailr_2302: upstream-reference=TopLevelComposition.Sdc_Prototype.RP_Sdc_Chassis_Data.EspAbsFailr, ecu-extract-reference=TopLevelCompositionPrototype.Sdc_Prototype.RP_Sdc_Chassis_Data.EspAbsFailr
      EspAbsFailr_Status_2303: upstream-reference=TopLevelComposition.Sdc_Prototype.RP_Sdc_Chassis_Data.EspAbsFailr_Status, ecu-extract-reference=TopLevelCompositionPrototype.Sdc_Prototype.RP_Sdc_Chassis_Data.EspAbsFailr_Status
      EspActvSts_2304: upstream-reference=TopLevelComposition.Sdc_Prototype.RP_Sdc_Chassis_Data.EspActvSts, ecu-extract-reference=TopLevelCompositionPrototype.Sdc_Prototype.RP_Sdc_Chassis_Data.EspActvSts
      EspActvSts_Status_2305: upstream-reference=TopLevelComposition.Sdc_Prototype.RP_Sdc_Chassis_Data.EspActvSts_Status, ecu-extract-reference=TopLevelCompositionPrototype.Sdc_Prototype.RP_Sdc_Chassis_Data.EspActvSts_Status
      EspEbdFailr_2306: upstream-reference=TopLevelComposition.Sdc_Prototype.RP_Sdc_Chassis_Data.EspEbdFailr, ecu-extract-reference=TopLevelCompositionPrototype.Sdc_Prototype.RP_Sdc_Chassis_Data.EspEbdFailr
      EspEbdFailr_Status_2307: upstream-reference=TopLevelComposition.Sdc_Prototype.RP_Sdc_Chassis_Data.EspEbdFailr_Status, ecu-extract-reference=TopLevelCompositionPrototype.Sdc_Prototype.RP_Sdc_Chassis_Data.EspEbdFailr_Status
      EspLatAccel_2308: upstream-reference=TopLevelComposition.Sdc_Prototype.RP_Sdc_Chassis_Data.EspLatAccel, ecu-extract-reference=TopLevelCompositionPrototype.Sdc_Prototype.RP_Sdc_Chassis_Data.EspLatAccel
      EspLatAccel_Status_2309: upstream-reference=TopLevelComposition.Sdc_Prototype.RP_Sdc_Chassis_Data.EspLatAccel_Status, ecu-extract-reference=TopLevelCompositionPrototype.Sdc_Prototype.RP_Sdc_Chassis_Data.EspLatAccel_Status
      EspLongAccel_2310: upstream-reference=TopLevelComposition.Sdc_Prototype.RP_Sdc_Chassis_Data.EspLongAccel, ecu-extract-reference=TopLevelCompositionPrototype.Sdc_Prototype.RP_Sdc_Chassis_Data.EspLongAccel
      EspLongAccel_Status_2311: upstream-reference=TopLevelComposition.Sdc_Prototype.RP_Sdc_Chassis_Data.EspLongAccel_Status, ecu-extract-reference=TopLevelCompositionPrototype.Sdc_Prototype.RP_Sdc_Chassis_Data.EspLongAccel_Status
      EspPrefillActive_2312: upstream-reference=TopLevelComposition.Sdc_Prototype.RP_Sdc_Chassis_Data.EspPrefillActive, ecu-extract-reference=TopLevelCompositionPrototype.Sdc_Prototype.RP_Sdc_Chassis_Data.EspPrefillActive
      EspPrefillActive_Status_2313: upstream-reference=TopLevelComposition.Sdc_Prototype.RP_Sdc_Chassis_Data.EspPrefillActive_Status, ecu-extract-reference=TopLevelCompositionPrototype.Sdc_Prototype.RP_Sdc_Chassis_Data.EspPrefillActive_Status
      EspPrefillAvailable_2314: upstream-reference=TopLevelComposition.Sdc_Prototype.RP_Sdc_Chassis_Data.EspPrefillAvailable, ecu-extract-reference=TopLevelCompositionPrototype.Sdc_Prototype.RP_Sdc_Chassis_Data.EspPrefillAvailable
      EspPrefillAvailable_Status_2315: upstream-reference=TopLevelComposition.Sdc_Prototype.RP_Sdc_Chassis_Data.EspPrefillAvailable_Status, ecu-extract-reference=TopLevelCompositionPrototype.Sdc_Prototype.RP_Sdc_Chassis_Data.EspPrefillAvailable_Status
      EspTcsActvSts_2316: upstream-reference=TopLevelComposition.Sdc_Prototype.RP_Sdc_Chassis_Data.EspTcsActvSts, ecu-extract-reference=TopLevelCompositionPrototype.Sdc_Prototype.RP_Sdc_Chassis_Data.EspTcsActvSts
      EspTcsActvSts_Status_2317: upstream-reference=TopLevelComposition.Sdc_Prototype.RP_Sdc_Chassis_Data.EspTcsActvSts_Status, ecu-extract-reference=TopLevelCompositionPrototype.Sdc_Prototype.RP_Sdc_Chassis_Data.EspTcsActvSts_Status
      EspTcsFailr_2318: upstream-reference=TopLevelComposition.Sdc_Prototype.RP_Sdc_Chassis_Data.EspTcsFailr, ecu-extract-reference=TopLevelCompositionPrototype.Sdc_Prototype.RP_Sdc_Chassis_Data.EspTcsFailr
      EspTcsFailr_Status_2319: upstream-reference=TopLevelComposition.Sdc_Prototype.RP_Sdc_Chassis_Data.EspTcsFailr_Status, ecu-extract-reference=TopLevelCompositionPrototype.Sdc_Prototype.RP_Sdc_Chassis_Data.EspTcsFailr_Status
      EspVdcActvSts_2320: upstream-reference=TopLevelComposition.Sdc_Prototype.RP_Sdc_Chassis_Data.EspVdcActvSts, ecu-extract-reference=TopLevelCompositionPrototype.Sdc_Prototype.RP_Sdc_Chassis_Data.EspVdcActvSts
      EspVdcActvSts_Status_2321: upstream-reference=TopLevelComposition.Sdc_Prototype.RP_Sdc_Chassis_Data.EspVdcActvSts_Status, ecu-extract-reference=TopLevelCompositionPrototype.Sdc_Prototype.RP_Sdc_Chassis_Data.EspVdcActvSts_Status
      EspVehSpd_2322: upstream-reference=TopLevelComposition.Sdc_Prototype.RP_Sdc_Chassis_Data.EspVehSpd, ecu-extract-reference=TopLevelCompositionPrototype.Sdc_Prototype.RP_Sdc_Chassis_Data.EspVehSpd
      EspVehSpdVld_2323: upstream-reference=TopLevelComposition.Sdc_Prototype.RP_Sdc_Chassis_Data.EspVehSpdVld, ecu-extract-reference=TopLevelCompositionPrototype.Sdc_Prototype.RP_Sdc_Chassis_Data.EspVehSpdVld
      EspVehSpd_Status_2324: upstream-reference=TopLevelComposition.Sdc_Prototype.RP_Sdc_Chassis_Data.EspVehSpd_Status, ecu-extract-reference=TopLevelCompositionPrototype.Sdc_Prototype.RP_Sdc_Chassis_Data.EspVehSpd_Status
      EspYawRate_2325: upstream-reference=TopLevelComposition.Sdc_Prototype.RP_Sdc_Chassis_Data.EspYawRate, ecu-extract-reference=TopLevelCompositionPrototype.Sdc_Prototype.RP_Sdc_Chassis_Data.EspYawRate
      EspYawRate_Status_2326: upstream-reference=TopLevelComposition.Sdc_Prototype.RP_Sdc_Chassis_Data.EspYawRate_Status, ecu-extract-reference=TopLevelCompositionPrototype.Sdc_Prototype.RP_Sdc_Chassis_Data.EspYawRate_Status
      IBCU_PFSBrakePressureValid_2327: upstream-reference=TopLevelComposition.Sdc_Prototype.RP_Sdc_Chassis_Data.IBCU_PFSBrakePressureValid, ecu-extract-reference=TopLevelCompositionPrototype.Sdc_Prototype.RP_Sdc_Chassis_Data.IBCU_PFSBrakePressureValid
      IbBrkPedlStsGb_2328: upstream-reference=TopLevelComposition.Sdc_Prototype.RP_Sdc_Chassis_Data.IbBrkPedlStsGb, ecu-extract-reference=TopLevelCompositionPrototype.Sdc_Prototype.RP_Sdc_Chassis_Data.IbBrkPedlStsGb
      IbBrkPedlStsGbVld_2329: upstream-reference=TopLevelComposition.Sdc_Prototype.RP_Sdc_Chassis_Data.IbBrkPedlStsGbVld, ecu-extract-reference=TopLevelCompositionPrototype.Sdc_Prototype.RP_Sdc_Chassis_Data.IbBrkPedlStsGbVld
      IbBrkPedlStsGb_Status_2330: upstream-reference=TopLevelComposition.Sdc_Prototype.RP_Sdc_Chassis_Data.IbBrkPedlStsGb_Status, ecu-extract-reference=TopLevelCompositionPrototype.Sdc_Prototype.RP_Sdc_Chassis_Data.IbBrkPedlStsGb_Status
      IbBrkPedlTrvlDrvr_2331: upstream-reference=TopLevelComposition.Sdc_Prototype.RP_Sdc_Chassis_Data.IbBrkPedlTrvlDrvr, ecu-extract-reference=TopLevelCompositionPrototype.Sdc_Prototype.RP_Sdc_Chassis_Data.IbBrkPedlTrvlDrvr
      IbBrkPedlTrvlDrvrVld_2332: upstream-reference=TopLevelComposition.Sdc_Prototype.RP_Sdc_Chassis_Data.IbBrkPedlTrvlDrvrVld, ecu-extract-reference=TopLevelCompositionPrototype.Sdc_Prototype.RP_Sdc_Chassis_Data.IbBrkPedlTrvlDrvrVld
      PlungerBrakePressure_2333: upstream-reference=TopLevelComposition.Sdc_Prototype.RP_Sdc_Chassis_Data.PlungerBrakePressure, ecu-extract-reference=TopLevelCompositionPrototype.Sdc_Prototype.RP_Sdc_Chassis_Data.PlungerBrakePressure
      PlungerBrakePressure_Status_2334: upstream-reference=TopLevelComposition.Sdc_Prototype.RP_Sdc_Chassis_Data.PlungerBrakePressure_Status, ecu-extract-reference=TopLevelCompositionPrototype.Sdc_Prototype.RP_Sdc_Chassis_Data.PlungerBrakePressure_Status
      VcuAccrPedlPosn_2335: upstream-reference=TopLevelComposition.Sdc_Prototype.RP_Sdc_Chassis_Data.VcuAccrPedlPosn, ecu-extract-reference=TopLevelCompositionPrototype.Sdc_Prototype.RP_Sdc_Chassis_Data.VcuAccrPedlPosn
      VcuAccrPedlPosnVld_2336: upstream-reference=TopLevelComposition.Sdc_Prototype.RP_Sdc_Chassis_Data.VcuAccrPedlPosnVld, ecu-extract-reference=TopLevelCompositionPrototype.Sdc_Prototype.RP_Sdc_Chassis_Data.VcuAccrPedlPosnVld
      VcuAccrPedlPosn_Status_2337: upstream-reference=TopLevelComposition.Sdc_Prototype.RP_Sdc_Chassis_Data.VcuAccrPedlPosn_Status, ecu-extract-reference=TopLevelCompositionPrototype.Sdc_Prototype.RP_Sdc_Chassis_Data.VcuAccrPedlPosn_Status
      VcuGearPosn_2338: upstream-reference=TopLevelComposition.Sdc_Prototype.RP_Sdc_Chassis_Data.VcuGearPosn, ecu-extract-reference=TopLevelCompositionPrototype.Sdc_Prototype.RP_Sdc_Chassis_Data.VcuGearPosn
      VcuGearPosn_Status_2339: upstream-reference=TopLevelComposition.Sdc_Prototype.RP_Sdc_Chassis_Data.VcuGearPosn_Status, ecu-extract-reference=TopLevelCompositionPrototype.Sdc_Prototype.RP_Sdc_Chassis_Data.VcuGearPosn_Status
      VcuVehGearPosnVld_2340: upstream-reference=TopLevelComposition.Sdc_Prototype.RP_Sdc_Chassis_Data.VcuVehGearPosnVld, ecu-extract-reference=TopLevelCompositionPrototype.Sdc_Prototype.RP_Sdc_Chassis_Data.VcuVehGearPosnVld
      RP_Sdc_Powertrain_Data_2341: upstream-reference=TopLevelComposition.Sdc_Prototype.RP_Sdc_Powertrain_Data, ecu-extract-reference=TopLevelCompositionPrototype.Sdc_Prototype.RP_Sdc_Powertrain_Data
      WhlSpdFrntLePls_2342: upstream-reference=TopLevelComposition.Sdc_Prototype.RP_Sdc_Powertrain_Data.WhlSpdFrntLePls, ecu-extract-reference=TopLevelCompositionPrototype.Sdc_Prototype.RP_Sdc_Powertrain_Data.WhlSpdFrntLePls
      WhlSpdFrntLePls_Status_2343: upstream-reference=TopLevelComposition.Sdc_Prototype.RP_Sdc_Powertrain_Data.WhlSpdFrntLePls_Status, ecu-extract-reference=TopLevelCompositionPrototype.Sdc_Prototype.RP_Sdc_Powertrain_Data.WhlSpdFrntLePls_Status
      WhlSpdFrntRiPls_2344: upstream-reference=TopLevelComposition.Sdc_Prototype.RP_Sdc_Powertrain_Data.WhlSpdFrntRiPls, ecu-extract-reference=TopLevelCompositionPrototype.Sdc_Prototype.RP_Sdc_Powertrain_Data.WhlSpdFrntRiPls
      WhlSpdFrntRiPls_Status_2345: upstream-reference=TopLevelComposition.Sdc_Prototype.RP_Sdc_Powertrain_Data.WhlSpdFrntRiPls_Status, ecu-extract-reference=TopLevelCompositionPrototype.Sdc_Prototype.RP_Sdc_Powertrain_Data.WhlSpdFrntRiPls_Status
      WhlSpdLeFrntData_2346: upstream-reference=TopLevelComposition.Sdc_Prototype.RP_Sdc_Powertrain_Data.WhlSpdLeFrntData, ecu-extract-reference=TopLevelCompositionPrototype.Sdc_Prototype.RP_Sdc_Powertrain_Data.WhlSpdLeFrntData
      WhlSpdLeFrntDataVld_2347: upstream-reference=TopLevelComposition.Sdc_Prototype.RP_Sdc_Powertrain_Data.WhlSpdLeFrntDataVld, ecu-extract-reference=TopLevelCompositionPrototype.Sdc_Prototype.RP_Sdc_Powertrain_Data.WhlSpdLeFrntDataVld
      WhlSpdLeFrntData_Status_2348: upstream-reference=TopLevelComposition.Sdc_Prototype.RP_Sdc_Powertrain_Data.WhlSpdLeFrntData_Status, ecu-extract-reference=TopLevelCompositionPrototype.Sdc_Prototype.RP_Sdc_Powertrain_Data.WhlSpdLeFrntData_Status
      WhlSpdLeFrntDir_2349: upstream-reference=TopLevelComposition.Sdc_Prototype.RP_Sdc_Powertrain_Data.WhlSpdLeFrntDir, ecu-extract-reference=TopLevelCompositionPrototype.Sdc_Prototype.RP_Sdc_Powertrain_Data.WhlSpdLeFrntDir
      WhlSpdLeFrntDir_Status_2350: upstream-reference=TopLevelComposition.Sdc_Prototype.RP_Sdc_Powertrain_Data.WhlSpdLeFrntDir_Status, ecu-extract-reference=TopLevelCompositionPrototype.Sdc_Prototype.RP_Sdc_Powertrain_Data.WhlSpdLeFrntDir_Status
      WhlSpdLeReData_2351: upstream-reference=TopLevelComposition.Sdc_Prototype.RP_Sdc_Powertrain_Data.WhlSpdLeReData, ecu-extract-reference=TopLevelCompositionPrototype.Sdc_Prototype.RP_Sdc_Powertrain_Data.WhlSpdLeReData
      WhlSpdLeReDataVld_2352: upstream-reference=TopLevelComposition.Sdc_Prototype.RP_Sdc_Powertrain_Data.WhlSpdLeReDataVld, ecu-extract-reference=TopLevelCompositionPrototype.Sdc_Prototype.RP_Sdc_Powertrain_Data.WhlSpdLeReDataVld
      WhlSpdLeReData_Status_2353: upstream-reference=TopLevelComposition.Sdc_Prototype.RP_Sdc_Powertrain_Data.WhlSpdLeReData_Status, ecu-extract-reference=TopLevelCompositionPrototype.Sdc_Prototype.RP_Sdc_Powertrain_Data.WhlSpdLeReData_Status
      WhlSpdLeReDir_2354: upstream-reference=TopLevelComposition.Sdc_Prototype.RP_Sdc_Powertrain_Data.WhlSpdLeReDir, ecu-extract-reference=TopLevelCompositionPrototype.Sdc_Prototype.RP_Sdc_Powertrain_Data.WhlSpdLeReDir
      WhlSpdLeReDir_Status_2355: upstream-reference=TopLevelComposition.Sdc_Prototype.RP_Sdc_Powertrain_Data.WhlSpdLeReDir_Status, ecu-extract-reference=TopLevelCompositionPrototype.Sdc_Prototype.RP_Sdc_Powertrain_Data.WhlSpdLeReDir_Status
      WhlSpdReLePls_2356: upstream-reference=TopLevelComposition.Sdc_Prototype.RP_Sdc_Powertrain_Data.WhlSpdReLePls, ecu-extract-reference=TopLevelCompositionPrototype.Sdc_Prototype.RP_Sdc_Powertrain_Data.WhlSpdReLePls
      WhlSpdReLePls_Status_2357: upstream-reference=TopLevelComposition.Sdc_Prototype.RP_Sdc_Powertrain_Data.WhlSpdReLePls_Status, ecu-extract-reference=TopLevelCompositionPrototype.Sdc_Prototype.RP_Sdc_Powertrain_Data.WhlSpdReLePls_Status
      WhlSpdReRiPls_2358: upstream-reference=TopLevelComposition.Sdc_Prototype.RP_Sdc_Powertrain_Data.WhlSpdReRiPls, ecu-extract-reference=TopLevelCompositionPrototype.Sdc_Prototype.RP_Sdc_Powertrain_Data.WhlSpdReRiPls
      WhlSpdReRiPls_Status_2359: upstream-reference=TopLevelComposition.Sdc_Prototype.RP_Sdc_Powertrain_Data.WhlSpdReRiPls_Status, ecu-extract-reference=TopLevelCompositionPrototype.Sdc_Prototype.RP_Sdc_Powertrain_Data.WhlSpdReRiPls_Status
      WhlSpdRiFrntData_2360: upstream-reference=TopLevelComposition.Sdc_Prototype.RP_Sdc_Powertrain_Data.WhlSpdRiFrntData, ecu-extract-reference=TopLevelCompositionPrototype.Sdc_Prototype.RP_Sdc_Powertrain_Data.WhlSpdRiFrntData
      WhlSpdRiFrntDataVld_2361: upstream-reference=TopLevelComposition.Sdc_Prototype.RP_Sdc_Powertrain_Data.WhlSpdRiFrntDataVld, ecu-extract-reference=TopLevelCompositionPrototype.Sdc_Prototype.RP_Sdc_Powertrain_Data.WhlSpdRiFrntDataVld
      WhlSpdRiFrntData_Status_2362: upstream-reference=TopLevelComposition.Sdc_Prototype.RP_Sdc_Powertrain_Data.WhlSpdRiFrntData_Status, ecu-extract-reference=TopLevelCompositionPrototype.Sdc_Prototype.RP_Sdc_Powertrain_Data.WhlSpdRiFrntData_Status
      WhlSpdRiFrntDir_2363: upstream-reference=TopLevelComposition.Sdc_Prototype.RP_Sdc_Powertrain_Data.WhlSpdRiFrntDir, ecu-extract-reference=TopLevelCompositionPrototype.Sdc_Prototype.RP_Sdc_Powertrain_Data.WhlSpdRiFrntDir
      WhlSpdRiFrntDir_Status_2364: upstream-reference=TopLevelComposition.Sdc_Prototype.RP_Sdc_Powertrain_Data.WhlSpdRiFrntDir_Status, ecu-extract-reference=TopLevelCompositionPrototype.Sdc_Prototype.RP_Sdc_Powertrain_Data.WhlSpdRiFrntDir_Status
      WhlSpdRiReData_2365: upstream-reference=TopLevelComposition.Sdc_Prototype.RP_Sdc_Powertrain_Data.WhlSpdRiReData, ecu-extract-reference=TopLevelCompositionPrototype.Sdc_Prototype.RP_Sdc_Powertrain_Data.WhlSpdRiReData
      WhlSpdRiReDataVld_2366: upstream-reference=TopLevelComposition.Sdc_Prototype.RP_Sdc_Powertrain_Data.WhlSpdRiReDataVld, ecu-extract-reference=TopLevelCompositionPrototype.Sdc_Prototype.RP_Sdc_Powertrain_Data.WhlSpdRiReDataVld
      WhlSpdRiReData_Status_2367: upstream-reference=TopLevelComposition.Sdc_Prototype.RP_Sdc_Powertrain_Data.WhlSpdRiReData_Status, ecu-extract-reference=TopLevelCompositionPrototype.Sdc_Prototype.RP_Sdc_Powertrain_Data.WhlSpdRiReData_Status
      WhlSpdRiReDir_2368: upstream-reference=TopLevelComposition.Sdc_Prototype.RP_Sdc_Powertrain_Data.WhlSpdRiReDir, ecu-extract-reference=TopLevelCompositionPrototype.Sdc_Prototype.RP_Sdc_Powertrain_Data.WhlSpdRiReDir
      WhlSpdRiReDir_Status_2369: upstream-reference=TopLevelComposition.Sdc_Prototype.RP_Sdc_Powertrain_Data.WhlSpdRiReDir_Status, ecu-extract-reference=TopLevelCompositionPrototype.Sdc_Prototype.RP_Sdc_Powertrain_Data.WhlSpdRiReDir_Status
      RP_VdyAdapter_VehDyn_2370: upstream-reference=TopLevelComposition.Sdc_Prototype.RP_VdyAdapter_VehDyn, ecu-extract-reference=TopLevelCompositionPrototype.Sdc_Prototype.RP_VdyAdapter_VehDyn
      VehDyn_2371: upstream-reference=TopLevelComposition.Sdc_Prototype.RP_VdyAdapter_VehDyn.VehDyn, ecu-extract-reference=TopLevelCompositionPrototype.Sdc_Prototype.RP_VdyAdapter_VehDyn.VehDyn
      Sed_Prototype_2372: upstream-reference=TopLevelComposition.Sed_Prototype, ecu-extract-reference=TopLevelCompositionPrototype.Sed_Prototype
      RP_Sdc_SendInterface_Diag_2373: upstream-reference=TopLevelComposition.Sed_Prototype.RP_Sdc_SendInterface_Diag, ecu-extract-reference=TopLevelCompositionPrototype.Sed_Prototype.RP_Sdc_SendInterface_Diag
      RP_Sdc_SendInterface_Eth_2374: upstream-reference=TopLevelComposition.Sed_Prototype.RP_Sdc_SendInterface_Eth, ecu-extract-reference=TopLevelCompositionPrototype.Sed_Prototype.RP_Sdc_SendInterface_Eth
      SpiSync_Prototype_2375: upstream-reference=TopLevelComposition.SpiSync_Prototype, ecu-extract-reference=TopLevelCompositionPrototype.SpiSync_Prototype
      RP_Sdc_TimeSync_2376: upstream-reference=TopLevelComposition.SpiSync_Prototype.RP_Sdc_TimeSync, ecu-extract-reference=TopLevelCompositionPrototype.SpiSync_Prototype.RP_Sdc_TimeSync
      StbM_Prototype_2377: upstream-reference=TopLevelComposition.StbM_Prototype, ecu-extract-reference=TopLevelCompositionPrototype.StbM_Prototype
      GlobalTime_Slave_StbMSynchronizedTimeBase_0_2378: upstream-reference=TopLevelComposition.StbM_Prototype.GlobalTime_Slave_StbMSynchronizedTimeBase_0, ecu-extract-reference=TopLevelCompositionPrototype.StbM_Prototype.GlobalTime_Slave_StbMSynchronizedTimeBase_0
      Time_Prototype_2379: upstream-reference=TopLevelComposition.Time_Prototype, ecu-extract-reference=TopLevelCompositionPrototype.Time_Prototype
      CS_Time_GetTimeStampInfo_2380: upstream-reference=TopLevelComposition.Time_Prototype.CS_Time_GetTimeStampInfo, ecu-extract-reference=TopLevelCompositionPrototype.Time_Prototype.CS_Time_GetTimeStampInfo
      GlobalTime_Slave_StbMSynchronizedTimeBase_0_2381: upstream-reference=TopLevelComposition.Time_Prototype.GlobalTime_Slave_StbMSynchronizedTimeBase_0, ecu-extract-reference=TopLevelCompositionPrototype.Time_Prototype.GlobalTime_Slave_StbMSynchronizedTimeBase_0
      TsaAdapter_Prototype_2382: upstream-reference=TopLevelComposition.TsaAdapter_Prototype, ecu-extract-reference=TopLevelCompositionPrototype.TsaAdapter_Prototype
      VdyAdapter_Prototype_2383: upstream-reference=TopLevelComposition.VdyAdapter_Prototype, ecu-extract-reference=TopLevelCompositionPrototype.VdyAdapter_Prototype
      PP_VdyAdapter_AlgoCompState_2384: upstream-reference=TopLevelComposition.VdyAdapter_Prototype.PP_VdyAdapter_AlgoCompState, ecu-extract-reference=TopLevelCompositionPrototype.VdyAdapter_Prototype.PP_VdyAdapter_AlgoCompState
      AlgoCompState_2385: upstream-reference=TopLevelComposition.VdyAdapter_Prototype.PP_VdyAdapter_AlgoCompState.AlgoCompState, ecu-extract-reference=TopLevelCompositionPrototype.VdyAdapter_Prototype.PP_VdyAdapter_AlgoCompState.AlgoCompState
      PP_VdyAdapter_VdyErrors_2386: upstream-reference=TopLevelComposition.VdyAdapter_Prototype.PP_VdyAdapter_VdyErrors, ecu-extract-reference=TopLevelCompositionPrototype.VdyAdapter_Prototype.PP_VdyAdapter_VdyErrors
      VdyErrors_2387: upstream-reference=TopLevelComposition.VdyAdapter_Prototype.PP_VdyAdapter_VdyErrors.VdyErrors, ecu-extract-reference=TopLevelCompositionPrototype.VdyAdapter_Prototype.PP_VdyAdapter_VdyErrors.VdyErrors
      PP_VdyAdapter_VdyEstCurves_2388: upstream-reference=TopLevelComposition.VdyAdapter_Prototype.PP_VdyAdapter_VdyEstCurves, ecu-extract-reference=TopLevelCompositionPrototype.VdyAdapter_Prototype.PP_VdyAdapter_VdyEstCurves
      VdyEstCurves_2389: upstream-reference=TopLevelComposition.VdyAdapter_Prototype.PP_VdyAdapter_VdyEstCurves.VdyEstCurves, ecu-extract-reference=TopLevelCompositionPrototype.VdyAdapter_Prototype.PP_VdyAdapter_VdyEstCurves.VdyEstCurves
      PP_VdyAdapter_VdyOffsets_2390: upstream-reference=TopLevelComposition.VdyAdapter_Prototype.PP_VdyAdapter_VdyOffsets, ecu-extract-reference=TopLevelCompositionPrototype.VdyAdapter_Prototype.PP_VdyAdapter_VdyOffsets
      VdyOffsets_2391: upstream-reference=TopLevelComposition.VdyAdapter_Prototype.PP_VdyAdapter_VdyOffsets.VdyOffsets, ecu-extract-reference=TopLevelCompositionPrototype.VdyAdapter_Prototype.PP_VdyAdapter_VdyOffsets.VdyOffsets
      PP_VdyAdapter_VdyOutputNvMData_2392: upstream-reference=TopLevelComposition.VdyAdapter_Prototype.PP_VdyAdapter_VdyOutputNvMData, ecu-extract-reference=TopLevelCompositionPrototype.VdyAdapter_Prototype.PP_VdyAdapter_VdyOutputNvMData
      VdyNvMInOutData_2393: upstream-reference=TopLevelComposition.VdyAdapter_Prototype.PP_VdyAdapter_VdyOutputNvMData.VdyNvMInOutData, ecu-extract-reference=TopLevelCompositionPrototype.VdyAdapter_Prototype.PP_VdyAdapter_VdyOutputNvMData.VdyNvMInOutData
      PP_VdyAdapter_VehDyn_2394: upstream-reference=TopLevelComposition.VdyAdapter_Prototype.PP_VdyAdapter_VehDyn, ecu-extract-reference=TopLevelCompositionPrototype.VdyAdapter_Prototype.PP_VdyAdapter_VehDyn
      VehDyn_2395: upstream-reference=TopLevelComposition.VdyAdapter_Prototype.PP_VdyAdapter_VehDyn.VehDyn, ecu-extract-reference=TopLevelCompositionPrototype.VdyAdapter_Prototype.PP_VdyAdapter_VehDyn.VehDyn
      RP_Cdm_VdyInputNvMData_2396: upstream-reference=TopLevelComposition.VdyAdapter_Prototype.RP_Cdm_VdyInputNvMData, ecu-extract-reference=TopLevelCompositionPrototype.VdyAdapter_Prototype.RP_Cdm_VdyInputNvMData
      VdyNvMInOutData_2397: upstream-reference=TopLevelComposition.VdyAdapter_Prototype.RP_Cdm_VdyInputNvMData.VdyNvMInOutData, ecu-extract-reference=TopLevelCompositionPrototype.VdyAdapter_Prototype.RP_Cdm_VdyInputNvMData.VdyNvMInOutData
      RP_Fcu_BaseCtrlData_2398: upstream-reference=TopLevelComposition.VdyAdapter_Prototype.RP_Fcu_BaseCtrlData, ecu-extract-reference=TopLevelCompositionPrototype.VdyAdapter_Prototype.RP_Fcu_BaseCtrlData
      BaseCtrlData_2399: upstream-reference=TopLevelComposition.VdyAdapter_Prototype.RP_Fcu_BaseCtrlData.BaseCtrlData, ecu-extract-reference=TopLevelCompositionPrototype.VdyAdapter_Prototype.RP_Fcu_BaseCtrlData.BaseCtrlData
      RP_Fcu_VehPar_2400: upstream-reference=TopLevelComposition.VdyAdapter_Prototype.RP_Fcu_VehPar, ecu-extract-reference=TopLevelCompositionPrototype.VdyAdapter_Prototype.RP_Fcu_VehPar
      VehPar_2401: upstream-reference=TopLevelComposition.VdyAdapter_Prototype.RP_Fcu_VehPar.VehPar, ecu-extract-reference=TopLevelCompositionPrototype.VdyAdapter_Prototype.RP_Fcu_VehPar.VehPar
      RP_Fcu_VehSig_2402: upstream-reference=TopLevelComposition.VdyAdapter_Prototype.RP_Fcu_VehSig, ecu-extract-reference=TopLevelCompositionPrototype.VdyAdapter_Prototype.RP_Fcu_VehSig
      VehSig_2403: upstream-reference=TopLevelComposition.VdyAdapter_Prototype.RP_Fcu_VehSig.VehSig, ecu-extract-reference=TopLevelCompositionPrototype.VdyAdapter_Prototype.RP_Fcu_VehSig.VehSig
      RP_MtsiAdapter_MeasFreezeData_2404: upstream-reference=TopLevelComposition.VdyAdapter_Prototype.RP_MtsiAdapter_MeasFreezeData, ecu-extract-reference=TopLevelCompositionPrototype.VdyAdapter_Prototype.RP_MtsiAdapter_MeasFreezeData
      RP_MtsiAdapter_UpdateTaskCycle_2405: upstream-reference=TopLevelComposition.VdyAdapter_Prototype.RP_MtsiAdapter_UpdateTaskCycle, ecu-extract-reference=TopLevelCompositionPrototype.VdyAdapter_Prototype.RP_MtsiAdapter_UpdateTaskCycle
      RP_NvM_VdyBlockOperation_2406: upstream-reference=TopLevelComposition.VdyAdapter_Prototype.RP_NvM_VdyBlockOperation, ecu-extract-reference=TopLevelCompositionPrototype.VdyAdapter_Prototype.RP_NvM_VdyBlockOperation
      VoltMonI_2407: upstream-reference=TopLevelComposition.VoltMonI, ecu-extract-reference=TopLevelCompositionPrototype.VoltMonI
      PP_VoltMonI_SRI_DisableCommunication_2408: upstream-reference=TopLevelComposition.VoltMonI.PP_VoltMonI_SRI_DisableCommunication, ecu-extract-reference=TopLevelCompositionPrototype.VoltMonI.PP_VoltMonI_SRI_DisableCommunication
      DE_VoltMonI_DisableCommunication_2409: upstream-reference=TopLevelComposition.VoltMonI.PP_VoltMonI_SRI_DisableCommunication.DE_VoltMonI_DisableCommunication, ecu-extract-reference=TopLevelCompositionPrototype.VoltMonI.PP_VoltMonI_SRI_DisableCommunication.DE_VoltMonI_DisableCommunication
      PP_VoltMonI_SRI_VoltState_2410: upstream-reference=TopLevelComposition.VoltMonI.PP_VoltMonI_SRI_VoltState, ecu-extract-reference=TopLevelCompositionPrototype.VoltMonI.PP_VoltMonI_SRI_VoltState
      DE_VoltMonI_VoltState_2411: upstream-reference=TopLevelComposition.VoltMonI.PP_VoltMonI_SRI_VoltState.DE_VoltMonI_VoltState, ecu-extract-reference=TopLevelCompositionPrototype.VoltMonI.PP_VoltMonI_SRI_VoltState.DE_VoltMonI_VoltState
      RP_Comco_CSI_NMWakupFlag_2412: upstream-reference=TopLevelComposition.VoltMonI.RP_Comco_CSI_NMWakupFlag, ecu-extract-reference=TopLevelCompositionPrototype.VoltMonI.RP_Comco_CSI_NMWakupFlag
      RP_EvAdc_GetValue_VMON_BATT_2413: upstream-reference=TopLevelComposition.VoltMonI.RP_EvAdc_GetValue_VMON_BATT, ecu-extract-reference=TopLevelCompositionPrototype.VoltMonI.RP_EvAdc_GetValue_VMON_BATT
      RP_EvAdc_GetValue_VMON_IGN_2414: upstream-reference=TopLevelComposition.VoltMonI.RP_EvAdc_GetValue_VMON_IGN, ecu-extract-reference=TopLevelCompositionPrototype.VoltMonI.RP_EvAdc_GetValue_VMON_IGN
      WdgM_CORE_0_Prototype_2415: upstream-reference=TopLevelComposition.WdgM_CORE_0_Prototype, ecu-extract-reference=TopLevelCompositionPrototype.WdgM_CORE_0_Prototype
      globalMode_2416: upstream-reference=TopLevelComposition.WdgM_CORE_0_Prototype.globalMode, ecu-extract-reference=TopLevelCompositionPrototype.WdgM_CORE_0_Prototype.globalMode
      alive_WdgM_SE_AS_HM_2417: upstream-reference=TopLevelComposition.WdgM_CORE_0_Prototype.alive_WdgM_SE_AS_HM, ecu-extract-reference=TopLevelCompositionPrototype.WdgM_CORE_0_Prototype.alive_WdgM_SE_AS_HM
      mode_WdgM_SE_AS_HM_2418: upstream-reference=TopLevelComposition.WdgM_CORE_0_Prototype.mode_WdgM_SE_AS_HM, ecu-extract-reference=TopLevelCompositionPrototype.WdgM_CORE_0_Prototype.mode_WdgM_SE_AS_HM
      alive_WdgM_SE_CameraTemp_2419: upstream-reference=TopLevelComposition.WdgM_CORE_0_Prototype.alive_WdgM_SE_CameraTemp, ecu-extract-reference=TopLevelCompositionPrototype.WdgM_CORE_0_Prototype.alive_WdgM_SE_CameraTemp
      mode_WdgM_SE_CameraTemp_2420: upstream-reference=TopLevelComposition.WdgM_CORE_0_Prototype.mode_WdgM_SE_CameraTemp, ecu-extract-reference=TopLevelCompositionPrototype.WdgM_CORE_0_Prototype.mode_WdgM_SE_CameraTemp
      alive_WdgM_SE_ConfigReg_2421: upstream-reference=TopLevelComposition.WdgM_CORE_0_Prototype.alive_WdgM_SE_ConfigReg, ecu-extract-reference=TopLevelCompositionPrototype.WdgM_CORE_0_Prototype.alive_WdgM_SE_ConfigReg
      mode_WdgM_SE_ConfigReg_2422: upstream-reference=TopLevelComposition.WdgM_CORE_0_Prototype.mode_WdgM_SE_ConfigReg, ecu-extract-reference=TopLevelCompositionPrototype.WdgM_CORE_0_Prototype.mode_WdgM_SE_ConfigReg
      alive_WdgM_SE_FS_MAIN_2423: upstream-reference=TopLevelComposition.WdgM_CORE_0_Prototype.alive_WdgM_SE_FS_MAIN, ecu-extract-reference=TopLevelCompositionPrototype.WdgM_CORE_0_Prototype.alive_WdgM_SE_FS_MAIN
      mode_WdgM_SE_FS_MAIN_2424: upstream-reference=TopLevelComposition.WdgM_CORE_0_Prototype.mode_WdgM_SE_FS_MAIN, ecu-extract-reference=TopLevelCompositionPrototype.WdgM_CORE_0_Prototype.mode_WdgM_SE_FS_MAIN
      alive_WdgM_SE_FS_ADC_2425: upstream-reference=TopLevelComposition.WdgM_CORE_0_Prototype.alive_WdgM_SE_FS_ADC, ecu-extract-reference=TopLevelCompositionPrototype.WdgM_CORE_0_Prototype.alive_WdgM_SE_FS_ADC
      mode_WdgM_SE_FS_ADC_2426: upstream-reference=TopLevelComposition.WdgM_CORE_0_Prototype.mode_WdgM_SE_FS_ADC, ecu-extract-reference=TopLevelCompositionPrototype.WdgM_CORE_0_Prototype.mode_WdgM_SE_FS_ADC
      WdgM_CORE_1_Prototype_2427: upstream-reference=TopLevelComposition.WdgM_CORE_1_Prototype, ecu-extract-reference=TopLevelCompositionPrototype.WdgM_CORE_1_Prototype
      alive_WdgM_SE_SWC_MONITOR_2428: upstream-reference=TopLevelComposition.WdgM_CORE_1_Prototype.alive_WdgM_SE_SWC_MONITOR, ecu-extract-reference=TopLevelCompositionPrototype.WdgM_CORE_1_Prototype.alive_WdgM_SE_SWC_MONITOR
      mode_WdgM_SE_SWC_MONITOR_2429: upstream-reference=TopLevelComposition.WdgM_CORE_1_Prototype.mode_WdgM_SE_SWC_MONITOR, ecu-extract-reference=TopLevelCompositionPrototype.WdgM_CORE_1_Prototype.mode_WdgM_SE_SWC_MONITOR
