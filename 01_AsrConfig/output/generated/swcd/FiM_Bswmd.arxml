AUTOSAR XML (schema 4-0-3)
package /AUTOSAR_FiM/BswModuleDescriptions
  bsw module description FiM: module-id=11, provided-entrys=[FiM_DemInit, FiM_GetFunctionPermission, FiM_Init, FiM_MainFunction]
    bsw internal behavior InternalBehavior_0
      exclusive area SCHM_FIM_EXCLUSIVE_AREA_0
      bsw schedulable entity FiM_MainFunction: implemented-entry=FiM_MainFunction
      bsw called entity FiM_Init: can-enter-exclusive-area=SCHM_FIM_EXCLUSIVE_AREA_0, implemented-entry=FiM_Init
      bsw timing event TimingEvent_MainFunction: starts-on-event=FiM_MainFunction, period=0.01
package /AUTOSAR_FiM/BswModuleEntrys
  4 x bsw module entry, all with is-synchronous=true, execution-context=TASK, sw-service-impl-policy=STANDARD:
    FiM_DemInit: service-id=3, is-reentrant=false, call-type=REGULAR
    FiM_GetFunctionPermission: service-id=1, is-reentrant=true, call-type=REGULAR
      return type RetVal: direction=OUT, implementation-data-type=Std_ReturnType
      sw service arg FID: direction=IN, implementation-data-type=FiM_FunctionIdType
      sw service arg Permission: direction=OUT, implementation-data-type=VoidPtr
    FiM_Init: service-id=0, is-reentrant=false, call-type=REGULAR
      sw service arg FiMConfigPtr: direction=IN, implementation-data-type=VoidPtr
    FiM_MainFunction: service-id=5, is-reentrant=false, call-type=SCHEDULED
package /AUTOSAR_FiM/ImplementationDataTypes
  impl type FiM_FunctionIdType: implementation-data-type=FunctionIdType, type-emitter=BSW
package /EB_FiM/Implementations
  bsw implementation BswImplementation_0: programming-language=C, sw-version=2.5.4, vendor-id=1, ar-release-version=4.0.3, behavior=InternalBehavior_0, vendor-specific-module-def=FiM
    code-descriptors:
      code Files
        artifact-descriptors:
          short-label=Autosar::include::FiM.h, category=SWHDR
          short-label=Autosar::include::FiM_Int.h, category=SWHDR
          short-label=Autosar::include::FiM_Types.h, category=SWHDR
          short-label=Autosar::include::FiM_Version.h, category=SWHDR
          short-label=Autosar::src::FiM.c, category=SWSRC
          short-label=make::FiM_defs.mak, category=SWMAKE
          short-label=make::FiM_rules.mak, category=SWMAKE
    resource consumption ResourceConsumption
      7 x memory section:
        CONST_UNSPECIFIED: alignment=UNSPECIFIED, sw-addrmethod=CONST
        CALIB_16: alignment=16, sw-addrmethod=CALIB
        CALIB_8: alignment=8, sw-addrmethod=CALIB
        CODE: sw-addrmethod=CODE
        VAR_INIT_8: alignment=8, sw-addrmethod=VAR
        VAR_CLEARED_UNSPECIFIED: alignment=UNSPECIFIED, sw-addrmethod=VAR_CLEARED
        VAR_CLEARED_8: alignment=8, sw-addrmethod=VAR_CLEARED
