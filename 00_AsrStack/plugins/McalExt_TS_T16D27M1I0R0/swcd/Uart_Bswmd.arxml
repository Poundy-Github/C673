<?xml version="1.0" encoding="ISO-8859-1"?>
[!AUTOSPACING!][!//
<AUTOSAR xmlns="http://autosar.org/schema/r4.0"
  xmlns:xsi="http://www.w3.org/2001/XMLSchema-instance"
  xsi:schemaLocation="http://autosar.org/schema/r4.0 AUTOSAR_4-0-3_STRICT_COMPACT.xsd">
  <AR-PACKAGES>
    <AR-PACKAGE>
      <SHORT-NAME>AUTOSAR_Uart</SHORT-NAME>
      <AR-PACKAGES>
            <AR-PACKAGE>
              <SHORT-NAME>BswModuleDescriptions</SHORT-NAME>
              <ELEMENTS>
                <BSW-MODULE-DESCRIPTION>
                  <SHORT-NAME>Uart</SHORT-NAME>
                  <MODULE-ID>255</MODULE-ID>
                  <PROVIDED-ENTRYS>
                    <BSW-MODULE-ENTRY-REF-CONDITIONAL>
                      <BSW-MODULE-ENTRY-REF DEST="BSW-MODULE-ENTRY">/AUTOSAR_Uart/BswModuleEntrys/Uart_Init</BSW-MODULE-ENTRY-REF>
                    </BSW-MODULE-ENTRY-REF-CONDITIONAL>
[!IF "as:modconf('Uart')[1]/UartConfigSet/UartChannel/*/UartRxChannelMode = 'POLLING'"!]
                    <BSW-MODULE-ENTRY-REF-CONDITIONAL>
                      <BSW-MODULE-ENTRY-REF DEST="BSW-MODULE-ENTRY">/AUTOSAR_Uart/BswModuleEntrys/Uart_MainFunction_Read</BSW-MODULE-ENTRY-REF>
                    </BSW-MODULE-ENTRY-REF-CONDITIONAL>
[!ENDIF!][!//
[!IF "as:modconf('Uart')[1]/UartConfigSet/UartChannel/*/UartTxChannelMode = 'POLLING'"!]
                    <BSW-MODULE-ENTRY-REF-CONDITIONAL>
                      <BSW-MODULE-ENTRY-REF DEST="BSW-MODULE-ENTRY">/AUTOSAR_Uart/BswModuleEntrys/Uart_MainFunction_Write</BSW-MODULE-ENTRY-REF>
                    </BSW-MODULE-ENTRY-REF-CONDITIONAL>
[!ENDIF!][!//
                  </PROVIDED-ENTRYS>
                  <INTERNAL-BEHAVIORS>
                    <BSW-INTERNAL-BEHAVIOR>
                      <SHORT-NAME>InternalBehavior_0</SHORT-NAME>
                      <EXCLUSIVE-AREAS>
                      </EXCLUSIVE-AREAS>
                      <ENTITYS>
<!-- No MainFunctions -->
                        <BSW-CALLED-ENTITY>
                          <SHORT-NAME>Uart_Init</SHORT-NAME>
                          <CAN-ENTER-EXCLUSIVE-AREA-REFS>
                          </CAN-ENTER-EXCLUSIVE-AREA-REFS>
                          <MINIMUM-START-INTERVAL>0.0</MINIMUM-START-INTERVAL>
                          <IMPLEMENTED-ENTRY-REF DEST="BSW-MODULE-ENTRY">/AUTOSAR_Uart/BswModuleEntrys/Uart_Init</IMPLEMENTED-ENTRY-REF>
                        </BSW-CALLED-ENTITY>
[!IF "as:modconf('Uart')[1]/UartConfigSet/UartChannel/*/UartRxChannelMode = 'POLLING'"!][!//
                        <BSW-SCHEDULABLE-ENTITY>
                          <SHORT-NAME>Uart_MainFunction_Read</SHORT-NAME>
                          <MINIMUM-START-INTERVAL>0.0</MINIMUM-START-INTERVAL>
                          <IMPLEMENTED-ENTRY-REF DEST="BSW-MODULE-ENTRY">/AUTOSAR_Uart/BswModuleEntrys/Uart_MainFunction_Read</IMPLEMENTED-ENTRY-REF>
                        </BSW-SCHEDULABLE-ENTITY>
[!ENDIF!][!//
[!IF "as:modconf('Uart')[1]/UartConfigSet/UartChannel/*/UartTxChannelMode = 'POLLING'"!][!//
                        <BSW-SCHEDULABLE-ENTITY>
                          <SHORT-NAME>Uart_MainFunction_Write</SHORT-NAME>
                          <MINIMUM-START-INTERVAL>0.0</MINIMUM-START-INTERVAL>
                          <IMPLEMENTED-ENTRY-REF DEST="BSW-MODULE-ENTRY">/AUTOSAR_Uart/BswModuleEntrys/Uart_MainFunction_Write</IMPLEMENTED-ENTRY-REF>
                        </BSW-SCHEDULABLE-ENTITY>
[!ENDIF!][!//
                      </ENTITYS>
                      <EVENTS>
[!IF "as:modconf('Uart')[1]/UartConfigSet/UartChannel/*/UartRxChannelMode = 'POLLING'"!][!//
                        <BSW-TIMING-EVENT>
                          <SHORT-NAME>TimingEvent_MainFunction_Read</SHORT-NAME>
                          <STARTS-ON-EVENT-REF DEST="BSW-SCHEDULABLE-ENTITY">/AUTOSAR_Uart/BswModuleDescriptions/Uart/InternalBehavior_0/Uart_MainFunction_Read</STARTS-ON-EVENT-REF>                      
                          <PERIOD>[!"as:modconf('Uart')[1]/UartGeneral/UartMainFunctionReadPeriod"!]</PERIOD>
                        </BSW-TIMING-EVENT>
[!ENDIF!][!//
[!IF "as:modconf('Uart')[1]/UartConfigSet/UartChannel/*/UartTxChannelMode = 'POLLING'"!][!//
                        <BSW-TIMING-EVENT>
                          <SHORT-NAME>TimingEvent_MainFunction_Write</SHORT-NAME>
                          <STARTS-ON-EVENT-REF DEST="BSW-SCHEDULABLE-ENTITY">/AUTOSAR_Uart/BswModuleDescriptions/Uart/InternalBehavior_0/Uart_MainFunction_Write</STARTS-ON-EVENT-REF>                      
                          <PERIOD>[!"as:modconf('Uart')[1]/UartGeneral/UartMainFunctionWritePeriod"!]</PERIOD>
                        </BSW-TIMING-EVENT>
[!ENDIF!][!//
                      </EVENTS>
                    </BSW-INTERNAL-BEHAVIOR>
                  </INTERNAL-BEHAVIORS>
                </BSW-MODULE-DESCRIPTION>
              </ELEMENTS>
            </AR-PACKAGE>
            <AR-PACKAGE>
              <SHORT-NAME>BswModuleEntrys</SHORT-NAME>
              <ELEMENTS>
                <BSW-MODULE-ENTRY>
                  <SHORT-NAME>Uart_Init</SHORT-NAME>
                  <SERVICE-ID>1000</SERVICE-ID>
                  <IS-REENTRANT>false</IS-REENTRANT>
                  <IS-SYNCHRONOUS>true</IS-SYNCHRONOUS>
                  <CALL-TYPE>REGULAR</CALL-TYPE>
                  <EXECUTION-CONTEXT>UNSPECIFIED</EXECUTION-CONTEXT>
                  <SW-SERVICE-IMPL-POLICY>STANDARD</SW-SERVICE-IMPL-POLICY>
                </BSW-MODULE-ENTRY>
[!IF "as:modconf('Uart')[1]/UartConfigSet/UartChannel/*/UartRxChannelMode = 'POLLING'"!][!//
                <BSW-MODULE-ENTRY>
                  <SHORT-NAME>Uart_MainFunction_Read</SHORT-NAME>
                  <SERVICE-ID>224</SERVICE-ID>
                  <IS-REENTRANT>false</IS-REENTRANT>
                  <IS-SYNCHRONOUS>true</IS-SYNCHRONOUS>
                  <CALL-TYPE>SCHEDULED</CALL-TYPE>
                  <EXECUTION-CONTEXT>TASK</EXECUTION-CONTEXT>
                  <SW-SERVICE-IMPL-POLICY>STANDARD</SW-SERVICE-IMPL-POLICY>
                </BSW-MODULE-ENTRY>
[!ENDIF!][!//
[!IF "as:modconf('Uart')[1]/UartConfigSet/UartChannel/*/UartTxChannelMode = 'POLLING'"!][!//
                <BSW-MODULE-ENTRY>
                  <SHORT-NAME>Uart_MainFunction_Write</SHORT-NAME>
                  <SERVICE-ID>225</SERVICE-ID>
                  <IS-REENTRANT>false</IS-REENTRANT>
                  <IS-SYNCHRONOUS>true</IS-SYNCHRONOUS>
                  <CALL-TYPE>SCHEDULED</CALL-TYPE>
                  <EXECUTION-CONTEXT>TASK</EXECUTION-CONTEXT>
                  <SW-SERVICE-IMPL-POLICY>STANDARD</SW-SERVICE-IMPL-POLICY>
                </BSW-MODULE-ENTRY>
[!ENDIF!][!//
              </ELEMENTS>
            </AR-PACKAGE>
      </AR-PACKAGES>
    </AR-PACKAGE>
    <AR-PACKAGE>
      <SHORT-NAME>Uart_Aurix2GAS422</SHORT-NAME>
      <AR-PACKAGES>
        <AR-PACKAGE>
          <SHORT-NAME>Implementations</SHORT-NAME>
          <ELEMENTS>
            <BSW-IMPLEMENTATION>
              <SHORT-NAME>BswImplementation_0</SHORT-NAME>
              <CODE-DESCRIPTORS>
                <CODE>
                  <SHORT-NAME>Files</SHORT-NAME>
                  <ARTIFACT-DESCRIPTORS>
                    <AUTOSAR-ENGINEERING-OBJECT>
                      <SHORT-LABEL>make::Uart_defs.mak</SHORT-LABEL>
                      <CATEGORY>SWMAKE</CATEGORY>
                    </AUTOSAR-ENGINEERING-OBJECT>
                    <AUTOSAR-ENGINEERING-OBJECT>
                      <SHORT-LABEL>make::Uart_rules.mak</SHORT-LABEL>
                      <CATEGORY>SWMAKE</CATEGORY>
                    </AUTOSAR-ENGINEERING-OBJECT>
                  </ARTIFACT-DESCRIPTORS>
                </CODE>
              </CODE-DESCRIPTORS>
              <PROGRAMMING-LANGUAGE>C</PROGRAMMING-LANGUAGE>
            <RESOURCE-CONSUMPTION>
              <SHORT-NAME>ResourceConsumption</SHORT-NAME>
                <MEMORY-SECTIONS>
                  <MEMORY-SECTION>
                    <SHORT-NAME>VAR_CLEARED_ASIL_B_LOCAL_8</SHORT-NAME>
                    <ALIGNMENT>8</ALIGNMENT>
                    <OPTIONS>
                    	<OPTION>coreLocal</OPTION>
                    	<OPTION>safetyAsilB</OPTION>
                    </OPTIONS>
                    <SW-ADDRMETHOD-REF DEST="SW-ADDR-METHOD">/AUTOSAR_MemMap/SwAddrMethods/VAR_CLEARED_ASIL_B_LOCAL</SW-ADDRMETHOD-REF>
                  </MEMORY-SECTION>
                  <MEMORY-SECTION>
                    <SHORT-NAME>VAR_CLEARED_ASIL_B_LOCAL_32</SHORT-NAME>
                    <ALIGNMENT>32</ALIGNMENT>
                    <OPTIONS>
                    	<OPTION>coreLocal</OPTION>
                    	<OPTION>safetyAsilB</OPTION>
                    </OPTIONS>
                    <SW-ADDRMETHOD-REF DEST="SW-ADDR-METHOD">/AUTOSAR_MemMap/SwAddrMethods/VAR_CLEARED_ASIL_B_LOCAL</SW-ADDRMETHOD-REF>
                  </MEMORY-SECTION>
                  <MEMORY-SECTION>
                    <SHORT-NAME>VAR_CLEARED_ASIL_B_LOCAL_UNSPECIFIED</SHORT-NAME>
                    <ALIGNMENT>UNSPECIFIED</ALIGNMENT>
                    <OPTIONS>
                    	<OPTION>coreLocal</OPTION>
                    	<OPTION>safetyAsilB</OPTION>
                    </OPTIONS>
                    <SW-ADDRMETHOD-REF DEST="SW-ADDR-METHOD">/AUTOSAR_MemMap/SwAddrMethods/VAR_CLEARED_ASIL_B_LOCAL</SW-ADDRMETHOD-REF>
                  </MEMORY-SECTION>
                  <MEMORY-SECTION>
                    <SHORT-NAME>CODE_ASIL_B_LOCAL</SHORT-NAME>
                    <ALIGNMENT>UNSPECIFIED</ALIGNMENT>
                    <OPTIONS>
                    	<OPTION>coreLocal</OPTION>
                    	<OPTION>safetyAsilB</OPTION>
                    </OPTIONS>
                    <SW-ADDRMETHOD-REF DEST="SW-ADDR-METHOD">/AUTOSAR_MemMap/SwAddrMethods/CODE_ASIL_B_LOCAL</SW-ADDRMETHOD-REF>
                  </MEMORY-SECTION>
                  <MEMORY-SECTION>
                    <SHORT-NAME>CONST_ASIL_B_16</SHORT-NAME>
                    <ALIGNMENT>16</ALIGNMENT>
                    <OPTIONS>
                    	<OPTION>safetyAsilB</OPTION>
                    </OPTIONS>
                    <SW-ADDRMETHOD-REF DEST="SW-ADDR-METHOD">/AUTOSAR_MemMap/SwAddrMethods/CONST_ASIL_B</SW-ADDRMETHOD-REF>
                  </MEMORY-SECTION>
                  <MEMORY-SECTION>
                    <SHORT-NAME>CONST_ASIL_B_LOCAL_32</SHORT-NAME>
                    <ALIGNMENT>32</ALIGNMENT>
                    <OPTIONS>
                    	<OPTION>coreLocal</OPTION>
                    	<OPTION>safetyAsilB</OPTION>
                    </OPTIONS>
                    <SW-ADDRMETHOD-REF DEST="SW-ADDR-METHOD">/AUTOSAR_McalExt/SwAddrMethods_McalExt/CONST_ASIL_B_LOCAL</SW-ADDRMETHOD-REF>
                  </MEMORY-SECTION>
                  <MEMORY-SECTION>
                    <SHORT-NAME>CONFIG_DATA_ASIL_B_LOCAL_UNSPECIFIED</SHORT-NAME>
                    <ALIGNMENT>UNSPECIFIED</ALIGNMENT>
                    <OPTIONS>
                    	<OPTION>coreLocal</OPTION>
                    	<OPTION>safetyAsilB</OPTION>
                    </OPTIONS>
                    <SW-ADDRMETHOD-REF DEST="SW-ADDR-METHOD">/AUTOSAR_McalExt/SwAddrMethods_McalExt/CONFIG_DATA_ASIL_B_LOCAL</SW-ADDRMETHOD-REF>
                  </MEMORY-SECTION>
				<MEMORY-SECTION>
                  <SHORT-NAME>CODE</SHORT-NAME>
                  <ALIGNMENT>UNSPECIFIED</ALIGNMENT>
                  <SW-ADDRMETHOD-REF DEST="SW-ADDR-METHOD">/AUTOSAR_MemMap/SwAddrMethods/CODE</SW-ADDRMETHOD-REF>
                </MEMORY-SECTION>
                </MEMORY-SECTIONS>
                <SECTION-NAME-PREFIXS>
                  <SECTION-NAME-PREFIX>
                    <SHORT-NAME>UART</SHORT-NAME>
                    <SYMBOL>UART</SYMBOL>
                  </SECTION-NAME-PREFIX>
                </SECTION-NAME-PREFIXS>
            </RESOURCE-CONSUMPTION>
              <SW-VERSION>20.0.1</SW-VERSION>
              <VENDOR-ID>17</VENDOR-ID>
              <AR-RELEASE-VERSION>4.2.2</AR-RELEASE-VERSION>
              <BEHAVIOR-REF DEST="BSW-INTERNAL-BEHAVIOR">/AUTOSAR_Uart/BswModuleDescriptions/Uart/InternalBehavior_0</BEHAVIOR-REF>
              <VENDOR-SPECIFIC-MODULE-DEF-REFS>
                <VENDOR-SPECIFIC-MODULE-DEF-REF DEST="ECUC-MODULE-DEF">/AURIX2G/EcucDefs/Uart</VENDOR-SPECIFIC-MODULE-DEF-REF>
              </VENDOR-SPECIFIC-MODULE-DEF-REFS>
            </BSW-IMPLEMENTATION>
          </ELEMENTS>
        </AR-PACKAGE>
      </AR-PACKAGES>
    </AR-PACKAGE>
  </AR-PACKAGES>
</AUTOSAR>
