AUTOSAR XML (schema 00045)
package /Logging
  application sw component type Logging
    behavior Logging_IB: handle-termination-and-restart=NO-SUPPORT
      init event InitEvent_Logging: start-on-event=Logging_InitFunction
      timing event TimingEvent_Logging: start-on-event=Logging_MainFunction, period=0.005
      runnable Logging_InitFunction
      runnable Logging_MainFunction
  swc implementation Logging_Impl: programming-language=C, sw-version=1.0.0, vendor-id=0, behavior=Logging_IB
    code-descriptors:
      code CodeGen: artifact-descriptors=[{short-label=SWHDR, category=SWHDR}, {short-label=SWSRC, category=SWSRC}]
    resource consumption Resource
      memory section CODE: sw-addrmethod=CODE
      memory section VAR_UNSPECIFIED: sw-addrmethod=VAR
