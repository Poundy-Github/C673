AUTOSAR XML (schema 00045)
package /TsaAdapter
  application sw component type TsaAdapter
    behavior TsaAdapter_IB: handle-termination-and-restart=NO-SUPPORT
      init event InitEvent_TsaAdapter_InitFunction: start-on-event=TsaAdapter_InitFunction
      timing event TimingEvent_TsaAdapter_MainFunction: start-on-event=TsaAdapter_MainFunction, period=0.06
      timing event TimingEvent_TsaAdapter_TsaExec: start-on-event=TsaAdapter_TsaExec, period=0.06
      runnable TsaAdapter_InitFunction
      runnable TsaAdapter_MainFunction
      runnable TsaAdapter_TsaExec
  swc implementation TsaAdapterImpl: programming-language=C, sw-version=1.0.0, vendor-id=0, behavior=TsaAdapter_IB
    code-descriptors:
      code CodeGen: artifact-descriptors=[{short-label=SWSRC, category=SWSRC}, {short-label=SWHDR, category=SWHDR}]
    resource consumption Resource
      memory section CODE: sw-addrmethod=CODE
      memory section VAR_UNSPECIFIED: sw-addrmethod=VAR
