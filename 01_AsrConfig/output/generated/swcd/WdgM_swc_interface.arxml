AUTOSAR XML (schema 4-0-3)
package /AUTOSAR_WdgM/ImplementationDataTypes
  impl type WdgM_SupervisedEntityIdType: implementation-data-type=uint16
  impl type WdgM_CheckpointIdType: compu {0=WdgMConf_WdgMCheckpoint_WdgMCheckpoint_AS_HM, 0=WdgMConf_WdgMCheckpoint_WdgMCheckpoint_SWC_MONITOR, 0=WdgMConf_WdgMCheckpoint_WdgMCheckpoint_CameraTemp, 0=WdgMConf_WdgMCheckpoint_WdgMCheckpoint_ConfigReg, 0=WdgMConf_WdgMCheckpoint_WdgMCheckpoint_FS_MAIN, 0=WdgMConf_WdgMCheckpoint_WdgMCheckpoint_FS_ADC}, implementation-data-type=uint16
  data type mapping set WdgMDataTypeMappingSet: mode-request-type-map{implementation-data-type=uint8, mode-group=WdgMMode}
package /AUTOSAR_WdgM/ModeDeclarationGroups
  mode declaration group WdgMMode: initial-mode=SUPERVISION_OK
    5 x mode:
      SUPERVISION_OK
      SUPERVISION_FAILED
      SUPERVISION_EXPIRED
      SUPERVISION_STOPPED
      SUPERVISION_DEACTIVATED
package /AUTOSAR_WdgM/PortInterfaces
  client server interface WdgM_AliveSupervision: is-service=true, service-kind=WATCH-DOG-MANAGER
    operation UpdateAliveCounter: possible-error=E_NOT_OK
    operation CheckpointReached: possible-error=E_NOT_OK
      arg CheckpointId: type=WdgM_CheckpointIdType, direction=IN
    error E_NOT_OK: error-code=1
  mode switch interface WdgM_GlobalMode: is-service=true, service-kind=WATCH-DOG-MANAGER
    mode group currentMode: type=WdgMMode
  mode switch interface WdgM_IndividualMode: is-service=true, service-kind=WATCH-DOG-MANAGER
    mode group currentMode: type=WdgMMode
