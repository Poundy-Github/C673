[part 1 of 4: package /EcuExtract]
AUTOSAR XML (schema 00046)
package /EcuExtract
  composition sw component type TopLevelComposition
    49 x component:
      AebDs: type=AebDs
      BswM_OsApplication_C{0..3}_Prototype: type=BswM_OsApplication_C{0..3}
      Cdd_EvAdc: type=EvAdc
      Cdm_Prototype: type=Cdm
      ComM_Prototype: type=ComM
      Comco: type=Comco
      Cpr_Prototype: type=Cpr
      Cps_Prototype: type=Cps
      CtCdSPI: type=CtCdSPI
      Dcm_Prototype: type=Dcm
      Dem_Prototype: type=Dem
      DevelopmentErrorTracer_Prototype: type=DevelopmentErrorTracer
      Dsm_Prototype: type=Dsm
      EcuM_Prototype: type=EcuM
      Esh: type=Esh
      Esm_Core{1..3}_Prototype: type=Esm_Core{1..3}
      Esm_Prototype: type=Esm
      FSMonitor_Prototype: type=FSMonitor
      FctAdapter_Prototype: type=FctAdapter
      Fcu_Prototype: type=Fcu
      FiM_Prototype: type=FiM
      HeartbeatDet: type=HeartbeatDet
      HlaAdapter_Prototype: type=HlaAdapter
      LcfAdapter_Prototype: type=LcfAdapter
      Logging: type=Logging
      Med_Prototype: type=Med
      ModM: type=ModM
      MtsiAdapter_Prototype: type=MtsiAdapter
      Nvm_Prototype: type=NvM
      Qsm_Prototype: type=Qsm
      RtaAdapter_C{0..3}: type=RtaAdapter_C{0..3}
      Sdc_Prototype: type=Sdc
      Sed_Prototype: type=Sed
      SpiSync_Prototype: type=SpiSync
      StbM_Prototype: type=StbM
      Time_Prototype: type=Time
      TsaAdapter_Prototype: type=TsaAdapter
      VdyAdapter_Prototype: type=VdyAdapter
      VoltMonI: type=VoltMonI
      WdgM_CORE_0_Prototype: type=WdgM_CORE_0
      WdgM_CORE_1_Prototype: type=WdgM_CORE_1
    connect Cpr_Prototype.PP_Cpr_Chassis_Data -> AebDs.RP_Cpr_Chassis_Data
    connect FctAdapter_Prototype.PP_FctAdapter_HeadOutputCustomData -> AebDs.RP_FctAdapter_HeadOutputCustomData
    connect Fcu_Prototype.PP_Fcu_Cps_TxSignal_Aeb -> AebDs.RP_Fcu_Aeb_Data
    connect Sdc_Prototype.PP_Sdc_Cem_GenObjectList -> AebDs.RP_Sdc_Cem_GenObjectList
    connect BswM_OsApplication_C0_Prototype.BswM_ModeSwitchPort_OsApplication_C0_BswMSwitchPort_DiagComControlState -> Comco.RP_BswM_MSI_DiagComControlMode
    connect BswM_OsApplication_C0_Prototype.BswM_ModeSwitchPort_OsApplication_C0_CanSMState_PrivateCan -> Esh.RP_BswM_CanSMState_PrivateCan
    connect BswM_OsApplication_C0_Prototype.BswM_ModeSwitchPort_OsApplication_C0_CanSMState_PublicCan -> Esh.RP_BswM_CanSMState_PublicCan
    connect Comco.PP_Comco_MSI_RxPduGroupSwitch -> BswM_OsApplication_C0_Prototype.ModeNotificationPort_BswMSwcModeNotification_Comco_RxReq
    connect Comco.PP_Comco_MSI_TxPduGroupSwitch -> BswM_OsApplication_C0_Prototype.ModeNotificationPort_BswMSwcModeNotification_Comco_TxReq
    connect Cdd_EvAdc.PP_Port_Cdd_EvAdc_GetValue_TMON_SYS1 -> Dsm_Prototype.RP_EvAdc_GetValue_TMON_SYS1
    connect Cdd_EvAdc.PP_Port_Cdd_EvAdc_GetValue_TMON_SYS1 -> Esh.RP_EvAdc_GetValue_TMON_SYS1
    connect Cdd_EvAdc.PP_Port_Cdd_EvAdc_GetValue_TMON_SYS1 -> FSMonitor_Prototype.RP_Fs_EvAdc_GetValue_VMON_SocExtTemp
    connect Cdd_EvAdc.PP_Port_Cdd_EvAdc_GetValue_TMON_SYS2 -> Dsm_Prototype.RP_EvAdc_GetValue_TMON_SYS2
    connect Cdd_EvAdc.PP_Port_Cdd_EvAdc_GetValue_TMON_SYS2 -> Esh.RP_EvAdc_GetValue_TMON_SYS2
    connect Cdd_EvAdc.PP_Port_Cdd_EvAdc_GetValue_TMON_SYS2 -> FSMonitor_Prototype.RP_Fs_EvAdc_GetValue_VMON_McuExtTemp
    connect Cdd_EvAdc.PP_Port_Cdd_EvAdc_GetValue_VMON_BATT -> Cdm_Prototype.RP_EvAdc_GetValue_VMON_BATT
    connect Cdd_EvAdc.PP_Port_Cdd_EvAdc_GetValue_VMON_BATT -> Dsm_Prototype.RP_EvAdc_GetValue_VMON_BATT
    connect Cdd_EvAdc.PP_Port_Cdd_EvAdc_GetValue_VMON_BATT -> Esh.RP_EvAdc_GetValue_VMON_BATT
    connect Cdd_EvAdc.PP_Port_Cdd_EvAdc_GetValue_VMON_BATT -> FSMonitor_Prototype.RP_Fs_EvAdc_GetValue_VMON_BATT
    connect Cdd_EvAdc.PP_Port_Cdd_EvAdc_GetValue_VMON_BATT -> VoltMonI.RP_EvAdc_GetValue_VMON_BATT
    connect Cdd_EvAdc.PP_Port_Cdd_EvAdc_GetValue_VMON_IGN -> Comco.RP_EvAdc_GetValue_VMON_IGN
    connect Cdd_EvAdc.PP_Port_Cdd_EvAdc_GetValue_VMON_IGN -> FSMonitor_Prototype.RP_Fs_EvAdc_GetValue_VMON_IGN
    connect Cdd_EvAdc.PP_Port_Cdd_EvAdc_GetValue_VMON_IGN -> VoltMonI.RP_EvAdc_GetValue_VMON_IGN
    connect VdyAdapter_Prototype.PP_VdyAdapter_VdyOutputNvMData -> Cdm_Prototype.RP_VdyAdapter_VdyOutputNvMData
    connect Cdm_Prototype.PP_Cdm_VdyInputNvMData -> VdyAdapter_Prototype.RP_Cdm_VdyInputNvMData
    connect Cdm_Prototype.PP_Cdm_BlockOp -> Dsm_Prototype.RP_Cdm_DsmBlockOp
    connect Cdm_Prototype.PP_Cdm_BlockOp -> Fcu_Prototype.RP_Cdm_FcuBlockOp
    connect Cdm_Prototype.PP_Cdm_NvmVdyMirror -> Nvm_Prototype.PMirror_NvM_BLOCK_VDYData
    connect Qsm_Prototype.PP_QsmDsmBlockStartup_Flag -> Cdm_Prototype.PP_Qsm_DsmBlock_Startup_Flag
    connect Qsm_Prototype.PP_Qsm_DsmBlockPartNumber_Sector -> Cdm_Prototype.RP_Qsm_DsmBlock_PartNumber_Sector
    connect Qsm_Prototype.PP_Qsm_DsmBlock_EOLModeGateOp -> Cdm_Prototype.RP_Qsm_DsmBlock_EOLModeGateOp
    connect Qsm_Prototype.PP_Qsm_DsmSecureUpdateLogOp -> Cdm_Prototype.PP_Qsm_DsmBlock_SecureUpdateLogOp
    connect ComM_Prototype.UR_ComMUser_Private -> Comco.RP_ComM_UserRequest_Private
    connect ComM_Prototype.UR_ComMUser_Public -> Comco.RP_ComM_UserRequest_Public
    connect Comco.PP_Comco_CSI_NMWakupFlag -> Esh.RP_Comco_CSI_NMWakupFlag
    connect Comco.PP_Comco_CSI_NMWakupFlag -> Esm_Prototype.RP_Comco_CSI_NMWakupFlag
    connect Comco.PP_Comco_CSI_NMWakupFlag -> VoltMonI.RP_Comco_CSI_NMWakupFlag
    connect Comco.PP_Comco_CSI_nmCurrentState -> Esm_Prototype.RP_Comco_CSI_nmCurrentState
    connect VoltMonI.PP_VoltMonI_SRI_DisableCommunication -> Comco.RP_VoltMonI_SRI_DisableCommunication
    connect Cpr_Prototype.PP_Cpr_Adas_Data -> Fcu_Prototype.RP_Fcu_Adas_Data
    connect Cpr_Prototype.PP_Cpr_Adas_Data -> Med_Prototype.RP_Cpr_Adas_Data_SRI_Cpr_RxSignal_Adas
    connect Cpr_Prototype.PP_Cpr_Adas_Data -> Sdc_Prototype.RP_Sdc_Adas_Data
    connect Cpr_Prototype.PP_Cpr_Body_Data -> Esh.RP_Cpr_Body_Data
    connect Cpr_Prototype.PP_Cpr_Body_Data -> Fcu_Prototype.RP_Fcu_Body_Data
    connect Cpr_Prototype.PP_Cpr_Body_Data -> Med_Prototype.RP_Cpr_Body_Data_SRI_Cpr_Rxsignal_Body
    connect Cpr_Prototype.PP_Cpr_Body_Data -> Sdc_Prototype.RP_Sdc_Body_Data
    connect Cpr_Prototype.PP_Cpr_Chassis_Data -> FSMonitor_Prototype.RP_Fs_Chassis_Data_EspVehSpd_Status
    connect Cpr_Prototype.PP_Cpr_Chassis_Data -> Fcu_Prototype.RP_Fcu_Chassis_Data
    connect Cpr_Prototype.PP_Cpr_Chassis_Data -> Med_Prototype.RP_Cpr_Chassis_Data_SRI_Cpr_RxSignal_Chassisd
    connect Cpr_Prototype.PP_Cpr_Chassis_Data -> Sdc_Prototype.RP_Sdc_Chassis_Data
    connect Cpr_Prototype.PP_Cpr_GetMsgStatusInfo -> Med_Prototype.RP_Cpr_GetMsgStatusInfo_CSI_Cpr_RxMessageState
    connect Cpr_Prototype.PP_Cpr_Powertrain_Data -> Fcu_Prototype.RP_Fcu_Powertrain_Data
    connect Cpr_Prototype.PP_Cpr_Powertrain_Data -> Med_Prototype.RP_Cpr_Powertrain_Data_SRI_Cpr_RxSignal_Powertrain
    connect Cpr_Prototype.PP_Cpr_Powertrain_Data -> Sdc_Prototype.RP_Sdc_Powertrain_Data
    connect Fcu_Prototype.PP_Fcu_Cps_TxSignal_Acc -> Cps_Prototype.RP_Cps_SRI_TxSignal_Acc
    connect Fcu_Prototype.PP_Fcu_Cps_TxSignal_Aeb -> Cps_Prototype.RP_Cps_SRI_TxSignal_Aeb
    connect Fcu_Prototype.PP_Fcu_Cps_TxSignal_Hla -> Cps_Prototype.RP_Cps_SRI_TxSignal_Hla
    connect Fcu_Prototype.PP_Fcu_Cps_TxSignal_Lcf -> Cps_Prototype.RP_Cps_SRI_TxSignal_Lcf
    connect Dsm_Prototype.PP_Dsm_ServiceRequestSupplierNotification -> Dcm_Prototype.ServiceRequestSupplierNotification_ServiceRequestSupplierNotification
    connect Dcm_Prototype.DCMServices -> Dsm_Prototype.RP_Dcm_DCMServices
    connect Dsm_Prototype.PP_Dsm_RC_ApplicationRollback -> Dcm_Prototype.RoutineServices_DcmDspRoutine_0x0205
    connect Dsm_Prototype.PP_Dsm_RC_ClearNvM -> Dcm_Prototype.RoutineServices_DcmDspRoutine_0xF012
    connect Dsm_Prototype.PP_Dsm_RC_EOLCalibration -> Dcm_Prototype.RoutineServices_DcmDspRoutine_0x800B
    connect Dsm_Prototype.PP_Dsm_RC_ETHCableDiagnostic -> Dcm_Prototype.RoutineServices_DcmDspRoutine_0x0305
    connect Dsm_Prototype.PP_Dsm_RC_ETHCableLengthDiagnostic -> Dcm_Prototype.RoutineServices_DcmDspRoutine_0x030A
    connect Dsm_Prototype.PP_Dsm_RC_ETHEnableTestMode -> Dcm_Prototype.RoutineServices_DcmDspRoutine_0x0306
    connect Dsm_Prototype.PP_Dsm_RC_ETHPhyLoopBackTest -> Dcm_Prototype.RoutineServices_DcmDspRoutine_0x0307
    connect Dsm_Prototype.PP_Dsm_RC_ETHReadPhyRegister -> Dcm_Prototype.RoutineServices_DcmDspRoutine_0x0303
    connect Dsm_Prototype.PP_Dsm_RC_ETHResetMACAddress -> Dcm_Prototype.RoutineServices_DcmDspRoutine_0x0308
    connect Dsm_Prototype.PP_Dsm_RC_ETHResetMACLayerStatistic -> Dcm_Prototype.RoutineServices_DcmDspRoutine_0x0309
    connect Dsm_Prototype.PP_Dsm_RC_ETHResetPortConfiguration -> Dcm_Prototype.RoutineServices_DcmDspRoutine_0x0302
    connect Dsm_Prototype.PP_Dsm_RC_ETHSetPortConfiguration -> Dcm_Prototype.RoutineServices_DcmDspRoutine_0x0301
    connect Dsm_Prototype.PP_Dsm_RC_ExchangeApplicationRunningArea -> Dcm_Prototype.RoutineServices_DcmDspRoutine_0x0204
    connect Dsm_Prototype.PP_Dsm_RC_JTAGDisable -> Dcm_Prototype.RoutineServices_DcmDspRoutine_0x8010
    connect Dsm_Prototype.PP_Dsm_RC_OTPEnable -> Dcm_Prototype.RoutineServices_DcmDspRoutine_0x8011
    connect Dsm_Prototype.PP_Dsm_RC_ProgrammingPreconditionCheck -> Dcm_Prototype.RoutineServices_DcmDspRoutine_0x0203
    connect Dsm_Prototype.PP_Dsm_RC_SDACalibration -> Dcm_Prototype.RoutineServices_DcmDspRoutine_0x800C
    connect Dsm_Prototype.PP_Dsm_RC_SaveNvM -> Dcm_Prototype.RoutineServices_DcmDspRoutine_0xF013
    connect Dsm_Prototype.PP_Dsm_RDBI_AEB_Lastappeared -> Dcm_Prototype.DataServices_DcmDspData_FD19
    connect Dsm_Prototype.PP_Dsm_RDBI_AEB_Lastbutoneappeared -> Dcm_Prototype.DataServices_DcmDspData_FD16
    connect Dsm_Prototype.PP_Dsm_RDBI_APPDownloadArea -> Dcm_Prototype.DataServices_DcmDspData_F010
    connect Dsm_Prototype.PP_Dsm_RDBI_AWB_Lastappeared -> Dcm_Prototype.DataServices_DcmDspData_FD18
    connect Dsm_Prototype.PP_Dsm_RDBI_AWB_Lastbutoneappeared -> Dcm_Prototype.DataServices_DcmDspData_FD15
    connect Dsm_Prototype.PP_Dsm_RDBI_ActiveDiagnosticSessionDataIdentifier -> Dcm_Prototype.DataServices_DcmDspData_F186
    connect Dsm_Prototype.PP_Dsm_RDBI_BodyHeightWheelHouseEdge -> Dcm_Prototype.DataServices_DcmDspData_F1F5
    connect Dsm_Prototype.PP_Dsm_RDBI_CalibrationBoardDistance -> Dcm_Prototype.DataServices_DcmDspData_3BAF
    connect Dsm_Prototype.PP_Dsm_RDBI_CalibrationStatus -> Dcm_Prototype.DataServices_DcmDspData_F1F7
    connect Dsm_Prototype.PP_Dsm_RDBI_CurrentStaticCalibrationDetails -> Dcm_Prototype.DataServices_DcmDspData_F1F8
    connect Dsm_Prototype.PP_Dsm_RDBI_DiagnosticDefinitionDataIdentifier -> Dcm_Prototype.DataServices_DcmDspData_F122
    connect Dsm_Prototype.PP_Dsm_RDBI_ECUHardwareVersionNumber -> Dcm_Prototype.DataServices_DcmDspData_F191
    connect Dsm_Prototype.PP_Dsm_RDBI_ECUInternalSoftwareVersionNumber -> Dcm_Prototype.DataServices_DcmDspData_FD28
    connect Dsm_Prototype.PP_Dsm_RDBI_ECUSoftwareVersionNumberDataIdentifier -> Dcm_Prototype.DataServices_DcmDspData_F189
    connect Dsm_Prototype.PP_Dsm_RDBI_ECUSupplierVoltage -> Dcm_Prototype.DataServices_DcmDspData_11B5
    connect Dsm_Prototype.PP_Dsm_RDBI_ECUTemperature -> Dcm_Prototype.DataServices_DcmDspData_11B7
    connect Dsm_Prototype.PP_Dsm_RDBI_EOL_CalibrationParameters -> Dcm_Prototype.DataServices_DcmDspData_F1F9
    connect Dsm_Prototype.PP_Dsm_RDBI_EOL_LastResult -> Dcm_Prototype.DataServices_DcmDspData_F1FA
    connect Dsm_Prototype.PP_Dsm_RDBI_EOL_Previous_EOLResult -> Dcm_Prototype.DataServices_DcmDspData_F1FB
    connect Dsm_Prototype.PP_Dsm_RDBI_ETH_MAC_Address -> Dcm_Prototype.DataServices_DcmDspData_F1A3
    connect Dsm_Prototype.PP_Dsm_RDBI_ETH_ReadCommunication_ReadyStatus -> Dcm_Prototype.DataServices_DcmDspData_F1A9
    connect Dsm_Prototype.PP_Dsm_RDBI_ETH_ReadMACLayer_Statistics -> Dcm_Prototype.DataServices_DcmDspData_F1AB
    connect Dsm_Prototype.PP_Dsm_RDBI_ETH_ReadMasterSlave_Configures -> Dcm_Prototype.DataServices_DcmDspData_F1AA
    connect Dsm_Prototype.PP_Dsm_RDBI_ETH_ReadPHYLink_State -> Dcm_Prototype.DataServices_DcmDspData_F1A4
    connect Dsm_Prototype.PP_Dsm_RDBI_ETH_ReadPHYSignal_QualityIndex -> Dcm_Prototype.DataServices_DcmDspData_F1A5
    connect Dsm_Prototype.PP_Dsm_RDBI_ETH_ReadPort_Configuration -> Dcm_Prototype.DataServices_DcmDspData_F1A8
    connect Dsm_Prototype.PP_Dsm_RDBI_ETH_Read_NumberOfPorts -> Dcm_Prototype.DataServices_DcmDspData_F1A7
    connect Dsm_Prototype.PP_Dsm_RDBI_FBLRequirementSpecification -> Dcm_Prototype.DataServices_DcmDspData_F171
    connect Dsm_Prototype.PP_Dsm_RDBI_FBLVersionInformation -> Dcm_Prototype.DataServices_DcmDspData_F170
    connect Dsm_Prototype.PP_Dsm_RDBI_FCW_Lastappeared -> Dcm_Prototype.DataServices_DcmDspData_FD17
    connect Dsm_Prototype.PP_Dsm_RDBI_FCW_Lastbutoneappeared -> Dcm_Prototype.DataServices_DcmDspData_FD14
    connect Dsm_Prototype.PP_Dsm_RDBI_FunctionSpecificationDataIdentifier -> Dcm_Prototype.DataServices_DcmDspData_F121
    connect Dsm_Prototype.PP_Dsm_RDBI_ImagerTemperature -> Dcm_Prototype.DataServices_DcmDspData_FD25
    connect Dsm_Prototype.PP_Dsm_RDBI_InternalSocTemperature -> Dcm_Prototype.DataServices_DcmDspData_FD1E
    connect Dsm_Prototype.PP_Dsm_RDBI_InvalidAttemptCounter -> Dcm_Prototype.DataServices_DcmDspData_0103
    connect Dsm_Prototype.PP_Dsm_RDBI_MCU_AbankError -> Dcm_Prototype.DataServices_DcmDspData_FD26
    connect Dsm_Prototype.PP_Dsm_RDBI_MCU_BbankError -> Dcm_Prototype.DataServices_DcmDspData_FD27
    connect Dsm_Prototype.PP_Dsm_RDBI_NetworkInformationDataIdentifier -> Dcm_Prototype.DataServices_DcmDspData_F120
    connect Dsm_Prototype.PP_Dsm_RDBI_OMCalibrationStatus -> Dcm_Prototype.DataServices_DcmDspData_FD20
    connect Dsm_Prototype.PP_Dsm_RDBI_OMSN -> Dcm_Prototype.DataServices_DcmDspData_FD22
    connect Dsm_Prototype.PP_Dsm_RDBI_ProjectID -> Dcm_Prototype.DataServices_DcmDspData_FD21
    connect Dsm_Prototype.PP_Dsm_RDBI_SDA_LastResults -> Dcm_Prototype.DataServices_DcmDspData_F1FC
    connect Dsm_Prototype.PP_Dsm_RDBI_SecureUpdateLog -> Dcm_Prototype.DataServices_DcmDspData_FEC0
    connect Dsm_Prototype.PP_Dsm_RDBI_SocBootSensor -> Dcm_Prototype.DataServices_DcmDspData_FD23
    connect Dsm_Prototype.PP_Dsm_RDBI_SocSoftwareNumberDataIdentifier -> Dcm_Prototype.DataServices_DcmDspData_FD29
    connect Dsm_Prototype.PP_Dsm_RDBI_SocSoftwareVersion -> Dcm_Prototype.DataServices_DcmDspData_FD1F
    connect Dsm_Prototype.PP_Dsm_RDBI_SocSupplierSoftwareNumber -> Dcm_Prototype.DataServices_DcmDspData_F194
    connect Dsm_Prototype.PP_Dsm_RDBI_SoftwareNumber -> Dcm_Prototype.DataServices_DcmDspData_F188
    connect Dsm_Prototype.PP_Dsm_RDBI_applicationSoftwareFingerprintDataIdentifier -> Dcm_Prototype.DataServices_DcmDspData_F184
    connect Dsm_Prototype.PP_Dsm_RDBI_CalibrationDataIdentifier -> Dcm_Prototype.DataServices_DcmDspData_F123
    connect Dsm_Prototype.PP_Dsm_RWDBI_ECUHardwareVersionNumberDataIdentifier -> Dcm_Prototype.DataServices_DcmDspData_F089
    connect Dsm_Prototype.PP_Dsm_RWDBI_ECUSerialNumberDataIdentifier -> Dcm_Prototype.DataServices_DcmDspData_F18C
    connect Dsm_Prototype.PP_Dsm_RWDBI_EOL_ModeGate -> Dcm_Prototype.DataServices_DcmDspData_F1FF
    connect Dsm_Prototype.PP_Dsm_RWDBI_EcuOperationMode -> Dcm_Prototype.DataServices_DcmDspData_F1FD
    connect Dsm_Prototype.PP_Dsm_RWDBI_FABSwitch -> Dcm_Prototype.DataServices_DcmDspData_F1F1
    connect Dsm_Prototype.PP_Dsm_RWDBI_Fusa_Debug_Statua -> Dcm_Prototype.DataServices_DcmDspData_FD2A
    connect Dsm_Prototype.PP_Dsm_RWDBI_InternalTestMode -> Dcm_Prototype.DataServices_DcmDspData_FDFF
    connect Dsm_Prototype.PP_Dsm_RWDBI_LaneFunctionConfiguration -> Dcm_Prototype.DataServices_DcmDspData_F1FE
    connect Dsm_Prototype.PP_Dsm_RWDBI_PCBASerialNumberDataIdentifier -> Dcm_Prototype.DataServices_DcmDspData_FD24
    connect Dsm_Prototype.PP_Dsm_RWDBI_PartNumberDataIdentifier -> Dcm_Prototype.DataServices_DcmDspData_F187
    connect Dsm_Prototype.PP_Dsm_RWDBI_SocResetControl -> Dcm_Prototype.DataServices_DcmDspData_FD00
    connect Dsm_Prototype.PP_Dsm_RWDBI_SystemSupplierIdentifier -> Dcm_Prototype.DataServices_DcmDspData_F18A
    connect Dsm_Prototype.PP_Dsm_RWDBI_TLASwitch -> Dcm_Prototype.DataServices_DcmDspData_F1F3
    connect Dsm_Prototype.PP_Dsm_RWDBI_TSRSwitch -> Dcm_Prototype.DataServices_DcmDspData_F1F2
    connect Dsm_Prototype.PP_Dsm_RWDBI_VINDataIdentifier -> Dcm_Prototype.DataServices_DcmDspData_F190
    connect Dsm_Prototype.PP_Dsm_RWDBI_VehicleType -> Dcm_Prototype.DataServices_DcmDspData_F1F0
    connect Dsm_Prototype.PP_Dsm_SecurityAccess_SA_Level1 -> Dcm_Prototype.SecurityAccess_SA_Level1
    connect Dem_Prototype.EnableCond_CONDITION_BcmPwrStsFbON -> Esh.RP_Dem_EC_BCMPowerModeState
    connect Dem_Prototype.EnableCond_CONDITION_EspVehSpd -> Esh.RP_Dem_EC_EspVehSpd
    connect Dem_Prototype.EnableCond_CONDITION_NO_BUSOFF_PrivateCAN -> Esh.RP_Dem_EC_PrivateBusoffEventCheck
    connect Dem_Prototype.EnableCond_CONDITION_NO_BUSOFF_PublicCAN -> Esh.RP_Dem_EC_PublicBusoffEventCheck
    connect Dem_Prototype.EnableCond_CONDITION_PowerON_3000ms -> Esh.RP_Dem_EC_PoweronTimer
    connect Dem_Prototype.EnableCond_CONDITION_Voltage_Normal -> Esh.RP_Dem_EC_BattVoltInNormalScope
    connect Dem_Prototype.OpCycle_DEM_OPCYC_IGN -> Esh.RP_Dem_OpCycle_OperationCycle_IGN
    connect Esh.PP_Esh_DemDataElementClass_ActualGearPosition -> Dem_Prototype.CBReadData_DemDataElementClass_GearPosition
    connect Esh.PP_Esh_DemDataElementClass_ECUTemperature -> Dem_Prototype.CBReadData_DemDataElementClass_ECUTemperature
    connect Esh.PP_Esh_DemDataElementClass_EngineSpeed -> Dem_Prototype.CBReadData_DemDataElementClass_EngineSpeed
    connect Esh.PP_Esh_DemDataElementClass_LocalTime -> Dem_Prototype.CBReadData_DemDataElementClass_LocalTime
    connect Esh.PP_Esh_DemDataElementClass_Odometer -> Dem_Prototype.CBReadData_DemDataElementClass_Odometer
    connect Esh.PP_Esh_DemDataElementClass_SOCErrMap -> Dem_Prototype.CBReadData_DemDataElementClass_Extended_SystemKernelErrMap
    connect Esh.PP_Esh_DemDataElementClass_SteeringAngle -> Dem_Prototype.CBReadData_DemDataElementClass_SteeringAngle
    connect Esh.PP_Esh_DemDataElementClass_VehicleSpeed -> Dem_Prototype.CBReadData_DemDataElementClass_VehicleSpeed
    connect Esh.PP_Esh_DemDataElementClass_Voltage -> Dem_Prototype.CBReadData_DemDataElementClass_Voltage
    connect Esh.PP_Esh_DemDataElementClass_YawRate -> Dem_Prototype.CBReadData_DemDataElementClass_Yawrate
    connect Med_Prototype.PP_Dem_CBStatusEvt_DEM_CAMERA_CALIBRATION_FAILURE -> Dem_Prototype.CBStatusEvt_DEM_CAMERA_CALIBRATION_FAILURE_1
    connect Med_Prototype.PP_Dem_CBStatusEvt_DEM_CAMERA_ONLINE_CALIBRATION_FAILURE -> Dem_Prototype.CBStatusEvt_DEM_CAMERA_ONLINE_CALIBRATION_FAILURE_1
    connect Med_Prototype.PP_Dem_CBStatusEvt_DEM_DTC_ADC_All_Node_Missing -> Dem_Prototype.CBStatusEvt_DEM_DTC_ADC_All_Node_Missing_1
    connect Med_Prototype.PP_Dem_CBStatusEvt_DEM_DTC_ADC_Message_Alive_Counter_Error -> Dem_Prototype.CBStatusEvt_DEM_DTC_ADC_Message_Alive_Counter_Error_1
    connect Med_Prototype.PP_Dem_CBStatusEvt_DEM_DTC_BCM_All_Node_Missing -> Dem_Prototype.CBStatusEvt_DEM_DTC_BCM_All_Node_Missing_1
    connect Med_Prototype.PP_Dem_CBStatusEvt_DEM_DTC_BCM_Brake_Lamp_Error -> Dem_Prototype.CBStatusEvt_DEM_DTC_BCM_Brake_Lamp_Error_1
    connect Med_Prototype.PP_Dem_CBStatusEvt_DEM_DTC_BCM_EmgyLi_Fault -> Dem_Prototype.CBStatusEvt_DEM_DTC_BCM_EmgyLi_Fault_1
    connect Med_Prototype.PP_Dem_CBStatusEvt_DEM_DTC_BCM_FrntWiperSts_Fault -> Dem_Prototype.CBStatusEvt_DEM_DTC_BCM_Frnt_Wiper_Sts_Fault_1
    connect Med_Prototype.PP_Dem_CBStatusEvt_DEM_DTC_BCM_Message_Alive_Counter_Error_40ms -> Dem_Prototype.CBStatusEvt_DEM_DTC_BCM_Message_Alive_Counter_Error_40ms_1
    connect Med_Prototype.PP_Dem_CBStatusEvt_DEM_DTC_BCM_TurnIndcrLight_Fault -> Dem_Prototype.CBStatusEvt_DEM_DTC_BCM_Turn_Indcr_Light_Fault_1
    connect Med_Prototype.PP_Dem_CBStatusEvt_DEM_DTC_EPS_APA_Epas_Fault -> Dem_Prototype.CBStatusEvt_DEM_DTC_EPS_APA_Epas_Fault_1
    connect Med_Prototype.PP_Dem_CBStatusEvt_DEM_DTC_EPS_ActualMotor_Invld -> Dem_Prototype.CBStatusEvt_DEM_DTC_EPS_Actual_Motor_Invld_1
    connect Med_Prototype.PP_Dem_CBStatusEvt_DEM_DTC_EPS_Actual_Motor_Torq_Invld -> Dem_Prototype.CBStatusEvt_DEM_DTC_EPS_Actual_Motor_Torq_Invld_1
    connect Med_Prototype.PP_Dem_CBStatusEvt_DEM_DTC_EPS_Actual_TorsionTorq_Invld -> Dem_Prototype.CBStatusEvt_DEM_DTC_EPS_Actual_Torsion_Torq_Invld_1
    connect Med_Prototype.PP_Dem_CBStatusEvt_DEM_DTC_EPS_All_Node_Missing -> Dem_Prototype.CBStatusEvt_DEM_DTC_EPS_All_Node_Missing_1
    connect Med_Prototype.PP_Dem_CBStatusEvt_DEM_DTC_EPS_Driver_handtorque_invalid -> Dem_Prototype.CBStatusEvt_DEM_DTC_EPS_Driver_hand_torque_invalid_1
    connect Med_Prototype.PP_Dem_CBStatusEvt_DEM_DTC_EPS_Fault -> Dem_Prototype.CBStatusEvt_DEM_DTC_EPS_Fault_1
    connect Med_Prototype.PP_Dem_CBStatusEvt_DEM_DTC_EPS_Message_Alive_Counter_Error_10ms -> Dem_Prototype.CBStatusEvt_DEM_DTC_EPS_Message_Alive_Counter_Error_10ms_1
    connect Med_Prototype.PP_Dem_CBStatusEvt_DEM_DTC_EPS_Message_Alive_Counter_Error_20ms -> Dem_Prototype.CBStatusEvt_DEM_DTC_EPS_Message_Alive_Counter_Error_20ms_1
    connect Med_Prototype.PP_Dem_CBStatusEvt_DEM_DTC_EPS_Pinionang_Fault -> Dem_Prototype.CBStatusEvt_DEM_DTC_EPS_Pinionang_Fault_1
    connect Med_Prototype.PP_Dem_CBStatusEvt_DEM_DTC_EPS_Pinionang_Invld -> Dem_Prototype.CBStatusEvt_DEM_DTC_EPS_Pinionang_Invld_1
    connect Med_Prototype.PP_Dem_CBStatusEvt_DEM_DTC_EPS_Sas_NOT_Cal -> Dem_Prototype.CBStatusEvt_DEM_DTC_EPS_Sas_NOT_Cal_1
    connect Med_Prototype.PP_Dem_CBStatusEvt_DEM_DTC_EPS_Steer_AgSens_Fault -> Dem_Prototype.CBStatusEvt_DEM_DTC_EPS_Steer_AgSens_Fault_1
    connect Med_Prototype.PP_Dem_CBStatusEvt_DEM_DTC_EPS_Steering_wheelvibration_failure -> Dem_Prototype.CBStatusEvt_DEM_DTC_EPS_Steering_wheel_vibration_failure_1
    connect Med_Prototype.PP_Dem_CBStatusEvt_DEM_DTC_ESP_ABA_NOT_Available -> Dem_Prototype.CBStatusEvt_DEM_DTC_ESP_ABA_NOT_Available_1
    connect Med_Prototype.PP_Dem_CBStatusEvt_DEM_DTC_ESP_ABS_Fault -> Dem_Prototype.CBStatusEvt_DEM_DTC_ESP_ABS_Fault_1
    connect Med_Prototype.PP_Dem_CBStatusEvt_DEM_DTC_ESP_AEB_NOT_Available -> Dem_Prototype.CBStatusEvt_DEM_DTC_ESP_AEB_NOT_Available_1
    connect Med_Prototype.PP_Dem_CBStatusEvt_DEM_DTC_ESP_AWB_NOT_Available -> Dem_Prototype.CBStatusEvt_DEM_DTC_ESP_AWB_NOT_Available_1
    connect Med_Prototype.PP_Dem_CBStatusEvt_DEM_DTC_ESP_All_Node_Missing -> Dem_Prototype.CBStatusEvt_DEM_DTC_ESP_All_Node_Missing_1
    connect Med_Prototype.PP_Dem_CBStatusEvt_DEM_DTC_ESP_Lat_Accel_Invld -> Dem_Prototype.CBStatusEvt_DEM_DTC_ESP_Lat_Accel_Invld_1
    connect Med_Prototype.PP_Dem_CBStatusEvt_DEM_DTC_ESP_Long_Accel_Invld -> Dem_Prototype.CBStatusEvt_DEM_DTC_ESP_Long_Accel_Invld_1
    connect Med_Prototype.PP_Dem_CBStatusEvt_DEM_DTC_ESP_Message_Alive_Counter_Error -> Dem_Prototype.CBStatusEvt_DEM_DTC_ESP_Message_Alive_Counter_Error_1
    connect Med_Prototype.PP_Dem_CBStatusEvt_DEM_DTC_ESP_Message_Alive_Counter_Error_100ms -> Dem_Prototype.CBStatusEvt_DEM_DTC_ESP_Message_Alive_Counter_Error_100ms_1
    connect Med_Prototype.PP_Dem_CBStatusEvt_DEM_DTC_ESP_TCS_Fault -> Dem_Prototype.CBStatusEvt_DEM_DTC_ESP_TCS_Fault_1
    connect Med_Prototype.PP_Dem_CBStatusEvt_DEM_DTC_ESP_Veh_Spd_Invld -> Dem_Prototype.CBStatusEvt_DEM_DTC_ESP_Veh_Spd_Invld_1
    connect Med_Prototype.PP_Dem_CBStatusEvt_DEM_DTC_ESP_Yaw_Rate_Invld -> Dem_Prototype.CBStatusEvt_DEM_DTC_ESP_Yaw_Rate_Invld_1
    connect Med_Prototype.PP_Dem_CBStatusEvt_DEM_DTC_Esp_Ebd_Failr -> Dem_Prototype.CBStatusEvt_DEM_DTC_Esp_Ebd_Failr_1
    connect Med_Prototype.PP_Dem_CBStatusEvt_DEM_DTC_FR_All_Node_Missing -> Dem_Prototype.CBStatusEvt_DEM_DTC_FR_All_Node_Missing_1
    connect Med_Prototype.PP_Dem_CBStatusEvt_DEM_DTC_Fradar_hardware_error -> Dem_Prototype.CBStatusEvt_DEM_DTC_Fradar_hardware_error_1
    connect Med_Prototype.PP_Dem_CBStatusEvt_DEM_DTC_Fradar_not_calibration_or_blockage -> Dem_Prototype.CBStatusEvt_DEM_DTC_Fradar_not_calibration_or_blockage_1
    connect Med_Prototype.PP_Dem_CBStatusEvt_DEM_DTC_Front_Radar_Alive_Counter_Error -> Dem_Prototype.CBStatusEvt_DEM_DTC_Front_Radar_Alive_Counter_Error_1
    connect Med_Prototype.PP_Dem_CBStatusEvt_DEM_DTC_IB_Brk_Pedl_Invld -> Dem_Prototype.CBStatusEvt_DEM_DTC_IB_Brk_Pedl_Invld_1
    connect Med_Prototype.PP_Dem_CBStatusEvt_DEM_DTC_IP_message_alive_counter_error -> Dem_Prototype.CBStatusEvt_DEM_DTC_IP_message_alive_counter_error_1
    connect Med_Prototype.PP_Dem_CBStatusEvt_DEM_DTC_IP_node_missing -> Dem_Prototype.CBStatusEvt_DEM_DTC_IP_node_missing_1
    connect Med_Prototype.PP_Dem_CBStatusEvt_DEM_DTC_IP_warning_invalid -> Dem_Prototype.CBStatusEvt_DEM_DTC_IP_warning_invalid_1
    connect Med_Prototype.PP_Dem_CBStatusEvt_DEM_DTC_J3_Camera_Blockage -> Dem_Prototype.CBStatusEvt_DEM_DTC_J3_Camera_Blockage_1
    connect Med_Prototype.PP_Dem_CBStatusEvt_DEM_DTC_J3_Camera_Error -> Dem_Prototype.CBStatusEvt_DEM_DTC_J3_Camera_Error_1
    connect Med_Prototype.PP_Dem_CBStatusEvt_DEM_DTC_J3_SOC_CPU_Error_PWM_Missing -> Dem_Prototype.CBStatusEvt_DEM_DTC_J3_SOC_CPU_Error_PWM_Missing_1
    connect Med_Prototype.PP_Dem_CBStatusEvt_DEM_DTC_J3_SOC_Perception_Error -> Dem_Prototype.CBStatusEvt_DEM_DTC_J3_SOC_Perception_Error_1
    connect Med_Prototype.PP_Dem_CBStatusEvt_DEM_DTC_J3_SOC_Safetylib_Error -> Dem_Prototype.CBStatusEvt_DEM_DTC_J3_SOC_Safetylib_Error_1
    connect Med_Prototype.PP_Dem_CBStatusEvt_DEM_DTC_J3_SOC_System_Service_Error -> Dem_Prototype.CBStatusEvt_DEM_DTC_J3_SOC_System_Service_Error_1
    connect Med_Prototype.PP_Dem_CBStatusEvt_DEM_DTC_J3_Time_Sync_Error -> Dem_Prototype.CBStatusEvt_DEM_DTC_J3_Time_Sync_Error_1
    connect Med_Prototype.PP_Dem_CBStatusEvt_DEM_DTC_MCU_TEMP_INITIAL_HIGH -> Dem_Prototype.CBStatusEvt_DEM_DTC_MCU_TEMP_INITIAL_HIGH_1
    connect Med_Prototype.PP_Dem_CBStatusEvt_DEM_DTC_Private_CAN_Bus_Off -> Dem_Prototype.CBStatusEvt_DEM_DTC_Private_CAN_Bus_Off_1
    connect Med_Prototype.PP_Dem_CBStatusEvt_DEM_DTC_Public_CAN_Bus_Off -> Dem_Prototype.CBStatusEvt_DEM_DTC_Public_CAN_Bus_Off_1
    connect Med_Prototype.PP_Dem_CBStatusEvt_DEM_DTC_RLR_Message_Alive_Counter_Error -> Dem_Prototype.CBStatusEvt_DEM_DTC_RLR_Message_Alive_Counter_Error_1
    connect Med_Prototype.PP_Dem_CBStatusEvt_DEM_DTC_SRS_All_Node_Missing -> Dem_Prototype.CBStatusEvt_DEM_DTC_SRS_All_Node_Missing_1
    connect Med_Prototype.PP_Dem_CBStatusEvt_DEM_DTC_SRS_Drvr_BucSwt_Invld -> Dem_Prototype.CBStatusEvt_DEM_DTC_SRS_Drvr_BucSwt_Invld_1
    connect Med_Prototype.PP_Dem_CBStatusEvt_DEM_DTC_SRS_Message_Alive_Counter_Error -> Dem_Prototype.CBStatusEvt_DEM_DTC_SRS_Message_Alive_Counter_Error_1
    connect Med_Prototype.PP_Dem_CBStatusEvt_DEM_DTC_VCU_Accr_Pedl_Posn_Invld -> Dem_Prototype.CBStatusEvt_DEM_DTC_VCU_Accr_Pedl_Posn_Invld_1
    connect Med_Prototype.PP_Dem_CBStatusEvt_DEM_DTC_VCU_All_Node_Missing -> Dem_Prototype.CBStatusEvt_DEM_DTC_VCU_All_Node_Missing_1
    connect Med_Prototype.PP_Dem_CBStatusEvt_DEM_DTC_VCU_Gear_Posn_Invld -> Dem_Prototype.CBStatusEvt_DEM_DTC_VCU_Gear_Posn_Invld_1
    connect Med_Prototype.PP_Dem_CBStatusEvt_DEM_DTC_VCU_Message_Alive_Counter_Error -> Dem_Prototype.CBStatusEvt_DEM_DTC_VCU_Message_Alive_Counter_Error_1
    connect Med_Prototype.PP_Dem_CBStatusEvt_DEM_DTC_Whl_Spd_Data_Invld -> Dem_Prototype.CBStatusEvt_DEM_DTC_Whl_Spd_Data_Invld_1
    connect Med_Prototype.PP_Dem_CBStatusEvt_DEM_DTC_Whl_Spd_Dir_Invld -> Dem_Prototype.CBStatusEvt_DEM_DTC_Whl_Spd_Dir_Invld_1
    connect Med_Prototype.PP_Dem_CBStatusEvt_DEM_DTC_Whl_Spd_Pls_Invld -> Dem_Prototype.CBStatusEvt_DEM_DTC_Whl_Spd_Pls_Invld_1
    connect Med_Prototype.PP_Dem_CBStatusEvt_DEM_J3_SYS_KERNEL_SW -> Dem_Prototype.CBStatusEvt_DEM_J3_SYS_KERNEL_SW_1
    connect Med_Prototype.PP_Dem_CBStatusEvt_DEM_MCU_TEMP_EXT_HIGH -> Dem_Prototype.CBStatusEvt_DEM_MCU_TEMP_EXT_HIGH_1
    connect Med_Prototype.PP_Dem_CBStatusEvt_DEM_MCU_TEMP_EXT_LOW -> Dem_Prototype.CBStatusEvt_DEM_MCU_TEMP_EXT_LOW_1
    connect Med_Prototype.PP_Dem_CBStatusEvt_DEM_SOCJ3_TEMP_EXT_HIGH -> Dem_Prototype.CBStatusEvt_DEM_SOCJ3_TEMP_EXT_HIGH_1
    connect Med_Prototype.PP_Dem_CBStatusEvt_DEM_VMON_BATT_HIGH -> Dem_Prototype.CBStatusEvt_DEM_VMON_BATT_HIGH_1
    connect Med_Prototype.PP_Dem_CBStatusEvt_DEM_VMON_BATT_LOW -> Dem_Prototype.CBStatusEvt_DEM_VMON_BATT_LOW_1
    connect Med_Prototype.PP_Dem_CBStatusEvt_SPI_E_HARDWARE_ERROR -> Dem_Prototype.CBStatusEvt_SPI_E_HARDWARE_ERROR_1
    connect Dsm_Prototype.PP_Dsm_SRI_InternalTestMode -> Med_Prototype.RP_Dsm_SRI_InternalTestMode
    connect Dsm_Prototype.PP_Dsm_SRI_InternalTestMode -> Sdc_Prototype.RP_Dsm_SRI_InternalTestMode
    connect Dsm_Prototype.PP_Dsm_SRI_SocResetControlState -> Esm_Prototype.RP_Dsm_SRI_SocResetControlState
    connect Nvm_Prototype.PS_NVM_BLOCK_AEBLastappearFD19 -> Dsm_Prototype.RP_Nvm_AEBLastappearFD19
    connect Nvm_Prototype.PS_NVM_BLOCK_AEBLastbutoneappearFD16 -> Dsm_Prototype.RP_Nvm_AEBLastbutoneappearFD16
    connect Nvm_Prototype.PS_NVM_BLOCK_AWBLastbutoneappearFD15 -> Dsm_Prototype.RP_Nvm_AWBLastbutoneappearFD15
    connect Nvm_Prototype.PS_NVM_BLOCK_AWBLasteappearFD18 -> Dsm_Prototype.RP_Nvm_AWBLasteappearFD18
    connect Nvm_Prototype.PS_NVM_BLOCK_EOL_Info_Input -> Dsm_Prototype.RP_Nvm_EOL_Info_Input
    connect Nvm_Prototype.PS_NVM_BLOCK_FAB_switch -> Dsm_Prototype.RP_Nvm_FAB_switch
    connect Nvm_Prototype.PS_NVM_BLOCK_FCWLastappearFD17 -> Dsm_Prototype.RP_Nvm_FCWLastappearFD17
    connect Nvm_Prototype.PS_NVM_BLOCK_FCWLastbutoneappearedFD14 -> Dsm_Prototype.RP_Nvm_FCWLastbutoneappearedFD14
    connect Nvm_Prototype.PS_NVM_BLOCK_Security_AttemptCount -> Dsm_Prototype.RP_Nvm_Security_AttemptCount
    connect Nvm_Prototype.PS_NVM_BLOCK_SerialNumberDataId -> Dsm_Prototype.RP_Nvm_SerialNumberDataId
    connect Nvm_Prototype.PS_NVM_BLOCK_TLA_switch -> Dsm_Prototype.RP_Nvm_TLA_switch
    connect Nvm_Prototype.PS_NVM_BLOCK_TSR_switch -> Dsm_Prototype.RP_Nvm_TSR_switch
    connect Nvm_Prototype.PS_NVM_BLOCK_VINDataIdentifier -> Dsm_Prototype.RP_Nvm_VINDataIdentifier
    connect Nvm_Prototype.PS_NvM_BLOCK_FS_Debug_Status -> Dsm_Prototype.RP_Nvm_FS_Debug_Status
    connect Nvm_Prototype.PS_NvM_BLOCK_VDYData -> Dsm_Prototype.RP_Nvm_VdyBlockOperation
    connect Nvm_Prototype.PS_NvM_Block_EOLCalibrationData -> Dsm_Prototype.RP_Nvm_EOLCalibrationData
    connect Nvm_Prototype.PS_NvM_Block_Fingerprint -> Dsm_Prototype.RP_Nvm_Fingerprint
    connect Nvm_Prototype.PS_NvM_Block_LaneFunctionConfiguration -> Dsm_Prototype.RP_Nvm_LaneFunctionConfiguration
    connect Nvm_Prototype.PS_NvM_Block_PCBASerialNumberDataIdentifier -> Dsm_Prototype.RP_Nvm_PCBASerialNumberDataIdentifier
    connect Nvm_Prototype.PS_NvM_Block_SDACalibrationData -> Dsm_Prototype.RP_Nvm_SDACalibrationData
    connect Nvm_Prototype.PS_NvM_Block_Vehicletype -> Dsm_Prototype.RP_Nvm_Vehicletype
    connect Qsm_Prototype.PP_QsmDsmBlockStartup_Flag -> Dsm_Prototype.RP_Qsm_BlockStartup_FlagOp
    connect Qsm_Prototype.PP_Qsm_DsmBlockPartNumber_Sector -> Dsm_Prototype.RP_Qsm_BlockPartNumber_SectorOp
    connect Qsm_Prototype.PP_Qsm_DsmBlock_EOLModeGateOp -> Dsm_Prototype.RP_Qsm_Block_EOLModeGateOP
    connect Qsm_Prototype.PP_Qsm_DsmSecureUpdateLogOp -> Dsm_Prototype.RP_Qsm_BlockSecureUpdateLogOp
    connect Sdc_Prototype.PP_Sdc_SendInterface_Calibration -> Dsm_Prototype.RP_Sdc_SendInterface_Calibration
    connect Sdc_Prototype.PP_Sdc_SendInterface_Diag -> Dsm_Prototype.RP_Sdc_SendInterface_Diag
    connect Sdc_Prototype.PP_Sdc_SendInterface_Eth -> Dsm_Prototype.RP_Sdc_SendInterface_Eth
    connect Sdc_Prototype.PP_Sdc_SendInterface_SocInfo -> Dsm_Prototype.RP_Sdc_SendInterface_SocInfo
    connect Time_Prototype.CS_Time_GetTimeStampInfo -> Dsm_Prototype.RP_Time_GlobalTime
    connect EcuM_Prototype.shutdownTarget -> Esm_Prototype.RP_EcuM_ShutdownTarget_Switchoff
    connect Esh.PP_Esh_SRI_Esh_ErrorStatusInfo -> Fcu_Prototype.RP_Fcu_SRI_Esh_ErrorStatusInfo
    connect FiM_Prototype.FI_FID_AEB -> Esh.RP_FIM_FunctionInhibition_AEB
    connect FiM_Prototype.FI_FID_ELK -> Esh.RP_FIM_FunctionInhibition_ELK
    connect FiM_Prototype.FI_FID_FAB -> Esh.RP_FIM_FunctionInhibition_FAB
    connect FiM_Prototype.FI_FID_FCW -> Esh.RP_FIM_FunctionInhibition_FCW
    connect FiM_Prototype.FI_FID_HLA -> Esh.RP_FIM_FunctionInhibition_HLA
    connect FiM_Prototype.FI_FID_LDW -> Esh.RP_FIM_FunctionInhibition_LDW
    connect FiM_Prototype.FI_FID_LKA -> Esh.RP_FIM_FunctionInhibition_LKA
    connect FiM_Prototype.FI_FID_TSA -> Esh.RP_FIM_FunctionInhibition_TSA
    connect FiM_Prototype.FI_FID_U17A1F0 -> Esh.RP_FIM_FunctionInhibition_LDW_U17A1F0
    connect Sdc_Prototype.PP_Sdc_SendInterface_Calibration -> Esh.RP_Sdc_SendInterface_Calibration
    connect Sdc_Prototype.PP_Sdc_SendInterface_Diag -> Esh.RP_Sdc_SendInterface_Diag
    connect Time_Prototype.CS_Time_GetTimeStampInfo -> Esh.RP_Time_GlobalTime
    connect Sdc_Prototype.PP_Sdc_SendInterface_SocInfo -> Esm_Prototype.RP_Sdc_SendInterface_SocInfo
    connect Time_Prototype.CS_Time_GetTimeStampInfo -> Esm_Prototype.RP_Time_GlobalTime
    connect Sdc_Prototype.PP_Sdc_Cem_FusionObjectList -> FctAdapter_Prototype.RP_Sdc_Cem_FusionObjectList
    connect Sdc_Prototype.PP_Sdc_Cem_GenObjectList -> FctAdapter_Prototype.RP_Sdc_Cem_GenObjectList
    connect FctAdapter_Prototype.PP_FctAdapter_HeadOutputCustomData -> Fcu_Prototype.RP_FctAdapter_HeadOutputCustomData
    connect VdyAdapter_Prototype.PP_VdyAdapter_VehDyn -> FctAdapter_Prototype.RP_VdyAdapter_VehDyn
    connect Fcu_Prototype.PP_Fcu_DimInputCustomData -> FctAdapter_Prototype.RP_Fcu_DimInputCustomData
    connect Fcu_Prototype.PP_Fcu_DimInputGenericData -> FctAdapter_Prototype.RP_Fcu_DimInputGenericData
    connect Fcu_Prototype.PP_Fcu_FctCtrlData -> FctAdapter_Prototype.RP_Fcu_FctCtrlData
    connect Fcu_Prototype.PP_Fcu_HeadInputCustomData -> FctAdapter_Prototype.RP_Fcu_HeadInputCustomData
    connect Fcu_Prototype.PP_Fcu_HeadInputGenericData -> FctAdapter_Prototype.RP_Fcu_HeadInputGenericData
    connect Fcu_Prototype.PP_Fcu_VehPar -> FctAdapter_Prototype.RP_Fcu_VehPar
    connect Fcu_Prototype.PP_Fcu_VehSig -> FctAdapter_Prototype.RP_Fcu_VehSig
    connect Sdc_Prototype.PP_Sdc_Cem_ARSObjectList -> FctAdapter_Prototype.RP_Sdc_Cem_ARSObjectList
    connect MtsiAdapter_Prototype.ppMeasFreezeData -> FctAdapter_Prototype.RP_MtsiAdapter_MeasFreezeData
    connect MtsiAdapter_Prototype.ppUpdateTaskCycle -> FctAdapter_Prototype.RP_UpdateTaskCycle
    connect Fcu_Prototype.PP_Fcu_VehPar -> LcfAdapter_Prototype.RP_Fcu_VehPar
    connect Fcu_Prototype.PP_Fcu_VehSig -> LcfAdapter_Prototype.RP_Fcu_VehSig
    connect Fcu_Prototype.PP_Fcu_LcfGenericInputData -> LcfAdapter_Prototype.RP_Fcu_LcfGenericInputData
    connect Fcu_Prototype.PP_Fcu_VehPar -> VdyAdapter_Prototype.RP_Fcu_VehPar
    connect Fcu_Prototype.PP_Fcu_VehSig -> VdyAdapter_Prototype.RP_Fcu_VehSig
    connect Fcu_Prototype.PP_Fcu_VehSig -> HlaAdapter_Prototype.RP_Fcu_VehSig
    connect Sdc_Prototype.PP_Sdc_Cem_GenObjectList -> Fcu_Prototype.RP_Sdc_Cem_GenObjectList
    connect LcfAdapter_Prototype.PP_LcfAdapter_LcfSenGenericOutputData -> Fcu_Prototype.RP_LcfAdapter_LcfSenGenericOutputData
    connect Fcu_Prototype.PP_Fcu_BaseCtrlData -> VdyAdapter_Prototype.RP_Fcu_BaseCtrlData
    connect Fcu_Prototype.PP_Fcu_BaseCtrlData -> LcfAdapter_Prototype.RP_Fcu_BaseCtrlData
    connect Fcu_Prototype.PP_Fcu_BaseCtrlData -> HlaAdapter_Prototype.RP_Fcu_BaseCtrlData
    connect LcfAdapter_Prototype.PP_LcfAdapter_LcfVehGenericOutputData -> Fcu_Prototype.RP_LcfAdapter_LcfVehGenericOutputData
    connect Fcu_Prototype.PP_Fcu_HlaInputData -> HlaAdapter_Prototype.RP_Fcu_HlaInputData
    connect HlaAdapter_Prototype.PP_HlaAdapter_OutputData -> Fcu_Prototype.RP_HlaAdapter_OutputData
    connect Nvm_Prototype.PS_NvM_Block_HMISwitchStatus -> Fcu_Prototype.RP_Nvm_HMISwitchStatus
    connect Sdc_Prototype.PP_Sdc_SendInterface_Perception -> Fcu_Prototype.RP_Sdc_SendInterface_Perception
    connect MtsiAdapter_Prototype.ppMeasFreezeData -> HlaAdapter_Prototype.RP_MtsiAdapter_MeasFreezeData
    connect MtsiAdapter_Prototype.ppUpdateTaskCycle -> HlaAdapter_Prototype.RP_UpdateTaskCycle
    connect VdyAdapter_Prototype.PP_VdyAdapter_VehDyn -> HlaAdapter_Prototype.RP_VdyAdapter_VehDynData
    connect Sdc_Prototype.PP_Sdc_Perception_AbdOutputData -> LcfAdapter_Prototype.RP_Sdc_Perception_AbdOutputData
    connect VdyAdapter_Prototype.PP_VdyAdapter_VdyOffsets -> LcfAdapter_Prototype.RP_VdyAdapter_VdyOffsets
    connect VdyAdapter_Prototype.PP_VdyAdapter_VehDyn -> LcfAdapter_Prototype.RP_VdyAdapter_VehDyn
    connect Sdc_Prototype.PP_Sdc_Cem_GenObjectList -> LcfAdapter_Prototype.RP_Sdc_Cem_GenObjectList
    connect MtsiAdapter_Prototype.ppMeasFreezeData -> LcfAdapter_Prototype.RP_MtsiAdapter_MeasFreezeData
    connect MtsiAdapter_Prototype.ppUpdateTaskCycle -> LcfAdapter_Prototype.RP_MtsiAdapter_UpdateTaskCycle
    connect VoltMonI.PP_VoltMonI_SRI_VoltState -> Med_Prototype.RP_VoltMonI_SRI_VoltState
    connect MtsiAdapter_Prototype.ppMtsiTxCallback -> MtsiAdapter_Prototype.rpMtsiTxCallback
    connect MtsiAdapter_Prototype.ppMeasFreezeData -> VdyAdapter_Prototype.RP_MtsiAdapter_MeasFreezeData
    connect MtsiAdapter_Prototype.ppUpdateTaskCycle -> RtaAdapter_C{0..3}.RP_MtsiAdapter_UpdateTaskCycle
    connect MtsiAdapter_Prototype.ppUpdateTaskCycle -> VdyAdapter_Prototype.RP_MtsiAdapter_UpdateTaskCycle
    connect Nvm_Prototype.PS_NvM_BLOCK_VDYData -> VdyAdapter_Prototype.RP_NvM_VdyBlockOperation
    connect VdyAdapter_Prototype.PP_VdyAdapter_VehDyn -> Sdc_Prototype.RP_VdyAdapter_VehDyn
    connect Sdc_Prototype.PP_Sdc_SendInterface_Diag -> Sed_Prototype.RP_Sdc_SendInterface_Diag
    connect Sdc_Prototype.PP_Sdc_SendInterface_Eth -> Sed_Prototype.RP_Sdc_SendInterface_Eth
    connect Sdc_Prototype.PP_Sdc_SendInterface_TSync -> SpiSync_Prototype.RP_Sdc_TimeSync
    connect StbM_Prototype.GlobalTime_Slave_StbMSynchronizedTimeBase_0 -> Time_Prototype.GlobalTime_Slave_StbMSynchronizedTimeBase_0
  system ECU: category=ECU_EXTRACT, system-version=1.0.0
    system mapping DummyEcuExtractSysMapping
    root-software-compositions:
      root sw composition prototype TopLevelCompositionPrototype: flat-map=FlatMap, software-composition=TopLevelComposition
  flat map FlatMap
    2430 x flat instance descriptor:
      AebDs_0: upstream-reference=TopLevelComposition.AebDs, ecu-extract-reference=TopLevelCompositionPrototype.AebDs
      RP_Cpr_Chassis_Data_1: upstream-reference=TopLevelComposition.AebDs.RP_Cpr_Chassis_Data, ecu-extract-reference=TopLevelCompositionPrototype.AebDs.RP_Cpr_Chassis_Data
      AdsUDLCStatus_2: upstream-reference=TopLevelComposition.AebDs.RP_Cpr_Chassis_Data.AdsUDLCStatus, ecu-extract-reference=TopLevelCompositionPrototype.AebDs.RP_Cpr_Chassis_Data.AdsUDLCStatus
      AdsUDLCStatus_Status_3: upstream-reference=TopLevelComposition.AebDs.RP_Cpr_Chassis_Data.AdsUDLCStatus_Status, ecu-extract-reference=TopLevelCompositionPrototype.AebDs.RP_Cpr_Chassis_Data.AdsUDLCStatus_Status
      BrakePressureSimulator_4: upstream-reference=TopLevelComposition.AebDs.RP_Cpr_Chassis_Data.BrakePressureSimulator, ecu-extract-reference=TopLevelCompositionPrototype.AebDs.RP_Cpr_Chassis_Data.BrakePressureSimulator
      BrakePressureSimulator_Status_5: upstream-reference=TopLevelComposition.AebDs.RP_Cpr_Chassis_Data.BrakePressureSimulator_Status, ecu-extract-reference=TopLevelCompositionPrototype.AebDs.RP_Cpr_Chassis_Data.BrakePressureSimulator_Status
      EPS_APA_EpasFAILED_6: upstream-reference=TopLevelComposition.AebDs.RP_Cpr_Chassis_Data.EPS_APA_EpasFAILED, ecu-extract-reference=TopLevelCompositionPrototype.AebDs.RP_Cpr_Chassis_Data.EPS_APA_EpasFAILED
      EPS_APA_EpasFAILED_Status_7: upstream-reference=TopLevelComposition.AebDs.RP_Cpr_Chassis_Data.EPS_APA_EpasFAILED_Status, ecu-extract-reference=TopLevelCompositionPrototype.AebDs.RP_Cpr_Chassis_Data.EPS_APA_EpasFAILED_Status
      EPS_ActualMotorTorq_8: upstream-reference=TopLevelComposition.AebDs.RP_Cpr_Chassis_Data.EPS_ActualMotorTorq, ecu-extract-reference=TopLevelCompositionPrototype.AebDs.RP_Cpr_Chassis_Data.EPS_ActualMotorTorq
      EPS_ActualMotorTorq_Status_9: upstream-reference=TopLevelComposition.AebDs.RP_Cpr_Chassis_Data.EPS_ActualMotorTorq_Status, ecu-extract-reference=TopLevelCompositionPrototype.AebDs.RP_Cpr_Chassis_Data.EPS_ActualMotorTorq_Status
      EPS_ActualTorsionBarTorq_10: upstream-reference=TopLevelComposition.AebDs.RP_Cpr_Chassis_Data.EPS_ActualTorsionBarTorq, ecu-extract-reference=TopLevelCompositionPrototype.AebDs.RP_Cpr_Chassis_Data.EPS_ActualTorsionBarTorq
      EPS_ActualTorsionBarTorq_Status_11: upstream-reference=TopLevelComposition.AebDs.RP_Cpr_Chassis_Data.EPS_ActualTorsionBarTorq_Status, ecu-extract-reference=TopLevelCompositionPrototype.AebDs.RP_Cpr_Chassis_Data.EPS_ActualTorsionBarTorq_Status
      EPS_MeasuredTorsionBarTorqValid_12: upstream-reference=TopLevelComposition.AebDs.RP_Cpr_Chassis_Data.EPS_MeasuredTorsionBarTorqValid, ecu-extract-reference=TopLevelCompositionPrototype.AebDs.RP_Cpr_Chassis_Data.EPS_MeasuredTorsionBarTorqValid
      EPS_Pinionang_Valid_13: upstream-reference=TopLevelComposition.AebDs.RP_Cpr_Chassis_Data.EPS_Pinionang_Valid, ecu-extract-reference=TopLevelCompositionPrototype.AebDs.RP_Cpr_Chassis_Data.EPS_Pinionang_Valid
      EPS_fault_state_14: upstream-reference=TopLevelComposition.AebDs.RP_Cpr_Chassis_Data.EPS_fault_state, ecu-extract-reference=TopLevelCompositionPrototype.AebDs.RP_Cpr_Chassis_Data.EPS_fault_state
      EPS_fault_state_Status_15: upstream-reference=TopLevelComposition.AebDs.RP_Cpr_Chassis_Data.EPS_fault_state_Status, ecu-extract-reference=TopLevelCompositionPrototype.AebDs.RP_Cpr_Chassis_Data.EPS_fault_state_Status
      ESP_LatAccelValid_16: upstream-reference=TopLevelComposition.AebDs.RP_Cpr_Chassis_Data.ESP_LatAccelValid, ecu-extract-reference=TopLevelCompositionPrototype.AebDs.RP_Cpr_Chassis_Data.ESP_LatAccelValid
      ESP_LongAccelValid_17: upstream-reference=TopLevelComposition.AebDs.RP_Cpr_Chassis_Data.ESP_LongAccelValid, ecu-extract-reference=TopLevelCompositionPrototype.AebDs.RP_Cpr_Chassis_Data.ESP_LongAccelValid
      ESP_YawRateValid_18: upstream-reference=TopLevelComposition.AebDs.RP_Cpr_Chassis_Data.ESP_YawRateValid, ecu-extract-reference=TopLevelCompositionPrototype.AebDs.RP_Cpr_Chassis_Data.ESP_YawRateValid
      EpsConcussAvailabilityStatus_19: upstream-reference=TopLevelComposition.AebDs.RP_Cpr_Chassis_Data.EpsConcussAvailabilityStatus, ecu-extract-reference=TopLevelCompositionPrototype.AebDs.RP_Cpr_Chassis_Data.EpsConcussAvailabilityStatus
      EpsConcussAvailabilityStatus_Status_20: upstream-reference=TopLevelComposition.AebDs.RP_Cpr_Chassis_Data.EpsConcussAvailabilityStatus_Status, ecu-extract-reference=TopLevelCompositionPrototype.AebDs.RP_Cpr_Chassis_Data.EpsConcussAvailabilityStatus_Status
      EpsFaild_21: upstream-reference=TopLevelComposition.AebDs.RP_Cpr_Chassis_Data.EpsFaild, ecu-extract-reference=TopLevelCompositionPrototype.AebDs.RP_Cpr_Chassis_Data.EpsFaild
      EpsFaild_Status_22: upstream-reference=TopLevelComposition.AebDs.RP_Cpr_Chassis_Data.EpsFaild_Status, ecu-extract-reference=TopLevelCompositionPrototype.AebDs.RP_Cpr_Chassis_Data.EpsFaild_Status
      EpsIACCabortreason_23: upstream-reference=TopLevelComposition.AebDs.RP_Cpr_Chassis_Data.EpsIACCabortreason, ecu-extract-reference=TopLevelCompositionPrototype.AebDs.RP_Cpr_Chassis_Data.EpsIACCabortreason
      EpsIACCabortreason_Status_24: upstream-reference=TopLevelComposition.AebDs.RP_Cpr_Chassis_Data.EpsIACCabortreason_Status, ecu-extract-reference=TopLevelCompositionPrototype.AebDs.RP_Cpr_Chassis_Data.EpsIACCabortreason_Status
      EpsLatCtrlActive_25: upstream-reference=TopLevelComposition.AebDs.RP_Cpr_Chassis_Data.EpsLatCtrlActive, ecu-extract-reference=TopLevelCompositionPrototype.AebDs.RP_Cpr_Chassis_Data.EpsLatCtrlActive
      EpsLatCtrlActive_Status_26: upstream-reference=TopLevelComposition.AebDs.RP_Cpr_Chassis_Data.EpsLatCtrlActive_Status, ecu-extract-reference=TopLevelCompositionPrototype.AebDs.RP_Cpr_Chassis_Data.EpsLatCtrlActive_Status
      EpsLatCtrlAvailabilityStatus_27: upstream-reference=TopLevelComposition.AebDs.RP_Cpr_Chassis_Data.EpsLatCtrlAvailabilityStatus, ecu-extract-reference=TopLevelCompositionPrototype.AebDs.RP_Cpr_Chassis_Data.EpsLatCtrlAvailabilityStatus
      EpsLatCtrlAvailabilityStatus_Status_28: upstream-reference=TopLevelComposition.AebDs.RP_Cpr_Chassis_Data.EpsLatCtrlAvailabilityStatus_Status, ecu-extract-reference=TopLevelCompositionPrototype.AebDs.RP_Cpr_Chassis_Data.EpsLatCtrlAvailabilityStatus_Status
      EpsMeasuredTorsionBarTorq_Status_29: upstream-reference=TopLevelComposition.AebDs.RP_Cpr_Chassis_Data.EpsMeasuredTorsionBarTorq_Status, ecu-extract-reference=TopLevelCompositionPrototype.AebDs.RP_Cpr_Chassis_Data.EpsMeasuredTorsionBarTorq_Status
      EpsMeasuredTorsionBarTorque_30: upstream-reference=TopLevelComposition.AebDs.RP_Cpr_Chassis_Data.EpsMeasuredTorsionBarTorque, ecu-extract-reference=TopLevelCompositionPrototype.AebDs.RP_Cpr_Chassis_Data.EpsMeasuredTorsionBarTorque
      EpsMeasuredTorsionBarTorque_Status_31: upstream-reference=TopLevelComposition.AebDs.RP_Cpr_Chassis_Data.EpsMeasuredTorsionBarTorque_Status, ecu-extract-reference=TopLevelCompositionPrototype.AebDs.RP_Cpr_Chassis_Data.EpsMeasuredTorsionBarTorque_Status
      EpsPinionang_32: upstream-reference=TopLevelComposition.AebDs.RP_Cpr_Chassis_Data.EpsPinionang, ecu-extract-reference=TopLevelCompositionPrototype.AebDs.RP_Cpr_Chassis_Data.EpsPinionang
      EpsPinionang_Status_33: upstream-reference=TopLevelComposition.AebDs.RP_Cpr_Chassis_Data.EpsPinionang_Status, ecu-extract-reference=TopLevelCompositionPrototype.AebDs.RP_Cpr_Chassis_Data.EpsPinionang_Status
      EpsSasCalSts_34: upstream-reference=TopLevelComposition.AebDs.RP_Cpr_Chassis_Data.EpsSasCalSts, ecu-extract-reference=TopLevelCompositionPrototype.AebDs.RP_Cpr_Chassis_Data.EpsSasCalSts
      EpsSasCalSts_Status_35: upstream-reference=TopLevelComposition.AebDs.RP_Cpr_Chassis_Data.EpsSasCalSts_Status, ecu-extract-reference=TopLevelCompositionPrototype.AebDs.RP_Cpr_Chassis_Data.EpsSasCalSts_Status
      EpsSasSteerAg_36: upstream-reference=TopLevelComposition.AebDs.RP_Cpr_Chassis_Data.EpsSasSteerAg, ecu-extract-reference=TopLevelCompositionPrototype.AebDs.RP_Cpr_Chassis_Data.EpsSasSteerAg
      EpsSasSteerAgVld_37: upstream-reference=TopLevelComposition.AebDs.RP_Cpr_Chassis_Data.EpsSasSteerAgVld, ecu-extract-reference=TopLevelCompositionPrototype.AebDs.RP_Cpr_Chassis_Data.EpsSasSteerAgVld
      EpsSasSteerAg_Status_38: upstream-reference=TopLevelComposition.AebDs.RP_Cpr_Chassis_Data.EpsSasSteerAg_Status, ecu-extract-reference=TopLevelCompositionPrototype.AebDs.RP_Cpr_Chassis_Data.EpsSasSteerAg_Status
      EpsSteerAgRate_39: upstream-reference=TopLevelComposition.AebDs.RP_Cpr_Chassis_Data.EpsSteerAgRate, ecu-extract-reference=TopLevelCompositionPrototype.AebDs.RP_Cpr_Chassis_Data.EpsSteerAgRate
      EpsSteerAgRate_Status_40: upstream-reference=TopLevelComposition.AebDs.RP_Cpr_Chassis_Data.EpsSteerAgRate_Status, ecu-extract-reference=TopLevelCompositionPrototype.AebDs.RP_Cpr_Chassis_Data.EpsSteerAgRate_Status
      EpsSteerAgSensFilr_41: upstream-reference=TopLevelComposition.AebDs.RP_Cpr_Chassis_Data.EpsSteerAgSensFilr, ecu-extract-reference=TopLevelCompositionPrototype.AebDs.RP_Cpr_Chassis_Data.EpsSteerAgSensFilr
      EpsSteerAgSensFilr_Status_42: upstream-reference=TopLevelComposition.AebDs.RP_Cpr_Chassis_Data.EpsSteerAgSensFilr_Status, ecu-extract-reference=TopLevelCompositionPrototype.AebDs.RP_Cpr_Chassis_Data.EpsSteerAgSensFilr_Status
      EspABAactive_43: upstream-reference=TopLevelComposition.AebDs.RP_Cpr_Chassis_Data.EspABAactive, ecu-extract-reference=TopLevelCompositionPrototype.AebDs.RP_Cpr_Chassis_Data.EspABAactive
      EspABAactive_Status_44: upstream-reference=TopLevelComposition.AebDs.RP_Cpr_Chassis_Data.EspABAactive_Status, ecu-extract-reference=TopLevelCompositionPrototype.AebDs.RP_Cpr_Chassis_Data.EspABAactive_Status
      EspABAavailable_45: upstream-reference=TopLevelComposition.AebDs.RP_Cpr_Chassis_Data.EspABAavailable, ecu-extract-reference=TopLevelCompositionPrototype.AebDs.RP_Cpr_Chassis_Data.EspABAavailable
      EspABAavailable_Status_46: upstream-reference=TopLevelComposition.AebDs.RP_Cpr_Chassis_Data.EspABAavailable_Status, ecu-extract-reference=TopLevelCompositionPrototype.AebDs.RP_Cpr_Chassis_Data.EspABAavailable_Status
      EspAEBAvailable_47: upstream-reference=TopLevelComposition.AebDs.RP_Cpr_Chassis_Data.EspAEBAvailable, ecu-extract-reference=TopLevelCompositionPrototype.AebDs.RP_Cpr_Chassis_Data.EspAEBAvailable
      EspAEBAvailable_Status_48: upstream-reference=TopLevelComposition.AebDs.RP_Cpr_Chassis_Data.EspAEBAvailable_Status, ecu-extract-reference=TopLevelCompositionPrototype.AebDs.RP_Cpr_Chassis_Data.EspAEBAvailable_Status
      EspAEBdecActive_49: upstream-reference=TopLevelComposition.AebDs.RP_Cpr_Chassis_Data.EspAEBdecActive, ecu-extract-reference=TopLevelCompositionPrototype.AebDs.RP_Cpr_Chassis_Data.EspAEBdecActive
      EspAEBdecActive_Status_50: upstream-reference=TopLevelComposition.AebDs.RP_Cpr_Chassis_Data.EspAEBdecActive_Status, ecu-extract-reference=TopLevelCompositionPrototype.AebDs.RP_Cpr_Chassis_Data.EspAEBdecActive_Status
      EspAWBactive_51: upstream-reference=TopLevelComposition.AebDs.RP_Cpr_Chassis_Data.EspAWBactive, ecu-extract-reference=TopLevelCompositionPrototype.AebDs.RP_Cpr_Chassis_Data.EspAWBactive
      EspAWBactive_Status_52: upstream-reference=TopLevelComposition.AebDs.RP_Cpr_Chassis_Data.EspAWBactive_Status, ecu-extract-reference=TopLevelCompositionPrototype.AebDs.RP_Cpr_Chassis_Data.EspAWBactive_Status
      EspAWBavailable_53: upstream-reference=TopLevelComposition.AebDs.RP_Cpr_Chassis_Data.EspAWBavailable, ecu-extract-reference=TopLevelCompositionPrototype.AebDs.RP_Cpr_Chassis_Data.EspAWBavailable
      EspAWBavailable_Status_54: upstream-reference=TopLevelComposition.AebDs.RP_Cpr_Chassis_Data.EspAWBavailable_Status, ecu-extract-reference=TopLevelCompositionPrototype.AebDs.RP_Cpr_Chassis_Data.EspAWBavailable_Status
      EspAbsActv_55: upstream-reference=TopLevelComposition.AebDs.RP_Cpr_Chassis_Data.EspAbsActv, ecu-extract-reference=TopLevelCompositionPrototype.AebDs.RP_Cpr_Chassis_Data.EspAbsActv
      EspAbsActv_Status_56: upstream-reference=TopLevelComposition.AebDs.RP_Cpr_Chassis_Data.EspAbsActv_Status, ecu-extract-reference=TopLevelCompositionPrototype.AebDs.RP_Cpr_Chassis_Data.EspAbsActv_Status
      EspAbsFailr_57: upstream-reference=TopLevelComposition.AebDs.RP_Cpr_Chassis_Data.EspAbsFailr, ecu-extract-reference=TopLevelCompositionPrototype.AebDs.RP_Cpr_Chassis_Data.EspAbsFailr
      EspAbsFailr_Status_58: upstream-reference=TopLevelComposition.AebDs.RP_Cpr_Chassis_Data.EspAbsFailr_Status, ecu-extract-reference=TopLevelCompositionPrototype.AebDs.RP_Cpr_Chassis_Data.EspAbsFailr_Status
      EspActvSts_59: upstream-reference=TopLevelComposition.AebDs.RP_Cpr_Chassis_Data.EspActvSts, ecu-extract-reference=TopLevelCompositionPrototype.AebDs.RP_Cpr_Chassis_Data.EspActvSts
      EspActvSts_Status_60: upstream-reference=TopLevelComposition.AebDs.RP_Cpr_Chassis_Data.EspActvSts_Status, ecu-extract-reference=TopLevelCompositionPrototype.AebDs.RP_Cpr_Chassis_Data.EspActvSts_Status
      EspEbdFailr_61: upstream-reference=TopLevelComposition.AebDs.RP_Cpr_Chassis_Data.EspEbdFailr, ecu-extract-reference=TopLevelCompositionPrototype.AebDs.RP_Cpr_Chassis_Data.EspEbdFailr
      EspEbdFailr_Status_62: upstream-reference=TopLevelComposition.AebDs.RP_Cpr_Chassis_Data.EspEbdFailr_Status, ecu-extract-reference=TopLevelCompositionPrototype.AebDs.RP_Cpr_Chassis_Data.EspEbdFailr_Status
      EspLatAccel_63: upstream-reference=TopLevelComposition.AebDs.RP_Cpr_Chassis_Data.EspLatAccel, ecu-extract-reference=TopLevelCompositionPrototype.AebDs.RP_Cpr_Chassis_Data.EspLatAccel
      EspLatAccel_Status_64: upstream-reference=TopLevelComposition.AebDs.RP_Cpr_Chassis_Data.EspLatAccel_Status, ecu-extract-reference=TopLevelCompositionPrototype.AebDs.RP_Cpr_Chassis_Data.EspLatAccel_Status
      EspLongAccel_65: upstream-reference=TopLevelComposition.AebDs.RP_Cpr_Chassis_Data.EspLongAccel, ecu-extract-reference=TopLevelCompositionPrototype.AebDs.RP_Cpr_Chassis_Data.EspLongAccel
      EspLongAccel_Status_66: upstream-reference=TopLevelComposition.AebDs.RP_Cpr_Chassis_Data.EspLongAccel_Status, ecu-extract-reference=TopLevelCompositionPrototype.AebDs.RP_Cpr_Chassis_Data.EspLongAccel_Status
      EspPrefillActive_67: upstream-reference=TopLevelComposition.AebDs.RP_Cpr_Chassis_Data.EspPrefillActive, ecu-extract-reference=TopLevelCompositionPrototype.AebDs.RP_Cpr_Chassis_Data.EspPrefillActive
      EspPrefillActive_Status_68: upstream-reference=TopLevelComposition.AebDs.RP_Cpr_Chassis_Data.EspPrefillActive_Status, ecu-extract-reference=TopLevelCompositionPrototype.AebDs.RP_Cpr_Chassis_Data.EspPrefillActive_Status
      EspPrefillAvailable_69: upstream-reference=TopLevelComposition.AebDs.RP_Cpr_Chassis_Data.EspPrefillAvailable, ecu-extract-reference=TopLevelCompositionPrototype.AebDs.RP_Cpr_Chassis_Data.EspPrefillAvailable
      EspPrefillAvailable_Status_70: upstream-reference=TopLevelComposition.AebDs.RP_Cpr_Chassis_Data.EspPrefillAvailable_Status, ecu-extract-reference=TopLevelCompositionPrototype.AebDs.RP_Cpr_Chassis_Data.EspPrefillAvailable_Status
      EspTcsActvSts_71: upstream-reference=TopLevelComposition.AebDs.RP_Cpr_Chassis_Data.EspTcsActvSts, ecu-extract-reference=TopLevelCompositionPrototype.AebDs.RP_Cpr_Chassis_Data.EspTcsActvSts
      EspTcsActvSts_Status_72: upstream-reference=TopLevelComposition.AebDs.RP_Cpr_Chassis_Data.EspTcsActvSts_Status, ecu-extract-reference=TopLevelCompositionPrototype.AebDs.RP_Cpr_Chassis_Data.EspTcsActvSts_Status
      EspTcsFailr_73: upstream-reference=TopLevelComposition.AebDs.RP_Cpr_Chassis_Data.EspTcsFailr, ecu-extract-reference=TopLevelCompositionPrototype.AebDs.RP_Cpr_Chassis_Data.EspTcsFailr
      EspTcsFailr_Status_74: upstream-reference=TopLevelComposition.AebDs.RP_Cpr_Chassis_Data.EspTcsFailr_Status, ecu-extract-reference=TopLevelCompositionPrototype.AebDs.RP_Cpr_Chassis_Data.EspTcsFailr_Status
      EspVdcActvSts_75: upstream-reference=TopLevelComposition.AebDs.RP_Cpr_Chassis_Data.EspVdcActvSts, ecu-extract-reference=TopLevelCompositionPrototype.AebDs.RP_Cpr_Chassis_Data.EspVdcActvSts
      EspVdcActvSts_Status_76: upstream-reference=TopLevelComposition.AebDs.RP_Cpr_Chassis_Data.EspVdcActvSts_Status, ecu-extract-reference=TopLevelCompositionPrototype.AebDs.RP_Cpr_Chassis_Data.EspVdcActvSts_Status
      EspVehSpd_77: upstream-reference=TopLevelComposition.AebDs.RP_Cpr_Chassis_Data.EspVehSpd, ecu-extract-reference=TopLevelCompositionPrototype.AebDs.RP_Cpr_Chassis_Data.EspVehSpd
      EspVehSpdVld_78: upstream-reference=TopLevelComposition.AebDs.RP_Cpr_Chassis_Data.EspVehSpdVld, ecu-extract-reference=TopLevelCompositionPrototype.AebDs.RP_Cpr_Chassis_Data.EspVehSpdVld
      EspVehSpd_Status_79: upstream-reference=TopLevelComposition.AebDs.RP_Cpr_Chassis_Data.EspVehSpd_Status, ecu-extract-reference=TopLevelCompositionPrototype.AebDs.RP_Cpr_Chassis_Data.EspVehSpd_Status
      EspYawRate_80: upstream-reference=TopLevelComposition.AebDs.RP_Cpr_Chassis_Data.EspYawRate, ecu-extract-reference=TopLevelCompositionPrototype.AebDs.RP_Cpr_Chassis_Data.EspYawRate
      EspYawRate_Status_81: upstream-reference=TopLevelComposition.AebDs.RP_Cpr_Chassis_Data.EspYawRate_Status, ecu-extract-reference=TopLevelCompositionPrototype.AebDs.RP_Cpr_Chassis_Data.EspYawRate_Status
      IBCU_PFSBrakePressureValid_82: upstream-reference=TopLevelComposition.AebDs.RP_Cpr_Chassis_Data.IBCU_PFSBrakePressureValid, ecu-extract-reference=TopLevelCompositionPrototype.AebDs.RP_Cpr_Chassis_Data.IBCU_PFSBrakePressureValid
      IbBrkPedlStsGb_83: upstream-reference=TopLevelComposition.AebDs.RP_Cpr_Chassis_Data.IbBrkPedlStsGb, ecu-extract-reference=TopLevelCompositionPrototype.AebDs.RP_Cpr_Chassis_Data.IbBrkPedlStsGb
      IbBrkPedlStsGbVld_84: upstream-reference=TopLevelComposition.AebDs.RP_Cpr_Chassis_Data.IbBrkPedlStsGbVld, ecu-extract-reference=TopLevelCompositionPrototype.AebDs.RP_Cpr_Chassis_Data.IbBrkPedlStsGbVld
      IbBrkPedlStsGb_Status_85: upstream-reference=TopLevelComposition.AebDs.RP_Cpr_Chassis_Data.IbBrkPedlStsGb_Status, ecu-extract-reference=TopLevelCompositionPrototype.AebDs.RP_Cpr_Chassis_Data.IbBrkPedlStsGb_Status
      IbBrkPedlTrvlDrvr_86: upstream-reference=TopLevelComposition.AebDs.RP_Cpr_Chassis_Data.IbBrkPedlTrvlDrvr, ecu-extract-reference=TopLevelCompositionPrototype.AebDs.RP_Cpr_Chassis_Data.IbBrkPedlTrvlDrvr
      IbBrkPedlTrvlDrvrVld_87: upstream-reference=TopLevelComposition.AebDs.RP_Cpr_Chassis_Data.IbBrkPedlTrvlDrvrVld, ecu-extract-reference=TopLevelCompositionPrototype.AebDs.RP_Cpr_Chassis_Data.IbBrkPedlTrvlDrvrVld
      PlungerBrakePressure_88: upstream-reference=TopLevelComposition.AebDs.RP_Cpr_Chassis_Data.PlungerBrakePressure, ecu-extract-reference=TopLevelCompositionPrototype.AebDs.RP_Cpr_Chassis_Data.PlungerBrakePressure
      PlungerBrakePressure_Status_89: upstream-reference=TopLevelComposition.AebDs.RP_Cpr_Chassis_Data.PlungerBrakePressure_Status, ecu-extract-reference=TopLevelCompositionPrototype.AebDs.RP_Cpr_Chassis_Data.PlungerBrakePressure_Status
      VcuAccrPedlPosn_90: upstream-reference=TopLevelComposition.AebDs.RP_Cpr_Chassis_Data.VcuAccrPedlPosn, ecu-extract-reference=TopLevelCompositionPrototype.AebDs.RP_Cpr_Chassis_Data.VcuAccrPedlPosn
      VcuAccrPedlPosnVld_91: upstream-reference=TopLevelComposition.AebDs.RP_Cpr_Chassis_Data.VcuAccrPedlPosnVld, ecu-extract-reference=TopLevelCompositionPrototype.AebDs.RP_Cpr_Chassis_Data.VcuAccrPedlPosnVld
      VcuAccrPedlPosn_Status_92: upstream-reference=TopLevelComposition.AebDs.RP_Cpr_Chassis_Data.VcuAccrPedlPosn_Status, ecu-extract-reference=TopLevelCompositionPrototype.AebDs.RP_Cpr_Chassis_Data.VcuAccrPedlPosn_Status
      VcuGearPosn_93: upstream-reference=TopLevelComposition.AebDs.RP_Cpr_Chassis_Data.VcuGearPosn, ecu-extract-reference=TopLevelCompositionPrototype.AebDs.RP_Cpr_Chassis_Data.VcuGearPosn
      VcuGearPosn_Status_94: upstream-reference=TopLevelComposition.AebDs.RP_Cpr_Chassis_Data.VcuGearPosn_Status, ecu-extract-reference=TopLevelCompositionPrototype.AebDs.RP_Cpr_Chassis_Data.VcuGearPosn_Status
      VcuVehGearPosnVld_95: upstream-reference=TopLevelComposition.AebDs.RP_Cpr_Chassis_Data.VcuVehGearPosnVld, ecu-extract-reference=TopLevelCompositionPrototype.AebDs.RP_Cpr_Chassis_Data.VcuVehGearPosnVld
      RP_FctAdapter_HeadOutputCustomData_96: upstream-reference=TopLevelComposition.AebDs.RP_FctAdapter_HeadOutputCustomData, ecu-extract-reference=TopLevelCompositionPrototype.AebDs.RP_FctAdapter_HeadOutputCustomData
      HeadOutputCustomData_97: upstream-reference=TopLevelComposition.AebDs.RP_FctAdapter_HeadOutputCustomData.HeadOutputCustomData, ecu-extract-reference=TopLevelCompositionPrototype.AebDs.RP_FctAdapter_HeadOutputCustomData.HeadOutputCustomData
      RP_Fcu_Aeb_Data_98: upstream-reference=TopLevelComposition.AebDs.RP_Fcu_Aeb_Data, ecu-extract-reference=TopLevelCompositionPrototype.AebDs.RP_Fcu_Aeb_Data
      Cps_SignalPhyData_FC_ABAActive_99: upstream-reference=TopLevelComposition.AebDs.RP_Fcu_Aeb_Data.Cps_SignalPhyData_FC_ABAActive, ecu-extract-reference=TopLevelCompositionPrototype.AebDs.RP_Fcu_Aeb_Data.Cps_SignalPhyData_FC_ABAActive
      Cps_SignalPhyData_FC_ABAlevel_100: upstream-reference=TopLevelComposition.AebDs.RP_Fcu_Aeb_Data.Cps_SignalPhyData_FC_ABAlevel, ecu-extract-reference=TopLevelCompositionPrototype.AebDs.RP_Fcu_Aeb_Data.Cps_SignalPhyData_FC_ABAlevel
      Cps_SignalPhyData_FC_AEBActive_101: upstream-reference=TopLevelComposition.AebDs.RP_Fcu_Aeb_Data.Cps_SignalPhyData_FC_AEBActive, ecu-extract-reference=TopLevelCompositionPrototype.AebDs.RP_Fcu_Aeb_Data.Cps_SignalPhyData_FC_AEBActive
      Cps_SignalPhyData_FC_AEBCtrlType_102: upstream-reference=TopLevelComposition.AebDs.RP_Fcu_Aeb_Data.Cps_SignalPhyData_FC_AEBCtrlType, ecu-extract-reference=TopLevelCompositionPrototype.AebDs.RP_Fcu_Aeb_Data.Cps_SignalPhyData_FC_AEBCtrlType
      Cps_SignalPhyData_FC_AEBEnable_103: upstream-reference=TopLevelComposition.AebDs.RP_Fcu_Aeb_Data.Cps_SignalPhyData_FC_AEBEnable, ecu-extract-reference=TopLevelCompositionPrototype.AebDs.RP_Fcu_Aeb_Data.Cps_SignalPhyData_FC_AEBEnable
      Cps_SignalPhyData_FC_AEBStatus_104: upstream-reference=TopLevelComposition.AebDs.RP_Fcu_Aeb_Data.Cps_SignalPhyData_FC_AEBStatus, ecu-extract-reference=TopLevelCompositionPrototype.AebDs.RP_Fcu_Aeb_Data.Cps_SignalPhyData_FC_AEBStatus
      Cps_SignalPhyData_FC_AEBTargetAx_105: upstream-reference=TopLevelComposition.AebDs.RP_Fcu_Aeb_Data.Cps_SignalPhyData_FC_AEBTargetAx, ecu-extract-reference=TopLevelCompositionPrototype.AebDs.RP_Fcu_Aeb_Data.Cps_SignalPhyData_FC_AEBTargetAx
      Cps_SignalPhyData_FC_AEBTargetAy_106: upstream-reference=TopLevelComposition.AebDs.RP_Fcu_Aeb_Data.Cps_SignalPhyData_FC_AEBTargetAy, ecu-extract-reference=TopLevelCompositionPrototype.AebDs.RP_Fcu_Aeb_Data.Cps_SignalPhyData_FC_AEBTargetAy
      Cps_SignalPhyData_FC_AEBTargetDeceleration_107: upstream-reference=TopLevelComposition.AebDs.RP_Fcu_Aeb_Data.Cps_SignalPhyData_FC_AEBTargetDeceleration, ecu-extract-reference=TopLevelCompositionPrototype.AebDs.RP_Fcu_Aeb_Data.Cps_SignalPhyData_FC_AEBTargetDeceleration
      Cps_SignalPhyData_FC_AEBTargetDetection_108: upstream-reference=TopLevelComposition.AebDs.RP_Fcu_Aeb_Data.Cps_SignalPhyData_FC_AEBTargetDetection, ecu-extract-reference=TopLevelCompositionPrototype.AebDs.RP_Fcu_Aeb_Data.Cps_SignalPhyData_FC_AEBTargetDetection
      Cps_SignalPhyData_FC_AEBTargetLatRange_109: upstream-reference=TopLevelComposition.AebDs.RP_Fcu_Aeb_Data.Cps_SignalPhyData_FC_AEBTargetLatRange, ecu-extract-reference=TopLevelCompositionPrototype.AebDs.RP_Fcu_Aeb_Data.Cps_SignalPhyData_FC_AEBTargetLatRange
      Cps_SignalPhyData_FC_AEBTargetLatRelSpeed_110: upstream-reference=TopLevelComposition.AebDs.RP_Fcu_Aeb_Data.Cps_SignalPhyData_FC_AEBTargetLatRelSpeed, ecu-extract-reference=TopLevelCompositionPrototype.AebDs.RP_Fcu_Aeb_Data.Cps_SignalPhyData_FC_AEBTargetLatRelSpeed
      Cps_SignalPhyData_FC_AEBTargetLngRange_111: upstream-reference=TopLevelComposition.AebDs.RP_Fcu_Aeb_Data.Cps_SignalPhyData_FC_AEBTargetLngRange, ecu-extract-reference=TopLevelCompositionPrototype.AebDs.RP_Fcu_Aeb_Data.Cps_SignalPhyData_FC_AEBTargetLngRange
      Cps_SignalPhyData_FC_AEBTargetProb_112: upstream-reference=TopLevelComposition.AebDs.RP_Fcu_Aeb_Data.Cps_SignalPhyData_FC_AEBTargetProb, ecu-extract-reference=TopLevelCompositionPrototype.AebDs.RP_Fcu_Aeb_Data.Cps_SignalPhyData_FC_AEBTargetProb
      Cps_SignalPhyData_FC_AEBTargetRelSpeed_113: upstream-reference=TopLevelComposition.AebDs.RP_Fcu_Aeb_Data.Cps_SignalPhyData_FC_AEBTargetRelSpeed, ecu-extract-reference=TopLevelCompositionPrototype.AebDs.RP_Fcu_Aeb_Data.Cps_SignalPhyData_FC_AEBTargetRelSpeed
      Cps_SignalPhyData_FC_AEBTargetType_114: upstream-reference=TopLevelComposition.AebDs.RP_Fcu_Aeb_Data.Cps_SignalPhyData_FC_AEBTargetType, ecu-extract-reference=TopLevelCompositionPrototype.AebDs.RP_Fcu_Aeb_Data.Cps_SignalPhyData_FC_AEBTargetType
      Cps_SignalPhyData_FC_AEBTargetmode_115: upstream-reference=TopLevelComposition.AebDs.RP_Fcu_Aeb_Data.Cps_SignalPhyData_FC_AEBTargetmode, ecu-extract-reference=TopLevelCompositionPrototype.AebDs.RP_Fcu_Aeb_Data.Cps_SignalPhyData_FC_AEBTargetmode
      Cps_SignalPhyData_FC_AEBTextInfo_116: upstream-reference=TopLevelComposition.AebDs.RP_Fcu_Aeb_Data.Cps_SignalPhyData_FC_AEBTextInfo, ecu-extract-reference=TopLevelCompositionPrototype.AebDs.RP_Fcu_Aeb_Data.Cps_SignalPhyData_FC_AEBTextInfo
      Cps_SignalPhyData_FC_AEBVehilceHoldReq_117: upstream-reference=TopLevelComposition.AebDs.RP_Fcu_Aeb_Data.Cps_SignalPhyData_FC_AEBVehilceHoldReq, ecu-extract-reference=TopLevelCompositionPrototype.AebDs.RP_Fcu_Aeb_Data.Cps_SignalPhyData_FC_AEBVehilceHoldReq
      Cps_SignalPhyData_FC_AWBActive_118: upstream-reference=TopLevelComposition.AebDs.RP_Fcu_Aeb_Data.Cps_SignalPhyData_FC_AWBActive, ecu-extract-reference=TopLevelCompositionPrototype.AebDs.RP_Fcu_Aeb_Data.Cps_SignalPhyData_FC_AWBActive
      Cps_SignalPhyData_FC_AWBlevel_119: upstream-reference=TopLevelComposition.AebDs.RP_Fcu_Aeb_Data.Cps_SignalPhyData_FC_AWBlevel, ecu-extract-reference=TopLevelCompositionPrototype.AebDs.RP_Fcu_Aeb_Data.Cps_SignalPhyData_FC_AWBlevel
      Cps_SignalPhyData_FC_FCWActive_120: upstream-reference=TopLevelComposition.AebDs.RP_Fcu_Aeb_Data.Cps_SignalPhyData_FC_FCWActive, ecu-extract-reference=TopLevelCompositionPrototype.AebDs.RP_Fcu_Aeb_Data.Cps_SignalPhyData_FC_FCWActive
      Cps_SignalPhyData_FC_FCWLatentWarning_121: upstream-reference=TopLevelComposition.AebDs.RP_Fcu_Aeb_Data.Cps_SignalPhyData_FC_FCWLatentWarning, ecu-extract-reference=TopLevelCompositionPrototype.AebDs.RP_Fcu_Aeb_Data.Cps_SignalPhyData_FC_FCWLatentWarning
      Cps_SignalPhyData_FC_FCWPreWarning_122: upstream-reference=TopLevelComposition.AebDs.RP_Fcu_Aeb_Data.Cps_SignalPhyData_FC_FCWPreWarning, ecu-extract-reference=TopLevelCompositionPrototype.AebDs.RP_Fcu_Aeb_Data.Cps_SignalPhyData_FC_FCWPreWarning
      Cps_SignalPhyData_FC_FCWSettingStatus_123: upstream-reference=TopLevelComposition.AebDs.RP_Fcu_Aeb_Data.Cps_SignalPhyData_FC_FCWSettingStatus, ecu-extract-reference=TopLevelCompositionPrototype.AebDs.RP_Fcu_Aeb_Data.Cps_SignalPhyData_FC_FCWSettingStatus
      Cps_SignalPhyData_FC_FCWStatus_124: upstream-reference=TopLevelComposition.AebDs.RP_Fcu_Aeb_Data.Cps_SignalPhyData_FC_FCWStatus, ecu-extract-reference=TopLevelCompositionPrototype.AebDs.RP_Fcu_Aeb_Data.Cps_SignalPhyData_FC_FCWStatus
      Cps_SignalPhyData_FC_LLaneDistanceFus_125: upstream-reference=TopLevelComposition.AebDs.RP_Fcu_Aeb_Data.Cps_SignalPhyData_FC_LLaneDistanceFus, ecu-extract-reference=TopLevelCompositionPrototype.AebDs.RP_Fcu_Aeb_Data.Cps_SignalPhyData_FC_LLaneDistanceFus
      Cps_SignalPhyData_FC_LLaneMarkerType_126: upstream-reference=TopLevelComposition.AebDs.RP_Fcu_Aeb_Data.Cps_SignalPhyData_FC_LLaneMarkerType, ecu-extract-reference=TopLevelCompositionPrototype.AebDs.RP_Fcu_Aeb_Data.Cps_SignalPhyData_FC_LLaneMarkerType
      Cps_SignalPhyData_FC_OBJ_AEB_ID_127: upstream-reference=TopLevelComposition.AebDs.RP_Fcu_Aeb_Data.Cps_SignalPhyData_FC_OBJ_AEB_ID, ecu-extract-reference=TopLevelCompositionPrototype.AebDs.RP_Fcu_Aeb_Data.Cps_SignalPhyData_FC_OBJ_AEB_ID
      Cps_SignalPhyData_FC_PrefillActive_128: upstream-reference=TopLevelComposition.AebDs.RP_Fcu_Aeb_Data.Cps_SignalPhyData_FC_PrefillActive, ecu-extract-reference=TopLevelCompositionPrototype.AebDs.RP_Fcu_Aeb_Data.Cps_SignalPhyData_FC_PrefillActive
      Cps_SignalPhyData_FC_RLaneDistanceFus_129: upstream-reference=TopLevelComposition.AebDs.RP_Fcu_Aeb_Data.Cps_SignalPhyData_FC_RLaneDistanceFus, ecu-extract-reference=TopLevelCompositionPrototype.AebDs.RP_Fcu_Aeb_Data.Cps_SignalPhyData_FC_RLaneDistanceFus
      Cps_SignalPhyData_FC_RLaneMarkerType_130: upstream-reference=TopLevelComposition.AebDs.RP_Fcu_Aeb_Data.Cps_SignalPhyData_FC_RLaneMarkerType, ecu-extract-reference=TopLevelCompositionPrototype.AebDs.RP_Fcu_Aeb_Data.Cps_SignalPhyData_FC_RLaneMarkerType
      RP_Sdc_Cem_GenObjectList_131: upstream-reference=TopLevelComposition.AebDs.RP_Sdc_Cem_GenObjectList, ecu-extract-reference=TopLevelCompositionPrototype.AebDs.RP_Sdc_Cem_GenObjectList
      GenObjectList_132: upstream-reference=TopLevelComposition.AebDs.RP_Sdc_Cem_GenObjectList.GenObjectList, ecu-extract-reference=TopLevelCompositionPrototype.AebDs.RP_Sdc_Cem_GenObjectList.GenObjectList
      BswM_OsApplication_C0_Prototype_133: upstream-reference=TopLevelComposition.BswM_OsApplication_C0_Prototype, ecu-extract-reference=TopLevelCompositionPrototype.BswM_OsApplication_C0_Prototype
      BswM_ModeSwitchPort_OsApplication_C0_BswMSwitchPort_Rte_134: upstream-reference=TopLevelComposition.BswM_OsApplication_C0_Prototype.BswM_ModeSwitchPort_OsApplication_C0_BswMSwitchPort_Rte, ecu-extract-reference=TopLevelCompositionPrototype.BswM_OsApplication_C0_Prototype.BswM_ModeSwitchPort_OsApplication_C0_BswMSwitchPort_Rte
      BswM_ModeSwitchPort_OsApplication_C0_CanSMState_PublicCan_135: upstream-reference=TopLevelComposition.BswM_OsApplication_C0_Prototype.BswM_ModeSwitchPort_OsApplication_C0_CanSMState_PublicCan, ecu-extract-reference=TopLevelCompositionPrototype.BswM_OsApplication_C0_Prototype.BswM_ModeSwitchPort_OsApplication_C0_CanSMState_PublicCan
      BswM_ModeSwitchPort_OsApplication_C0_CanSMState_PrivateCan_136: upstream-reference=TopLevelComposition.BswM_OsApplication_C0_Prototype.BswM_ModeSwitchPort_OsApplication_C0_CanSMState_PrivateCan, ecu-extract-reference=TopLevelCompositionPrototype.BswM_OsApplication_C0_Prototype.BswM_ModeSwitchPort_OsApplication_C0_CanSMState_PrivateCan
      BswM_ModeSwitchPort_OsApplication_C0_BswMSwitchPort_DiagComControlState_137: upstream-reference=TopLevelComposition.BswM_OsApplication_C0_Prototype.BswM_ModeSwitchPort_OsApplication_C0_BswMSwitchPort_DiagComControlState, ecu-extract-reference=TopLevelCompositionPrototype.BswM_OsApplication_C0_Prototype.BswM_ModeSwitchPort_OsApplication_C0_BswMSwitchPort_DiagComControlState
      ModeNotificationPort_BswMSwcModeNotification_Comco_RxReq_138: upstream-reference=TopLevelComposition.BswM_OsApplication_C0_Prototype.ModeNotificationPort_BswMSwcModeNotification_Comco_RxReq, ecu-extract-reference=TopLevelCompositionPrototype.BswM_OsApplication_C0_Prototype.ModeNotificationPort_BswMSwcModeNotification_Comco_RxReq
      ModeNotificationPort_BswMSwcModeNotification_Comco_TxReq_139: upstream-reference=TopLevelComposition.BswM_OsApplication_C0_Prototype.ModeNotificationPort_BswMSwcModeNotification_Comco_TxReq, ecu-extract-reference=TopLevelCompositionPrototype.BswM_OsApplication_C0_Prototype.ModeNotificationPort_BswMSwcModeNotification_Comco_TxReq
      BswM_OsApplication_C1_Prototype_140: upstream-reference=TopLevelComposition.BswM_OsApplication_C1_Prototype, ecu-extract-reference=TopLevelCompositionPrototype.BswM_OsApplication_C1_Prototype
      BswM_OsApplication_C2_Prototype_141: upstream-reference=TopLevelComposition.BswM_OsApplication_C2_Prototype, ecu-extract-reference=TopLevelCompositionPrototype.BswM_OsApplication_C2_Prototype
      BswM_OsApplication_C3_Prototype_142: upstream-reference=TopLevelComposition.BswM_OsApplication_C3_Prototype, ecu-extract-reference=TopLevelCompositionPrototype.BswM_OsApplication_C3_Prototype
      Cdd_EvAdc_143: upstream-reference=TopLevelComposition.Cdd_EvAdc, ecu-extract-reference=TopLevelCompositionPrototype.Cdd_EvAdc
      PP_Port_Cdd_EvAdc_GetValue_PMIC_FS84_AMUX_OUT_144: upstream-reference=TopLevelComposition.Cdd_EvAdc.PP_Port_Cdd_EvAdc_GetValue_PMIC_FS84_AMUX_OUT, ecu-extract-reference=TopLevelCompositionPrototype.Cdd_EvAdc.PP_Port_Cdd_EvAdc_GetValue_PMIC_FS84_AMUX_OUT
      PP_Port_Cdd_EvAdc_GetValue_SOC_PMIC_8200_AMUX_OUT_145: upstream-reference=TopLevelComposition.Cdd_EvAdc.PP_Port_Cdd_EvAdc_GetValue_SOC_PMIC_8200_AMUX_OUT, ecu-extract-reference=TopLevelCompositionPrototype.Cdd_EvAdc.PP_Port_Cdd_EvAdc_GetValue_SOC_PMIC_8200_AMUX_OUT
      PP_Port_Cdd_EvAdc_GetValue_TMON_SYS1_146: upstream-reference=TopLevelComposition.Cdd_EvAdc.PP_Port_Cdd_EvAdc_GetValue_TMON_SYS1, ecu-extract-reference=TopLevelCompositionPrototype.Cdd_EvAdc.PP_Port_Cdd_EvAdc_GetValue_TMON_SYS1
      PP_Port_Cdd_EvAdc_GetValue_TMON_SYS2_147: upstream-reference=TopLevelComposition.Cdd_EvAdc.PP_Port_Cdd_EvAdc_GetValue_TMON_SYS2, ecu-extract-reference=TopLevelCompositionPrototype.Cdd_EvAdc.PP_Port_Cdd_EvAdc_GetValue_TMON_SYS2
      PP_Port_Cdd_EvAdc_GetValue_VMON_1V0_GEPHY_148: upstream-reference=TopLevelComposition.Cdd_EvAdc.PP_Port_Cdd_EvAdc_GetValue_VMON_1V0_GEPHY, ecu-extract-reference=TopLevelCompositionPrototype.Cdd_EvAdc.PP_Port_Cdd_EvAdc_GetValue_VMON_1V0_GEPHY
      PP_Port_Cdd_EvAdc_GetValue_VMON_3V3_GEPHY_149: upstream-reference=TopLevelComposition.Cdd_EvAdc.PP_Port_Cdd_EvAdc_GetValue_VMON_3V3_GEPHY, ecu-extract-reference=TopLevelCompositionPrototype.Cdd_EvAdc.PP_Port_Cdd_EvAdc_GetValue_VMON_3V3_GEPHY
      PP_Port_Cdd_EvAdc_GetValue_VMON_BATT_150: upstream-reference=TopLevelComposition.Cdd_EvAdc.PP_Port_Cdd_EvAdc_GetValue_VMON_BATT, ecu-extract-reference=TopLevelCompositionPrototype.Cdd_EvAdc.PP_Port_Cdd_EvAdc_GetValue_VMON_BATT
      PP_Port_Cdd_EvAdc_GetValue_VMON_IGN_151: upstream-reference=TopLevelComposition.Cdd_EvAdc.PP_Port_Cdd_EvAdc_GetValue_VMON_IGN, ecu-extract-reference=TopLevelCompositionPrototype.Cdd_EvAdc.PP_Port_Cdd_EvAdc_GetValue_VMON_IGN
      Cdm_Prototype_152: upstream-reference=TopLevelComposition.Cdm_Prototype, ecu-extract-reference=TopLevelCompositionPrototype.Cdm_Prototype
      PP_Cdm_BlockOp_153: upstream-reference=TopLevelComposition.Cdm_Prototype.PP_Cdm_BlockOp, ecu-extract-reference=TopLevelCompositionPrototype.Cdm_Prototype.PP_Cdm_BlockOp
      PP_Cdm_NvmVdyMirror_154: upstream-reference=TopLevelComposition.Cdm_Prototype.PP_Cdm_NvmVdyMirror, ecu-extract-reference=TopLevelCompositionPrototype.Cdm_Prototype.PP_Cdm_NvmVdyMirror
      PP_Cdm_VdyInputNvMData_155: upstream-reference=TopLevelComposition.Cdm_Prototype.PP_Cdm_VdyInputNvMData, ecu-extract-reference=TopLevelCompositionPrototype.Cdm_Prototype.PP_Cdm_VdyInputNvMData
      VdyNvMInOutData_156: upstream-reference=TopLevelComposition.Cdm_Prototype.PP_Cdm_VdyInputNvMData.VdyNvMInOutData, ecu-extract-reference=TopLevelCompositionPrototype.Cdm_Prototype.PP_Cdm_VdyInputNvMData.VdyNvMInOutData
      PP_Qsm_DsmBlock_SecureUpdateLogOp_157: upstream-reference=TopLevelComposition.Cdm_Prototype.PP_Qsm_DsmBlock_SecureUpdateLogOp, ecu-extract-reference=TopLevelCompositionPrototype.Cdm_Prototype.PP_Qsm_DsmBlock_SecureUpdateLogOp
      PP_Qsm_DsmBlock_Startup_Flag_158: upstream-reference=TopLevelComposition.Cdm_Prototype.PP_Qsm_DsmBlock_Startup_Flag, ecu-extract-reference=TopLevelCompositionPrototype.Cdm_Prototype.PP_Qsm_DsmBlock_Startup_Flag
      RP_EvAdc_GetValue_VMON_BATT_159: upstream-reference=TopLevelComposition.Cdm_Prototype.RP_EvAdc_GetValue_VMON_BATT, ecu-extract-reference=TopLevelCompositionPrototype.Cdm_Prototype.RP_EvAdc_GetValue_VMON_BATT
      RP_Qsm_DsmBlock_EOLModeGateOp_160: upstream-reference=TopLevelComposition.Cdm_Prototype.RP_Qsm_DsmBlock_EOLModeGateOp, ecu-extract-reference=TopLevelCompositionPrototype.Cdm_Prototype.RP_Qsm_DsmBlock_EOLModeGateOp
      RP_Qsm_DsmBlock_PartNumber_Sector_161: upstream-reference=TopLevelComposition.Cdm_Prototype.RP_Qsm_DsmBlock_PartNumber_Sector, ecu-extract-reference=TopLevelCompositionPrototype.Cdm_Prototype.RP_Qsm_DsmBlock_PartNumber_Sector
      RP_VdyAdapter_VdyOutputNvMData_162: upstream-reference=TopLevelComposition.Cdm_Prototype.RP_VdyAdapter_VdyOutputNvMData, ecu-extract-reference=TopLevelCompositionPrototype.Cdm_Prototype.RP_VdyAdapter_VdyOutputNvMData
      VdyNvMInOutData_163: upstream-reference=TopLevelComposition.Cdm_Prototype.RP_VdyAdapter_VdyOutputNvMData.VdyNvMInOutData, ecu-extract-reference=TopLevelCompositionPrototype.Cdm_Prototype.RP_VdyAdapter_VdyOutputNvMData.VdyNvMInOutData
      ComM_Prototype_164: upstream-reference=TopLevelComposition.ComM_Prototype, ecu-extract-reference=TopLevelCompositionPrototype.ComM_Prototype
      UM_ComMUser_Public_165: upstream-reference=TopLevelComposition.ComM_Prototype.UM_ComMUser_Public, ecu-extract-reference=TopLevelCompositionPrototype.ComM_Prototype.UM_ComMUser_Public
      UR_ComMUser_Public_166: upstream-reference=TopLevelComposition.ComM_Prototype.UR_ComMUser_Public, ecu-extract-reference=TopLevelCompositionPrototype.ComM_Prototype.UR_ComMUser_Public
      UM_ComMUser_Private_167: upstream-reference=TopLevelComposition.ComM_Prototype.UM_ComMUser_Private, ecu-extract-reference=TopLevelCompositionPrototype.ComM_Prototype.UM_ComMUser_Private
      UR_ComMUser_Private_168: upstream-reference=TopLevelComposition.ComM_Prototype.UR_ComMUser_Private, ecu-extract-reference=TopLevelCompositionPrototype.ComM_Prototype.UR_ComMUser_Private
      Comco_169: upstream-reference=TopLevelComposition.Comco, ecu-extract-reference=TopLevelCompositionPrototype.Comco
      PP_Comco_CSI_NMWakupFlag_170: upstream-reference=TopLevelComposition.Comco.PP_Comco_CSI_NMWakupFlag, ecu-extract-reference=TopLevelCompositionPrototype.Comco.PP_Comco_CSI_NMWakupFlag
      PP_Comco_CSI_nmCurrentState_171: upstream-reference=TopLevelComposition.Comco.PP_Comco_CSI_nmCurrentState, ecu-extract-reference=TopLevelCompositionPrototype.Comco.PP_Comco_CSI_nmCurrentState
      PP_Comco_CSI_nmPreviousState_172: upstream-reference=TopLevelComposition.Comco.PP_Comco_CSI_nmPreviousState, ecu-extract-reference=TopLevelCompositionPrototype.Comco.PP_Comco_CSI_nmPreviousState
      PP_Comco_MSI_RxPduGroupSwitch_173: upstream-reference=TopLevelComposition.Comco.PP_Comco_MSI_RxPduGroupSwitch, ecu-extract-reference=TopLevelCompositionPrototype.Comco.PP_Comco_MSI_RxPduGroupSwitch
      PP_Comco_MSI_TxPduGroupSwitch_174: upstream-reference=TopLevelComposition.Comco.PP_Comco_MSI_TxPduGroupSwitch, ecu-extract-reference=TopLevelCompositionPrototype.Comco.PP_Comco_MSI_TxPduGroupSwitch
      RP_BswM_MSI_DiagComControlMode_175: upstream-reference=TopLevelComposition.Comco.RP_BswM_MSI_DiagComControlMode, ecu-extract-reference=TopLevelCompositionPrototype.Comco.RP_BswM_MSI_DiagComControlMode
      RP_ComM_UserRequest_Private_176: upstream-reference=TopLevelComposition.Comco.RP_ComM_UserRequest_Private, ecu-extract-reference=TopLevelCompositionPrototype.Comco.RP_ComM_UserRequest_Private
      RP_ComM_UserRequest_Public_177: upstream-reference=TopLevelComposition.Comco.RP_ComM_UserRequest_Public, ecu-extract-reference=TopLevelCompositionPrototype.Comco.RP_ComM_UserRequest_Public
      RP_Com_SRI_EspVehSpd_178: upstream-reference=TopLevelComposition.Comco.RP_Com_SRI_EspVehSpd, ecu-extract-reference=TopLevelCompositionPrototype.Comco.RP_Com_SRI_EspVehSpd
      DE_EspVehSpd_179: upstream-reference=TopLevelComposition.Comco.RP_Com_SRI_EspVehSpd.DE_EspVehSpd, ecu-extract-reference=TopLevelCompositionPrototype.Comco.RP_Com_SRI_EspVehSpd.DE_EspVehSpd
      RP_Com_SRI_EspVehSpdVld_180: upstream-reference=TopLevelComposition.Comco.RP_Com_SRI_EspVehSpdVld, ecu-extract-reference=TopLevelCompositionPrototype.Comco.RP_Com_SRI_EspVehSpdVld
      DE_EspVehSpdVld_181: upstream-reference=TopLevelComposition.Comco.RP_Com_SRI_EspVehSpdVld.DE_EspVehSpdVld, ecu-extract-reference=TopLevelCompositionPrototype.Comco.RP_Com_SRI_EspVehSpdVld.DE_EspVehSpdVld
      RP_EvAdc_GetValue_VMON_IGN_182: upstream-reference=TopLevelComposition.Comco.RP_EvAdc_GetValue_VMON_IGN, ecu-extract-reference=TopLevelCompositionPrototype.Comco.RP_EvAdc_GetValue_VMON_IGN
      RP_VoltMonI_SRI_DisableCommunication_183: upstream-reference=TopLevelComposition.Comco.RP_VoltMonI_SRI_DisableCommunication, ecu-extract-reference=TopLevelCompositionPrototype.Comco.RP_VoltMonI_SRI_DisableCommunication
      DE_VoltMonI_DisableCommunication_184: upstream-reference=TopLevelComposition.Comco.RP_VoltMonI_SRI_DisableCommunication.DE_VoltMonI_DisableCommunication, ecu-extract-reference=TopLevelCompositionPrototype.Comco.RP_VoltMonI_SRI_DisableCommunication.DE_VoltMonI_DisableCommunication
      Cpr_Prototype_185: upstream-reference=TopLevelComposition.Cpr_Prototype, ecu-extract-reference=TopLevelCompositionPrototype.Cpr_Prototype
      PP_Cpr_Adas_Data_186: upstream-reference=TopLevelComposition.Cpr_Prototype.PP_Cpr_Adas_Data, ecu-extract-reference=TopLevelCompositionPrototype.Cpr_Prototype.PP_Cpr_Adas_Data
      ACCMode_187: upstream-reference=TopLevelComposition.Cpr_Prototype.PP_Cpr_Adas_Data.ACCMode, ecu-extract-reference=TopLevelCompositionPrototype.Cpr_Prototype.PP_Cpr_Adas_Data.ACCMode
      ACCMode_Status_188: upstream-reference=TopLevelComposition.Cpr_Prototype.PP_Cpr_Adas_Data.ACCMode_Status, ecu-extract-reference=TopLevelCompositionPrototype.Cpr_Prototype.PP_Cpr_Adas_Data.ACCMode_Status
      FR_RadarFailureStatus_189: upstream-reference=TopLevelComposition.Cpr_Prototype.PP_Cpr_Adas_Data.FR_RadarFailureStatus, ecu-extract-reference=TopLevelCompositionPrototype.Cpr_Prototype.PP_Cpr_Adas_Data.FR_RadarFailureStatus
      FR_RadarFailureStatus_Status_190: upstream-reference=TopLevelComposition.Cpr_Prototype.PP_Cpr_Adas_Data.FR_RadarFailureStatus_Status, ecu-extract-reference=TopLevelCompositionPrototype.Cpr_Prototype.PP_Cpr_Adas_Data.FR_RadarFailureStatus_Status
      FRadarCalibrationStatus_191: upstream-reference=TopLevelComposition.Cpr_Prototype.PP_Cpr_Adas_Data.FRadarCalibrationStatus, ecu-extract-reference=TopLevelCompositionPrototype.Cpr_Prototype.PP_Cpr_Adas_Data.FRadarCalibrationStatus
      FRadarCalibrationStatus_Status_192: upstream-reference=TopLevelComposition.Cpr_Prototype.PP_Cpr_Adas_Data.FRadarCalibrationStatus_Status, ecu-extract-reference=TopLevelCompositionPrototype.Cpr_Prototype.PP_Cpr_Adas_Data.FRadarCalibrationStatus_Status
      RadarObj1_Dx_193: upstream-reference=TopLevelComposition.Cpr_Prototype.PP_Cpr_Adas_Data.RadarObj1_Dx, ecu-extract-reference=TopLevelCompositionPrototype.Cpr_Prototype.PP_Cpr_Adas_Data.RadarObj1_Dx
      RadarObj1_Dx_Status_194: upstream-reference=TopLevelComposition.Cpr_Prototype.PP_Cpr_Adas_Data.RadarObj1_Dx_Status, ecu-extract-reference=TopLevelCompositionPrototype.Cpr_Prototype.PP_Cpr_Adas_Data.RadarObj1_Dx_Status
      RadarObj1_Dy_195: upstream-reference=TopLevelComposition.Cpr_Prototype.PP_Cpr_Adas_Data.RadarObj1_Dy, ecu-extract-reference=TopLevelCompositionPrototype.Cpr_Prototype.PP_Cpr_Adas_Data.RadarObj1_Dy
      RadarObj1_Dy_Status_196: upstream-reference=TopLevelComposition.Cpr_Prototype.PP_Cpr_Adas_Data.RadarObj1_Dy_Status, ecu-extract-reference=TopLevelCompositionPrototype.Cpr_Prototype.PP_Cpr_Adas_Data.RadarObj1_Dy_Status
      RadarObj1_ExistProb_197: upstream-reference=TopLevelComposition.Cpr_Prototype.PP_Cpr_Adas_Data.RadarObj1_ExistProb, ecu-extract-reference=TopLevelCompositionPrototype.Cpr_Prototype.PP_Cpr_Adas_Data.RadarObj1_ExistProb
      RadarObj1_ExistProb_Status_198: upstream-reference=TopLevelComposition.Cpr_Prototype.PP_Cpr_Adas_Data.RadarObj1_ExistProb_Status, ecu-extract-reference=TopLevelCompositionPrototype.Cpr_Prototype.PP_Cpr_Adas_Data.RadarObj1_ExistProb_Status
      RadarObj1_Length_199: upstream-reference=TopLevelComposition.Cpr_Prototype.PP_Cpr_Adas_Data.RadarObj1_Length, ecu-extract-reference=TopLevelCompositionPrototype.Cpr_Prototype.PP_Cpr_Adas_Data.RadarObj1_Length
      RadarObj1_Length_Status_200: upstream-reference=TopLevelComposition.Cpr_Prototype.PP_Cpr_Adas_Data.RadarObj1_Length_Status, ecu-extract-reference=TopLevelCompositionPrototype.Cpr_Prototype.PP_Cpr_Adas_Data.RadarObj1_Length_Status
      RadarObj1_Location_201: upstream-reference=TopLevelComposition.Cpr_Prototype.PP_Cpr_Adas_Data.RadarObj1_Location, ecu-extract-reference=TopLevelCompositionPrototype.Cpr_Prototype.PP_Cpr_Adas_Data.RadarObj1_Location
      RadarObj1_Location_Status_202: upstream-reference=TopLevelComposition.Cpr_Prototype.PP_Cpr_Adas_Data.RadarObj1_Location_Status, ecu-extract-reference=TopLevelCompositionPrototype.Cpr_Prototype.PP_Cpr_Adas_Data.RadarObj1_Location_Status
      RadarObj1_Measured_203: upstream-reference=TopLevelComposition.Cpr_Prototype.PP_Cpr_Adas_Data.RadarObj1_Measured, ecu-extract-reference=TopLevelCompositionPrototype.Cpr_Prototype.PP_Cpr_Adas_Data.RadarObj1_Measured
      RadarObj1_Measured_Status_204: upstream-reference=TopLevelComposition.Cpr_Prototype.PP_Cpr_Adas_Data.RadarObj1_Measured_Status, ecu-extract-reference=TopLevelCompositionPrototype.Cpr_Prototype.PP_Cpr_Adas_Data.RadarObj1_Measured_Status
      RadarObj1_RelAx_205: upstream-reference=TopLevelComposition.Cpr_Prototype.PP_Cpr_Adas_Data.RadarObj1_RelAx, ecu-extract-reference=TopLevelCompositionPrototype.Cpr_Prototype.PP_Cpr_Adas_Data.RadarObj1_RelAx
      RadarObj1_RelAx_Status_206: upstream-reference=TopLevelComposition.Cpr_Prototype.PP_Cpr_Adas_Data.RadarObj1_RelAx_Status, ecu-extract-reference=TopLevelCompositionPrototype.Cpr_Prototype.PP_Cpr_Adas_Data.RadarObj1_RelAx_Status
      RadarObj1_RelVx_207: upstream-reference=TopLevelComposition.Cpr_Prototype.PP_Cpr_Adas_Data.RadarObj1_RelVx, ecu-extract-reference=TopLevelCompositionPrototype.Cpr_Prototype.PP_Cpr_Adas_Data.RadarObj1_RelVx
      RadarObj1_RelVx_Status_208: upstream-reference=TopLevelComposition.Cpr_Prototype.PP_Cpr_Adas_Data.RadarObj1_RelVx_Status, ecu-extract-reference=TopLevelCompositionPrototype.Cpr_Prototype.PP_Cpr_Adas_Data.RadarObj1_RelVx_Status
      RadarObj1_RelVy_209: upstream-reference=TopLevelComposition.Cpr_Prototype.PP_Cpr_Adas_Data.RadarObj1_RelVy, ecu-extract-reference=TopLevelCompositionPrototype.Cpr_Prototype.PP_Cpr_Adas_Data.RadarObj1_RelVy
      RadarObj1_RelVy_Status_210: upstream-reference=TopLevelComposition.Cpr_Prototype.PP_Cpr_Adas_Data.RadarObj1_RelVy_Status, ecu-extract-reference=TopLevelCompositionPrototype.Cpr_Prototype.PP_Cpr_Adas_Data.RadarObj1_RelVy_Status
      RadarObj1_Width_211: upstream-reference=TopLevelComposition.Cpr_Prototype.PP_Cpr_Adas_Data.RadarObj1_Width, ecu-extract-reference=TopLevelCompositionPrototype.Cpr_Prototype.PP_Cpr_Adas_Data.RadarObj1_Width
      RadarObj1_Width_Status_212: upstream-reference=TopLevelComposition.Cpr_Prototype.PP_Cpr_Adas_Data.RadarObj1_Width_Status, ecu-extract-reference=TopLevelCompositionPrototype.Cpr_Prototype.PP_Cpr_Adas_Data.RadarObj1_Width_Status
      RadarObj2_Dx_213: upstream-reference=TopLevelComposition.Cpr_Prototype.PP_Cpr_Adas_Data.RadarObj2_Dx, ecu-extract-reference=TopLevelCompositionPrototype.Cpr_Prototype.PP_Cpr_Adas_Data.RadarObj2_Dx
      RadarObj2_Dx_Status_214: upstream-reference=TopLevelComposition.Cpr_Prototype.PP_Cpr_Adas_Data.RadarObj2_Dx_Status, ecu-extract-reference=TopLevelCompositionPrototype.Cpr_Prototype.PP_Cpr_Adas_Data.RadarObj2_Dx_Status
      RadarObj2_Dy_215: upstream-reference=TopLevelComposition.Cpr_Prototype.PP_Cpr_Adas_Data.RadarObj2_Dy, ecu-extract-reference=TopLevelCompositionPrototype.Cpr_Prototype.PP_Cpr_Adas_Data.RadarObj2_Dy
      RadarObj2_Dy_Status_216: upstream-reference=TopLevelComposition.Cpr_Prototype.PP_Cpr_Adas_Data.RadarObj2_Dy_Status, ecu-extract-reference=TopLevelCompositionPrototype.Cpr_Prototype.PP_Cpr_Adas_Data.RadarObj2_Dy_Status
      RadarObj2_ExistProb_217: upstream-reference=TopLevelComposition.Cpr_Prototype.PP_Cpr_Adas_Data.RadarObj2_ExistProb, ecu-extract-reference=TopLevelCompositionPrototype.Cpr_Prototype.PP_Cpr_Adas_Data.RadarObj2_ExistProb
      RadarObj2_ExistProb_Status_218: upstream-reference=TopLevelComposition.Cpr_Prototype.PP_Cpr_Adas_Data.RadarObj2_ExistProb_Status, ecu-extract-reference=TopLevelCompositionPrototype.Cpr_Prototype.PP_Cpr_Adas_Data.RadarObj2_ExistProb_Status
      RadarObj2_Length_219: upstream-reference=TopLevelComposition.Cpr_Prototype.PP_Cpr_Adas_Data.RadarObj2_Length, ecu-extract-reference=TopLevelCompositionPrototype.Cpr_Prototype.PP_Cpr_Adas_Data.RadarObj2_Length
      RadarObj2_Length_Status_220: upstream-reference=TopLevelComposition.Cpr_Prototype.PP_Cpr_Adas_Data.RadarObj2_Length_Status, ecu-extract-reference=TopLevelCompositionPrototype.Cpr_Prototype.PP_Cpr_Adas_Data.RadarObj2_Length_Status
      RadarObj2_Location_221: upstream-reference=TopLevelComposition.Cpr_Prototype.PP_Cpr_Adas_Data.RadarObj2_Location, ecu-extract-reference=TopLevelCompositionPrototype.Cpr_Prototype.PP_Cpr_Adas_Data.RadarObj2_Location
      RadarObj2_Location_Status_222: upstream-reference=TopLevelComposition.Cpr_Prototype.PP_Cpr_Adas_Data.RadarObj2_Location_Status, ecu-extract-reference=TopLevelCompositionPrototype.Cpr_Prototype.PP_Cpr_Adas_Data.RadarObj2_Location_Status
      RadarObj2_Measured_223: upstream-reference=TopLevelComposition.Cpr_Prototype.PP_Cpr_Adas_Data.RadarObj2_Measured, ecu-extract-reference=TopLevelCompositionPrototype.Cpr_Prototype.PP_Cpr_Adas_Data.RadarObj2_Measured
      RadarObj2_Measured_Status_224: upstream-reference=TopLevelComposition.Cpr_Prototype.PP_Cpr_Adas_Data.RadarObj2_Measured_Status, ecu-extract-reference=TopLevelCompositionPrototype.Cpr_Prototype.PP_Cpr_Adas_Data.RadarObj2_Measured_Status
      RadarObj2_RelAx_225: upstream-reference=TopLevelComposition.Cpr_Prototype.PP_Cpr_Adas_Data.RadarObj2_RelAx, ecu-extract-reference=TopLevelCompositionPrototype.Cpr_Prototype.PP_Cpr_Adas_Data.RadarObj2_RelAx
      RadarObj2_RelAx_Status_226: upstream-reference=TopLevelComposition.Cpr_Prototype.PP_Cpr_Adas_Data.RadarObj2_RelAx_Status, ecu-extract-reference=TopLevelCompositionPrototype.Cpr_Prototype.PP_Cpr_Adas_Data.RadarObj2_RelAx_Status
      RadarObj2_RelVx_227: upstream-reference=TopLevelComposition.Cpr_Prototype.PP_Cpr_Adas_Data.RadarObj2_RelVx, ecu-extract-reference=TopLevelCompositionPrototype.Cpr_Prototype.PP_Cpr_Adas_Data.RadarObj2_RelVx
      RadarObj2_RelVx_Status_228: upstream-reference=TopLevelComposition.Cpr_Prototype.PP_Cpr_Adas_Data.RadarObj2_RelVx_Status, ecu-extract-reference=TopLevelCompositionPrototype.Cpr_Prototype.PP_Cpr_Adas_Data.RadarObj2_RelVx_Status
      RadarObj2_RelVy_229: upstream-reference=TopLevelComposition.Cpr_Prototype.PP_Cpr_Adas_Data.RadarObj2_RelVy, ecu-extract-reference=TopLevelCompositionPrototype.Cpr_Prototype.PP_Cpr_Adas_Data.RadarObj2_RelVy
      RadarObj2_RelVy_Status_230: upstream-reference=TopLevelComposition.Cpr_Prototype.PP_Cpr_Adas_Data.RadarObj2_RelVy_Status, ecu-extract-reference=TopLevelCompositionPrototype.Cpr_Prototype.PP_Cpr_Adas_Data.RadarObj2_RelVy_Status
      RadarObj2_Width_231: upstream-reference=TopLevelComposition.Cpr_Prototype.PP_Cpr_Adas_Data.RadarObj2_Width, ecu-extract-reference=TopLevelCompositionPrototype.Cpr_Prototype.PP_Cpr_Adas_Data.RadarObj2_Width
      RadarObj2_Width_Status_232: upstream-reference=TopLevelComposition.Cpr_Prototype.PP_Cpr_Adas_Data.RadarObj2_Width_Status, ecu-extract-reference=TopLevelCompositionPrototype.Cpr_Prototype.PP_Cpr_Adas_Data.RadarObj2_Width_Status
      RadarObj3_Dx_233: upstream-reference=TopLevelComposition.Cpr_Prototype.PP_Cpr_Adas_Data.RadarObj3_Dx, ecu-extract-reference=TopLevelCompositionPrototype.Cpr_Prototype.PP_Cpr_Adas_Data.RadarObj3_Dx
      RadarObj3_Dx_Status_234: upstream-reference=TopLevelComposition.Cpr_Prototype.PP_Cpr_Adas_Data.RadarObj3_Dx_Status, ecu-extract-reference=TopLevelCompositionPrototype.Cpr_Prototype.PP_Cpr_Adas_Data.RadarObj3_Dx_Status
      RadarObj3_Dy_235: upstream-reference=TopLevelComposition.Cpr_Prototype.PP_Cpr_Adas_Data.RadarObj3_Dy, ecu-extract-reference=TopLevelCompositionPrototype.Cpr_Prototype.PP_Cpr_Adas_Data.RadarObj3_Dy
      RadarObj3_Dy_Status_236: upstream-reference=TopLevelComposition.Cpr_Prototype.PP_Cpr_Adas_Data.RadarObj3_Dy_Status, ecu-extract-reference=TopLevelCompositionPrototype.Cpr_Prototype.PP_Cpr_Adas_Data.RadarObj3_Dy_Status
      RadarObj3_ExistProb_237: upstream-reference=TopLevelComposition.Cpr_Prototype.PP_Cpr_Adas_Data.RadarObj3_ExistProb, ecu-extract-reference=TopLevelCompositionPrototype.Cpr_Prototype.PP_Cpr_Adas_Data.RadarObj3_ExistProb
      RadarObj3_ExistProb_Status_238: upstream-reference=TopLevelComposition.Cpr_Prototype.PP_Cpr_Adas_Data.RadarObj3_ExistProb_Status, ecu-extract-reference=TopLevelCompositionPrototype.Cpr_Prototype.PP_Cpr_Adas_Data.RadarObj3_ExistProb_Status
      RadarObj3_Length_239: upstream-reference=TopLevelComposition.Cpr_Prototype.PP_Cpr_Adas_Data.RadarObj3_Length, ecu-extract-reference=TopLevelCompositionPrototype.Cpr_Prototype.PP_Cpr_Adas_Data.RadarObj3_Length
      RadarObj3_Length_Status_240: upstream-reference=TopLevelComposition.Cpr_Prototype.PP_Cpr_Adas_Data.RadarObj3_Length_Status, ecu-extract-reference=TopLevelCompositionPrototype.Cpr_Prototype.PP_Cpr_Adas_Data.RadarObj3_Length_Status
      RadarObj3_Location_241: upstream-reference=TopLevelComposition.Cpr_Prototype.PP_Cpr_Adas_Data.RadarObj3_Location, ecu-extract-reference=TopLevelCompositionPrototype.Cpr_Prototype.PP_Cpr_Adas_Data.RadarObj3_Location
      RadarObj3_Location_Status_242: upstream-reference=TopLevelComposition.Cpr_Prototype.PP_Cpr_Adas_Data.RadarObj3_Location_Status, ecu-extract-reference=TopLevelCompositionPrototype.Cpr_Prototype.PP_Cpr_Adas_Data.RadarObj3_Location_Status
      RadarObj3_Measured_243: upstream-reference=TopLevelComposition.Cpr_Prototype.PP_Cpr_Adas_Data.RadarObj3_Measured, ecu-extract-reference=TopLevelCompositionPrototype.Cpr_Prototype.PP_Cpr_Adas_Data.RadarObj3_Measured
      RadarObj3_Measured_Status_244: upstream-reference=TopLevelComposition.Cpr_Prototype.PP_Cpr_Adas_Data.RadarObj3_Measured_Status, ecu-extract-reference=TopLevelCompositionPrototype.Cpr_Prototype.PP_Cpr_Adas_Data.RadarObj3_Measured_Status
      RadarObj3_RelAx_245: upstream-reference=TopLevelComposition.Cpr_Prototype.PP_Cpr_Adas_Data.RadarObj3_RelAx, ecu-extract-reference=TopLevelCompositionPrototype.Cpr_Prototype.PP_Cpr_Adas_Data.RadarObj3_RelAx
      RadarObj3_RelAx_Status_246: upstream-reference=TopLevelComposition.Cpr_Prototype.PP_Cpr_Adas_Data.RadarObj3_RelAx_Status, ecu-extract-reference=TopLevelCompositionPrototype.Cpr_Prototype.PP_Cpr_Adas_Data.RadarObj3_RelAx_Status
      RadarObj3_RelVx_247: upstream-reference=TopLevelComposition.Cpr_Prototype.PP_Cpr_Adas_Data.RadarObj3_RelVx, ecu-extract-reference=TopLevelCompositionPrototype.Cpr_Prototype.PP_Cpr_Adas_Data.RadarObj3_RelVx
      RadarObj3_RelVx_Status_248: upstream-reference=TopLevelComposition.Cpr_Prototype.PP_Cpr_Adas_Data.RadarObj3_RelVx_Status, ecu-extract-reference=TopLevelCompositionPrototype.Cpr_Prototype.PP_Cpr_Adas_Data.RadarObj3_RelVx_Status
      RadarObj3_RelVy_249: upstream-reference=TopLevelComposition.Cpr_Prototype.PP_Cpr_Adas_Data.RadarObj3_RelVy, ecu-extract-reference=TopLevelCompositionPrototype.Cpr_Prototype.PP_Cpr_Adas_Data.RadarObj3_RelVy
      RadarObj3_RelVy_Status_250: upstream-reference=TopLevelComposition.Cpr_Prototype.PP_Cpr_Adas_Data.RadarObj3_RelVy_Status, ecu-extract-reference=TopLevelCompositionPrototype.Cpr_Prototype.PP_Cpr_Adas_Data.RadarObj3_RelVy_Status
      RadarObj3_Width_251: upstream-reference=TopLevelComposition.Cpr_Prototype.PP_Cpr_Adas_Data.RadarObj3_Width, ecu-extract-reference=TopLevelCompositionPrototype.Cpr_Prototype.PP_Cpr_Adas_Data.RadarObj3_Width
      RadarObj3_Width_Status_252: upstream-reference=TopLevelComposition.Cpr_Prototype.PP_Cpr_Adas_Data.RadarObj3_Width_Status, ecu-extract-reference=TopLevelCompositionPrototype.Cpr_Prototype.PP_Cpr_Adas_Data.RadarObj3_Width_Status
      RadarObj4_Dx_253: upstream-reference=TopLevelComposition.Cpr_Prototype.PP_Cpr_Adas_Data.RadarObj4_Dx, ecu-extract-reference=TopLevelCompositionPrototype.Cpr_Prototype.PP_Cpr_Adas_Data.RadarObj4_Dx
      RadarObj4_Dx_Status_254: upstream-reference=TopLevelComposition.Cpr_Prototype.PP_Cpr_Adas_Data.RadarObj4_Dx_Status, ecu-extract-reference=TopLevelCompositionPrototype.Cpr_Prototype.PP_Cpr_Adas_Data.RadarObj4_Dx_Status
      RadarObj4_Dy_255: upstream-reference=TopLevelComposition.Cpr_Prototype.PP_Cpr_Adas_Data.RadarObj4_Dy, ecu-extract-reference=TopLevelCompositionPrototype.Cpr_Prototype.PP_Cpr_Adas_Data.RadarObj4_Dy
      RadarObj4_Dy_Status_256: upstream-reference=TopLevelComposition.Cpr_Prototype.PP_Cpr_Adas_Data.RadarObj4_Dy_Status, ecu-extract-reference=TopLevelCompositionPrototype.Cpr_Prototype.PP_Cpr_Adas_Data.RadarObj4_Dy_Status
      RadarObj4_ExistProb_257: upstream-reference=TopLevelComposition.Cpr_Prototype.PP_Cpr_Adas_Data.RadarObj4_ExistProb, ecu-extract-reference=TopLevelCompositionPrototype.Cpr_Prototype.PP_Cpr_Adas_Data.RadarObj4_ExistProb
      RadarObj4_ExistProb_Status_258: upstream-reference=TopLevelComposition.Cpr_Prototype.PP_Cpr_Adas_Data.RadarObj4_ExistProb_Status, ecu-extract-reference=TopLevelCompositionPrototype.Cpr_Prototype.PP_Cpr_Adas_Data.RadarObj4_ExistProb_Status
      RadarObj4_Length_259: upstream-reference=TopLevelComposition.Cpr_Prototype.PP_Cpr_Adas_Data.RadarObj4_Length, ecu-extract-reference=TopLevelCompositionPrototype.Cpr_Prototype.PP_Cpr_Adas_Data.RadarObj4_Length
      RadarObj4_Length_Status_260: upstream-reference=TopLevelComposition.Cpr_Prototype.PP_Cpr_Adas_Data.RadarObj4_Length_Status, ecu-extract-reference=TopLevelCompositionPrototype.Cpr_Prototype.PP_Cpr_Adas_Data.RadarObj4_Length_Status
      RadarObj4_Location_261: upstream-reference=TopLevelComposition.Cpr_Prototype.PP_Cpr_Adas_Data.RadarObj4_Location, ecu-extract-reference=TopLevelCompositionPrototype.Cpr_Prototype.PP_Cpr_Adas_Data.RadarObj4_Location
      RadarObj4_Location_Status_262: upstream-reference=TopLevelComposition.Cpr_Prototype.PP_Cpr_Adas_Data.RadarObj4_Location_Status, ecu-extract-reference=TopLevelCompositionPrototype.Cpr_Prototype.PP_Cpr_Adas_Data.RadarObj4_Location_Status
      RadarObj4_Measured_263: upstream-reference=TopLevelComposition.Cpr_Prototype.PP_Cpr_Adas_Data.RadarObj4_Measured, ecu-extract-reference=TopLevelCompositionPrototype.Cpr_Prototype.PP_Cpr_Adas_Data.RadarObj4_Measured
      RadarObj4_Measured_Status_264: upstream-reference=TopLevelComposition.Cpr_Prototype.PP_Cpr_Adas_Data.RadarObj4_Measured_Status, ecu-extract-reference=TopLevelCompositionPrototype.Cpr_Prototype.PP_Cpr_Adas_Data.RadarObj4_Measured_Status
      RadarObj4_RelAx_265: upstream-reference=TopLevelComposition.Cpr_Prototype.PP_Cpr_Adas_Data.RadarObj4_RelAx, ecu-extract-reference=TopLevelCompositionPrototype.Cpr_Prototype.PP_Cpr_Adas_Data.RadarObj4_RelAx
      RadarObj4_RelAx_Status_266: upstream-reference=TopLevelComposition.Cpr_Prototype.PP_Cpr_Adas_Data.RadarObj4_RelAx_Status, ecu-extract-reference=TopLevelCompositionPrototype.Cpr_Prototype.PP_Cpr_Adas_Data.RadarObj4_RelAx_Status
      RadarObj4_RelVx_267: upstream-reference=TopLevelComposition.Cpr_Prototype.PP_Cpr_Adas_Data.RadarObj4_RelVx, ecu-extract-reference=TopLevelCompositionPrototype.Cpr_Prototype.PP_Cpr_Adas_Data.RadarObj4_RelVx
      RadarObj4_RelVx_Status_268: upstream-reference=TopLevelComposition.Cpr_Prototype.PP_Cpr_Adas_Data.RadarObj4_RelVx_Status, ecu-extract-reference=TopLevelCompositionPrototype.Cpr_Prototype.PP_Cpr_Adas_Data.RadarObj4_RelVx_Status
      RadarObj4_RelVy_269: upstream-reference=TopLevelComposition.Cpr_Prototype.PP_Cpr_Adas_Data.RadarObj4_RelVy, ecu-extract-reference=TopLevelCompositionPrototype.Cpr_Prototype.PP_Cpr_Adas_Data.RadarObj4_RelVy
      RadarObj4_RelVy_Status_270: upstream-reference=TopLevelComposition.Cpr_Prototype.PP_Cpr_Adas_Data.RadarObj4_RelVy_Status, ecu-extract-reference=TopLevelCompositionPrototype.Cpr_Prototype.PP_Cpr_Adas_Data.RadarObj4_RelVy_Status
      RadarObj4_Width_271: upstream-reference=TopLevelComposition.Cpr_Prototype.PP_Cpr_Adas_Data.RadarObj4_Width, ecu-extract-reference=TopLevelCompositionPrototype.Cpr_Prototype.PP_Cpr_Adas_Data.RadarObj4_Width
      RadarObj4_Width_Status_272: upstream-reference=TopLevelComposition.Cpr_Prototype.PP_Cpr_Adas_Data.RadarObj4_Width_Status, ecu-extract-reference=TopLevelCompositionPrototype.Cpr_Prototype.PP_Cpr_Adas_Data.RadarObj4_Width_Status
      PP_Cpr_Body_Data_273: upstream-reference=TopLevelComposition.Cpr_Prototype.PP_Cpr_Body_Data, ecu-extract-reference=TopLevelCompositionPrototype.Cpr_Prototype.PP_Cpr_Body_Data
      ACC_HostLaneLeftStatus_274: upstream-reference=TopLevelComposition.Cpr_Prototype.PP_Cpr_Body_Data.ACC_HostLaneLeftStatus, ecu-extract-reference=TopLevelCompositionPrototype.Cpr_Prototype.PP_Cpr_Body_Data.ACC_HostLaneLeftStatus
      ACC_HostLaneRightStatus_275: upstream-reference=TopLevelComposition.Cpr_Prototype.PP_Cpr_Body_Data.ACC_HostLaneRightStatus, ecu-extract-reference=TopLevelCompositionPrototype.Cpr_Prototype.PP_Cpr_Body_Data.ACC_HostLaneRightStatus
      AccIaccHWAMode_276: upstream-reference=TopLevelComposition.Cpr_Prototype.PP_Cpr_Body_Data.AccIaccHWAMode, ecu-extract-reference=TopLevelCompositionPrototype.Cpr_Prototype.PP_Cpr_Body_Data.AccIaccHWAMode
      AccIaccHWAMode_Status_277: upstream-reference=TopLevelComposition.Cpr_Prototype.PP_Cpr_Body_Data.AccIaccHWAMode_Status, ecu-extract-reference=TopLevelCompositionPrototype.Cpr_Prototype.PP_Cpr_Body_Data.AccIaccHWAMode_Status
      BCM_BrakeLampError_278: upstream-reference=TopLevelComposition.Cpr_Prototype.PP_Cpr_Body_Data.BCM_BrakeLampError, ecu-extract-reference=TopLevelCompositionPrototype.Cpr_Prototype.PP_Cpr_Body_Data.BCM_BrakeLampError
      BCM_BrakeLampError_Status_279: upstream-reference=TopLevelComposition.Cpr_Prototype.PP_Cpr_Body_Data.BCM_BrakeLampError_Status, ecu-extract-reference=TopLevelCompositionPrototype.Cpr_Prototype.PP_Cpr_Body_Data.BCM_BrakeLampError_Status
      BCM_TurnLightSwitchSts_280: upstream-reference=TopLevelComposition.Cpr_Prototype.PP_Cpr_Body_Data.BCM_TurnLightSwitchSts, ecu-extract-reference=TopLevelCompositionPrototype.Cpr_Prototype.PP_Cpr_Body_Data.BCM_TurnLightSwitchSts
      BCM_TurnLightSwitchSts_Status_281: upstream-reference=TopLevelComposition.Cpr_Prototype.PP_Cpr_Body_Data.BCM_TurnLightSwitchSts_Status, ecu-extract-reference=TopLevelCompositionPrototype.Cpr_Prototype.PP_Cpr_Body_Data.BCM_TurnLightSwitchSts_Status
      BcmAutHeadLiSts_282: upstream-reference=TopLevelComposition.Cpr_Prototype.PP_Cpr_Body_Data.BcmAutHeadLiSts, ecu-extract-reference=TopLevelCompositionPrototype.Cpr_Prototype.PP_Cpr_Body_Data.BcmAutHeadLiSts
      BcmAutHeadLiSts_Status_283: upstream-reference=TopLevelComposition.Cpr_Prototype.PP_Cpr_Body_Data.BcmAutHeadLiSts_Status, ecu-extract-reference=TopLevelCompositionPrototype.Cpr_Prototype.PP_Cpr_Body_Data.BcmAutHeadLiSts_Status
      BcmDrvrDoorSts_284: upstream-reference=TopLevelComposition.Cpr_Prototype.PP_Cpr_Body_Data.BcmDrvrDoorSts, ecu-extract-reference=TopLevelCompositionPrototype.Cpr_Prototype.PP_Cpr_Body_Data.BcmDrvrDoorSts
      BcmDrvrDoorSts_Status_285: upstream-reference=TopLevelComposition.Cpr_Prototype.PP_Cpr_Body_Data.BcmDrvrDoorSts_Status, ecu-extract-reference=TopLevelCompositionPrototype.Cpr_Prototype.PP_Cpr_Body_Data.BcmDrvrDoorSts_Status
      BcmEmgyLiSts_286: upstream-reference=TopLevelComposition.Cpr_Prototype.PP_Cpr_Body_Data.BcmEmgyLiSts, ecu-extract-reference=TopLevelCompositionPrototype.Cpr_Prototype.PP_Cpr_Body_Data.BcmEmgyLiSts
      BcmEmgyLiSts_Status_287: upstream-reference=TopLevelComposition.Cpr_Prototype.PP_Cpr_Body_Data.BcmEmgyLiSts_Status, ecu-extract-reference=TopLevelCompositionPrototype.Cpr_Prototype.PP_Cpr_Body_Data.BcmEmgyLiSts_Status
      BcmFrntFogLmpSts_288: upstream-reference=TopLevelComposition.Cpr_Prototype.PP_Cpr_Body_Data.BcmFrntFogLmpSts, ecu-extract-reference=TopLevelCompositionPrototype.Cpr_Prototype.PP_Cpr_Body_Data.BcmFrntFogLmpSts
      BcmFrntFogLmpSts_Status_289: upstream-reference=TopLevelComposition.Cpr_Prototype.PP_Cpr_Body_Data.BcmFrntFogLmpSts_Status, ecu-extract-reference=TopLevelCompositionPrototype.Cpr_Prototype.PP_Cpr_Body_Data.BcmFrntFogLmpSts_Status
      BcmFrntWiperSts_290: upstream-reference=TopLevelComposition.Cpr_Prototype.PP_Cpr_Body_Data.BcmFrntWiperSts, ecu-extract-reference=TopLevelCompositionPrototype.Cpr_Prototype.PP_Cpr_Body_Data.BcmFrntWiperSts
      BcmFrntWiperSts_Status_291: upstream-reference=TopLevelComposition.Cpr_Prototype.PP_Cpr_Body_Data.BcmFrntWiperSts_Status, ecu-extract-reference=TopLevelCompositionPrototype.Cpr_Prototype.PP_Cpr_Body_Data.BcmFrntWiperSts_Status
      BcmHiBeamSts_292: upstream-reference=TopLevelComposition.Cpr_Prototype.PP_Cpr_Body_Data.BcmHiBeamSts, ecu-extract-reference=TopLevelCompositionPrototype.Cpr_Prototype.PP_Cpr_Body_Data.BcmHiBeamSts
      BcmHiBeamSts_Status_293: upstream-reference=TopLevelComposition.Cpr_Prototype.PP_Cpr_Body_Data.BcmHiBeamSts_Status, ecu-extract-reference=TopLevelCompositionPrototype.Cpr_Prototype.PP_Cpr_Body_Data.BcmHiBeamSts_Status
      BcmLeReDoorSts_294: upstream-reference=TopLevelComposition.Cpr_Prototype.PP_Cpr_Body_Data.BcmLeReDoorSts, ecu-extract-reference=TopLevelCompositionPrototype.Cpr_Prototype.PP_Cpr_Body_Data.BcmLeReDoorSts
      BcmLeReDoorSts_Status_295: upstream-reference=TopLevelComposition.Cpr_Prototype.PP_Cpr_Body_Data.BcmLeReDoorSts_Status, ecu-extract-reference=TopLevelCompositionPrototype.Cpr_Prototype.PP_Cpr_Body_Data.BcmLeReDoorSts_Status
      BcmLoBeamSts_296: upstream-reference=TopLevelComposition.Cpr_Prototype.PP_Cpr_Body_Data.BcmLoBeamSts, ecu-extract-reference=TopLevelCompositionPrototype.Cpr_Prototype.PP_Cpr_Body_Data.BcmLoBeamSts
      BcmLoBeamSts_Status_297: upstream-reference=TopLevelComposition.Cpr_Prototype.PP_Cpr_Body_Data.BcmLoBeamSts_Status, ecu-extract-reference=TopLevelCompositionPrototype.Cpr_Prototype.PP_Cpr_Body_Data.BcmLoBeamSts_Status
      BcmPassDoorSts_298: upstream-reference=TopLevelComposition.Cpr_Prototype.PP_Cpr_Body_Data.BcmPassDoorSts, ecu-extract-reference=TopLevelCompositionPrototype.Cpr_Prototype.PP_Cpr_Body_Data.BcmPassDoorSts
      BcmPassDoorSts_Status_299: upstream-reference=TopLevelComposition.Cpr_Prototype.PP_Cpr_Body_Data.BcmPassDoorSts_Status, ecu-extract-reference=TopLevelCompositionPrototype.Cpr_Prototype.PP_Cpr_Body_Data.BcmPassDoorSts_Status
      BcmReFoglmpSts_300: upstream-reference=TopLevelComposition.Cpr_Prototype.PP_Cpr_Body_Data.BcmReFoglmpSts, ecu-extract-reference=TopLevelCompositionPrototype.Cpr_Prototype.PP_Cpr_Body_Data.BcmReFoglmpSts
      BcmReFoglmpSts_Status_301: upstream-reference=TopLevelComposition.Cpr_Prototype.PP_Cpr_Body_Data.BcmReFoglmpSts_Status, ecu-extract-reference=TopLevelCompositionPrototype.Cpr_Prototype.PP_Cpr_Body_Data.BcmReFoglmpSts_Status
      BcmRiReDoorSts_302: upstream-reference=TopLevelComposition.Cpr_Prototype.PP_Cpr_Body_Data.BcmRiReDoorSts, ecu-extract-reference=TopLevelCompositionPrototype.Cpr_Prototype.PP_Cpr_Body_Data.BcmRiReDoorSts
      BcmRiReDoorSts_Status_303: upstream-reference=TopLevelComposition.Cpr_Prototype.PP_Cpr_Body_Data.BcmRiReDoorSts_Status, ecu-extract-reference=TopLevelCompositionPrototype.Cpr_Prototype.PP_Cpr_Body_Data.BcmRiReDoorSts_Status
      BcmTurnIndcrLe_304: upstream-reference=TopLevelComposition.Cpr_Prototype.PP_Cpr_Body_Data.BcmTurnIndcrLe, ecu-extract-reference=TopLevelCompositionPrototype.Cpr_Prototype.PP_Cpr_Body_Data.BcmTurnIndcrLe
      BcmTurnIndcrLe_Status_305: upstream-reference=TopLevelComposition.Cpr_Prototype.PP_Cpr_Body_Data.BcmTurnIndcrLe_Status, ecu-extract-reference=TopLevelCompositionPrototype.Cpr_Prototype.PP_Cpr_Body_Data.BcmTurnIndcrLe_Status
      BcmTurnIndcrRi_306: upstream-reference=TopLevelComposition.Cpr_Prototype.PP_Cpr_Body_Data.BcmTurnIndcrRi, ecu-extract-reference=TopLevelCompositionPrototype.Cpr_Prototype.PP_Cpr_Body_Data.BcmTurnIndcrRi
      BcmTurnIndcrRi_Status_307: upstream-reference=TopLevelComposition.Cpr_Prototype.PP_Cpr_Body_Data.BcmTurnIndcrRi_Status, ecu-extract-reference=TopLevelCompositionPrototype.Cpr_Prototype.PP_Cpr_Body_Data.BcmTurnIndcrRi_Status
      IP_DISFail_308: upstream-reference=TopLevelComposition.Cpr_Prototype.PP_Cpr_Body_Data.IP_DISFail, ecu-extract-reference=TopLevelCompositionPrototype.Cpr_Prototype.PP_Cpr_Body_Data.IP_DISFail
      IP_DISFail_Status_309: upstream-reference=TopLevelComposition.Cpr_Prototype.PP_Cpr_Body_Data.IP_DISFail_Status, ecu-extract-reference=TopLevelCompositionPrototype.Cpr_Prototype.PP_Cpr_Body_Data.IP_DISFail_Status
      IP_QDashACCFail_310: upstream-reference=TopLevelComposition.Cpr_Prototype.PP_Cpr_Body_Data.IP_QDashACCFail, ecu-extract-reference=TopLevelCompositionPrototype.Cpr_Prototype.PP_Cpr_Body_Data.IP_QDashACCFail
      IP_QDashACCFail_Status_311: upstream-reference=TopLevelComposition.Cpr_Prototype.PP_Cpr_Body_Data.IP_QDashACCFail_Status, ecu-extract-reference=TopLevelCompositionPrototype.Cpr_Prototype.PP_Cpr_Body_Data.IP_QDashACCFail_Status
      SrsDrvrBucSwtSts_312: upstream-reference=TopLevelComposition.Cpr_Prototype.PP_Cpr_Body_Data.SrsDrvrBucSwtSts, ecu-extract-reference=TopLevelCompositionPrototype.Cpr_Prototype.PP_Cpr_Body_Data.SrsDrvrBucSwtSts
      SrsDrvrBucSwtSts_Status_313: upstream-reference=TopLevelComposition.Cpr_Prototype.PP_Cpr_Body_Data.SrsDrvrBucSwtSts_Status, ecu-extract-reference=TopLevelCompositionPrototype.Cpr_Prototype.PP_Cpr_Body_Data.SrsDrvrBucSwtSts_Status
      SrsPassBucSwtSts_314: upstream-reference=TopLevelComposition.Cpr_Prototype.PP_Cpr_Body_Data.SrsPassBucSwtSts, ecu-extract-reference=TopLevelCompositionPrototype.Cpr_Prototype.PP_Cpr_Body_Data.SrsPassBucSwtSts
      SrsPassBucSwtSts_Status_315: upstream-reference=TopLevelComposition.Cpr_Prototype.PP_Cpr_Body_Data.SrsPassBucSwtSts_Status, ecu-extract-reference=TopLevelCompositionPrototype.Cpr_Prototype.PP_Cpr_Body_Data.SrsPassBucSwtSts_Status
      TmsFrntBlowMod_316: upstream-reference=TopLevelComposition.Cpr_Prototype.PP_Cpr_Body_Data.TmsFrntBlowMod, ecu-extract-reference=TopLevelCompositionPrototype.Cpr_Prototype.PP_Cpr_Body_Data.TmsFrntBlowMod
      TmsFrntBlowMod_Status_317: upstream-reference=TopLevelComposition.Cpr_Prototype.PP_Cpr_Body_Data.TmsFrntBlowMod_Status, ecu-extract-reference=TopLevelCompositionPrototype.Cpr_Prototype.PP_Cpr_Body_Data.TmsFrntBlowMod_Status
      PP_Cpr_Chassis_Data_318: upstream-reference=TopLevelComposition.Cpr_Prototype.PP_Cpr_Chassis_Data, ecu-extract-reference=TopLevelCompositionPrototype.Cpr_Prototype.PP_Cpr_Chassis_Data
      AdsUDLCStatus_319: upstream-reference=TopLevelComposition.Cpr_Prototype.PP_Cpr_Chassis_Data.AdsUDLCStatus, ecu-extract-reference=TopLevelCompositionPrototype.Cpr_Prototype.PP_Cpr_Chassis_Data.AdsUDLCStatus
      AdsUDLCStatus_Status_320: upstream-reference=TopLevelComposition.Cpr_Prototype.PP_Cpr_Chassis_Data.AdsUDLCStatus_Status, ecu-extract-reference=TopLevelCompositionPrototype.Cpr_Prototype.PP_Cpr_Chassis_Data.AdsUDLCStatus_Status
      BrakePressureSimulator_321: upstream-reference=TopLevelComposition.Cpr_Prototype.PP_Cpr_Chassis_Data.BrakePressureSimulator, ecu-extract-reference=TopLevelCompositionPrototype.Cpr_Prototype.PP_Cpr_Chassis_Data.BrakePressureSimulator
      BrakePressureSimulator_Status_322: upstream-reference=TopLevelComposition.Cpr_Prototype.PP_Cpr_Chassis_Data.BrakePressureSimulator_Status, ecu-extract-reference=TopLevelCompositionPrototype.Cpr_Prototype.PP_Cpr_Chassis_Data.BrakePressureSimulator_Status
      EPS_APA_EpasFAILED_323: upstream-reference=TopLevelComposition.Cpr_Prototype.PP_Cpr_Chassis_Data.EPS_APA_EpasFAILED, ecu-extract-reference=TopLevelCompositionPrototype.Cpr_Prototype.PP_Cpr_Chassis_Data.EPS_APA_EpasFAILED
      EPS_APA_EpasFAILED_Status_324: upstream-reference=TopLevelComposition.Cpr_Prototype.PP_Cpr_Chassis_Data.EPS_APA_EpasFAILED_Status, ecu-extract-reference=TopLevelCompositionPrototype.Cpr_Prototype.PP_Cpr_Chassis_Data.EPS_APA_EpasFAILED_Status
      EPS_ActualMotorTorq_325: upstream-reference=TopLevelComposition.Cpr_Prototype.PP_Cpr_Chassis_Data.EPS_ActualMotorTorq, ecu-extract-reference=TopLevelCompositionPrototype.Cpr_Prototype.PP_Cpr_Chassis_Data.EPS_ActualMotorTorq
      EPS_ActualMotorTorq_Status_326: upstream-reference=TopLevelComposition.Cpr_Prototype.PP_Cpr_Chassis_Data.EPS_ActualMotorTorq_Status, ecu-extract-reference=TopLevelCompositionPrototype.Cpr_Prototype.PP_Cpr_Chassis_Data.EPS_ActualMotorTorq_Status
      EPS_ActualTorsionBarTorq_327: upstream-reference=TopLevelComposition.Cpr_Prototype.PP_Cpr_Chassis_Data.EPS_ActualTorsionBarTorq, ecu-extract-reference=TopLevelCompositionPrototype.Cpr_Prototype.PP_Cpr_Chassis_Data.EPS_ActualTorsionBarTorq
      EPS_ActualTorsionBarTorq_Status_328: upstream-reference=TopLevelComposition.Cpr_Prototype.PP_Cpr_Chassis_Data.EPS_ActualTorsionBarTorq_Status, ecu-extract-reference=TopLevelCompositionPrototype.Cpr_Prototype.PP_Cpr_Chassis_Data.EPS_ActualTorsionBarTorq_Status
      EPS_MeasuredTorsionBarTorqValid_329: upstream-reference=TopLevelComposition.Cpr_Prototype.PP_Cpr_Chassis_Data.EPS_MeasuredTorsionBarTorqValid, ecu-extract-reference=TopLevelCompositionPrototype.Cpr_Prototype.PP_Cpr_Chassis_Data.EPS_MeasuredTorsionBarTorqValid
      EPS_Pinionang_Valid_330: upstream-reference=TopLevelComposition.Cpr_Prototype.PP_Cpr_Chassis_Data.EPS_Pinionang_Valid, ecu-extract-reference=TopLevelCompositionPrototype.Cpr_Prototype.PP_Cpr_Chassis_Data.EPS_Pinionang_Valid
      EPS_fault_state_331: upstream-reference=TopLevelComposition.Cpr_Prototype.PP_Cpr_Chassis_Data.EPS_fault_state, ecu-extract-reference=TopLevelCompositionPrototype.Cpr_Prototype.PP_Cpr_Chassis_Data.EPS_fault_state
      EPS_fault_state_Status_332: upstream-reference=TopLevelComposition.Cpr_Prototype.PP_Cpr_Chassis_Data.EPS_fault_state_Status, ecu-extract-reference=TopLevelCompositionPrototype.Cpr_Prototype.PP_Cpr_Chassis_Data.EPS_fault_state_Status
      ESP_LatAccelValid_333: upstream-reference=TopLevelComposition.Cpr_Prototype.PP_Cpr_Chassis_Data.ESP_LatAccelValid, ecu-extract-reference=TopLevelCompositionPrototype.Cpr_Prototype.PP_Cpr_Chassis_Data.ESP_LatAccelValid
      ESP_LongAccelValid_334: upstream-reference=TopLevelComposition.Cpr_Prototype.PP_Cpr_Chassis_Data.ESP_LongAccelValid, ecu-extract-reference=TopLevelCompositionPrototype.Cpr_Prototype.PP_Cpr_Chassis_Data.ESP_LongAccelValid
      ESP_YawRateValid_335: upstream-reference=TopLevelComposition.Cpr_Prototype.PP_Cpr_Chassis_Data.ESP_YawRateValid, ecu-extract-reference=TopLevelCompositionPrototype.Cpr_Prototype.PP_Cpr_Chassis_Data.ESP_YawRateValid
      EpsConcussAvailabilityStatus_336: upstream-reference=TopLevelComposition.Cpr_Prototype.PP_Cpr_Chassis_Data.EpsConcussAvailabilityStatus, ecu-extract-reference=TopLevelCompositionPrototype.Cpr_Prototype.PP_Cpr_Chassis_Data.EpsConcussAvailabilityStatus
      EpsConcussAvailabilityStatus_Status_337: upstream-reference=TopLevelComposition.Cpr_Prototype.PP_Cpr_Chassis_Data.EpsConcussAvailabilityStatus_Status, ecu-extract-reference=TopLevelCompositionPrototype.Cpr_Prototype.PP_Cpr_Chassis_Data.EpsConcussAvailabilityStatus_Status
      EpsFaild_338: upstream-reference=TopLevelComposition.Cpr_Prototype.PP_Cpr_Chassis_Data.EpsFaild, ecu-extract-reference=TopLevelCompositionPrototype.Cpr_Prototype.PP_Cpr_Chassis_Data.EpsFaild
      EpsFaild_Status_339: upstream-reference=TopLevelComposition.Cpr_Prototype.PP_Cpr_Chassis_Data.EpsFaild_Status, ecu-extract-reference=TopLevelCompositionPrototype.Cpr_Prototype.PP_Cpr_Chassis_Data.EpsFaild_Status
      EpsIACCabortreason_340: upstream-reference=TopLevelComposition.Cpr_Prototype.PP_Cpr_Chassis_Data.EpsIACCabortreason, ecu-extract-reference=TopLevelCompositionPrototype.Cpr_Prototype.PP_Cpr_Chassis_Data.EpsIACCabortreason
      EpsIACCabortreason_Status_341: upstream-reference=TopLevelComposition.Cpr_Prototype.PP_Cpr_Chassis_Data.EpsIACCabortreason_Status, ecu-extract-reference=TopLevelCompositionPrototype.Cpr_Prototype.PP_Cpr_Chassis_Data.EpsIACCabortreason_Status
      EpsLatCtrlActive_342: upstream-reference=TopLevelComposition.Cpr_Prototype.PP_Cpr_Chassis_Data.EpsLatCtrlActive, ecu-extract-reference=TopLevelCompositionPrototype.Cpr_Prototype.PP_Cpr_Chassis_Data.EpsLatCtrlActive
      EpsLatCtrlActive_Status_343: upstream-reference=TopLevelComposition.Cpr_Prototype.PP_Cpr_Chassis_Data.EpsLatCtrlActive_Status, ecu-extract-reference=TopLevelCompositionPrototype.Cpr_Prototype.PP_Cpr_Chassis_Data.EpsLatCtrlActive_Status
      EpsLatCtrlAvailabilityStatus_344: upstream-reference=TopLevelComposition.Cpr_Prototype.PP_Cpr_Chassis_Data.EpsLatCtrlAvailabilityStatus, ecu-extract-reference=TopLevelCompositionPrototype.Cpr_Prototype.PP_Cpr_Chassis_Data.EpsLatCtrlAvailabilityStatus
      EpsLatCtrlAvailabilityStatus_Status_345: upstream-reference=TopLevelComposition.Cpr_Prototype.PP_Cpr_Chassis_Data.EpsLatCtrlAvailabilityStatus_Status, ecu-extract-reference=TopLevelCompositionPrototype.Cpr_Prototype.PP_Cpr_Chassis_Data.EpsLatCtrlAvailabilityStatus_Status
      EpsMeasuredTorsionBarTorq_Status_346: upstream-reference=TopLevelComposition.Cpr_Prototype.PP_Cpr_Chassis_Data.EpsMeasuredTorsionBarTorq_Status, ecu-extract-reference=TopLevelCompositionPrototype.Cpr_Prototype.PP_Cpr_Chassis_Data.EpsMeasuredTorsionBarTorq_Status
      EpsMeasuredTorsionBarTorque_347: upstream-reference=TopLevelComposition.Cpr_Prototype.PP_Cpr_Chassis_Data.EpsMeasuredTorsionBarTorque, ecu-extract-reference=TopLevelCompositionPrototype.Cpr_Prototype.PP_Cpr_Chassis_Data.EpsMeasuredTorsionBarTorque
      EpsMeasuredTorsionBarTorque_Status_348: upstream-reference=TopLevelComposition.Cpr_Prototype.PP_Cpr_Chassis_Data.EpsMeasuredTorsionBarTorque_Status, ecu-extract-reference=TopLevelCompositionPrototype.Cpr_Prototype.PP_Cpr_Chassis_Data.EpsMeasuredTorsionBarTorque_Status
      EpsPinionang_349: upstream-reference=TopLevelComposition.Cpr_Prototype.PP_Cpr_Chassis_Data.EpsPinionang, ecu-extract-reference=TopLevelCompositionPrototype.Cpr_Prototype.PP_Cpr_Chassis_Data.EpsPinionang
      EpsPinionang_Status_350: upstream-reference=TopLevelComposition.Cpr_Prototype.PP_Cpr_Chassis_Data.EpsPinionang_Status, ecu-extract-reference=TopLevelCompositionPrototype.Cpr_Prototype.PP_Cpr_Chassis_Data.EpsPinionang_Status
      EpsSasCalSts_351: upstream-reference=TopLevelComposition.Cpr_Prototype.PP_Cpr_Chassis_Data.EpsSasCalSts, ecu-extract-reference=TopLevelCompositionPrototype.Cpr_Prototype.PP_Cpr_Chassis_Data.EpsSasCalSts
      EpsSasCalSts_Status_352: upstream-reference=TopLevelComposition.Cpr_Prototype.PP_Cpr_Chassis_Data.EpsSasCalSts_Status, ecu-extract-reference=TopLevelCompositionPrototype.Cpr_Prototype.PP_Cpr_Chassis_Data.EpsSasCalSts_Status
      EpsSasSteerAg_353: upstream-reference=TopLevelComposition.Cpr_Prototype.PP_Cpr_Chassis_Data.EpsSasSteerAg, ecu-extract-reference=TopLevelCompositionPrototype.Cpr_Prototype.PP_Cpr_Chassis_Data.EpsSasSteerAg
      EpsSasSteerAgVld_354: upstream-reference=TopLevelComposition.Cpr_Prototype.PP_Cpr_Chassis_Data.EpsSasSteerAgVld, ecu-extract-reference=TopLevelCompositionPrototype.Cpr_Prototype.PP_Cpr_Chassis_Data.EpsSasSteerAgVld
      EpsSasSteerAg_Status_355: upstream-reference=TopLevelComposition.Cpr_Prototype.PP_Cpr_Chassis_Data.EpsSasSteerAg_Status, ecu-extract-reference=TopLevelCompositionPrototype.Cpr_Prototype.PP_Cpr_Chassis_Data.EpsSasSteerAg_Status
      EpsSteerAgRate_356: upstream-reference=TopLevelComposition.Cpr_Prototype.PP_Cpr_Chassis_Data.EpsSteerAgRate, ecu-extract-reference=TopLevelCompositionPrototype.Cpr_Prototype.PP_Cpr_Chassis_Data.EpsSteerAgRate
      EpsSteerAgRate_Status_357: upstream-reference=TopLevelComposition.Cpr_Prototype.PP_Cpr_Chassis_Data.EpsSteerAgRate_Status, ecu-extract-reference=TopLevelCompositionPrototype.Cpr_Prototype.PP_Cpr_Chassis_Data.EpsSteerAgRate_Status
      EpsSteerAgSensFilr_358: upstream-reference=TopLevelComposition.Cpr_Prototype.PP_Cpr_Chassis_Data.EpsSteerAgSensFilr, ecu-extract-reference=TopLevelCompositionPrototype.Cpr_Prototype.PP_Cpr_Chassis_Data.EpsSteerAgSensFilr
      EpsSteerAgSensFilr_Status_359: upstream-reference=TopLevelComposition.Cpr_Prototype.PP_Cpr_Chassis_Data.EpsSteerAgSensFilr_Status, ecu-extract-reference=TopLevelCompositionPrototype.Cpr_Prototype.PP_Cpr_Chassis_Data.EpsSteerAgSensFilr_Status
      EspABAactive_360: upstream-reference=TopLevelComposition.Cpr_Prototype.PP_Cpr_Chassis_Data.EspABAactive, ecu-extract-reference=TopLevelCompositionPrototype.Cpr_Prototype.PP_Cpr_Chassis_Data.EspABAactive
      EspABAactive_Status_361: upstream-reference=TopLevelComposition.Cpr_Prototype.PP_Cpr_Chassis_Data.EspABAactive_Status, ecu-extract-reference=TopLevelCompositionPrototype.Cpr_Prototype.PP_Cpr_Chassis_Data.EspABAactive_Status
      EspABAavailable_362: upstream-reference=TopLevelComposition.Cpr_Prototype.PP_Cpr_Chassis_Data.EspABAavailable, ecu-extract-reference=TopLevelCompositionPrototype.Cpr_Prototype.PP_Cpr_Chassis_Data.EspABAavailable
      EspABAavailable_Status_363: upstream-reference=TopLevelComposition.Cpr_Prototype.PP_Cpr_Chassis_Data.EspABAavailable_Status, ecu-extract-reference=TopLevelCompositionPrototype.Cpr_Prototype.PP_Cpr_Chassis_Data.EspABAavailable_Status
      EspAEBAvailable_364: upstream-reference=TopLevelComposition.Cpr_Prototype.PP_Cpr_Chassis_Data.EspAEBAvailable, ecu-extract-reference=TopLevelCompositionPrototype.Cpr_Prototype.PP_Cpr_Chassis_Data.EspAEBAvailable
      EspAEBAvailable_Status_365: upstream-reference=TopLevelComposition.Cpr_Prototype.PP_Cpr_Chassis_Data.EspAEBAvailable_Status, ecu-extract-reference=TopLevelCompositionPrototype.Cpr_Prototype.PP_Cpr_Chassis_Data.EspAEBAvailable_Status
      EspAEBdecActive_366: upstream-reference=TopLevelComposition.Cpr_Prototype.PP_Cpr_Chassis_Data.EspAEBdecActive, ecu-extract-reference=TopLevelCompositionPrototype.Cpr_Prototype.PP_Cpr_Chassis_Data.EspAEBdecActive
      EspAEBdecActive_Status_367: upstream-reference=TopLevelComposition.Cpr_Prototype.PP_Cpr_Chassis_Data.EspAEBdecActive_Status, ecu-extract-reference=TopLevelCompositionPrototype.Cpr_Prototype.PP_Cpr_Chassis_Data.EspAEBdecActive_Status
      EspAWBactive_368: upstream-reference=TopLevelComposition.Cpr_Prototype.PP_Cpr_Chassis_Data.EspAWBactive, ecu-extract-reference=TopLevelCompositionPrototype.Cpr_Prototype.PP_Cpr_Chassis_Data.EspAWBactive
      EspAWBactive_Status_369: upstream-reference=TopLevelComposition.Cpr_Prototype.PP_Cpr_Chassis_Data.EspAWBactive_Status, ecu-extract-reference=TopLevelCompositionPrototype.Cpr_Prototype.PP_Cpr_Chassis_Data.EspAWBactive_Status
      EspAWBavailable_370: upstream-reference=TopLevelComposition.Cpr_Prototype.PP_Cpr_Chassis_Data.EspAWBavailable, ecu-extract-reference=TopLevelCompositionPrototype.Cpr_Prototype.PP_Cpr_Chassis_Data.EspAWBavailable
      EspAWBavailable_Status_371: upstream-reference=TopLevelComposition.Cpr_Prototype.PP_Cpr_Chassis_Data.EspAWBavailable_Status, ecu-extract-reference=TopLevelCompositionPrototype.Cpr_Prototype.PP_Cpr_Chassis_Data.EspAWBavailable_Status
      EspAbsActv_372: upstream-reference=TopLevelComposition.Cpr_Prototype.PP_Cpr_Chassis_Data.EspAbsActv, ecu-extract-reference=TopLevelCompositionPrototype.Cpr_Prototype.PP_Cpr_Chassis_Data.EspAbsActv
      EspAbsActv_Status_373: upstream-reference=TopLevelComposition.Cpr_Prototype.PP_Cpr_Chassis_Data.EspAbsActv_Status, ecu-extract-reference=TopLevelCompositionPrototype.Cpr_Prototype.PP_Cpr_Chassis_Data.EspAbsActv_Status
      EspAbsFailr_374: upstream-reference=TopLevelComposition.Cpr_Prototype.PP_Cpr_Chassis_Data.EspAbsFailr, ecu-extract-reference=TopLevelCompositionPrototype.Cpr_Prototype.PP_Cpr_Chassis_Data.EspAbsFailr
      EspAbsFailr_Status_375: upstream-reference=TopLevelComposition.Cpr_Prototype.PP_Cpr_Chassis_Data.EspAbsFailr_Status, ecu-extract-reference=TopLevelCompositionPrototype.Cpr_Prototype.PP_Cpr_Chassis_Data.EspAbsFailr_Status
      EspActvSts_376: upstream-reference=TopLevelComposition.Cpr_Prototype.PP_Cpr_Chassis_Data.EspActvSts, ecu-extract-reference=TopLevelCompositionPrototype.Cpr_Prototype.PP_Cpr_Chassis_Data.EspActvSts
      EspActvSts_Status_377: upstream-reference=TopLevelComposition.Cpr_Prototype.PP_Cpr_Chassis_Data.EspActvSts_Status, ecu-extract-reference=TopLevelCompositionPrototype.Cpr_Prototype.PP_Cpr_Chassis_Data.EspActvSts_Status
      EspEbdFailr_378: upstream-reference=TopLevelComposition.Cpr_Prototype.PP_Cpr_Chassis_Data.EspEbdFailr, ecu-extract-reference=TopLevelCompositionPrototype.Cpr_Prototype.PP_Cpr_Chassis_Data.EspEbdFailr
      EspEbdFailr_Status_379: upstream-reference=TopLevelComposition.Cpr_Prototype.PP_Cpr_Chassis_Data.EspEbdFailr_Status, ecu-extract-reference=TopLevelCompositionPrototype.Cpr_Prototype.PP_Cpr_Chassis_Data.EspEbdFailr_Status
      EspLatAccel_380: upstream-reference=TopLevelComposition.Cpr_Prototype.PP_Cpr_Chassis_Data.EspLatAccel, ecu-extract-reference=TopLevelCompositionPrototype.Cpr_Prototype.PP_Cpr_Chassis_Data.EspLatAccel
      EspLatAccel_Status_381: upstream-reference=TopLevelComposition.Cpr_Prototype.PP_Cpr_Chassis_Data.EspLatAccel_Status, ecu-extract-reference=TopLevelCompositionPrototype.Cpr_Prototype.PP_Cpr_Chassis_Data.EspLatAccel_Status
      EspLongAccel_382: upstream-reference=TopLevelComposition.Cpr_Prototype.PP_Cpr_Chassis_Data.EspLongAccel, ecu-extract-reference=TopLevelCompositionPrototype.Cpr_Prototype.PP_Cpr_Chassis_Data.EspLongAccel
      EspLongAccel_Status_383: upstream-reference=TopLevelComposition.Cpr_Prototype.PP_Cpr_Chassis_Data.EspLongAccel_Status, ecu-extract-reference=TopLevelCompositionPrototype.Cpr_Prototype.PP_Cpr_Chassis_Data.EspLongAccel_Status
      EspPrefillActive_384: upstream-reference=TopLevelComposition.Cpr_Prototype.PP_Cpr_Chassis_Data.EspPrefillActive, ecu-extract-reference=TopLevelCompositionPrototype.Cpr_Prototype.PP_Cpr_Chassis_Data.EspPrefillActive
      EspPrefillActive_Status_385: upstream-reference=TopLevelComposition.Cpr_Prototype.PP_Cpr_Chassis_Data.EspPrefillActive_Status, ecu-extract-reference=TopLevelCompositionPrototype.Cpr_Prototype.PP_Cpr_Chassis_Data.EspPrefillActive_Status
      EspPrefillAvailable_386: upstream-reference=TopLevelComposition.Cpr_Prototype.PP_Cpr_Chassis_Data.EspPrefillAvailable, ecu-extract-reference=TopLevelCompositionPrototype.Cpr_Prototype.PP_Cpr_Chassis_Data.EspPrefillAvailable
      EspPrefillAvailable_Status_387: upstream-reference=TopLevelComposition.Cpr_Prototype.PP_Cpr_Chassis_Data.EspPrefillAvailable_Status, ecu-extract-reference=TopLevelCompositionPrototype.Cpr_Prototype.PP_Cpr_Chassis_Data.EspPrefillAvailable_Status
      EspTcsActvSts_388: upstream-reference=TopLevelComposition.Cpr_Prototype.PP_Cpr_Chassis_Data.EspTcsActvSts, ecu-extract-reference=TopLevelCompositionPrototype.Cpr_Prototype.PP_Cpr_Chassis_Data.EspTcsActvSts
      EspTcsActvSts_Status_389: upstream-reference=TopLevelComposition.Cpr_Prototype.PP_Cpr_Chassis_Data.EspTcsActvSts_Status, ecu-extract-reference=TopLevelCompositionPrototype.Cpr_Prototype.PP_Cpr_Chassis_Data.EspTcsActvSts_Status
      EspTcsFailr_390: upstream-reference=TopLevelComposition.Cpr_Prototype.PP_Cpr_Chassis_Data.EspTcsFailr, ecu-extract-reference=TopLevelCompositionPrototype.Cpr_Prototype.PP_Cpr_Chassis_Data.EspTcsFailr
      EspTcsFailr_Status_391: upstream-reference=TopLevelComposition.Cpr_Prototype.PP_Cpr_Chassis_Data.EspTcsFailr_Status, ecu-extract-reference=TopLevelCompositionPrototype.Cpr_Prototype.PP_Cpr_Chassis_Data.EspTcsFailr_Status
      EspVdcActvSts_392: upstream-reference=TopLevelComposition.Cpr_Prototype.PP_Cpr_Chassis_Data.EspVdcActvSts, ecu-extract-reference=TopLevelCompositionPrototype.Cpr_Prototype.PP_Cpr_Chassis_Data.EspVdcActvSts
      EspVdcActvSts_Status_393: upstream-reference=TopLevelComposition.Cpr_Prototype.PP_Cpr_Chassis_Data.EspVdcActvSts_Status, ecu-extract-reference=TopLevelCompositionPrototype.Cpr_Prototype.PP_Cpr_Chassis_Data.EspVdcActvSts_Status
      EspVehSpd_394: upstream-reference=TopLevelComposition.Cpr_Prototype.PP_Cpr_Chassis_Data.EspVehSpd, ecu-extract-reference=TopLevelCompositionPrototype.Cpr_Prototype.PP_Cpr_Chassis_Data.EspVehSpd
      EspVehSpdVld_395: upstream-reference=TopLevelComposition.Cpr_Prototype.PP_Cpr_Chassis_Data.EspVehSpdVld, ecu-extract-reference=TopLevelCompositionPrototype.Cpr_Prototype.PP_Cpr_Chassis_Data.EspVehSpdVld
      EspVehSpd_Status_396: upstream-reference=TopLevelComposition.Cpr_Prototype.PP_Cpr_Chassis_Data.EspVehSpd_Status, ecu-extract-reference=TopLevelCompositionPrototype.Cpr_Prototype.PP_Cpr_Chassis_Data.EspVehSpd_Status
      EspYawRate_397: upstream-reference=TopLevelComposition.Cpr_Prototype.PP_Cpr_Chassis_Data.EspYawRate, ecu-extract-reference=TopLevelCompositionPrototype.Cpr_Prototype.PP_Cpr_Chassis_Data.EspYawRate
      EspYawRate_Status_398: upstream-reference=TopLevelComposition.Cpr_Prototype.PP_Cpr_Chassis_Data.EspYawRate_Status, ecu-extract-reference=TopLevelCompositionPrototype.Cpr_Prototype.PP_Cpr_Chassis_Data.EspYawRate_Status
      IBCU_PFSBrakePressureValid_399: upstream-reference=TopLevelComposition.Cpr_Prototype.PP_Cpr_Chassis_Data.IBCU_PFSBrakePressureValid, ecu-extract-reference=TopLevelCompositionPrototype.Cpr_Prototype.PP_Cpr_Chassis_Data.IBCU_PFSBrakePressureValid
      IbBrkPedlStsGb_400: upstream-reference=TopLevelComposition.Cpr_Prototype.PP_Cpr_Chassis_Data.IbBrkPedlStsGb, ecu-extract-reference=TopLevelCompositionPrototype.Cpr_Prototype.PP_Cpr_Chassis_Data.IbBrkPedlStsGb
      IbBrkPedlStsGbVld_401: upstream-reference=TopLevelComposition.Cpr_Prototype.PP_Cpr_Chassis_Data.IbBrkPedlStsGbVld, ecu-extract-reference=TopLevelCompositionPrototype.Cpr_Prototype.PP_Cpr_Chassis_Data.IbBrkPedlStsGbVld
      IbBrkPedlStsGb_Status_402: upstream-reference=TopLevelComposition.Cpr_Prototype.PP_Cpr_Chassis_Data.IbBrkPedlStsGb_Status, ecu-extract-reference=TopLevelCompositionPrototype.Cpr_Prototype.PP_Cpr_Chassis_Data.IbBrkPedlStsGb_Status
      IbBrkPedlTrvlDrvr_403: upstream-reference=TopLevelComposition.Cpr_Prototype.PP_Cpr_Chassis_Data.IbBrkPedlTrvlDrvr, ecu-extract-reference=TopLevelCompositionPrototype.Cpr_Prototype.PP_Cpr_Chassis_Data.IbBrkPedlTrvlDrvr
      IbBrkPedlTrvlDrvrVld_404: upstream-reference=TopLevelComposition.Cpr_Prototype.PP_Cpr_Chassis_Data.IbBrkPedlTrvlDrvrVld, ecu-extract-reference=TopLevelCompositionPrototype.Cpr_Prototype.PP_Cpr_Chassis_Data.IbBrkPedlTrvlDrvrVld
      PlungerBrakePressure_405: upstream-reference=TopLevelComposition.Cpr_Prototype.PP_Cpr_Chassis_Data.PlungerBrakePressure, ecu-extract-reference=TopLevelCompositionPrototype.Cpr_Prototype.PP_Cpr_Chassis_Data.PlungerBrakePressure
      PlungerBrakePressure_Status_406: upstream-reference=TopLevelComposition.Cpr_Prototype.PP_Cpr_Chassis_Data.PlungerBrakePressure_Status, ecu-extract-reference=TopLevelCompositionPrototype.Cpr_Prototype.PP_Cpr_Chassis_Data.PlungerBrakePressure_Status
      VcuAccrPedlPosn_407: upstream-reference=TopLevelComposition.Cpr_Prototype.PP_Cpr_Chassis_Data.VcuAccrPedlPosn, ecu-extract-reference=TopLevelCompositionPrototype.Cpr_Prototype.PP_Cpr_Chassis_Data.VcuAccrPedlPosn
      VcuAccrPedlPosnVld_408: upstream-reference=TopLevelComposition.Cpr_Prototype.PP_Cpr_Chassis_Data.VcuAccrPedlPosnVld, ecu-extract-reference=TopLevelCompositionPrototype.Cpr_Prototype.PP_Cpr_Chassis_Data.VcuAccrPedlPosnVld
      VcuAccrPedlPosn_Status_409: upstream-reference=TopLevelComposition.Cpr_Prototype.PP_Cpr_Chassis_Data.VcuAccrPedlPosn_Status, ecu-extract-reference=TopLevelCompositionPrototype.Cpr_Prototype.PP_Cpr_Chassis_Data.VcuAccrPedlPosn_Status
      VcuGearPosn_410: upstream-reference=TopLevelComposition.Cpr_Prototype.PP_Cpr_Chassis_Data.VcuGearPosn, ecu-extract-reference=TopLevelCompositionPrototype.Cpr_Prototype.PP_Cpr_Chassis_Data.VcuGearPosn
      VcuGearPosn_Status_411: upstream-reference=TopLevelComposition.Cpr_Prototype.PP_Cpr_Chassis_Data.VcuGearPosn_Status, ecu-extract-reference=TopLevelCompositionPrototype.Cpr_Prototype.PP_Cpr_Chassis_Data.VcuGearPosn_Status
      VcuVehGearPosnVld_412: upstream-reference=TopLevelComposition.Cpr_Prototype.PP_Cpr_Chassis_Data.VcuVehGearPosnVld, ecu-extract-reference=TopLevelCompositionPrototype.Cpr_Prototype.PP_Cpr_Chassis_Data.VcuVehGearPosnVld
      PP_Cpr_GetMsgStatusInfo_413: upstream-reference=TopLevelComposition.Cpr_Prototype.PP_Cpr_GetMsgStatusInfo, ecu-extract-reference=TopLevelCompositionPrototype.Cpr_Prototype.PP_Cpr_GetMsgStatusInfo
      PP_Cpr_Powertrain_Data_414: upstream-reference=TopLevelComposition.Cpr_Prototype.PP_Cpr_Powertrain_Data, ecu-extract-reference=TopLevelCompositionPrototype.Cpr_Prototype.PP_Cpr_Powertrain_Data
      WhlSpdFrntLePls_415: upstream-reference=TopLevelComposition.Cpr_Prototype.PP_Cpr_Powertrain_Data.WhlSpdFrntLePls, ecu-extract-reference=TopLevelCompositionPrototype.Cpr_Prototype.PP_Cpr_Powertrain_Data.WhlSpdFrntLePls
      WhlSpdFrntLePls_Status_416: upstream-reference=TopLevelComposition.Cpr_Prototype.PP_Cpr_Powertrain_Data.WhlSpdFrntLePls_Status, ecu-extract-reference=TopLevelCompositionPrototype.Cpr_Prototype.PP_Cpr_Powertrain_Data.WhlSpdFrntLePls_Status
      WhlSpdFrntRiPls_417: upstream-reference=TopLevelComposition.Cpr_Prototype.PP_Cpr_Powertrain_Data.WhlSpdFrntRiPls, ecu-extract-reference=TopLevelCompositionPrototype.Cpr_Prototype.PP_Cpr_Powertrain_Data.WhlSpdFrntRiPls
      WhlSpdFrntRiPls_Status_418: upstream-reference=TopLevelComposition.Cpr_Prototype.PP_Cpr_Powertrain_Data.WhlSpdFrntRiPls_Status, ecu-extract-reference=TopLevelCompositionPrototype.Cpr_Prototype.PP_Cpr_Powertrain_Data.WhlSpdFrntRiPls_Status
      WhlSpdLeFrntData_419: upstream-reference=TopLevelComposition.Cpr_Prototype.PP_Cpr_Powertrain_Data.WhlSpdLeFrntData, ecu-extract-reference=TopLevelCompositionPrototype.Cpr_Prototype.PP_Cpr_Powertrain_Data.WhlSpdLeFrntData
      WhlSpdLeFrntDataVld_420: upstream-reference=TopLevelComposition.Cpr_Prototype.PP_Cpr_Powertrain_Data.WhlSpdLeFrntDataVld, ecu-extract-reference=TopLevelCompositionPrototype.Cpr_Prototype.PP_Cpr_Powertrain_Data.WhlSpdLeFrntDataVld
      WhlSpdLeFrntData_Status_421: upstream-reference=TopLevelComposition.Cpr_Prototype.PP_Cpr_Powertrain_Data.WhlSpdLeFrntData_Status, ecu-extract-reference=TopLevelCompositionPrototype.Cpr_Prototype.PP_Cpr_Powertrain_Data.WhlSpdLeFrntData_Status
      WhlSpdLeFrntDir_422: upstream-reference=TopLevelComposition.Cpr_Prototype.PP_Cpr_Powertrain_Data.WhlSpdLeFrntDir, ecu-extract-reference=TopLevelCompositionPrototype.Cpr_Prototype.PP_Cpr_Powertrain_Data.WhlSpdLeFrntDir
      WhlSpdLeFrntDir_Status_423: upstream-reference=TopLevelComposition.Cpr_Prototype.PP_Cpr_Powertrain_Data.WhlSpdLeFrntDir_Status, ecu-extract-reference=TopLevelCompositionPrototype.Cpr_Prototype.PP_Cpr_Powertrain_Data.WhlSpdLeFrntDir_Status
      WhlSpdLeReData_424: upstream-reference=TopLevelComposition.Cpr_Prototype.PP_Cpr_Powertrain_Data.WhlSpdLeReData, ecu-extract-reference=TopLevelCompositionPrototype.Cpr_Prototype.PP_Cpr_Powertrain_Data.WhlSpdLeReData
      WhlSpdLeReDataVld_425: upstream-reference=TopLevelComposition.Cpr_Prototype.PP_Cpr_Powertrain_Data.WhlSpdLeReDataVld, ecu-extract-reference=TopLevelCompositionPrototype.Cpr_Prototype.PP_Cpr_Powertrain_Data.WhlSpdLeReDataVld
      WhlSpdLeReData_Status_426: upstream-reference=TopLevelComposition.Cpr_Prototype.PP_Cpr_Powertrain_Data.WhlSpdLeReData_Status, ecu-extract-reference=TopLevelCompositionPrototype.Cpr_Prototype.PP_Cpr_Powertrain_Data.WhlSpdLeReData_Status
      WhlSpdLeReDir_427: upstream-reference=TopLevelComposition.Cpr_Prototype.PP_Cpr_Powertrain_Data.WhlSpdLeReDir, ecu-extract-reference=TopLevelCompositionPrototype.Cpr_Prototype.PP_Cpr_Powertrain_Data.WhlSpdLeReDir
      WhlSpdLeReDir_Status_428: upstream-reference=TopLevelComposition.Cpr_Prototype.PP_Cpr_Powertrain_Data.WhlSpdLeReDir_Status, ecu-extract-reference=TopLevelCompositionPrototype.Cpr_Prototype.PP_Cpr_Powertrain_Data.WhlSpdLeReDir_Status
      WhlSpdReLePls_429: upstream-reference=TopLevelComposition.Cpr_Prototype.PP_Cpr_Powertrain_Data.WhlSpdReLePls, ecu-extract-reference=TopLevelCompositionPrototype.Cpr_Prototype.PP_Cpr_Powertrain_Data.WhlSpdReLePls
      WhlSpdReLePls_Status_430: upstream-reference=TopLevelComposition.Cpr_Prototype.PP_Cpr_Powertrain_Data.WhlSpdReLePls_Status, ecu-extract-reference=TopLevelCompositionPrototype.Cpr_Prototype.PP_Cpr_Powertrain_Data.WhlSpdReLePls_Status
      WhlSpdReRiPls_431: upstream-reference=TopLevelComposition.Cpr_Prototype.PP_Cpr_Powertrain_Data.WhlSpdReRiPls, ecu-extract-reference=TopLevelCompositionPrototype.Cpr_Prototype.PP_Cpr_Powertrain_Data.WhlSpdReRiPls
      WhlSpdReRiPls_Status_432: upstream-reference=TopLevelComposition.Cpr_Prototype.PP_Cpr_Powertrain_Data.WhlSpdReRiPls_Status, ecu-extract-reference=TopLevelCompositionPrototype.Cpr_Prototype.PP_Cpr_Powertrain_Data.WhlSpdReRiPls_Status
      WhlSpdRiFrntData_433: upstream-reference=TopLevelComposition.Cpr_Prototype.PP_Cpr_Powertrain_Data.WhlSpdRiFrntData, ecu-extract-reference=TopLevelCompositionPrototype.Cpr_Prototype.PP_Cpr_Powertrain_Data.WhlSpdRiFrntData
      WhlSpdRiFrntDataVld_434: upstream-reference=TopLevelComposition.Cpr_Prototype.PP_Cpr_Powertrain_Data.WhlSpdRiFrntDataVld, ecu-extract-reference=TopLevelCompositionPrototype.Cpr_Prototype.PP_Cpr_Powertrain_Data.WhlSpdRiFrntDataVld
      WhlSpdRiFrntData_Status_435: upstream-reference=TopLevelComposition.Cpr_Prototype.PP_Cpr_Powertrain_Data.WhlSpdRiFrntData_Status, ecu-extract-reference=TopLevelCompositionPrototype.Cpr_Prototype.PP_Cpr_Powertrain_Data.WhlSpdRiFrntData_Status
      WhlSpdRiFrntDir_436: upstream-reference=TopLevelComposition.Cpr_Prototype.PP_Cpr_Powertrain_Data.WhlSpdRiFrntDir, ecu-extract-reference=TopLevelCompositionPrototype.Cpr_Prototype.PP_Cpr_Powertrain_Data.WhlSpdRiFrntDir
      WhlSpdRiFrntDir_Status_437: upstream-reference=TopLevelComposition.Cpr_Prototype.PP_Cpr_Powertrain_Data.WhlSpdRiFrntDir_Status, ecu-extract-reference=TopLevelCompositionPrototype.Cpr_Prototype.PP_Cpr_Powertrain_Data.WhlSpdRiFrntDir_Status
      WhlSpdRiReData_438: upstream-reference=TopLevelComposition.Cpr_Prototype.PP_Cpr_Powertrain_Data.WhlSpdRiReData, ecu-extract-reference=TopLevelCompositionPrototype.Cpr_Prototype.PP_Cpr_Powertrain_Data.WhlSpdRiReData
      WhlSpdRiReDataVld_439: upstream-reference=TopLevelComposition.Cpr_Prototype.PP_Cpr_Powertrain_Data.WhlSpdRiReDataVld, ecu-extract-reference=TopLevelCompositionPrototype.Cpr_Prototype.PP_Cpr_Powertrain_Data.WhlSpdRiReDataVld
      WhlSpdRiReData_Status_440: upstream-reference=TopLevelComposition.Cpr_Prototype.PP_Cpr_Powertrain_Data.WhlSpdRiReData_Status, ecu-extract-reference=TopLevelCompositionPrototype.Cpr_Prototype.PP_Cpr_Powertrain_Data.WhlSpdRiReData_Status
      WhlSpdRiReDir_441: upstream-reference=TopLevelComposition.Cpr_Prototype.PP_Cpr_Powertrain_Data.WhlSpdRiReDir, ecu-extract-reference=TopLevelCompositionPrototype.Cpr_Prototype.PP_Cpr_Powertrain_Data.WhlSpdRiReDir
      WhlSpdRiReDir_Status_442: upstream-reference=TopLevelComposition.Cpr_Prototype.PP_Cpr_Powertrain_Data.WhlSpdRiReDir_Status, ecu-extract-reference=TopLevelCompositionPrototype.Cpr_Prototype.PP_Cpr_Powertrain_Data.WhlSpdRiReDir_Status
      Cps_Prototype_443: upstream-reference=TopLevelComposition.Cps_Prototype, ecu-extract-reference=TopLevelCompositionPrototype.Cps_Prototype
      RP_Cps_SRI_TxSignal_Acc_444: upstream-reference=TopLevelComposition.Cps_Prototype.RP_Cps_SRI_TxSignal_Acc, ecu-extract-reference=TopLevelCompositionPrototype.Cps_Prototype.RP_Cps_SRI_TxSignal_Acc
      Cps_SignalPhyData_FC_ACC_temp_445: upstream-reference=TopLevelComposition.Cps_Prototype.RP_Cps_SRI_TxSignal_Acc.Cps_SignalPhyData_FC_ACC_temp, ecu-extract-reference=TopLevelCompositionPrototype.Cps_Prototype.RP_Cps_SRI_TxSignal_Acc.Cps_SignalPhyData_FC_ACC_temp
      RP_Cps_SRI_TxSignal_Aeb_446: upstream-reference=TopLevelComposition.Cps_Prototype.RP_Cps_SRI_TxSignal_Aeb, ecu-extract-reference=TopLevelCompositionPrototype.Cps_Prototype.RP_Cps_SRI_TxSignal_Aeb
      Cps_SignalPhyData_FC_ABAActive_447: upstream-reference=TopLevelComposition.Cps_Prototype.RP_Cps_SRI_TxSignal_Aeb.Cps_SignalPhyData_FC_ABAActive, ecu-extract-reference=TopLevelCompositionPrototype.Cps_Prototype.RP_Cps_SRI_TxSignal_Aeb.Cps_SignalPhyData_FC_ABAActive
      Cps_SignalPhyData_FC_ABAlevel_448: upstream-reference=TopLevelComposition.Cps_Prototype.RP_Cps_SRI_TxSignal_Aeb.Cps_SignalPhyData_FC_ABAlevel, ecu-extract-reference=TopLevelCompositionPrototype.Cps_Prototype.RP_Cps_SRI_TxSignal_Aeb.Cps_SignalPhyData_FC_ABAlevel
      Cps_SignalPhyData_FC_AEBActive_449: upstream-reference=TopLevelComposition.Cps_Prototype.RP_Cps_SRI_TxSignal_Aeb.Cps_SignalPhyData_FC_AEBActive, ecu-extract-reference=TopLevelCompositionPrototype.Cps_Prototype.RP_Cps_SRI_TxSignal_Aeb.Cps_SignalPhyData_FC_AEBActive
      Cps_SignalPhyData_FC_AEBCtrlType_450: upstream-reference=TopLevelComposition.Cps_Prototype.RP_Cps_SRI_TxSignal_Aeb.Cps_SignalPhyData_FC_AEBCtrlType, ecu-extract-reference=TopLevelCompositionPrototype.Cps_Prototype.RP_Cps_SRI_TxSignal_Aeb.Cps_SignalPhyData_FC_AEBCtrlType
      Cps_SignalPhyData_FC_AEBEnable_451: upstream-reference=TopLevelComposition.Cps_Prototype.RP_Cps_SRI_TxSignal_Aeb.Cps_SignalPhyData_FC_AEBEnable, ecu-extract-reference=TopLevelCompositionPrototype.Cps_Prototype.RP_Cps_SRI_TxSignal_Aeb.Cps_SignalPhyData_FC_AEBEnable
      Cps_SignalPhyData_FC_AEBStatus_452: upstream-reference=TopLevelComposition.Cps_Prototype.RP_Cps_SRI_TxSignal_Aeb.Cps_SignalPhyData_FC_AEBStatus, ecu-extract-reference=TopLevelCompositionPrototype.Cps_Prototype.RP_Cps_SRI_TxSignal_Aeb.Cps_SignalPhyData_FC_AEBStatus
      Cps_SignalPhyData_FC_AEBTargetAx_453: upstream-reference=TopLevelComposition.Cps_Prototype.RP_Cps_SRI_TxSignal_Aeb.Cps_SignalPhyData_FC_AEBTargetAx, ecu-extract-reference=TopLevelCompositionPrototype.Cps_Prototype.RP_Cps_SRI_TxSignal_Aeb.Cps_SignalPhyData_FC_AEBTargetAx
      Cps_SignalPhyData_FC_AEBTargetAy_454: upstream-reference=TopLevelComposition.Cps_Prototype.RP_Cps_SRI_TxSignal_Aeb.Cps_SignalPhyData_FC_AEBTargetAy, ecu-extract-reference=TopLevelCompositionPrototype.Cps_Prototype.RP_Cps_SRI_TxSignal_Aeb.Cps_SignalPhyData_FC_AEBTargetAy
      Cps_SignalPhyData_FC_AEBTargetDeceleration_455: upstream-reference=TopLevelComposition.Cps_Prototype.RP_Cps_SRI_TxSignal_Aeb.Cps_SignalPhyData_FC_AEBTargetDeceleration, ecu-extract-reference=TopLevelCompositionPrototype.Cps_Prototype.RP_Cps_SRI_TxSignal_Aeb.Cps_SignalPhyData_FC_AEBTargetDeceleration
      Cps_SignalPhyData_FC_AEBTargetDetection_456: upstream-reference=TopLevelComposition.Cps_Prototype.RP_Cps_SRI_TxSignal_Aeb.Cps_SignalPhyData_FC_AEBTargetDetection, ecu-extract-reference=TopLevelCompositionPrototype.Cps_Prototype.RP_Cps_SRI_TxSignal_Aeb.Cps_SignalPhyData_FC_AEBTargetDetection
      Cps_SignalPhyData_FC_AEBTargetLatRange_457: upstream-reference=TopLevelComposition.Cps_Prototype.RP_Cps_SRI_TxSignal_Aeb.Cps_SignalPhyData_FC_AEBTargetLatRange, ecu-extract-reference=TopLevelCompositionPrototype.Cps_Prototype.RP_Cps_SRI_TxSignal_Aeb.Cps_SignalPhyData_FC_AEBTargetLatRange
      Cps_SignalPhyData_FC_AEBTargetLatRelSpeed_458: upstream-reference=TopLevelComposition.Cps_Prototype.RP_Cps_SRI_TxSignal_Aeb.Cps_SignalPhyData_FC_AEBTargetLatRelSpeed, ecu-extract-reference=TopLevelCompositionPrototype.Cps_Prototype.RP_Cps_SRI_TxSignal_Aeb.Cps_SignalPhyData_FC_AEBTargetLatRelSpeed
      Cps_SignalPhyData_FC_AEBTargetLngRange_459: upstream-reference=TopLevelComposition.Cps_Prototype.RP_Cps_SRI_TxSignal_Aeb.Cps_SignalPhyData_FC_AEBTargetLngRange, ecu-extract-reference=TopLevelCompositionPrototype.Cps_Prototype.RP_Cps_SRI_TxSignal_Aeb.Cps_SignalPhyData_FC_AEBTargetLngRange
      Cps_SignalPhyData_FC_AEBTargetProb_460: upstream-reference=TopLevelComposition.Cps_Prototype.RP_Cps_SRI_TxSignal_Aeb.Cps_SignalPhyData_FC_AEBTargetProb, ecu-extract-reference=TopLevelCompositionPrototype.Cps_Prototype.RP_Cps_SRI_TxSignal_Aeb.Cps_SignalPhyData_FC_AEBTargetProb
      Cps_SignalPhyData_FC_AEBTargetRelSpeed_461: upstream-reference=TopLevelComposition.Cps_Prototype.RP_Cps_SRI_TxSignal_Aeb.Cps_SignalPhyData_FC_AEBTargetRelSpeed, ecu-extract-reference=TopLevelCompositionPrototype.Cps_Prototype.RP_Cps_SRI_TxSignal_Aeb.Cps_SignalPhyData_FC_AEBTargetRelSpeed
      Cps_SignalPhyData_FC_AEBTargetType_462: upstream-reference=TopLevelComposition.Cps_Prototype.RP_Cps_SRI_TxSignal_Aeb.Cps_SignalPhyData_FC_AEBTargetType, ecu-extract-reference=TopLevelCompositionPrototype.Cps_Prototype.RP_Cps_SRI_TxSignal_Aeb.Cps_SignalPhyData_FC_AEBTargetType
      Cps_SignalPhyData_FC_AEBTargetmode_463: upstream-reference=TopLevelComposition.Cps_Prototype.RP_Cps_SRI_TxSignal_Aeb.Cps_SignalPhyData_FC_AEBTargetmode, ecu-extract-reference=TopLevelCompositionPrototype.Cps_Prototype.RP_Cps_SRI_TxSignal_Aeb.Cps_SignalPhyData_FC_AEBTargetmode
      Cps_SignalPhyData_FC_AEBTextInfo_464: upstream-reference=TopLevelComposition.Cps_Prototype.RP_Cps_SRI_TxSignal_Aeb.Cps_SignalPhyData_FC_AEBTextInfo, ecu-extract-reference=TopLevelCompositionPrototype.Cps_Prototype.RP_Cps_SRI_TxSignal_Aeb.Cps_SignalPhyData_FC_AEBTextInfo
      Cps_SignalPhyData_FC_AEBVehilceHoldReq_465: upstream-reference=TopLevelComposition.Cps_Prototype.RP_Cps_SRI_TxSignal_Aeb.Cps_SignalPhyData_FC_AEBVehilceHoldReq, ecu-extract-reference=TopLevelCompositionPrototype.Cps_Prototype.RP_Cps_SRI_TxSignal_Aeb.Cps_SignalPhyData_FC_AEBVehilceHoldReq
      Cps_SignalPhyData_FC_AWBActive_466: upstream-reference=TopLevelComposition.Cps_Prototype.RP_Cps_SRI_TxSignal_Aeb.Cps_SignalPhyData_FC_AWBActive, ecu-extract-reference=TopLevelCompositionPrototype.Cps_Prototype.RP_Cps_SRI_TxSignal_Aeb.Cps_SignalPhyData_FC_AWBActive
      Cps_SignalPhyData_FC_AWBlevel_467: upstream-reference=TopLevelComposition.Cps_Prototype.RP_Cps_SRI_TxSignal_Aeb.Cps_SignalPhyData_FC_AWBlevel, ecu-extract-reference=TopLevelCompositionPrototype.Cps_Prototype.RP_Cps_SRI_TxSignal_Aeb.Cps_SignalPhyData_FC_AWBlevel
      Cps_SignalPhyData_FC_FCWActive_468: upstream-reference=TopLevelComposition.Cps_Prototype.RP_Cps_SRI_TxSignal_Aeb.Cps_SignalPhyData_FC_FCWActive, ecu-extract-reference=TopLevelCompositionPrototype.Cps_Prototype.RP_Cps_SRI_TxSignal_Aeb.Cps_SignalPhyData_FC_FCWActive
      Cps_SignalPhyData_FC_FCWLatentWarning_469: upstream-reference=TopLevelComposition.Cps_Prototype.RP_Cps_SRI_TxSignal_Aeb.Cps_SignalPhyData_FC_FCWLatentWarning, ecu-extract-reference=TopLevelCompositionPrototype.Cps_Prototype.RP_Cps_SRI_TxSignal_Aeb.Cps_SignalPhyData_FC_FCWLatentWarning
      Cps_SignalPhyData_FC_FCWPreWarning_470: upstream-reference=TopLevelComposition.Cps_Prototype.RP_Cps_SRI_TxSignal_Aeb.Cps_SignalPhyData_FC_FCWPreWarning, ecu-extract-reference=TopLevelCompositionPrototype.Cps_Prototype.RP_Cps_SRI_TxSignal_Aeb.Cps_SignalPhyData_FC_FCWPreWarning
      Cps_SignalPhyData_FC_FCWSettingStatus_471: upstream-reference=TopLevelComposition.Cps_Prototype.RP_Cps_SRI_TxSignal_Aeb.Cps_SignalPhyData_FC_FCWSettingStatus, ecu-extract-reference=TopLevelCompositionPrototype.Cps_Prototype.RP_Cps_SRI_TxSignal_Aeb.Cps_SignalPhyData_FC_FCWSettingStatus
      Cps_SignalPhyData_FC_FCWStatus_472: upstream-reference=TopLevelComposition.Cps_Prototype.RP_Cps_SRI_TxSignal_Aeb.Cps_SignalPhyData_FC_FCWStatus, ecu-extract-reference=TopLevelCompositionPrototype.Cps_Prototype.RP_Cps_SRI_TxSignal_Aeb.Cps_SignalPhyData_FC_FCWStatus
      Cps_SignalPhyData_FC_LLaneDistanceFus_473: upstream-reference=TopLevelComposition.Cps_Prototype.RP_Cps_SRI_TxSignal_Aeb.Cps_SignalPhyData_FC_LLaneDistanceFus, ecu-extract-reference=TopLevelCompositionPrototype.Cps_Prototype.RP_Cps_SRI_TxSignal_Aeb.Cps_SignalPhyData_FC_LLaneDistanceFus
      Cps_SignalPhyData_FC_LLaneMarkerType_474: upstream-reference=TopLevelComposition.Cps_Prototype.RP_Cps_SRI_TxSignal_Aeb.Cps_SignalPhyData_FC_LLaneMarkerType, ecu-extract-reference=TopLevelCompositionPrototype.Cps_Prototype.RP_Cps_SRI_TxSignal_Aeb.Cps_SignalPhyData_FC_LLaneMarkerType
      Cps_SignalPhyData_FC_OBJ_AEB_ID_475: upstream-reference=TopLevelComposition.Cps_Prototype.RP_Cps_SRI_TxSignal_Aeb.Cps_SignalPhyData_FC_OBJ_AEB_ID, ecu-extract-reference=TopLevelCompositionPrototype.Cps_Prototype.RP_Cps_SRI_TxSignal_Aeb.Cps_SignalPhyData_FC_OBJ_AEB_ID
      Cps_SignalPhyData_FC_PrefillActive_476: upstream-reference=TopLevelComposition.Cps_Prototype.RP_Cps_SRI_TxSignal_Aeb.Cps_SignalPhyData_FC_PrefillActive, ecu-extract-reference=TopLevelCompositionPrototype.Cps_Prototype.RP_Cps_SRI_TxSignal_Aeb.Cps_SignalPhyData_FC_PrefillActive
      Cps_SignalPhyData_FC_RLaneDistanceFus_477: upstream-reference=TopLevelComposition.Cps_Prototype.RP_Cps_SRI_TxSignal_Aeb.Cps_SignalPhyData_FC_RLaneDistanceFus, ecu-extract-reference=TopLevelCompositionPrototype.Cps_Prototype.RP_Cps_SRI_TxSignal_Aeb.Cps_SignalPhyData_FC_RLaneDistanceFus
      Cps_SignalPhyData_FC_RLaneMarkerType_478: upstream-reference=TopLevelComposition.Cps_Prototype.RP_Cps_SRI_TxSignal_Aeb.Cps_SignalPhyData_FC_RLaneMarkerType, ecu-extract-reference=TopLevelCompositionPrototype.Cps_Prototype.RP_Cps_SRI_TxSignal_Aeb.Cps_SignalPhyData_FC_RLaneMarkerType
      RP_Cps_SRI_TxSignal_Hla_479: upstream-reference=TopLevelComposition.Cps_Prototype.RP_Cps_SRI_TxSignal_Hla, ecu-extract-reference=TopLevelCompositionPrototype.Cps_Prototype.RP_Cps_SRI_TxSignal_Hla
      Cps_SignalPhyData_FC_HMAEnableStatus_480: upstream-reference=TopLevelComposition.Cps_Prototype.RP_Cps_SRI_TxSignal_Hla.Cps_SignalPhyData_FC_HMAEnableStatus, ecu-extract-reference=TopLevelCompositionPrototype.Cps_Prototype.RP_Cps_SRI_TxSignal_Hla.Cps_SignalPhyData_FC_HMAEnableStatus
      Cps_SignalPhyData_FC_HMALightDistribution_481: upstream-reference=TopLevelComposition.Cps_Prototype.RP_Cps_SRI_TxSignal_Hla.Cps_SignalPhyData_FC_HMALightDistribution, ecu-extract-reference=TopLevelCompositionPrototype.Cps_Prototype.RP_Cps_SRI_TxSignal_Hla.Cps_SignalPhyData_FC_HMALightDistribution
      Cps_SignalPhyData_FC_HMAStatus_482: upstream-reference=TopLevelComposition.Cps_Prototype.RP_Cps_SRI_TxSignal_Hla.Cps_SignalPhyData_FC_HMAStatus, ecu-extract-reference=TopLevelCompositionPrototype.Cps_Prototype.RP_Cps_SRI_TxSignal_Hla.Cps_SignalPhyData_FC_HMAStatus
      RP_Cps_SRI_TxSignal_Lcf_483: upstream-reference=TopLevelComposition.Cps_Prototype.RP_Cps_SRI_TxSignal_Lcf, ecu-extract-reference=TopLevelCompositionPrototype.Cps_Prototype.RP_Cps_SRI_TxSignal_Lcf
      Cps_SignalPhyData_ACC_HostLaneLeftStatus_484: upstream-reference=TopLevelComposition.Cps_Prototype.RP_Cps_SRI_TxSignal_Lcf.Cps_SignalPhyData_ACC_HostLaneLeftStatus, ecu-extract-reference=TopLevelCompositionPrototype.Cps_Prototype.RP_Cps_SRI_TxSignal_Lcf.Cps_SignalPhyData_ACC_HostLaneLeftStatus
      Cps_SignalPhyData_ACC_HostLaneRightStatus_485: upstream-reference=TopLevelComposition.Cps_Prototype.RP_Cps_SRI_TxSignal_Lcf.Cps_SignalPhyData_ACC_HostLaneRightStatus, ecu-extract-reference=TopLevelCompositionPrototype.Cps_Prototype.RP_Cps_SRI_TxSignal_Lcf.Cps_SignalPhyData_ACC_HostLaneRightStatus
      Cps_SignalPhyData_ACC_LatAngReq_486: upstream-reference=TopLevelComposition.Cps_Prototype.RP_Cps_SRI_TxSignal_Lcf.Cps_SignalPhyData_ACC_LatAngReq, ecu-extract-reference=TopLevelCompositionPrototype.Cps_Prototype.RP_Cps_SRI_TxSignal_Lcf.Cps_SignalPhyData_ACC_LatAngReq
      Cps_SignalPhyData_ACC_LatAngReqActive_487: upstream-reference=TopLevelComposition.Cps_Prototype.RP_Cps_SRI_TxSignal_Lcf.Cps_SignalPhyData_ACC_LatAngReqActive, ecu-extract-reference=TopLevelCompositionPrototype.Cps_Prototype.RP_Cps_SRI_TxSignal_Lcf.Cps_SignalPhyData_ACC_LatAngReqActive
      Cps_SignalPhyData_FC_ELKEnableStatus_488: upstream-reference=TopLevelComposition.Cps_Prototype.RP_Cps_SRI_TxSignal_Lcf.Cps_SignalPhyData_FC_ELKEnableStatus, ecu-extract-reference=TopLevelCompositionPrototype.Cps_Prototype.RP_Cps_SRI_TxSignal_Lcf.Cps_SignalPhyData_FC_ELKEnableStatus
      Cps_SignalPhyData_FC_ELKInterventionMode_489: upstream-reference=TopLevelComposition.Cps_Prototype.RP_Cps_SRI_TxSignal_Lcf.Cps_SignalPhyData_FC_ELKInterventionMode, ecu-extract-reference=TopLevelCompositionPrototype.Cps_Prototype.RP_Cps_SRI_TxSignal_Lcf.Cps_SignalPhyData_FC_ELKInterventionMode
      Cps_SignalPhyData_FC_ELKMode_490: upstream-reference=TopLevelComposition.Cps_Prototype.RP_Cps_SRI_TxSignal_Lcf.Cps_SignalPhyData_FC_ELKMode, ecu-extract-reference=TopLevelCompositionPrototype.Cps_Prototype.RP_Cps_SRI_TxSignal_Lcf.Cps_SignalPhyData_FC_ELKMode
      Cps_SignalPhyData_FC_HostLaneLeftStatus_491: upstream-reference=TopLevelComposition.Cps_Prototype.RP_Cps_SRI_TxSignal_Lcf.Cps_SignalPhyData_FC_HostLaneLeftStatus, ecu-extract-reference=TopLevelCompositionPrototype.Cps_Prototype.RP_Cps_SRI_TxSignal_Lcf.Cps_SignalPhyData_FC_HostLaneLeftStatus
      Cps_SignalPhyData_FC_HostLaneRightStatus_492: upstream-reference=TopLevelComposition.Cps_Prototype.RP_Cps_SRI_TxSignal_Lcf.Cps_SignalPhyData_FC_HostLaneRightStatus, ecu-extract-reference=TopLevelCompositionPrototype.Cps_Prototype.RP_Cps_SRI_TxSignal_Lcf.Cps_SignalPhyData_FC_HostLaneRightStatus
      Cps_SignalPhyData_FC_LASModeSelectionStatus_493: upstream-reference=TopLevelComposition.Cps_Prototype.RP_Cps_SRI_TxSignal_Lcf.Cps_SignalPhyData_FC_LASModeSelectionStatus, ecu-extract-reference=TopLevelCompositionPrototype.Cps_Prototype.RP_Cps_SRI_TxSignal_Lcf.Cps_SignalPhyData_FC_LASModeSelectionStatus
      Cps_SignalPhyData_FC_LASWarningModeSelectionSts_494: upstream-reference=TopLevelComposition.Cps_Prototype.RP_Cps_SRI_TxSignal_Lcf.Cps_SignalPhyData_FC_LASWarningModeSelectionSts, ecu-extract-reference=TopLevelCompositionPrototype.Cps_Prototype.RP_Cps_SRI_TxSignal_Lcf.Cps_SignalPhyData_FC_LASWarningModeSelectionSts
      Cps_SignalPhyData_FC_LDWShakeLevStatus_495: upstream-reference=TopLevelComposition.Cps_Prototype.RP_Cps_SRI_TxSignal_Lcf.Cps_SignalPhyData_FC_LDWShakeLevStatus, ecu-extract-reference=TopLevelCompositionPrototype.Cps_Prototype.RP_Cps_SRI_TxSignal_Lcf.Cps_SignalPhyData_FC_LDWShakeLevStatus
      Cps_SignalPhyData_FC_LDWStatus_496: upstream-reference=TopLevelComposition.Cps_Prototype.RP_Cps_SRI_TxSignal_Lcf.Cps_SignalPhyData_FC_LDWStatus, ecu-extract-reference=TopLevelCompositionPrototype.Cps_Prototype.RP_Cps_SRI_TxSignal_Lcf.Cps_SignalPhyData_FC_LDWStatus
      Cps_SignalPhyData_FC_LDWVibrationWarningReq_497: upstream-reference=TopLevelComposition.Cps_Prototype.RP_Cps_SRI_TxSignal_Lcf.Cps_SignalPhyData_FC_LDWVibrationWarningReq, ecu-extract-reference=TopLevelCompositionPrototype.Cps_Prototype.RP_Cps_SRI_TxSignal_Lcf.Cps_SignalPhyData_FC_LDWVibrationWarningReq
      Cps_SignalPhyData_FC_LKAStatus_498: upstream-reference=TopLevelComposition.Cps_Prototype.RP_Cps_SRI_TxSignal_Lcf.Cps_SignalPhyData_FC_LKAStatus, ecu-extract-reference=TopLevelCompositionPrototype.Cps_Prototype.RP_Cps_SRI_TxSignal_Lcf.Cps_SignalPhyData_FC_LKAStatus
      Cps_SignalPhyData_FC_LKATakeoverReq_499: upstream-reference=TopLevelComposition.Cps_Prototype.RP_Cps_SRI_TxSignal_Lcf.Cps_SignalPhyData_FC_LKATakeoverReq, ecu-extract-reference=TopLevelCompositionPrototype.Cps_Prototype.RP_Cps_SRI_TxSignal_Lcf.Cps_SignalPhyData_FC_LKATakeoverReq
      Cps_SignalPhyData_FC_LatAngReq_500: upstream-reference=TopLevelComposition.Cps_Prototype.RP_Cps_SRI_TxSignal_Lcf.Cps_SignalPhyData_FC_LatAngReq, ecu-extract-reference=TopLevelCompositionPrototype.Cps_Prototype.RP_Cps_SRI_TxSignal_Lcf.Cps_SignalPhyData_FC_LatAngReq
      Cps_SignalPhyData_FC_LatAngReqActive_501: upstream-reference=TopLevelComposition.Cps_Prototype.RP_Cps_SRI_TxSignal_Lcf.Cps_SignalPhyData_FC_LatAngReqActive, ecu-extract-reference=TopLevelCompositionPrototype.Cps_Prototype.RP_Cps_SRI_TxSignal_Lcf.Cps_SignalPhyData_FC_LatAngReqActive
      Cps_SignalPhyData_FC_MotorTorqueMaxLimitRequest_502: upstream-reference=TopLevelComposition.Cps_Prototype.RP_Cps_SRI_TxSignal_Lcf.Cps_SignalPhyData_FC_MotorTorqueMaxLimitRequest, ecu-extract-reference=TopLevelCompositionPrototype.Cps_Prototype.RP_Cps_SRI_TxSignal_Lcf.Cps_SignalPhyData_FC_MotorTorqueMaxLimitRequest
