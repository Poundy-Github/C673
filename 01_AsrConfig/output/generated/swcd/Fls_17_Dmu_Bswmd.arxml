AUTOSAR XML (schema 4-0-3)
package /AUTOSAR_Fls/BswModuleDescriptions
  bsw module description Fls_17_Dmu: module-id=92, provided-entrys=[Fls_17_Dmu_Init, Fls_17_Dmu_MainFunction]
    bsw internal behavior InternalBehavior_0
      bsw called entity Fls_17_Dmu_Init: implemented-entry=Fls_17_Dmu_Init, scheduler-name-prefix=Prefix_Fls_17_Dmu
      bsw schedulable entity Fls_17_Dmu_MainFunction: implemented-entry=Fls_17_Dmu_MainFunction, scheduler-name-prefix=Prefix_Fls_17_Dmu
      bsw timing event TimingEvent_MainFunction: starts-on-event=Fls_17_Dmu_MainFunction, period=0.01
      bsw scheduler name prefix Prefix_Fls_17_Dmu: symbol=Fls_17_Dmu
package /AUTOSAR_Fls/BswModuleEntrys
  bsw module entry Fls_17_Dmu_Init: service-id=0, is-reentrant=false, is-synchronous=true, call-type=REGULAR, execution-context=UNSPECIFIED, sw-service-impl-policy=STANDARD
  bsw module entry Fls_17_Dmu_MainFunction: service-id=6, is-reentrant=false, is-synchronous=true, call-type=SCHEDULED, execution-context=TASK, sw-service-impl-policy=STANDARD
package /AUTOSAR_Fls/ImplementationDataTypes
  impl type Fls_LengthType: implementation-data-type=uint32, type-emitter=BSW
  impl type Fls_AddressType: implementation-data-type=uint32, type-emitter=BSW
package /Fls_Aurix2GAS422/Implementations
  bsw implementation BswImplementation_0: programming-language=C, sw-version=20.0.1, vendor-id=17, ar-release-version=4.2.2, behavior=InternalBehavior_0, vendor-specific-module-def=Fls
    code-descriptors:
      code Files: artifact-descriptors=[{short-label=make::Fls_defs.mak, category=SWMAKE}, {short-label=make::Fls_rules.mak, category=SWMAKE}]
    resource consumption ResourceConsumption
      5 x memory section:
        CODE: sw-addrmethod=CODE
        CODE_ASIL_B_LOCAL: alignment=UNSPECIFIED, options=[coreLocal, safetyAsilB], sw-addrmethod=CODE_ASIL_B_LOCAL
        VAR_CLEARED_ASIL_B_LOCAL_32: alignment=32, options=[coreLocal, safetyAsilB], sw-addrmethod=VAR_CLEARED_ASIL_B_LOCAL
        VAR_CLEARED_ASIL_B_LOCAL_UNSPECIFIED: alignment=UNSPECIFIED, options=[coreLocal, safetyAsilB], sw-addrmethod=VAR_CLEARED_ASIL_B_LOCAL
        CONFIG_DATA_ASIL_B_LOCAL_UNSPECIFIED: alignment=UNSPECIFIED, options=[coreLocal, safetyAsilB], sw-addrmethod=CONFIG_DATA_ASIL_B_LOCAL
      section name prefix FLS_17_DMU
