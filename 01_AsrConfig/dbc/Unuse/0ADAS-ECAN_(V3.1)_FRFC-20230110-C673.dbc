VERSION ""

NS_ :

BS_:
BU_: FR FC ADC

BO_ 288 FR_120: 64 FR
 SG_ FR_CRCCheck_120 : 503|16@0+ (1.0000000000,0.0000000000) [0.0000000000|65535.0000000000] ""  FR,ADC,FC
 SG_ FR_RollingCounter_120 : 491|4@0+ (1.0000000000,0.0000000000) [0.0000000000|15.0000000000] ""  FR,ADC,FC
 SG_ FR_OBJ32_HeightGround : 211|9@0+ (0.1000000000,0.0000000000) [0.0000000000|51.1000000000] "m"  FR,ADC,FC
 SG_ FR_OBJ32_MotionStatusConf : 397|6@0+ (2.0000000000,0.0000000000) [0.0000000000|63.0000000000] "-"  FR,ADC,FC
 SG_ FR_OBJ32_ClassConf : 377|6@0+ (2.0000000000,0.0000000000) [0.0000000000|63.0000000000] "-"  FR,ADC,FC
 SG_ FR_OBJ32_MotionStatus : 370|3@0+ (1.0000000000,0.0000000000) [0.0000000000|7.0000000000] ""  FR,ADC,FC
 SG_ FR_OBJ32_Location : 375|2@0+ (1.0000000000,0.0000000000) [0.0000000000|3.0000000000] ""  FR,ADC,FC
 SG_ FR_OBJ32_Measured : 363|2@0+ (1.0000000000,0.0000000000) [0.0000000000|3.0000000000] ""  FR,ADC,FC
 SG_ FR_OBJ32_valid : 366|1@0+ (1.0000000000,0.0000000000) [0.0000000000|1.0000000000] ""  FR,ADC,FC
 SG_ FR_OBJ32_Track_Age : 359|8@0+ (1.0000000000,0.0000000000) [0.0000000000|255.0000000000] ""  FR,ADC,FC
 SG_ FR_OBJ32_Track_ID : 351|8@0+ (1.0000000000,0.0000000000) [0.0000000000|255.0000000000] ""  FR,ADC,FC
 SG_ FR_OBJ32_ObstacleProb : 341|6@0+ (2.0000000000,0.0000000000) [0.0000000000|100.0000000000] "%"  FR,ADC,FC
 SG_ FR_OBJ32_ExistProb : 331|6@0+ (2.0000000000,0.0000000000) [0.0000000000|100.0000000000] "%"  FR,ADC,FC
 SG_ FR_OBJ32_RelAx : 325|10@0+ (0.0312500000,-16.0000000000) [-16.0000000000|15.9687500000] "m/s2"  FR,ADC,FC
 SG_ FR_OBJ32_RelAy : 318|9@0+ (0.0625000000,-16.0000000000) [-16.0000000000|15.9375000000] "m/s2"  FR,ADC,FC
 SG_ FR_OBJ32_RelVx_std : 298|12@0+ (0.0625000000,0.0000000000) [0.0000000000|255.9375000000] "m/s"  FR,ADC,FC
 SG_ FR_OBJ32_RelVx : 294|12@0+ (0.0625000000,-128.0000000000) [-128.0000000000|127.9375000000] "m/s"  FR,ADC,FC
 SG_ FR_OBJ32_RelVy_std : 272|10@0+ (0.1250000000,0.0000000000) [0.0000000000|127.8750000000] "m/s"  FR,ADC,FC
 SG_ FR_OBJ32_RelVy : 266|10@0+ (0.1250000000,-64.0000000000) [-64.0000000000|63.8750000000] "m/s"  FR,ADC,FC
 SG_ FR_OBJ32_Dx_Vnce : 248|14@0+ (0.0500000000,0.0000000000) [0.0000000000|50.0000000000] "m2"  FR,ADC,FC
 SG_ FR_OBJ32_Dx : 245|13@0+ (0.0625000000,-100.0000000000) [-100.0000000000|411.9375000000] "m"  FR,ADC,FC
 SG_ FR_OBJ32_Dy_Vnce : 239|10@0+ (0.0200000000,0.0000000000) [0.0000000000|20.0000000000] "m2"  FR,ADC,FC
 SG_ FR_OBJ32_Dy : 218|11@0+ (0.1250000000,-128.0000000000) [-128.0000000000|127.8750000000] "m"  FR,ADC,FC
 SG_ FR_OBJ32_HeadingAngle : 413|10@0+ (0.0100000000,-3.1400000000) [-3.1400000000|3.1400000000] "rad"  FR,ADC,FC
 SG_ FR_OBJ32_Length : 204|9@0+ (0.0500000000,0.0000000000) [0.0000000000|25.5000000000] "m"  FR,ADC,FC
 SG_ FR_OBJ32_Height : 197|9@0+ (0.0100000000,0.0000000000) [0.0000000000|5.1100000000] "m"  FR,ADC,FC
 SG_ FR_OBJ32_Width : 176|11@0+ (0.0100000000,0.0000000000) [0.0000000000|12.0000000000] "m"  FR,ADC,FC
 SG_ FR_OBJ32_Class : 179|3@0+ (1.0000000000,0.0000000000) [0.0000000000|7.0000000000] ""  FR,ADC,FC
 SG_ FR_OBJ31_HeightGround : 39|9@0+ (0.1000000000,0.0000000000) [0.0000000000|51.1000000000] "m"  FR,ADC,FC
 SG_ FR_OBJ31_MotionStatusConf : 387|6@0+ (2.0000000000,0.0000000000) [0.0000000000|63.0000000000] "-"  FR,ADC,FC
 SG_ FR_OBJ31_ClassConf : 383|6@0+ (2.0000000000,0.0000000000) [0.0000000000|63.0000000000] "-"  FR,ADC,FC
 SG_ FR_OBJ31_MotionStatus : 373|3@0+ (1.0000000000,0.0000000000) [0.0000000000|7.0000000000] ""  FR,ADC,FC
 SG_ FR_OBJ31_Location : 361|2@0+ (1.0000000000,0.0000000000) [0.0000000000|3.0000000000] ""  FR,ADC,FC
 SG_ FR_OBJ31_Measured : 365|2@0+ (1.0000000000,0.0000000000) [0.0000000000|3.0000000000] ""  FR,ADC,FC
 SG_ FR_Obj31_valid : 367|1@0+ (1.0000000000,0.0000000000) [0.0000000000|1.0000000000] ""  FR,ADC,FC
 SG_ FR_OBJ31_Track_Age : 171|8@0+ (1.0000000000,0.0000000000) [0.0000000000|255.0000000000] ""  FR,ADC,FC
 SG_ FR_OBJ31_Track_ID : 163|8@0+ (1.0000000000,0.0000000000) [0.0000000000|255.0000000000] ""  FR,ADC,FC
 SG_ FR_OBJ31_ObstacleProb : 153|6@0+ (2.0000000000,0.0000000000) [0.0000000000|100.0000000000] "%"  FR,ADC,FC
 SG_ FR_OBJ31_ExistProb : 159|6@0+ (2.0000000000,0.0000000000) [0.0000000000|100.0000000000] "%"  FR,ADC,FC
 SG_ FR_OBJ31_RelAx : 137|10@0+ (0.0312500000,-16.0000000000) [-16.0000000000|15.9687500000] "m/s2"  FR,ADC,FC
 SG_ FR_OBJ31_RelAy : 130|9@0+ (0.0625000000,-16.0000000000) [-16.0000000000|15.9375000000] "m/s2"  FR,ADC,FC
 SG_ FR_OBJ31_RelVx_std : 126|12@0+ (0.0625000000,0.0000000000) [0.0000000000|255.9375000000] "m/s"  FR,ADC,FC
 SG_ FR_OBJ31_RelVx : 106|12@0+ (0.0625000000,-128.0000000000) [-128.0000000000|127.9375000000] "m/s"  FR,ADC,FC
 SG_ FR_OBJ31_RelVy_std : 100|10@0+ (0.1250000000,0.0000000000) [0.0000000000|127.8750000000] "m/s"  FR,ADC,FC
 SG_ FR_OBJ31_RelVy : 94|10@0+ (0.1250000000,-64.0000000000) [-64.0000000000|63.8750000000] "m/s"  FR,ADC,FC
 SG_ FR_OBJ31_Dx_Vnce : 76|14@0+ (0.0500000000,0.0000000000) [0.0000000000|50.0000000000] "m2"  FR,ADC,FC
 SG_ FR_OBJ31_Dx : 57|13@0+ (0.0625000000,-100.0000000000) [-100.0000000000|411.9375000000] "m"  FR,ADC,FC
 SG_ FR_OBJ31_Dy_Vnce : 51|10@0+ (0.0200000000,0.0000000000) [0.0000000000|20.0000000000] "m2"  FR,ADC,FC
 SG_ FR_OBJ31_Dy : 46|11@0+ (0.1250000000,-128.0000000000) [-128.0000000000|127.8750000000] "m"  FR,ADC,FC
 SG_ FR_OBJ31_HeadingAngle : 407|10@0+ (0.0100000000,-3.1400000000) [-3.1400000000|3.1400000000] "rad"  FR,ADC,FC
 SG_ FR_OBJ31_Length : 16|9@0+ (0.0500000000,0.0000000000) [0.0000000000|25.5000000000] "m"  FR,ADC,FC
 SG_ FR_OBJ31_Height : 9|9@0+ (0.0100000000,0.0000000000) [0.0000000000|5.1100000000] "m"  FR,ADC,FC
 SG_ FR_OBJ31_Width : 4|11@0+ (0.0100000000,0.0000000000) [0.0000000000|12.0000000000] "m"  FR,ADC,FC
 SG_ FR_OBJ31_Class : 7|3@0+ (1.0000000000,0.0000000000) [0.0000000000|7.0000000000] ""  FR,ADC,FC

BO_ 310 FR_136: 64 FR
 SG_ FR_CRCCheck_136 : 503|16@0+ (1.0000000000,0.0000000000) [0.0000000000|65535.0000000000] ""  FR,ADC,FC
 SG_ FR_RollingCounter_136 : 491|4@0+ (1.0000000000,0.0000000000) [0.0000000000|15.0000000000] ""  FR,ADC,FC
 SG_ FR_FrameCount : 71|32@0+ (1.0000000000,0.0000000000) [0.0000000000|4294967295.0000000000] ""  FR,ADC,FC
 SG_ FR_MisAlignment : 58|3@0+ (1.0000000000,0.0000000000) [0.0000000000|7.0000000000] ""  FR,ADC,FC
 SG_ FR_WorkMode : 49|2@0+ (1.0000000000,0.0000000000) [0.0000000000|3.0000000000] ""  FR,ADC,FC
 SG_ FR_RadarFailureStatus : 42|3@0+ (1.0000000000,0.0000000000) [0.0000000000|7.0000000000] ""  FR,ADC,FC
 SG_ FR_FRadarCalibrationStatus : 33|2@0+ (1.0000000000,0.0000000000) [0.0000000000|3.0000000000] ""  FR,ADC,FC
 SG_ FR_Frametime : 23|16@0+ (0.0100000000,0.0000000000) [0.0000000000|655.3500000000] "ms"  FR,ADC,FC
 SG_ FR_ObjCount : 15|8@0+ (1.0000000000,0.0000000000) [0.0000000000|32.0000000000] ""  FR,ADC,FC

BO_ 312 FR_138: 64 FR
 SG_ ADC_CRCCheck_138 : 503|16@0+ (1.0000000000,0.0000000000) [0.0000000000|65535.0000000000] ""  FR,ADC,FC
 SG_ ADC_RollingCounter_138 : 491|4@0+ (1.0000000000,0.0000000000) [0.0000000000|15.0000000000] ""  FR,ADC,FC
 SG_ DiffTime_Time_uS : 151|16@0+ (1.0000000000,0.0000000000) [0.0000000000|65535.0000000000] "um"  FR,ADC,FC
 SG_ FR_TiOut : 37|1@0+ (1.0000000000,0.0000000000) [0.0000000000|1.0000000000] "-"  FR,ADC,FC
 SG_ FR_TiLeap : 38|1@0+ (1.0000000000,0.0000000000) [0.0000000000|1.0000000000] "-"  FR,ADC,FC
 SG_ FR_TiBas : 39|1@0+ (1.0000000000,0.0000000000) [0.0000000000|1.0000000000] "-"  FR,ADC,FC
 SG_ FR_TiStamp : 7|32@0+ (0.0001000000,0.0000000000) [0.0000000000|429496.7295000000] "s"  FR,ADC,FC

BO_ 320 FR_140: 64 FR
 SG_ FR_DTC2_Status : 63|8@0+ (1.0000000000,0.0000000000) [0.0000000000|255.0000000000] ""  FR,ADC
 SG_ FR_DTC2_LowByte : 55|8@0+ (1.0000000000,0.0000000000) [0.0000000000|255.0000000000] ""  FR,ADC
 SG_ FR_DTC2_MiddByte : 47|8@0+ (1.0000000000,0.0000000000) [0.0000000000|255.0000000000] ""  FR,ADC
 SG_ FR_DTC2_HighByte : 39|8@0+ (1.0000000000,0.0000000000) [0.0000000000|255.0000000000] ""  FR,ADC
 SG_ FR_DTC1_Status : 31|8@0+ (1.0000000000,0.0000000000) [0.0000000000|255.0000000000] ""  FR,ADC
 SG_ FR_DTC1_LowByte : 23|8@0+ (1.0000000000,0.0000000000) [0.0000000000|255.0000000000] ""  FR,ADC
 SG_ FR_DTC1_MiddByte : 15|8@0+ (1.0000000000,0.0000000000) [0.0000000000|255.0000000000] ""  FR,ADC
 SG_ FR_DTC1_HighByte : 7|8@0+ (1.0000000000,0.0000000000) [0.0000000000|255.0000000000] ""  FR,ADC

BO_ 336 FC_150: 64 FC
 SG_ FC_CRCCheck_150 : 503|16@0+ (1.0000000000,0.0000000000) [0.0000000000|65535.0000000000] ""  FC,ADC
 SG_ FC_RollingCounter_150 : 491|4@0+ (1.0000000000,0.0000000000) [0.0000000000|15.0000000000] ""  FC,ADC
 SG_ FC_Line_2_exist_prob : 303|6@0+ (2.0000000000,0.0000000000) [0.0000000000|100.0000000000] "%"  FC,ADC
 SG_ FC_Line_2_RMSE : 281|8@0+ (1.0000000000,0.0000000000) [0.0000000000|100.0000000000] "-"  FC,ADC
 SG_ FC_Line_2_ParseConf : 273|8@0+ (1.0000000000,0.0000000000) [0.0000000000|100.0000000000] "-"  FC,ADC
 SG_ FC_Line_2_MeasureType : 276|3@0+ (1.0000000000,0.0000000000) [0.0000000000|7.0000000000] "-"  FC,ADC
 SG_ FC_Line_2_ModelC3 : 256|12@0+ (0.0000001272,-0.0002604200) [-0.0002604200|0.0002604170] "1/m2"  FC,ADC
 SG_ FC_Line_2_ModelC2 : 327|16@0+ (0.0000010000,-0.0320000000) [-0.0320000000|0.0335350000] "1/m"  FC,ADC
 SG_ FC_Line_2_ModelC1 : 235|13@0+ (0.0004882810,-1.6000000000) [-1.6000000000|1.6000000000] "rad"  FC,ADC
 SG_ FC_Line_2_ModelC0 : 231|12@0+ (0.0156250000,-32.0000000000) [-32.0000000000|31.9843750000] "m"  FC,ADC
 SG_ FC_Line_2_dx_End : 202|10@0+ (0.2500000000,0.0000000000) [0.0000000000|255.7500000000] "m"  FC,ADC
 SG_ FC_Line_2_dx_Start : 176|13@0+ (0.0250000000,0.0000000000) [0.0000000000|204.7750000000] "m"  FC,ADC
 SG_ FC_Line_2_Width : 168|8@0+ (0.0100000000,0.0000000000) [0.0000000000|2.5500000000] "m"  FC,ADC
 SG_ FC_Line_2_color : 171|3@0+ (1.0000000000,0.0000000000) [0.0000000000|7.0000000000] ""  FC,ADC
 SG_ FC_Line_2_Id : 163|8@0+ (1.0000000000,0.0000000000) [1.0000000000|255.0000000000] ""  FC,ADC
 SG_ FC_Line_2_TypeConfidence : 153|6@0+ (2.0000000000,0.0000000000) [0.0000000000|100.0000000000] "%"  FC,ADC
 SG_ FC_Line_2_Type : 158|5@0+ (1.0000000000,0.0000000000) [0.0000000000|31.0000000000] ""  FC,ADC
 SG_ FC_Line_1_exist_prob : 136|6@0+ (2.0000000000,0.0000000000) [0.0000000000|100.0000000000] "%"  FC,ADC
 SG_ FC_Line_1_RMSE : 130|8@0+ (1.0000000000,0.0000000000) [0.0000000000|100.0000000000] "-"  FC,ADC
 SG_ FC_Line_1_ParseConf : 122|8@0+ (1.0000000000,0.0000000000) [0.0000000000|100.0000000000] "-"  FC,ADC
 SG_ FC_Line_1_MeasureType : 125|3@0+ (1.0000000000,0.0000000000) [0.0000000000|7.0000000000] "-"  FC,ADC
 SG_ FC_Line_1_ModelC3 : 105|12@0+ (0.0000001272,-0.0002604200) [-0.0002604200|0.0002604170] "1/m2"  FC,ADC
 SG_ FC_Line_1_ModelC2 : 311|16@0+ (0.0000010000,-0.0320000000) [-0.0320000000|0.0335350000] "1/m"  FC,ADC
 SG_ FC_Line_1_ModelC1 : 84|13@0+ (0.0004882810,-1.6000000000) [-1.6000000000|1.6000000000] "rad"  FC,ADC
 SG_ FC_Line_1_ModelC0 : 64|12@0+ (0.0156250000,-32.0000000000) [-32.0000000000|31.9843750000] "m"  FC,ADC
 SG_ FC_Line_1_dx_End : 51|10@0+ (0.2500000000,0.0000000000) [0.0000000000|255.7500000000] "m"  FC,ADC
 SG_ FC_Line_1_dx_Start : 25|13@0+ (0.0250000000,0.0000000000) [0.0000000000|204.7750000000] "m"  FC,ADC
 SG_ FC_Line_1_Width : 17|8@0+ (0.0100000000,0.0000000000) [0.0000000000|2.5500000000] "m"  FC,ADC
 SG_ FC_Line_1_color : 20|3@0+ (1.0000000000,0.0000000000) [0.0000000000|7.0000000000] ""  FC,ADC
 SG_ FC_Line_1_Id : 12|8@0+ (1.0000000000,0.0000000000) [1.0000000000|255.0000000000] ""  FC,ADC
 SG_ FC_Line_1_TypeConfidence : 2|6@0+ (2.0000000000,0.0000000000) [0.0000000000|100.0000000000] "%"  FC,ADC
 SG_ FC_Line_1_Type : 7|5@0+ (1.0000000000,0.0000000000) [0.0000000000|31.0000000000] ""  FC,ADC

BO_ 337 FC_151: 64 FC
 SG_ FC_CRCCheck_151 : 503|16@0+ (1.0000000000,0.0000000000) [0.0000000000|65535.0000000000] ""  FC,ADC
 SG_ FC_RollingCounter_151 : 491|4@0+ (1.0000000000,0.0000000000) [0.0000000000|15.0000000000] ""  FC,ADC
 SG_ FC_Line_4_exist_prob : 303|6@0+ (2.0000000000,0.0000000000) [0.0000000000|100.0000000000] "%"  FC,ADC
 SG_ FC_Line_4_RMSE : 281|8@0+ (1.0000000000,0.0000000000) [0.0000000000|100.0000000000] "-"  FC,ADC
 SG_ FC_Line_4_ParseConf : 273|8@0+ (1.0000000000,0.0000000000) [0.0000000000|100.0000000000] "-"  FC,ADC
 SG_ FC_Line_4_MeasureType : 276|3@0+ (1.0000000000,0.0000000000) [0.0000000000|7.0000000000] "-"  FC,ADC
 SG_ FC_Line_4_ModelC3 : 256|12@0+ (0.0000001272,-0.0002604200) [-0.0002604200|0.0002604170] "1/m2"  FC,ADC
 SG_ FC_Line_4_ModelC2 : 327|16@0+ (0.0000010000,-0.0320000000) [-0.0320000000|0.0335350000] "1/m"  FC,ADC
 SG_ FC_Line_4_ModelC1 : 235|13@0+ (0.0004882810,-1.6000000000) [-1.6000000000|1.6000000000] "rad"  FC,ADC
 SG_ FC_Line_4_ModelC0 : 231|12@0+ (0.0156250000,-32.0000000000) [-32.0000000000|31.9843750000] "m"  FC,ADC
 SG_ FC_Line_4_dx_End : 202|10@0+ (0.2500000000,0.0000000000) [0.0000000000|255.7500000000] "m"  FC,ADC
 SG_ FC_Line_4_dx_Start : 176|13@0+ (0.0250000000,0.0000000000) [0.0000000000|204.7750000000] "m"  FC,ADC
 SG_ FC_Line_4_Width : 168|8@0+ (0.0100000000,0.0000000000) [0.0000000000|2.5500000000] "m"  FC,ADC
 SG_ FC_Line_4_color : 171|3@0+ (1.0000000000,0.0000000000) [0.0000000000|7.0000000000] ""  FC,ADC
 SG_ FC_Line_4_Id : 163|8@0+ (1.0000000000,0.0000000000) [1.0000000000|255.0000000000] ""  FC,ADC
 SG_ FC_Line_4_TypeConfidence : 153|6@0+ (2.0000000000,0.0000000000) [0.0000000000|100.0000000000] "%"  FC,ADC
 SG_ FC_Line_4_Type : 158|5@0+ (1.0000000000,0.0000000000) [0.0000000000|31.0000000000] ""  FC,ADC
 SG_ FC_Line_3_exist_prob : 136|6@0+ (2.0000000000,0.0000000000) [0.0000000000|100.0000000000] "%"  FC,ADC
 SG_ FC_Line_3_RMSE : 130|8@0+ (1.0000000000,0.0000000000) [0.0000000000|100.0000000000] "-"  FC,ADC
 SG_ FC_Line_3_ParseConf : 122|8@0+ (1.0000000000,0.0000000000) [0.0000000000|100.0000000000] "-"  FC,ADC
 SG_ FC_Line_3_MeasureType : 125|3@0+ (1.0000000000,0.0000000000) [0.0000000000|7.0000000000] "-"  FC,ADC
 SG_ FC_Line_3_ModelC3 : 105|12@0+ (0.0000001272,-0.0002604200) [-0.0002604200|0.0002604170] "1/m2"  FC,ADC
 SG_ FC_Line_3_ModelC2 : 311|16@0+ (0.0000010000,-0.0320000000) [-0.0320000000|0.0335350000] "1/m"  FC,ADC
 SG_ FC_Line_3_ModelC1 : 84|13@0+ (0.0004882810,-1.6000000000) [-1.6000000000|1.6000000000] "rad"  FC,ADC
 SG_ FC_Line_3_ModelC0 : 64|12@0+ (0.0156250000,-32.0000000000) [-32.0000000000|31.9843750000] "m"  FC,ADC
 SG_ FC_Line_3_dx_End : 51|10@0+ (0.2500000000,0.0000000000) [0.0000000000|255.7500000000] "m"  FC,ADC
 SG_ FC_Line_3_dx_Start : 25|13@0+ (0.0250000000,0.0000000000) [0.0000000000|204.7750000000] "m"  FC,ADC
 SG_ FC_Line_3_Width : 17|8@0+ (0.0100000000,0.0000000000) [0.0000000000|2.5500000000] "m"  FC,ADC
 SG_ FC_Line_3_color : 20|3@0+ (1.0000000000,0.0000000000) [0.0000000000|7.0000000000] ""  FC,ADC
 SG_ FC_Line_3_Id : 12|8@0+ (1.0000000000,0.0000000000) [1.0000000000|255.0000000000] ""  FC,ADC
 SG_ FC_Line_3_TypeConfidence : 2|6@0+ (2.0000000000,0.0000000000) [0.0000000000|100.0000000000] "%"  FC,ADC
 SG_ FC_Line_3_Type : 7|5@0+ (1.0000000000,0.0000000000) [0.0000000000|31.0000000000] ""  FC,ADC

BO_ 338 FC_152: 64 FC
 SG_ FC_CRCCheck_152 : 503|16@0+ (1.0000000000,0.0000000000) [0.0000000000|65535.0000000000] ""  FC,ADC
 SG_ FC_RollingCounter_152 : 491|4@0+ (1.0000000000,0.0000000000) [0.0000000000|15.0000000000] ""  FC,ADC
 SG_ FC_Line_6_exist_prob : 303|6@0+ (2.0000000000,0.0000000000) [0.0000000000|100.0000000000] "%"  FC,ADC
 SG_ FC_Line_6_RMSE : 281|8@0+ (1.0000000000,0.0000000000) [0.0000000000|100.0000000000] "-"  FC,ADC
 SG_ FC_Line_6_ParseConf : 273|8@0+ (1.0000000000,0.0000000000) [0.0000000000|100.0000000000] "-"  FC,ADC
 SG_ FC_Line_6_MeasureType : 276|3@0+ (1.0000000000,0.0000000000) [0.0000000000|7.0000000000] "-"  FC,ADC
 SG_ FC_Line_6_ModelC3 : 256|12@0+ (0.0000001272,-0.0002604200) [-0.0002604200|0.0002604170] "1/m2"  FC,ADC
 SG_ FC_Line_6_ModelC2 : 327|16@0+ (0.0000010000,-0.0320000000) [-0.0320000000|0.0335350000] "1/m"  FC,ADC
 SG_ FC_Line_6_ModelC1 : 235|13@0+ (0.0004882810,-1.6000000000) [-1.6000000000|1.6000000000] "rad"  FC,ADC
 SG_ FC_Line_6_ModelC0 : 231|12@0+ (0.0156250000,-32.0000000000) [-32.0000000000|31.9843750000] "m"  FC,ADC
 SG_ FC_Line_6_dx_End : 202|10@0+ (0.2500000000,0.0000000000) [0.0000000000|255.7500000000] "m"  FC,ADC
 SG_ FC_Line_6_dx_Start : 176|13@0+ (0.0250000000,0.0000000000) [0.0000000000|204.7750000000] "m"  FC,ADC
 SG_ FC_Line_6_Width : 168|8@0+ (0.0100000000,0.0000000000) [0.0000000000|2.5500000000] "m"  FC,ADC
 SG_ FC_Line_6_color : 171|3@0+ (1.0000000000,0.0000000000) [0.0000000000|7.0000000000] ""  FC,ADC
 SG_ FC_Line_6_Id : 163|8@0+ (1.0000000000,0.0000000000) [1.0000000000|255.0000000000] ""  FC,ADC
 SG_ FC_Line_6_TypeConfidence : 153|6@0+ (2.0000000000,0.0000000000) [0.0000000000|100.0000000000] "%"  FC,ADC
 SG_ FC_Line_6_Type : 158|5@0+ (1.0000000000,0.0000000000) [0.0000000000|31.0000000000] ""  FC,ADC
 SG_ FC_Line_5_exist_prob : 136|6@0+ (2.0000000000,0.0000000000) [0.0000000000|100.0000000000] "%"  FC,ADC
 SG_ FC_Line_5_RMSE : 130|8@0+ (1.0000000000,0.0000000000) [0.0000000000|100.0000000000] "-"  FC,ADC
 SG_ FC_Line_5_ParseConf : 122|8@0+ (1.0000000000,0.0000000000) [0.0000000000|100.0000000000] "-"  FC,ADC
 SG_ FC_Line_5_MeasureType : 125|3@0+ (1.0000000000,0.0000000000) [0.0000000000|7.0000000000] "-"  FC,ADC
 SG_ FC_Line_5_ModelC3 : 105|12@0+ (0.0000001272,-0.0002604200) [-0.0002604200|0.0002604170] "1/m2"  FC,ADC
 SG_ FC_Line_5_ModelC2 : 311|16@0+ (0.0000010000,-0.0320000000) [-0.0320000000|0.0335350000] "1/m"  FC,ADC
 SG_ FC_Line_5_ModelC1 : 84|13@0+ (0.0004882810,-1.6000000000) [-1.6000000000|1.6000000000] "rad"  FC,ADC
 SG_ FC_Line_5_ModelC0 : 64|12@0+ (0.0156250000,-32.0000000000) [-32.0000000000|31.9843750000] "m"  FC,ADC
 SG_ FC_Line_5_dx_End : 51|10@0+ (0.2500000000,0.0000000000) [0.0000000000|255.7500000000] "m"  FC,ADC
 SG_ FC_Line_5_dx_Start : 25|13@0+ (0.0250000000,0.0000000000) [0.0000000000|204.7750000000] "m"  FC,ADC
 SG_ FC_Line_5_Width : 17|8@0+ (0.0100000000,0.0000000000) [0.0000000000|2.5500000000] "m"  FC,ADC
 SG_ FC_Line_5_color : 20|3@0+ (1.0000000000,0.0000000000) [0.0000000000|7.0000000000] ""  FC,ADC
 SG_ FC_Line_5_Id : 12|8@0+ (1.0000000000,0.0000000000) [1.0000000000|255.0000000000] ""  FC,ADC
 SG_ FC_Line_5_TypeConfidence : 2|6@0+ (2.0000000000,0.0000000000) [0.0000000000|100.0000000000] "%"  FC,ADC
 SG_ FC_Line_5_Type : 7|5@0+ (1.0000000000,0.0000000000) [0.0000000000|31.0000000000] ""  FC,ADC

BO_ 339 FC_153: 64 FC
 SG_ FC_CRCCheck_153 : 503|16@0+ (1.0000000000,0.0000000000) [0.0000000000|65535.0000000000] ""  FC,ADC
 SG_ FC_RollingCounter_153 : 491|4@0+ (1.0000000000,0.0000000000) [0.0000000000|15.0000000000] ""  FC,ADC
 SG_ FC_Line_8_exist_prob : 303|6@0+ (2.0000000000,0.0000000000) [0.0000000000|100.0000000000] "%"  FC,ADC
 SG_ FC_Line_8_RMSE : 281|8@0+ (1.0000000000,0.0000000000) [0.0000000000|100.0000000000] "-"  FC,ADC
 SG_ FC_Line_8_ParseConf : 273|8@0+ (1.0000000000,0.0000000000) [0.0000000000|100.0000000000] "-"  FC,ADC
 SG_ FC_Line_8_MeasureType : 276|3@0+ (1.0000000000,0.0000000000) [0.0000000000|7.0000000000] "-"  FC,ADC
 SG_ FC_Line_8_ModelC3 : 256|12@0+ (0.0000001272,-0.0002604200) [-0.0002604200|0.0002604170] "1/m2"  FC,ADC
 SG_ FC_Line_8_ModelC2 : 327|16@0+ (0.0000010000,-0.0320000000) [-0.0320000000|0.0335350000] "1/m"  FC,ADC
 SG_ FC_Line_8_ModelC1 : 235|13@0+ (0.0004882810,-1.6000000000) [-1.6000000000|1.6000000000] "rad"  FC,ADC
 SG_ FC_Line_8_ModelC0 : 231|12@0+ (0.0156250000,-32.0000000000) [-32.0000000000|31.9843750000] "m"  FC,ADC
 SG_ FC_Line_8_dx_End : 202|10@0+ (0.2500000000,0.0000000000) [0.0000000000|255.7500000000] "m"  FC,ADC
 SG_ FC_Line_8_dx_Start : 176|13@0+ (0.0250000000,0.0000000000) [0.0000000000|204.7750000000] "m"  FC,ADC
 SG_ FC_Line_8_Width : 168|8@0+ (0.0100000000,0.0000000000) [0.0000000000|2.5500000000] "m"  FC,ADC
 SG_ FC_Line_8_color : 171|3@0+ (1.0000000000,0.0000000000) [0.0000000000|7.0000000000] ""  FC,ADC
 SG_ FC_Line_8_Id : 163|8@0+ (1.0000000000,0.0000000000) [1.0000000000|255.0000000000] ""  FC,ADC
 SG_ FC_Line_8_TypeConfidence : 153|6@0+ (2.0000000000,0.0000000000) [0.0000000000|100.0000000000] "%"  FC,ADC
 SG_ FC_Line_8_Type : 158|5@0+ (1.0000000000,0.0000000000) [0.0000000000|31.0000000000] ""  FC,ADC
 SG_ FC_Line_7_exist_prob : 136|6@0+ (2.0000000000,0.0000000000) [0.0000000000|100.0000000000] "%"  FC,ADC
 SG_ FC_Line_7_RMSE : 130|8@0+ (1.0000000000,0.0000000000) [0.0000000000|100.0000000000] "-"  FC,ADC
 SG_ FC_Line_7_ParseConf : 122|8@0+ (1.0000000000,0.0000000000) [0.0000000000|100.0000000000] "-"  FC,ADC
 SG_ FC_Line_7_MeasureType : 125|3@0+ (1.0000000000,0.0000000000) [0.0000000000|7.0000000000] "-"  FC,ADC
 SG_ FC_Line_7_ModelC3 : 105|12@0+ (0.0000001272,-0.0002604200) [-0.0002604200|0.0002604170] "1/m2"  FC,ADC
 SG_ FC_Line_7_ModelC2 : 311|16@0+ (0.0000010000,-0.0320000000) [-0.0320000000|0.0335350000] "1/m"  FC,ADC
 SG_ FC_Line_7_ModelC1 : 84|13@0+ (0.0004882810,-1.6000000000) [-1.6000000000|1.6000000000] "rad"  FC,ADC
 SG_ FC_Line_7_ModelC0 : 64|12@0+ (0.0156250000,-32.0000000000) [-32.0000000000|31.9843750000] "m"  FC,ADC
 SG_ FC_Line_7_dx_End : 51|10@0+ (0.2500000000,0.0000000000) [0.0000000000|255.7500000000] "m"  FC,ADC
 SG_ FC_Line_7_dx_Start : 25|13@0+ (0.0250000000,0.0000000000) [0.0000000000|204.7750000000] "m"  FC,ADC
 SG_ FC_Line_7_Width : 17|8@0+ (0.0100000000,0.0000000000) [0.0000000000|2.5500000000] "m"  FC,ADC
 SG_ FC_Line_7_color : 20|3@0+ (1.0000000000,0.0000000000) [0.0000000000|7.0000000000] ""  FC,ADC
 SG_ FC_Line_7_Id : 12|8@0+ (1.0000000000,0.0000000000) [1.0000000000|255.0000000000] ""  FC,ADC
 SG_ FC_Line_7_TypeConfidence : 2|6@0+ (2.0000000000,0.0000000000) [0.0000000000|100.0000000000] "%"  FC,ADC
 SG_ FC_Line_7_Type : 7|5@0+ (1.0000000000,0.0000000000) [0.0000000000|31.0000000000] ""  FC,ADC

BO_ 340 FC_154: 64 FC
 SG_ FC_CRCCheck_154 : 503|16@0+ (1.0000000000,0.0000000000) [0.0000000000|65535.0000000000] ""  FC,ADC
 SG_ FC_RollingCounter_154 : 491|4@0+ (1.0000000000,0.0000000000) [0.0000000000|15.0000000000] ""  FC,ADC
 SG_ FC_LineMCUTiStamp : 207|8@0+ (1.0000000000,0.0000000000) [0.0000000000|255.0000000000] ""  FC,ADC
 SG_ FC_LineTiOut : 196|1@0+ (1.0000000000,0.0000000000) [0.0000000000|1.0000000000] "-"  FC,ADC
 SG_ FC_LineTiLeap : 197|1@0+ (1.0000000000,0.0000000000) [0.0000000000|1.0000000000] "-"  FC,ADC
 SG_ FC_LineTiBas : 198|1@0+ (1.0000000000,0.0000000000) [0.0000000000|1.0000000000] "-"  FC,ADC
 SG_ FC_LineTiStamp : 166|32@0+ (0.0001000000,0.0000000000) [0.0000000000|429496.7295000000] "s"  FC,ADC
 SG_ FC_WeatherType : 154|4@0+ (1.0000000000,0.0000000000) [0.0000000000|15.0000000000] ""  FC,ADC
 SG_ FC_RCrossPiont_StartEnd : 59|2@0+ (1.0000000000,0.0000000000) [0.0000000000|3.0000000000] ""  FC,ADC
 SG_ FC_RCrossPiont_DivMer : 61|2@0+ (1.0000000000,0.0000000000) [0.0000000000|3.0000000000] ""  FC,ADC
 SG_ FC_RCrossPiont_ExistProb : 51|6@0+ (2.0000000000,0.0000000000) [0.0000000000|100.0000000000] "%"  FC,ADC
 SG_ FC_RCrossPiont_Dy : 45|10@0+ (0.1000000000,-50.0000000000) [-50.0000000000|50.0000000000] "m"  FC,ADC
 SG_ FC_RCrossPoint_DX : 24|11@0+ (0.1000000000,0.0000000000) [0.0000000000|200.0000000000] "m"  FC,ADC
 SG_ FC_LCrossPiont_StartEnd : 26|2@0+ (1.0000000000,0.0000000000) [0.0000000000|3.0000000000] ""  FC,ADC
 SG_ FC_LCrossPiont_DivMer : 28|2@0+ (1.0000000000,0.0000000000) [0.0000000000|3.0000000000] ""  FC,ADC
 SG_ FC_LCrossPiont_ExistProb : 18|6@0+ (2.0000000000,0.0000000000) [0.0000000000|100.0000000000] "%"  FC,ADC
 SG_ FC_LCrossPiont_Dy : 12|10@0+ (0.1000000000,-50.0000000000) [-50.0000000000|50.0000000000] "m"  FC,ADC
 SG_ FC_LCrossPoint_DX : 7|11@0+ (0.1000000000,0.0000000000) [0.0000000000|200.0000000000] "m"  FC,ADC

BO_ 352 FC_160: 64 FC
 SG_ FC_Obj1WSInfoPosType : 133|4@0+ (1.0000000000,0.0000000000) [0.0000000000|15.0000000000] ""  FC,ADC
 SG_ FC_CRCCheck_160 : 503|16@0+ (1.0000000000,0.0000000000) [0.0000000000|65535.0000000000] ""  FC,ADC
 SG_ FC_RollingCounter_160 : 491|4@0+ (1.0000000000,0.0000000000) [0.0000000000|15.0000000000] ""  FC,ADC
 SG_ FC_Obj1_Img2dBox_RightDown_V : 288|12@0+ (1.0000000000,0.0000000000) [0.0000000000|3000.0000000000] "pix"  FC,ADC
 SG_ FC_Obj1_Img2dBox_LeftTop_V : 284|12@0+ (1.0000000000,0.0000000000) [0.0000000000|3000.0000000000] "pix"  FC,ADC
 SG_ FC_Obj1_Img2dBox_RightDown_U : 264|12@0+ (1.0000000000,0.0000000000) [0.0000000000|4095.0000000000] "pix"  FC,ADC
 SG_ FC_Obj1_Img2dBox_LeftTop_U : 260|12@0+ (1.0000000000,0.0000000000) [0.0000000000|4095.0000000000] "pix"  FC,ADC
 SG_ FC_Obj1_TurnLight : 262|2@0+ (1.0000000000,0.0000000000) [0.0000000000|3.0000000000] ""  FC,ADC
 SG_ FC_Obj1_valid : 263|1@0+ (1.0000000000,0.0000000000) [0.0000000000|1.0000000000] ""  FC,ADC
 SG_ FC_Obj1_Vy_Vnce : 241|10@0+ (0.1250000000,-64.0000000000) [-64.0000000000|63.8750000000] "m/s"  FC,ADC
 SG_ FC_Obj1_Vx_Vnce : 237|12@0+ (0.0625000000,-128.0000000000) [-128.0000000000|127.9375000000] "m/s"  FC,ADC
 SG_ FC_Obj1_CenterAngle : 230|9@0+ (0.0100000000,-1.5700000000) [-1.5700000000|1.5700000000] ""  FC,ADC
 SG_ FC_Obj1_DistInLane : 209|11@0+ (0.0100000000,-10.0000000000) [-10.0000000000|10.0000000000] ""  FC,ADC
 SG_ FC_Obj1_objCutInLane : 211|2@0+ (1.0000000000,0.0000000000) [0.0000000000|2.0000000000] ""  FC,ADC
 SG_ FC_Obj1_objCutInFlag : 201|2@0+ (1.0000000000,0.0000000000) [0.0000000000|2.0000000000] ""  FC,ADC
 SG_ FC_Obj1_CornerPoint_y : 199|14@0+ (0.0100000000,-80.0000000000) [-80.0000000000|80.0000000000] ""  FC,ADC
 SG_ FC_Obj1_CornerPoint_x : 182|15@0+ (0.0100000000,0.0000000000) [0.0000000000|200.0000000000] ""  FC,ADC
 SG_ FC_Obj1_LaneAssignment : 169|3@0+ (1.0000000000,0.0000000000) [0.0000000000|7.0000000000] ""  FC,ADC
 SG_ FC_Obj1_MotionType : 172|3@0+ (1.0000000000,0.0000000000) [0.0000000000|4.0000000000] ""  FC,ADC
 SG_ FC_obj1_Brakelight_Info : 173|1@0+ (1.0000000000,0.0000000000) [0.0000000000|1.0000000000] ""  FC,ADC
 SG_ FC_Obj1_Width : 155|11@0+ (0.0100000000,0.0000000000) [0.0000000000|12.0000000000] "m"  FC,ADC
 SG_ FC_Obj1_Length : 148|9@0+ (0.0500000000,0.0000000000) [0.0000000000|25.5000000000] "m"  FC,ADC
 SG_ FC_Obj1_Height : 141|9@0+ (0.0100000000,0.0000000000) [0.0000000000|5.1100000000] "m"  FC,ADC
 SG_ FC_Obj1_HeadOrientation : 129|4@0+ (1.0000000000,0.0000000000) [0.0000000000|15.0000000000] ""  FC,ADC
 SG_ FC_Obj1_HeadingAngle : 308|10@0+ (0.0100000000,-3.1400000000) [-3.1400000000|3.1400000000] "rad"  FC,ADC
 SG_ FC_Obj1_ExistProb : 112|6@0+ (2.0000000000,0.0000000000) [0.0000000000|100.0000000000] "%"  FC,ADC
 SG_ FC_Obj1_Dy_Vnce : 106|10@0+ (0.0200000000,0.0000000000) [0.0000000000|20.0000000000] "m2"  FC,ADC
 SG_ FC_Obj1_Dy : 88|14@0+ (0.0100000000,-80.0000000000) [-80.0000000000|80.0000000000] "m"  FC,ADC
 SG_ FC_Obj1_Dx_Vnce : 86|14@0+ (0.0500000000,0.0000000000) [0.0000000000|50.0000000000] "m2"  FC,ADC
 SG_ FC_Obj1_Dx : 66|12@0+ (0.0500000000,0.0000000000) [0.0000000000|204.7000000000] "m"  FC,ADC
 SG_ FC_Obj1_RelVy : 60|10@0+ (0.1000000000,-50.0000000000) [-50.0000000000|50.0000000000] "m/s"  FC,ADC
 SG_ FC_Obj1_RelVx : 40|12@0+ (0.1000000000,-154.0000000000) [-154.0000000000|50.0000000000] "m/s"  FC,ADC
 SG_ FC_Obj1_RelAy : 32|8@0+ (0.1000000000,-12.0000000000) [-12.0000000000|12.0000000000] "m/s2"  FC,ADC
 SG_ FC_Obj1_RelAx : 25|9@0+ (0.1000000000,-16.0000000000) [-16.0000000000|16.0000000000] "m/s2"  FC,ADC
 SG_ FC_Obj1_TypeProb : 31|6@0+ (2.0000000000,0.0000000000) [0.0000000000|100.0000000000] "%"  FC,ADC
 SG_ FC_Obj1_Type : 19|4@0+ (1.0000000000,0.0000000000) [0.0000000000|15.0000000000] ""  FC,ADC
 SG_ FC_Obj1_Track_Age : 314|16@0+ (1.0000000000,0.0000000000) [0.0000000000|65535.0000000000] ""  FC,ADC
 SG_ FC_Obj1_Track_ID : 3|8@0+ (1.0000000000,0.0000000000) [0.0000000000|255.0000000000] ""  FC,ADC

BO_ 353 FC_161: 64 FC
 SG_ FC_Obj2WSInfoPosType : 133|4@0+ (1.0000000000,0.0000000000) [0.0000000000|15.0000000000] ""  FC,ADC
 SG_ FC_CRCCheck_161 : 503|16@0+ (1.0000000000,0.0000000000) [0.0000000000|65535.0000000000] ""  FC,ADC
 SG_ FC_RollingCounter_161 : 491|4@0+ (1.0000000000,0.0000000000) [0.0000000000|15.0000000000] ""  FC,ADC
 SG_ FC_Obj2_Img2dBox_RightDown_V : 288|12@0+ (1.0000000000,0.0000000000) [0.0000000000|3000.0000000000] "pix"  FC,ADC
 SG_ FC_Obj2_Img2dBox_LeftTop_V : 284|12@0+ (1.0000000000,0.0000000000) [0.0000000000|3000.0000000000] "pix"  FC,ADC
 SG_ FC_Obj2_Img2dBox_RightDown_U : 264|12@0+ (1.0000000000,0.0000000000) [0.0000000000|4095.0000000000] "pix"  FC,ADC
 SG_ FC_Obj2_Img2dBox_LeftTop_U : 260|12@0+ (1.0000000000,0.0000000000) [0.0000000000|4095.0000000000] "pix"  FC,ADC
 SG_ FC_Obj2_TurnLight : 262|2@0+ (1.0000000000,0.0000000000) [0.0000000000|3.0000000000] ""  FC,ADC
 SG_ FC_Obj2_valid : 263|1@0+ (1.0000000000,0.0000000000) [0.0000000000|1.0000000000] ""  FC,ADC
 SG_ FC_Obj2_Vy_Vnce : 241|10@0+ (0.1250000000,-64.0000000000) [-64.0000000000|63.8750000000] "m/s"  FC,ADC
 SG_ FC_Obj2_Vx_Vnce : 237|12@0+ (0.0625000000,-128.0000000000) [-128.0000000000|127.9375000000] "m/s"  FC,ADC
 SG_ FC_Obj2_CenterAngle : 230|9@0+ (0.0100000000,-1.5700000000) [-1.5700000000|1.5700000000] ""  FC,ADC
 SG_ FC_Obj2_DistInLane : 209|11@0+ (0.0100000000,-10.0000000000) [-10.0000000000|10.0000000000] ""  FC,ADC
 SG_ FC_Obj2_objCutInLane : 211|2@0+ (1.0000000000,0.0000000000) [0.0000000000|2.0000000000] ""  FC,ADC
 SG_ FC_Obj2_objCutInFlag : 201|2@0+ (1.0000000000,0.0000000000) [0.0000000000|2.0000000000] ""  FC,ADC
 SG_ FC_Obj2_CornerPoint_y : 199|14@0+ (0.0100000000,-80.0000000000) [-80.0000000000|80.0000000000] ""  FC,ADC
 SG_ FC_Obj2_CornerPoint_x : 182|15@0+ (0.0100000000,0.0000000000) [0.0000000000|200.0000000000] ""  FC,ADC
 SG_ FC_Obj2_LaneAssignment : 169|3@0+ (1.0000000000,0.0000000000) [0.0000000000|7.0000000000] ""  FC,ADC
 SG_ FC_Obj2_MotionType : 172|3@0+ (1.0000000000,0.0000000000) [0.0000000000|4.0000000000] ""  FC,ADC
 SG_ FC_obj2_Brakelight_Info : 173|1@0+ (1.0000000000,0.0000000000) [0.0000000000|1.0000000000] ""  FC,ADC
 SG_ FC_Obj2_Width : 155|11@0+ (0.0100000000,0.0000000000) [0.0000000000|12.0000000000] "m"  FC,ADC
 SG_ FC_Obj2_Length : 148|9@0+ (0.0500000000,0.0000000000) [0.0000000000|25.5000000000] "m"  FC,ADC
 SG_ FC_Obj2_Height : 141|9@0+ (0.0100000000,0.0000000000) [0.0000000000|5.1100000000] "m"  FC,ADC
 SG_ FC_Obj2_HeadOrientation : 129|4@0+ (1.0000000000,0.0000000000) [0.0000000000|15.0000000000] ""  FC,ADC
 SG_ FC_Obj2_HeadingAngle : 308|10@0+ (0.0100000000,-3.1400000000) [-3.1400000000|3.1400000000] "rad"  FC,ADC
 SG_ FC_Obj2_ExistProb : 112|6@0+ (2.0000000000,0.0000000000) [0.0000000000|100.0000000000] "%"  FC,ADC
 SG_ FC_Obj2_Dy_Vnce : 106|10@0+ (0.0200000000,0.0000000000) [0.0000000000|20.0000000000] "m2"  FC,ADC
 SG_ FC_Obj2_Dy : 88|14@0+ (0.0100000000,-80.0000000000) [-80.0000000000|80.0000000000] "m"  FC,ADC
 SG_ FC_Obj2_Dx_Vnce : 86|14@0+ (0.0500000000,0.0000000000) [0.0000000000|50.0000000000] "m2"  FC,ADC
 SG_ FC_Obj2_Dx : 66|12@0+ (0.0500000000,0.0000000000) [0.0000000000|204.7000000000] "m"  FC,ADC
 SG_ FC_Obj2_RelVy : 60|10@0+ (0.1000000000,-50.0000000000) [-50.0000000000|50.0000000000] "m/s"  FC,ADC
 SG_ FC_Obj2_RelVx : 40|12@0+ (0.1000000000,-154.0000000000) [-154.0000000000|50.0000000000] "m/s"  FC,ADC
 SG_ FC_Obj2_RelAy : 32|8@0+ (0.1000000000,-12.0000000000) [-12.0000000000|12.0000000000] "m/s2"  FC,ADC
 SG_ FC_Obj2_RelAx : 25|9@0+ (0.1000000000,-16.0000000000) [-16.0000000000|16.0000000000] "m/s2"  FC,ADC
 SG_ FC_Obj2_TypeProb : 31|6@0+ (2.0000000000,0.0000000000) [0.0000000000|100.0000000000] "%"  FC,ADC
 SG_ FC_Obj2_Type : 19|4@0+ (1.0000000000,0.0000000000) [0.0000000000|15.0000000000] ""  FC,ADC
 SG_ FC_Obj2_Track_Age : 314|16@0+ (1.0000000000,0.0000000000) [0.0000000000|65535.0000000000] ""  FC,ADC
 SG_ FC_Obj2_Track_ID : 3|8@0+ (1.0000000000,0.0000000000) [0.0000000000|255.0000000000] ""  FC,ADC

BO_ 354 FC_162: 64 FC
 SG_ FC_Obj3WSInfoPosType : 133|4@0+ (1.0000000000,0.0000000000) [0.0000000000|15.0000000000] ""  FC,ADC
 SG_ FC_CRCCheck_162 : 503|16@0+ (1.0000000000,0.0000000000) [0.0000000000|65535.0000000000] ""  FC,ADC
 SG_ FC_RollingCounter_162 : 491|4@0+ (1.0000000000,0.0000000000) [0.0000000000|15.0000000000] ""  FC,ADC
 SG_ FC_Obj3_Img2dBox_RightDown_V : 288|12@0+ (1.0000000000,0.0000000000) [0.0000000000|3000.0000000000] "pix"  FC,ADC
 SG_ FC_Obj3_Img2dBox_LeftTop_V : 284|12@0+ (1.0000000000,0.0000000000) [0.0000000000|3000.0000000000] "pix"  FC,ADC
 SG_ FC_Obj3_Img2dBox_RightDown_U : 264|12@0+ (1.0000000000,0.0000000000) [0.0000000000|4095.0000000000] "pix"  FC,ADC
 SG_ FC_Obj3_Img2dBox_LeftTop_U : 260|12@0+ (1.0000000000,0.0000000000) [0.0000000000|4095.0000000000] "pix"  FC,ADC
 SG_ FC_Obj3_TurnLight : 262|2@0+ (1.0000000000,0.0000000000) [0.0000000000|3.0000000000] ""  FC,ADC
 SG_ FC_Obj3_valid : 263|1@0+ (1.0000000000,0.0000000000) [0.0000000000|1.0000000000] ""  FC,ADC
 SG_ FC_Obj3_Vy_Vnce : 241|10@0+ (0.1250000000,-64.0000000000) [-64.0000000000|63.8750000000] "m/s"  FC,ADC
 SG_ FC_Obj3_Vx_Vnce : 237|12@0+ (0.0625000000,-128.0000000000) [-128.0000000000|127.9375000000] "m/s"  FC,ADC
 SG_ FC_Obj3_CenterAngle : 230|9@0+ (0.0100000000,-1.5700000000) [-1.5700000000|1.5700000000] ""  FC,ADC
 SG_ FC_Obj3_DistInLane : 209|11@0+ (0.0100000000,-10.0000000000) [-10.0000000000|10.0000000000] ""  FC,ADC
 SG_ FC_Obj3_objCutInLane : 211|2@0+ (1.0000000000,0.0000000000) [0.0000000000|2.0000000000] ""  FC,ADC
 SG_ FC_Obj3_objCutInFlag : 201|2@0+ (1.0000000000,0.0000000000) [0.0000000000|2.0000000000] ""  FC,ADC
 SG_ FC_Obj3_CornerPoint_y : 199|14@0+ (0.0100000000,-80.0000000000) [-80.0000000000|80.0000000000] ""  FC,ADC
 SG_ FC_Obj3_CornerPoint_x : 182|15@0+ (0.0100000000,0.0000000000) [0.0000000000|200.0000000000] ""  FC,ADC
 SG_ FC_Obj3_LaneAssignment : 169|3@0+ (1.0000000000,0.0000000000) [0.0000000000|7.0000000000] ""  FC,ADC
 SG_ FC_Obj3_MotionType : 172|3@0+ (1.0000000000,0.0000000000) [0.0000000000|4.0000000000] ""  FC,ADC
 SG_ FC_obj3_Brakelight_Info : 173|1@0+ (1.0000000000,0.0000000000) [0.0000000000|1.0000000000] ""  FC,ADC
 SG_ FC_Obj3_Width : 155|11@0+ (0.0100000000,0.0000000000) [0.0000000000|12.0000000000] "m"  FC,ADC
 SG_ FC_Obj3_Length : 148|9@0+ (0.0500000000,0.0000000000) [0.0000000000|25.5000000000] "m"  FC,ADC
 SG_ FC_Obj3_Height : 141|9@0+ (0.0100000000,0.0000000000) [0.0000000000|5.1100000000] "m"  FC,ADC
 SG_ FC_Obj3_HeadOrientation : 129|4@0+ (1.0000000000,0.0000000000) [0.0000000000|15.0000000000] ""  FC,ADC
 SG_ FC_Obj3_HeadingAngle : 308|10@0+ (0.0100000000,-3.1400000000) [-3.1400000000|3.1400000000] "rad"  FC,ADC
 SG_ FC_Obj3_ExistProb : 112|6@0+ (2.0000000000,0.0000000000) [0.0000000000|100.0000000000] "%"  FC,ADC
 SG_ FC_Obj3_Dy_Vnce : 106|10@0+ (0.0200000000,0.0000000000) [0.0000000000|20.0000000000] "m2"  FC,ADC
 SG_ FC_Obj3_Dy : 88|14@0+ (0.0100000000,-80.0000000000) [-80.0000000000|80.0000000000] "m"  FC,ADC
 SG_ FC_Obj3_Dx_Vnce : 86|14@0+ (0.0500000000,0.0000000000) [0.0000000000|50.0000000000] "m2"  FC,ADC
 SG_ FC_Obj3_Dx : 66|12@0+ (0.0500000000,0.0000000000) [0.0000000000|204.7000000000] "m"  FC,ADC
 SG_ FC_Obj3_RelVy : 60|10@0+ (0.1000000000,-50.0000000000) [-50.0000000000|50.0000000000] "m/s"  FC,ADC
 SG_ FC_Obj3_RelVx : 40|12@0+ (0.1000000000,-154.0000000000) [-154.0000000000|50.0000000000] "m/s"  FC,ADC
 SG_ FC_Obj3_RelAy : 32|8@0+ (0.1000000000,-12.0000000000) [-12.0000000000|12.0000000000] "m/s2"  FC,ADC
 SG_ FC_Obj3_RelAx : 25|9@0+ (0.1000000000,-16.0000000000) [-16.0000000000|16.0000000000] "m/s2"  FC,ADC
 SG_ FC_Obj3_TypeProb : 31|6@0+ (2.0000000000,0.0000000000) [0.0000000000|100.0000000000] "%"  FC,ADC
 SG_ FC_Obj3_Type : 19|4@0+ (1.0000000000,0.0000000000) [0.0000000000|15.0000000000] ""  FC,ADC
 SG_ FC_Obj3_Track_Age : 314|16@0+ (1.0000000000,0.0000000000) [0.0000000000|65535.0000000000] ""  FC,ADC
 SG_ FC_Obj3_Track_ID : 3|8@0+ (1.0000000000,0.0000000000) [0.0000000000|255.0000000000] ""  FC,ADC

BO_ 355 FC_163: 64 FC
 SG_ FC_Obj4WSInfoPosType : 133|4@0+ (1.0000000000,0.0000000000) [0.0000000000|15.0000000000] ""  FC,ADC
 SG_ FC_CRCCheck_163 : 503|16@0+ (1.0000000000,0.0000000000) [0.0000000000|65535.0000000000] ""  FC,ADC
 SG_ FC_RollingCounter_163 : 491|4@0+ (1.0000000000,0.0000000000) [0.0000000000|15.0000000000] ""  FC,ADC
 SG_ FC_Obj4_Img2dBox_RightDown_V : 288|12@0+ (1.0000000000,0.0000000000) [0.0000000000|3000.0000000000] "pix"  FC,ADC
 SG_ FC_Obj4_Img2dBox_LeftTop_V : 284|12@0+ (1.0000000000,0.0000000000) [0.0000000000|3000.0000000000] "pix"  FC,ADC
 SG_ FC_Obj4_Img2dBox_RightDown_U : 264|12@0+ (1.0000000000,0.0000000000) [0.0000000000|4095.0000000000] "pix"  FC,ADC
 SG_ FC_Obj4_Img2dBox_LeftTop_U : 260|12@0+ (1.0000000000,0.0000000000) [0.0000000000|4095.0000000000] "pix"  FC,ADC
 SG_ FC_Obj4_TurnLight : 262|2@0+ (1.0000000000,0.0000000000) [0.0000000000|3.0000000000] ""  FC,ADC
 SG_ FC_Obj4_valid : 263|1@0+ (1.0000000000,0.0000000000) [0.0000000000|1.0000000000] ""  FC,ADC
 SG_ FC_Obj4_Vy_Vnce : 241|10@0+ (0.1250000000,-64.0000000000) [-64.0000000000|63.8750000000] "m/s"  FC,ADC
 SG_ FC_Obj4_Vx_Vnce : 237|12@0+ (0.0625000000,-128.0000000000) [-128.0000000000|127.9375000000] "m/s"  FC,ADC
 SG_ FC_Obj4_CenterAngle : 230|9@0+ (0.0100000000,-1.5700000000) [-1.5700000000|1.5700000000] ""  FC,ADC
 SG_ FC_Obj4_DistInLane : 209|11@0+ (0.0100000000,-10.0000000000) [-10.0000000000|10.0000000000] ""  FC,ADC
 SG_ FC_Obj4_objCutInLane : 211|2@0+ (1.0000000000,0.0000000000) [0.0000000000|2.0000000000] ""  FC,ADC
 SG_ FC_Obj4_objCutInFlag : 201|2@0+ (1.0000000000,0.0000000000) [0.0000000000|2.0000000000] ""  FC,ADC
 SG_ FC_Obj4_CornerPoint_y : 199|14@0+ (0.0100000000,-80.0000000000) [-80.0000000000|80.0000000000] ""  FC,ADC
 SG_ FC_Obj4_CornerPoint_x : 182|15@0+ (0.0100000000,0.0000000000) [0.0000000000|200.0000000000] ""  FC,ADC
 SG_ FC_Obj4_LaneAssignment : 169|3@0+ (1.0000000000,0.0000000000) [0.0000000000|7.0000000000] ""  FC,ADC
 SG_ FC_Obj4_MotionType : 172|3@0+ (1.0000000000,0.0000000000) [0.0000000000|4.0000000000] ""  FC,ADC
 SG_ FC_obj4_Brakelight_Info : 173|1@0+ (1.0000000000,0.0000000000) [0.0000000000|1.0000000000] ""  FC,ADC
 SG_ FC_Obj4_Width : 155|11@0+ (0.0100000000,0.0000000000) [0.0000000000|12.0000000000] "m"  FC,ADC
 SG_ FC_Obj4_Length : 148|9@0+ (0.0500000000,0.0000000000) [0.0000000000|25.5000000000] "m"  FC,ADC
 SG_ FC_Obj4_Height : 141|9@0+ (0.0100000000,0.0000000000) [0.0000000000|5.1100000000] "m"  FC,ADC
 SG_ FC_Obj4_HeadOrientation : 129|4@0+ (1.0000000000,0.0000000000) [0.0000000000|15.0000000000] ""  FC,ADC
 SG_ FC_Obj4_HeadingAngle : 308|10@0+ (0.0100000000,-3.1400000000) [-3.1400000000|3.1400000000] "rad"  FC,ADC
 SG_ FC_Obj4_ExistProb : 112|6@0+ (2.0000000000,0.0000000000) [0.0000000000|100.0000000000] "%"  FC,ADC
 SG_ FC_Obj4_Dy_Vnce : 106|10@0+ (0.0200000000,0.0000000000) [0.0000000000|20.0000000000] "m2"  FC,ADC
 SG_ FC_Obj4_Dy : 88|14@0+ (0.0100000000,-80.0000000000) [-80.0000000000|80.0000000000] "m"  FC,ADC
 SG_ FC_Obj4_Dx_Vnce : 86|14@0+ (0.0500000000,0.0000000000) [0.0000000000|50.0000000000] "m2"  FC,ADC
 SG_ FC_Obj4_Dx : 66|12@0+ (0.0500000000,0.0000000000) [0.0000000000|204.7000000000] "m"  FC,ADC
 SG_ FC_Obj4_RelVy : 60|10@0+ (0.1000000000,-50.0000000000) [-50.0000000000|50.0000000000] "m/s"  FC,ADC
 SG_ FC_Obj4_RelVx : 40|12@0+ (0.1000000000,-154.0000000000) [-154.0000000000|50.0000000000] "m/s"  FC,ADC
 SG_ FC_Obj4_RelAy : 32|8@0+ (0.1000000000,-12.0000000000) [-12.0000000000|12.0000000000] "m/s2"  FC,ADC
 SG_ FC_Obj4_RelAx : 25|9@0+ (0.1000000000,-16.0000000000) [-16.0000000000|16.0000000000] "m/s2"  FC,ADC
 SG_ FC_Obj4_TypeProb : 31|6@0+ (2.0000000000,0.0000000000) [0.0000000000|100.0000000000] "%"  FC,ADC
 SG_ FC_Obj4_Type : 19|4@0+ (1.0000000000,0.0000000000) [0.0000000000|15.0000000000] ""  FC,ADC
 SG_ FC_Obj4_Track_Age : 314|16@0+ (1.0000000000,0.0000000000) [0.0000000000|65535.0000000000] ""  FC,ADC
 SG_ FC_Obj4_Track_ID : 3|8@0+ (1.0000000000,0.0000000000) [0.0000000000|255.0000000000] ""  FC,ADC

BO_ 356 FC_164: 64 FC
 SG_ FC_Obj5WSInfoPosType : 133|4@0+ (1.0000000000,0.0000000000) [0.0000000000|15.0000000000] ""  FC,ADC
 SG_ FC_CRCCheck_164 : 503|16@0+ (1.0000000000,0.0000000000) [0.0000000000|65535.0000000000] ""  FC,ADC
 SG_ FC_RollingCounter_164 : 491|4@0+ (1.0000000000,0.0000000000) [0.0000000000|15.0000000000] ""  FC,ADC
 SG_ FC_Obj5_Img2dBox_RightDown_V : 288|12@0+ (1.0000000000,0.0000000000) [0.0000000000|3000.0000000000] "pix"  FC,ADC
 SG_ FC_Obj5_Img2dBox_LeftTop_V : 284|12@0+ (1.0000000000,0.0000000000) [0.0000000000|3000.0000000000] "pix"  FC,ADC
 SG_ FC_Obj5_Img2dBox_RightDown_U : 264|12@0+ (1.0000000000,0.0000000000) [0.0000000000|4095.0000000000] "pix"  FC,ADC
 SG_ FC_Obj5_Img2dBox_LeftTop_U : 260|12@0+ (1.0000000000,0.0000000000) [0.0000000000|4095.0000000000] "pix"  FC,ADC
 SG_ FC_Obj5_TurnLight : 262|2@0+ (1.0000000000,0.0000000000) [0.0000000000|3.0000000000] ""  FC,ADC
 SG_ FC_Obj5_valid : 263|1@0+ (1.0000000000,0.0000000000) [0.0000000000|1.0000000000] ""  FC,ADC
 SG_ FC_Obj5_Vy_Vnce : 241|10@0+ (0.1250000000,-64.0000000000) [-64.0000000000|63.8750000000] "m/s"  FC,ADC
 SG_ FC_Obj5_Vx_Vnce : 237|12@0+ (0.0625000000,-128.0000000000) [-128.0000000000|127.9375000000] "m/s"  FC,ADC
 SG_ FC_Obj5_CenterAngle : 230|9@0+ (0.0100000000,-1.5700000000) [-1.5700000000|1.5700000000] ""  FC,ADC
 SG_ FC_Obj5_DistInLane : 209|11@0+ (0.0100000000,-10.0000000000) [-10.0000000000|10.0000000000] ""  FC,ADC
 SG_ FC_Obj5_objCutInLane : 211|2@0+ (1.0000000000,0.0000000000) [0.0000000000|2.0000000000] ""  FC,ADC
 SG_ FC_Obj5_objCutInFlag : 201|2@0+ (1.0000000000,0.0000000000) [0.0000000000|2.0000000000] ""  FC,ADC
 SG_ FC_Obj5_CornerPoint_y : 199|14@0+ (0.0100000000,-80.0000000000) [-80.0000000000|80.0000000000] ""  FC,ADC
 SG_ FC_Obj5_CornerPoint_x : 182|15@0+ (0.0100000000,0.0000000000) [0.0000000000|200.0000000000] ""  FC,ADC
 SG_ FC_Obj5_LaneAssignment : 169|3@0+ (1.0000000000,0.0000000000) [0.0000000000|7.0000000000] ""  FC,ADC
 SG_ FC_Obj5_MotionType : 172|3@0+ (1.0000000000,0.0000000000) [0.0000000000|4.0000000000] ""  FC,ADC
 SG_ FC_obj5_Brakelight_Info : 173|1@0+ (1.0000000000,0.0000000000) [0.0000000000|1.0000000000] ""  FC,ADC
 SG_ FC_Obj5_Width : 155|11@0+ (0.0100000000,0.0000000000) [0.0000000000|12.0000000000] "m"  FC,ADC
 SG_ FC_Obj5_Length : 148|9@0+ (0.0500000000,0.0000000000) [0.0000000000|25.5000000000] "m"  FC,ADC
 SG_ FC_Obj5_Height : 141|9@0+ (0.0100000000,0.0000000000) [0.0000000000|5.1100000000] "m"  FC,ADC
 SG_ FC_Obj5_HeadOrientation : 129|4@0+ (1.0000000000,0.0000000000) [0.0000000000|15.0000000000] ""  FC,ADC
 SG_ FC_Obj5_HeadingAngle : 308|10@0+ (0.0100000000,-3.1400000000) [-3.1400000000|3.1400000000] "rad"  FC,ADC
 SG_ FC_Obj5_ExistProb : 112|6@0+ (2.0000000000,0.0000000000) [0.0000000000|100.0000000000] "%"  FC,ADC
 SG_ FC_Obj5_Dy_Vnce : 106|10@0+ (0.0200000000,0.0000000000) [0.0000000000|20.0000000000] "m2"  FC,ADC
 SG_ FC_Obj5_Dy : 88|14@0+ (0.0100000000,-80.0000000000) [-80.0000000000|80.0000000000] "m"  FC,ADC
 SG_ FC_Obj5_Dx_Vnce : 86|14@0+ (0.0500000000,0.0000000000) [0.0000000000|50.0000000000] "m2"  FC,ADC
 SG_ FC_Obj5_Dx : 66|12@0+ (0.0500000000,0.0000000000) [0.0000000000|204.7000000000] "m"  FC,ADC
 SG_ FC_Obj5_RelVy : 60|10@0+ (0.1000000000,-50.0000000000) [-50.0000000000|50.0000000000] "m/s"  FC,ADC
 SG_ FC_Obj5_RelVx : 40|12@0+ (0.1000000000,-154.0000000000) [-154.0000000000|50.0000000000] "m/s"  FC,ADC
 SG_ FC_Obj5_RelAy : 32|8@0+ (0.1000000000,-12.0000000000) [-12.0000000000|12.0000000000] "m/s2"  FC,ADC
 SG_ FC_Obj5_RelAx : 25|9@0+ (0.1000000000,-16.0000000000) [-16.0000000000|16.0000000000] "m/s2"  FC,ADC
 SG_ FC_Obj5_TypeProb : 31|6@0+ (2.0000000000,0.0000000000) [0.0000000000|100.0000000000] "%"  FC,ADC
 SG_ FC_Obj5_Type : 19|4@0+ (1.0000000000,0.0000000000) [0.0000000000|15.0000000000] ""  FC,ADC
 SG_ FC_Obj5_Track_Age : 314|16@0+ (1.0000000000,0.0000000000) [0.0000000000|65535.0000000000] ""  FC,ADC
 SG_ FC_Obj5_Track_ID : 3|8@0+ (1.0000000000,0.0000000000) [0.0000000000|255.0000000000] ""  FC,ADC

BO_ 357 FC_165: 64 FC
 SG_ FC_Obj6WSInfoPosType : 133|4@0+ (1.0000000000,0.0000000000) [0.0000000000|15.0000000000] ""  FC,ADC
 SG_ FC_CRCCheck_165 : 503|16@0+ (1.0000000000,0.0000000000) [0.0000000000|65535.0000000000] ""  FC,ADC
 SG_ FC_RollingCounter_165 : 491|4@0+ (1.0000000000,0.0000000000) [0.0000000000|15.0000000000] ""  FC,ADC
 SG_ FC_Obj6_Img2dBox_RightDown_V : 288|12@0+ (1.0000000000,0.0000000000) [0.0000000000|3000.0000000000] "pix"  FC,ADC
 SG_ FC_Obj6_Img2dBox_LeftTop_V : 284|12@0+ (1.0000000000,0.0000000000) [0.0000000000|3000.0000000000] "pix"  FC,ADC
 SG_ FC_Obj6_Img2dBox_RightDown_U : 264|12@0+ (1.0000000000,0.0000000000) [0.0000000000|4095.0000000000] "pix"  FC,ADC
 SG_ FC_Obj6_Img2dBox_LeftTop_U : 260|12@0+ (1.0000000000,0.0000000000) [0.0000000000|4095.0000000000] "pix"  FC,ADC
 SG_ FC_Obj6_TurnLight : 262|2@0+ (1.0000000000,0.0000000000) [0.0000000000|3.0000000000] ""  FC,ADC
 SG_ FC_Obj6_valid : 263|1@0+ (1.0000000000,0.0000000000) [0.0000000000|1.0000000000] ""  FC,ADC
 SG_ FC_Obj6_Vy_Vnce : 241|10@0+ (0.1250000000,-64.0000000000) [-64.0000000000|63.8750000000] "m/s"  FC,ADC
 SG_ FC_Obj6_Vx_Vnce : 237|12@0+ (0.0625000000,-128.0000000000) [-128.0000000000|127.9375000000] "m/s"  FC,ADC
 SG_ FC_Obj6_CenterAngle : 230|9@0+ (0.0100000000,-1.5700000000) [-1.5700000000|1.5700000000] ""  FC,ADC
 SG_ FC_Obj6_DistInLane : 209|11@0+ (0.0100000000,-10.0000000000) [-10.0000000000|10.0000000000] ""  FC,ADC
 SG_ FC_Obj6_objCutInLane : 211|2@0+ (1.0000000000,0.0000000000) [0.0000000000|2.0000000000] ""  FC,ADC
 SG_ FC_Obj6_objCutInFlag : 201|2@0+ (1.0000000000,0.0000000000) [0.0000000000|2.0000000000] ""  FC,ADC
 SG_ FC_Obj6_CornerPoint_y : 199|14@0+ (0.0100000000,-80.0000000000) [-80.0000000000|80.0000000000] ""  FC,ADC
 SG_ FC_Obj6_CornerPoint_x : 182|15@0+ (0.0100000000,0.0000000000) [0.0000000000|200.0000000000] ""  FC,ADC
 SG_ FC_Obj6_LaneAssignment : 169|3@0+ (1.0000000000,0.0000000000) [0.0000000000|7.0000000000] ""  FC,ADC
 SG_ FC_Obj6_MotionType : 172|3@0+ (1.0000000000,0.0000000000) [0.0000000000|4.0000000000] ""  FC,ADC
 SG_ FC_obj6_Brakelight_Info : 173|1@0+ (1.0000000000,0.0000000000) [0.0000000000|1.0000000000] ""  FC,ADC
 SG_ FC_Obj6_Width : 155|11@0+ (0.0100000000,0.0000000000) [0.0000000000|12.0000000000] "m"  FC,ADC
 SG_ FC_Obj6_Length : 148|9@0+ (0.0500000000,0.0000000000) [0.0000000000|25.5000000000] "m"  FC,ADC
 SG_ FC_Obj6_Height : 141|9@0+ (0.0100000000,0.0000000000) [0.0000000000|5.1100000000] "m"  FC,ADC
 SG_ FC_Obj6_HeadOrientation : 129|4@0+ (1.0000000000,0.0000000000) [0.0000000000|15.0000000000] ""  FC,ADC
 SG_ FC_Obj6_HeadingAngle : 308|10@0+ (0.0100000000,-3.1400000000) [-3.1400000000|3.1400000000] "rad"  FC,ADC
 SG_ FC_Obj6_ExistProb : 112|6@0+ (2.0000000000,0.0000000000) [0.0000000000|100.0000000000] "%"  FC,ADC
 SG_ FC_Obj6_Dy_Vnce : 106|10@0+ (0.0200000000,0.0000000000) [0.0000000000|20.0000000000] "m2"  FC,ADC
 SG_ FC_Obj6_Dy : 88|14@0+ (0.0100000000,-80.0000000000) [-80.0000000000|80.0000000000] "m"  FC,ADC
 SG_ FC_Obj6_Dx_Vnce : 86|14@0+ (0.0500000000,0.0000000000) [0.0000000000|50.0000000000] "m2"  FC,ADC
 SG_ FC_Obj6_Dx : 66|12@0+ (0.0500000000,0.0000000000) [0.0000000000|204.7000000000] "m"  FC,ADC
 SG_ FC_Obj6_RelVy : 60|10@0+ (0.1000000000,-50.0000000000) [-50.0000000000|50.0000000000] "m/s"  FC,ADC
 SG_ FC_Obj6_RelVx : 40|12@0+ (0.1000000000,-154.0000000000) [-154.0000000000|50.0000000000] "m/s"  FC,ADC
 SG_ FC_Obj6_RelAy : 32|8@0+ (0.1000000000,-12.0000000000) [-12.0000000000|12.0000000000] "m/s2"  FC,ADC
 SG_ FC_Obj6_RelAx : 25|9@0+ (0.1000000000,-16.0000000000) [-16.0000000000|16.0000000000] "m/s2"  FC,ADC
 SG_ FC_Obj6_TypeProb : 31|6@0+ (2.0000000000,0.0000000000) [0.0000000000|100.0000000000] "%"  FC,ADC
 SG_ FC_Obj6_Type : 19|4@0+ (1.0000000000,0.0000000000) [0.0000000000|15.0000000000] ""  FC,ADC
 SG_ FC_Obj6_Track_Age : 314|16@0+ (1.0000000000,0.0000000000) [0.0000000000|65535.0000000000] ""  FC,ADC
 SG_ FC_Obj6_Track_ID : 3|8@0+ (1.0000000000,0.0000000000) [0.0000000000|255.0000000000] ""  FC,ADC

BO_ 358 FC_166: 64 FC
 SG_ FC_Obj7WSInfoPosType : 133|4@0+ (1.0000000000,0.0000000000) [0.0000000000|15.0000000000] ""  FC,ADC
 SG_ FC_CRCCheck_166 : 503|16@0+ (1.0000000000,0.0000000000) [0.0000000000|65535.0000000000] ""  FC,ADC
 SG_ FC_RollingCounter_166 : 491|4@0+ (1.0000000000,0.0000000000) [0.0000000000|15.0000000000] ""  FC,ADC
 SG_ FC_Obj7_Img2dBox_RightDown_V : 288|12@0+ (1.0000000000,0.0000000000) [0.0000000000|3000.0000000000] "pix"  FC,ADC
 SG_ FC_Obj7_Img2dBox_LeftTop_V : 284|12@0+ (1.0000000000,0.0000000000) [0.0000000000|3000.0000000000] "pix"  FC,ADC
 SG_ FC_Obj7_Img2dBox_RightDown_U : 264|12@0+ (1.0000000000,0.0000000000) [0.0000000000|4095.0000000000] "pix"  FC,ADC
 SG_ FC_Obj7_Img2dBox_LeftTop_U : 260|12@0+ (1.0000000000,0.0000000000) [0.0000000000|4095.0000000000] "pix"  FC,ADC
 SG_ FC_Obj7_TurnLight : 262|2@0+ (1.0000000000,0.0000000000) [0.0000000000|3.0000000000] ""  FC,ADC
 SG_ FC_Obj7_valid : 263|1@0+ (1.0000000000,0.0000000000) [0.0000000000|1.0000000000] ""  FC,ADC
 SG_ FC_Obj7_Vy_Vnce : 241|10@0+ (0.1250000000,-64.0000000000) [-64.0000000000|63.8750000000] "m/s"  FC,ADC
 SG_ FC_Obj7_Vx_Vnce : 237|12@0+ (0.0625000000,-128.0000000000) [-128.0000000000|127.9375000000] "m/s"  FC,ADC
 SG_ FC_Obj7_CenterAngle : 230|9@0+ (0.0100000000,-1.5700000000) [-1.5700000000|1.5700000000] ""  FC,ADC
 SG_ FC_Obj7_DistInLane : 209|11@0+ (0.0100000000,-10.0000000000) [-10.0000000000|10.0000000000] ""  FC,ADC
 SG_ FC_Obj7_objCutInLane : 211|2@0+ (1.0000000000,0.0000000000) [0.0000000000|2.0000000000] ""  FC,ADC
 SG_ FC_Obj7_objCutInFlag : 201|2@0+ (1.0000000000,0.0000000000) [0.0000000000|2.0000000000] ""  FC,ADC
 SG_ FC_Obj7_CornerPoint_y : 199|14@0+ (0.0100000000,-80.0000000000) [-80.0000000000|80.0000000000] ""  FC,ADC
 SG_ FC_Obj7_CornerPoint_x : 182|15@0+ (0.0100000000,0.0000000000) [0.0000000000|200.0000000000] ""  FC,ADC
 SG_ FC_Obj7_LaneAssignment : 169|3@0+ (1.0000000000,0.0000000000) [0.0000000000|7.0000000000] ""  FC,ADC
 SG_ FC_Obj7_MotionType : 172|3@0+ (1.0000000000,0.0000000000) [0.0000000000|4.0000000000] ""  FC,ADC
 SG_ FC_obj7_Brakelight_Info : 173|1@0+ (1.0000000000,0.0000000000) [0.0000000000|1.0000000000] ""  FC,ADC
 SG_ FC_Obj7_Width : 155|11@0+ (0.0100000000,0.0000000000) [0.0000000000|12.0000000000] "m"  FC,ADC
 SG_ FC_Obj7_Length : 148|9@0+ (0.0500000000,0.0000000000) [0.0000000000|25.5000000000] "m"  FC,ADC
 SG_ FC_Obj7_Height : 141|9@0+ (0.0100000000,0.0000000000) [0.0000000000|5.1100000000] "m"  FC,ADC
 SG_ FC_Obj7_HeadOrientation : 129|4@0+ (1.0000000000,0.0000000000) [0.0000000000|15.0000000000] ""  FC,ADC
 SG_ FC_Obj7_HeadingAngle : 308|10@0+ (0.0100000000,-3.1400000000) [-3.1400000000|3.1400000000] "rad"  FC,ADC
 SG_ FC_Obj7_ExistProb : 112|6@0+ (2.0000000000,0.0000000000) [0.0000000000|100.0000000000] "%"  FC,ADC
 SG_ FC_Obj7_Dy_Vnce : 106|10@0+ (0.0200000000,0.0000000000) [0.0000000000|20.0000000000] "m2"  FC,ADC
 SG_ FC_Obj7_Dy : 88|14@0+ (0.0100000000,-80.0000000000) [-80.0000000000|80.0000000000] "m"  FC,ADC
 SG_ FC_Obj7_Dx_Vnce : 86|14@0+ (0.0500000000,0.0000000000) [0.0000000000|50.0000000000] "m2"  FC,ADC
 SG_ FC_Obj7_Dx : 66|12@0+ (0.0500000000,0.0000000000) [0.0000000000|204.7000000000] "m"  FC,ADC
 SG_ FC_Obj7_RelVy : 60|10@0+ (0.1000000000,-50.0000000000) [-50.0000000000|50.0000000000] "m/s"  FC,ADC
 SG_ FC_Obj7_RelVx : 40|12@0+ (0.1000000000,-154.0000000000) [-154.0000000000|50.0000000000] "m/s"  FC,ADC
 SG_ FC_Obj7_RelAy : 32|8@0+ (0.1000000000,-12.0000000000) [-12.0000000000|12.0000000000] "m/s2"  FC,ADC
 SG_ FC_Obj7_RelAx : 25|9@0+ (0.1000000000,-16.0000000000) [-16.0000000000|16.0000000000] "m/s2"  FC,ADC
 SG_ FC_Obj7_TypeProb : 31|6@0+ (2.0000000000,0.0000000000) [0.0000000000|100.0000000000] "%"  FC,ADC
 SG_ FC_Obj7_Type : 19|4@0+ (1.0000000000,0.0000000000) [0.0000000000|15.0000000000] ""  FC,ADC
 SG_ FC_Obj7_Track_Age : 314|16@0+ (1.0000000000,0.0000000000) [0.0000000000|65535.0000000000] ""  FC,ADC
 SG_ FC_Obj7_Track_ID : 3|8@0+ (1.0000000000,0.0000000000) [0.0000000000|255.0000000000] ""  FC,ADC

BO_ 359 FC_167: 64 FC
 SG_ FC_Obj8WSInfoPosType : 133|4@0+ (1.0000000000,0.0000000000) [0.0000000000|15.0000000000] ""  FC,ADC
 SG_ FC_CRCCheck_167 : 503|16@0+ (1.0000000000,0.0000000000) [0.0000000000|65535.0000000000] ""  FC,ADC
 SG_ FC_RollingCounter_167 : 491|4@0+ (1.0000000000,0.0000000000) [0.0000000000|15.0000000000] ""  FC,ADC
 SG_ FC_Obj8_Img2dBox_RightDown_V : 288|12@0+ (1.0000000000,0.0000000000) [0.0000000000|3000.0000000000] "pix"  FC,ADC
 SG_ FC_Obj8_Img2dBox_LeftTop_V : 284|12@0+ (1.0000000000,0.0000000000) [0.0000000000|3000.0000000000] "pix"  FC,ADC
 SG_ FC_Obj8_Img2dBox_RightDown_U : 264|12@0+ (1.0000000000,0.0000000000) [0.0000000000|4095.0000000000] "pix"  FC,ADC
 SG_ FC_Obj8_Img2dBox_LeftTop_U : 260|12@0+ (1.0000000000,0.0000000000) [0.0000000000|4095.0000000000] "pix"  FC,ADC
 SG_ FC_Obj8_TurnLight : 262|2@0+ (1.0000000000,0.0000000000) [0.0000000000|3.0000000000] ""  FC,ADC
 SG_ FC_Obj8_valid : 263|1@0+ (1.0000000000,0.0000000000) [0.0000000000|1.0000000000] ""  FC,ADC
 SG_ FC_Obj8_Vy_Vnce : 241|10@0+ (0.1250000000,-64.0000000000) [-64.0000000000|63.8750000000] "m/s"  FC,ADC
 SG_ FC_Obj8_Vx_Vnce : 237|12@0+ (0.0625000000,-128.0000000000) [-128.0000000000|127.9375000000] "m/s"  FC,ADC
 SG_ FC_Obj8_CenterAngle : 230|9@0+ (0.0100000000,-1.5700000000) [-1.5700000000|1.5700000000] ""  FC,ADC
 SG_ FC_Obj8_DistInLane : 209|11@0+ (0.0100000000,-10.0000000000) [-10.0000000000|10.0000000000] ""  FC,ADC
 SG_ FC_Obj8_objCutInLane : 211|2@0+ (1.0000000000,0.0000000000) [0.0000000000|2.0000000000] ""  FC,ADC
 SG_ FC_Obj8_objCutInFlag : 201|2@0+ (1.0000000000,0.0000000000) [0.0000000000|2.0000000000] ""  FC,ADC
 SG_ FC_Obj8_CornerPoint_y : 199|14@0+ (0.0100000000,-80.0000000000) [-80.0000000000|80.0000000000] ""  FC,ADC
 SG_ FC_Obj8_CornerPoint_x : 182|15@0+ (0.0100000000,0.0000000000) [0.0000000000|200.0000000000] ""  FC,ADC
 SG_ FC_Obj8_LaneAssignment : 169|3@0+ (1.0000000000,0.0000000000) [0.0000000000|7.0000000000] ""  FC,ADC
 SG_ FC_Obj8_MotionType : 172|3@0+ (1.0000000000,0.0000000000) [0.0000000000|4.0000000000] ""  FC,ADC
 SG_ FC_obj8_Brakelight_Info : 173|1@0+ (1.0000000000,0.0000000000) [0.0000000000|1.0000000000] ""  FC,ADC
 SG_ FC_Obj8_Width : 155|11@0+ (0.0100000000,0.0000000000) [0.0000000000|12.0000000000] "m"  FC,ADC
 SG_ FC_Obj8_Length : 148|9@0+ (0.0500000000,0.0000000000) [0.0000000000|25.5000000000] "m"  FC,ADC
 SG_ FC_Obj8_Height : 141|9@0+ (0.0100000000,0.0000000000) [0.0000000000|5.1100000000] "m"  FC,ADC
 SG_ FC_Obj8_HeadOrientation : 129|4@0+ (1.0000000000,0.0000000000) [0.0000000000|15.0000000000] ""  FC,ADC
 SG_ FC_Obj8_HeadingAngle : 308|10@0+ (0.0100000000,-3.1400000000) [-3.1400000000|3.1400000000] "rad"  FC,ADC
 SG_ FC_Obj8_ExistProb : 112|6@0+ (2.0000000000,0.0000000000) [0.0000000000|100.0000000000] "%"  FC,ADC
 SG_ FC_Obj8_Dy_Vnce : 106|10@0+ (0.0200000000,0.0000000000) [0.0000000000|20.0000000000] "m2"  FC,ADC
 SG_ FC_Obj8_Dy : 88|14@0+ (0.0100000000,-80.0000000000) [-80.0000000000|80.0000000000] "m"  FC,ADC
 SG_ FC_Obj8_Dx_Vnce : 86|14@0+ (0.0500000000,0.0000000000) [0.0000000000|50.0000000000] "m2"  FC,ADC
 SG_ FC_Obj8_Dx : 66|12@0+ (0.0500000000,0.0000000000) [0.0000000000|204.7000000000] "m"  FC,ADC
 SG_ FC_Obj8_RelVy : 60|10@0+ (0.1000000000,-50.0000000000) [-50.0000000000|50.0000000000] "m/s"  FC,ADC
 SG_ FC_Obj8_RelVx : 40|12@0+ (0.1000000000,-154.0000000000) [-154.0000000000|50.0000000000] "m/s"  FC,ADC
 SG_ FC_Obj8_RelAy : 32|8@0+ (0.1000000000,-12.0000000000) [-12.0000000000|12.0000000000] "m/s2"  FC,ADC
 SG_ FC_Obj8_RelAx : 25|9@0+ (0.1000000000,-16.0000000000) [-16.0000000000|16.0000000000] "m/s2"  FC,ADC
 SG_ FC_Obj8_TypeProb : 31|6@0+ (2.0000000000,0.0000000000) [0.0000000000|100.0000000000] "%"  FC,ADC
 SG_ FC_Obj8_Type : 19|4@0+ (1.0000000000,0.0000000000) [0.0000000000|15.0000000000] ""  FC,ADC
 SG_ FC_Obj8_Track_Age : 314|16@0+ (1.0000000000,0.0000000000) [0.0000000000|65535.0000000000] ""  FC,ADC
 SG_ FC_Obj8_Track_ID : 3|8@0+ (1.0000000000,0.0000000000) [0.0000000000|255.0000000000] ""  FC,ADC

BO_ 360 FC_168: 64 FC
 SG_ FC_Obj9WSInfoPosType : 133|4@0+ (1.0000000000,0.0000000000) [0.0000000000|15.0000000000] ""  FC,ADC
 SG_ FC_CRCCheck_168 : 503|16@0+ (1.0000000000,0.0000000000) [0.0000000000|65535.0000000000] ""  FC,ADC
 SG_ FC_RollingCounter_168 : 491|4@0+ (1.0000000000,0.0000000000) [0.0000000000|15.0000000000] ""  FC,ADC
 SG_ FC_Obj9_Img2dBox_RightDown_V : 288|12@0+ (1.0000000000,0.0000000000) [0.0000000000|3000.0000000000] "pix"  FC,ADC
 SG_ FC_Obj9_Img2dBox_LeftTop_V : 284|12@0+ (1.0000000000,0.0000000000) [0.0000000000|3000.0000000000] "pix"  FC,ADC
 SG_ FC_Obj9_Img2dBox_RightDown_U : 264|12@0+ (1.0000000000,0.0000000000) [0.0000000000|4095.0000000000] "pix"  FC,ADC
 SG_ FC_Obj9_Img2dBox_LeftTop_U : 260|12@0+ (1.0000000000,0.0000000000) [0.0000000000|4095.0000000000] "pix"  FC,ADC
 SG_ FC_Obj9_TurnLight : 262|2@0+ (1.0000000000,0.0000000000) [0.0000000000|3.0000000000] ""  FC,ADC
 SG_ FC_Obj9_valid : 263|1@0+ (1.0000000000,0.0000000000) [0.0000000000|1.0000000000] ""  FC,ADC
 SG_ FC_Obj9_Vy_Vnce : 241|10@0+ (0.1250000000,-64.0000000000) [-64.0000000000|63.8750000000] "m/s"  FC,ADC
 SG_ FC_Obj9_Vx_Vnce : 237|12@0+ (0.0625000000,-128.0000000000) [-128.0000000000|127.9375000000] "m/s"  FC,ADC
 SG_ FC_Obj9_CenterAngle : 230|9@0+ (0.0100000000,-1.5700000000) [-1.5700000000|1.5700000000] ""  FC,ADC
 SG_ FC_Obj9_DistInLane : 209|11@0+ (0.0100000000,-10.0000000000) [-10.0000000000|10.0000000000] ""  FC,ADC
 SG_ FC_Obj9_objCutInLane : 211|2@0+ (1.0000000000,0.0000000000) [0.0000000000|2.0000000000] ""  FC,ADC
 SG_ FC_Obj9_objCutInFlag : 201|2@0+ (1.0000000000,0.0000000000) [0.0000000000|2.0000000000] ""  FC,ADC
 SG_ FC_Obj9_CornerPoint_y : 199|14@0+ (0.0100000000,-80.0000000000) [-80.0000000000|80.0000000000] ""  FC,ADC
 SG_ FC_Obj9_CornerPoint_x : 182|15@0+ (0.0100000000,0.0000000000) [0.0000000000|200.0000000000] ""  FC,ADC
 SG_ FC_Obj9_LaneAssignment : 169|3@0+ (1.0000000000,0.0000000000) [0.0000000000|7.0000000000] ""  FC,ADC
 SG_ FC_Obj9_MotionType : 172|3@0+ (1.0000000000,0.0000000000) [0.0000000000|4.0000000000] ""  FC,ADC
 SG_ FC_obj9_Brakelight_Info : 173|1@0+ (1.0000000000,0.0000000000) [0.0000000000|1.0000000000] ""  FC,ADC
 SG_ FC_Obj9_Width : 155|11@0+ (0.0100000000,0.0000000000) [0.0000000000|12.0000000000] "m"  FC,ADC
 SG_ FC_Obj9_Length : 148|9@0+ (0.0500000000,0.0000000000) [0.0000000000|25.5000000000] "m"  FC,ADC
 SG_ FC_Obj9_Height : 141|9@0+ (0.0100000000,0.0000000000) [0.0000000000|5.1100000000] "m"  FC,ADC
 SG_ FC_Obj9_HeadOrientation : 129|4@0+ (1.0000000000,0.0000000000) [0.0000000000|15.0000000000] ""  FC,ADC
 SG_ FC_Obj9_HeadingAngle : 308|10@0+ (0.0100000000,-3.1400000000) [-3.1400000000|3.1400000000] "rad"  FC,ADC
 SG_ FC_Obj9_ExistProb : 112|6@0+ (2.0000000000,0.0000000000) [0.0000000000|100.0000000000] "%"  FC,ADC
 SG_ FC_Obj9_Dy_Vnce : 106|10@0+ (0.0200000000,0.0000000000) [0.0000000000|20.0000000000] "m2"  FC,ADC
 SG_ FC_Obj9_Dy : 88|14@0+ (0.0100000000,-80.0000000000) [-80.0000000000|80.0000000000] "m"  FC,ADC
 SG_ FC_Obj9_Dx_Vnce : 86|14@0+ (0.0500000000,0.0000000000) [0.0000000000|50.0000000000] "m2"  FC,ADC
 SG_ FC_Obj9_Dx : 66|12@0+ (0.0500000000,0.0000000000) [0.0000000000|204.7000000000] "m"  FC,ADC
 SG_ FC_Obj9_RelVy : 60|10@0+ (0.1000000000,-50.0000000000) [-50.0000000000|50.0000000000] "m/s"  FC,ADC
 SG_ FC_Obj9_RelVx : 40|12@0+ (0.1000000000,-154.0000000000) [-154.0000000000|50.0000000000] "m/s"  FC,ADC
 SG_ FC_Obj9_RelAy : 32|8@0+ (0.1000000000,-12.0000000000) [-12.0000000000|12.0000000000] "m/s2"  FC,ADC
 SG_ FC_Obj9_RelAx : 25|9@0+ (0.1000000000,-16.0000000000) [-16.0000000000|16.0000000000] "m/s2"  FC,ADC
 SG_ FC_Obj9_TypeProb : 31|6@0+ (2.0000000000,0.0000000000) [0.0000000000|100.0000000000] "%"  FC,ADC
 SG_ FC_Obj9_Type : 19|4@0+ (1.0000000000,0.0000000000) [0.0000000000|15.0000000000] ""  FC,ADC
 SG_ FC_Obj9_Track_Age : 314|16@0+ (1.0000000000,0.0000000000) [0.0000000000|65535.0000000000] ""  FC,ADC
 SG_ FC_Obj9_Track_ID : 3|8@0+ (1.0000000000,0.0000000000) [0.0000000000|255.0000000000] ""  FC,ADC

BO_ 361 FC_169: 64 FC
 SG_ FC_Obj10WSInfoPosType : 133|4@0+ (1.0000000000,0.0000000000) [0.0000000000|15.0000000000] ""  FC,ADC
 SG_ FC_CRCCheck_169 : 503|16@0+ (1.0000000000,0.0000000000) [0.0000000000|65535.0000000000] ""  FC,ADC
 SG_ FC_RollingCounter_169 : 491|4@0+ (1.0000000000,0.0000000000) [0.0000000000|15.0000000000] ""  FC,ADC
 SG_ FC_Obj10_Img2dBox_RightDown_V : 288|12@0+ (1.0000000000,0.0000000000) [0.0000000000|3000.0000000000] "pix"  FC,ADC
 SG_ FC_Obj10_Img2dBox_LeftTop_V : 284|12@0+ (1.0000000000,0.0000000000) [0.0000000000|3000.0000000000] "pix"  FC,ADC
 SG_ FC_Obj10_Img2dBox_RightDown_U : 264|12@0+ (1.0000000000,0.0000000000) [0.0000000000|4095.0000000000] "pix"  FC,ADC
 SG_ FC_Obj10_Img2dBox_LeftTop_U : 260|12@0+ (1.0000000000,0.0000000000) [0.0000000000|4095.0000000000] "pix"  FC,ADC
 SG_ FC_Obj10_TurnLight : 262|2@0+ (1.0000000000,0.0000000000) [0.0000000000|3.0000000000] ""  FC,ADC
 SG_ FC_Obj10_valid : 263|1@0+ (1.0000000000,0.0000000000) [0.0000000000|1.0000000000] ""  FC,ADC
 SG_ FC_Obj10_Vy_Vnce : 241|10@0+ (0.1250000000,-64.0000000000) [-64.0000000000|63.8750000000] "m/s"  FC,ADC
 SG_ FC_Obj10_Vx_Vnce : 237|12@0+ (0.0625000000,-128.0000000000) [-128.0000000000|127.9375000000] "m/s"  FC,ADC
 SG_ FC_Obj10_CenterAngle : 230|9@0+ (0.0100000000,-1.5700000000) [-1.5700000000|1.5700000000] ""  FC,ADC
 SG_ FC_Obj10_DistInLane : 209|11@0+ (0.0100000000,-10.0000000000) [-10.0000000000|10.0000000000] ""  FC,ADC
 SG_ FC_Obj10_objCutInLane : 211|2@0+ (1.0000000000,0.0000000000) [0.0000000000|2.0000000000] ""  FC,ADC
 SG_ FC_Obj10_objCutInFlag : 201|2@0+ (1.0000000000,0.0000000000) [0.0000000000|2.0000000000] ""  FC,ADC
 SG_ FC_Obj10_CornerPoint_y : 199|14@0+ (0.0100000000,-80.0000000000) [-80.0000000000|80.0000000000] ""  FC,ADC
 SG_ FC_Obj10_CornerPoint_x : 182|15@0+ (0.0100000000,0.0000000000) [0.0000000000|200.0000000000] ""  FC,ADC
 SG_ FC_Obj10_LaneAssignment : 169|3@0+ (1.0000000000,0.0000000000) [0.0000000000|7.0000000000] ""  FC,ADC
 SG_ FC_Obj10_MotionType : 172|3@0+ (1.0000000000,0.0000000000) [0.0000000000|4.0000000000] ""  FC,ADC
 SG_ FC_obj10_Brakelight_Info : 173|1@0+ (1.0000000000,0.0000000000) [0.0000000000|1.0000000000] ""  FC,ADC
 SG_ FC_Obj10_Width : 155|11@0+ (0.0100000000,0.0000000000) [0.0000000000|12.0000000000] "m"  FC,ADC
 SG_ FC_Obj10_Length : 148|9@0+ (0.0500000000,0.0000000000) [0.0000000000|25.5000000000] "m"  FC,ADC
 SG_ FC_Obj10_Height : 141|9@0+ (0.0100000000,0.0000000000) [0.0000000000|5.1100000000] "m"  FC,ADC
 SG_ FC_Obj10_HeadOrientation : 129|4@0+ (1.0000000000,0.0000000000) [0.0000000000|15.0000000000] ""  FC,ADC
 SG_ FC_Obj10_HeadingAngle : 308|10@0+ (0.0100000000,-3.1400000000) [-3.1400000000|3.1400000000] "rad"  FC,ADC
 SG_ FC_Obj10_ExistProb : 112|6@0+ (2.0000000000,0.0000000000) [0.0000000000|100.0000000000] "%"  FC,ADC
 SG_ FC_Obj10_Dy_Vnce : 106|10@0+ (0.0200000000,0.0000000000) [0.0000000000|20.0000000000] "m2"  FC,ADC
 SG_ FC_Obj10_Dy : 88|14@0+ (0.0100000000,-80.0000000000) [-80.0000000000|80.0000000000] "m"  FC,ADC
 SG_ FC_Obj10_Dx_Vnce : 86|14@0+ (0.0500000000,0.0000000000) [0.0000000000|50.0000000000] "m2"  FC,ADC
 SG_ FC_Obj10_Dx : 66|12@0+ (0.0500000000,0.0000000000) [0.0000000000|204.7000000000] "m"  FC,ADC
 SG_ FC_Obj10_RelVy : 60|10@0+ (0.1000000000,-50.0000000000) [-50.0000000000|50.0000000000] "m/s"  FC,ADC
 SG_ FC_Obj10_RelVx : 40|12@0+ (0.1000000000,-154.0000000000) [-154.0000000000|50.0000000000] "m/s"  FC,ADC
 SG_ FC_Obj10_RelAy : 32|8@0+ (0.1000000000,-12.0000000000) [-12.0000000000|12.0000000000] "m/s2"  FC,ADC
 SG_ FC_Obj10_RelAx : 25|9@0+ (0.1000000000,-16.0000000000) [-16.0000000000|16.0000000000] "m/s2"  FC,ADC
 SG_ FC_Obj10_TypeProb : 31|6@0+ (2.0000000000,0.0000000000) [0.0000000000|100.0000000000] "%"  FC,ADC
 SG_ FC_Obj10_Type : 19|4@0+ (1.0000000000,0.0000000000) [0.0000000000|15.0000000000] ""  FC,ADC
 SG_ FC_Obj10_Track_Age : 314|16@0+ (1.0000000000,0.0000000000) [0.0000000000|65535.0000000000] ""  FC,ADC
 SG_ FC_Obj10_Track_ID : 3|8@0+ (1.0000000000,0.0000000000) [0.0000000000|255.0000000000] ""  FC,ADC

BO_ 368 FC_170: 64 FC
 SG_ FC_Obj11WSInfoPosType : 133|4@0+ (1.0000000000,0.0000000000) [0.0000000000|15.0000000000] ""  FC,ADC
 SG_ FC_CRCCheck_170 : 503|16@0+ (1.0000000000,0.0000000000) [0.0000000000|65535.0000000000] ""  FC,ADC
 SG_ FC_RollingCounter_170 : 491|4@0+ (1.0000000000,0.0000000000) [0.0000000000|15.0000000000] ""  FC,ADC
 SG_ FC_Obj11_Img2dBox_RightDown_V : 288|12@0+ (1.0000000000,0.0000000000) [0.0000000000|3000.0000000000] "pix"  FC,ADC
 SG_ FC_Obj11_Img2dBox_LeftTop_V : 284|12@0+ (1.0000000000,0.0000000000) [0.0000000000|3000.0000000000] "pix"  FC,ADC
 SG_ FC_Obj11_Img2dBox_RightDown_U : 264|12@0+ (1.0000000000,0.0000000000) [0.0000000000|4095.0000000000] "pix"  FC,ADC
 SG_ FC_Obj11_Img2dBox_LeftTop_U : 260|12@0+ (1.0000000000,0.0000000000) [0.0000000000|4095.0000000000] "pix"  FC,ADC
 SG_ FC_Obj11_TurnLight : 262|2@0+ (1.0000000000,0.0000000000) [0.0000000000|3.0000000000] ""  FC,ADC
 SG_ FC_Obj11_valid : 263|1@0+ (1.0000000000,0.0000000000) [0.0000000000|1.0000000000] ""  FC,ADC
 SG_ FC_Obj11_Vy_Vnce : 241|10@0+ (0.1250000000,-64.0000000000) [-64.0000000000|63.8750000000] "m/s"  FC,ADC
 SG_ FC_Obj11_Vx_Vnce : 237|12@0+ (0.0625000000,-128.0000000000) [-128.0000000000|127.9375000000] "m/s"  FC,ADC
 SG_ FC_Obj11_CenterAngle : 230|9@0+ (0.0100000000,-1.5700000000) [-1.5700000000|1.5700000000] ""  FC,ADC
 SG_ FC_Obj11_DistInLane : 209|11@0+ (0.0100000000,-10.0000000000) [-10.0000000000|10.0000000000] ""  FC,ADC
 SG_ FC_Obj11_objCutInLane : 211|2@0+ (1.0000000000,0.0000000000) [0.0000000000|2.0000000000] ""  FC,ADC
 SG_ FC_Obj11_objCutInFlag : 201|2@0+ (1.0000000000,0.0000000000) [0.0000000000|2.0000000000] ""  FC,ADC
 SG_ FC_Obj11_CornerPoint_y : 199|14@0+ (0.0100000000,-80.0000000000) [-80.0000000000|80.0000000000] ""  FC,ADC
 SG_ FC_Obj11_CornerPoint_x : 182|15@0+ (0.0100000000,0.0000000000) [0.0000000000|200.0000000000] ""  FC,ADC
 SG_ FC_Obj11_LaneAssignment : 169|3@0+ (1.0000000000,0.0000000000) [0.0000000000|7.0000000000] ""  FC,ADC
 SG_ FC_Obj11_MotionType : 172|3@0+ (1.0000000000,0.0000000000) [0.0000000000|4.0000000000] ""  FC,ADC
 SG_ FC_obj11_Brakelight_Info : 173|1@0+ (1.0000000000,0.0000000000) [0.0000000000|1.0000000000] ""  FC,ADC
 SG_ FC_Obj11_Width : 155|11@0+ (0.0100000000,0.0000000000) [0.0000000000|12.0000000000] "m"  FC,ADC
 SG_ FC_Obj11_Length : 148|9@0+ (0.0500000000,0.0000000000) [0.0000000000|25.5000000000] "m"  FC,ADC
 SG_ FC_Obj11_Height : 141|9@0+ (0.0100000000,0.0000000000) [0.0000000000|5.1100000000] "m"  FC,ADC
 SG_ FC_Obj11_HeadOrientation : 129|4@0+ (1.0000000000,0.0000000000) [0.0000000000|15.0000000000] ""  FC,ADC
 SG_ FC_Obj11_HeadingAngle : 308|10@0+ (0.0100000000,-3.1400000000) [-3.1400000000|3.1400000000] "rad"  FC,ADC
 SG_ FC_Obj11_ExistProb : 112|6@0+ (2.0000000000,0.0000000000) [0.0000000000|100.0000000000] "%"  FC,ADC
 SG_ FC_Obj11_Dy_Vnce : 106|10@0+ (0.0200000000,0.0000000000) [0.0000000000|20.0000000000] "m2"  FC,ADC
 SG_ FC_Obj11_Dy : 88|14@0+ (0.0100000000,-80.0000000000) [-80.0000000000|80.0000000000] "m"  FC,ADC
 SG_ FC_Obj11_Dx_Vnce : 86|14@0+ (0.0500000000,0.0000000000) [0.0000000000|50.0000000000] "m2"  FC,ADC
 SG_ FC_Obj11_Dx : 66|12@0+ (0.0500000000,0.0000000000) [0.0000000000|204.7000000000] "m"  FC,ADC
 SG_ FC_Obj11_RelVy : 60|10@0+ (0.1000000000,-50.0000000000) [-50.0000000000|50.0000000000] "m/s"  FC,ADC
 SG_ FC_Obj11_RelVx : 40|12@0+ (0.1000000000,-154.0000000000) [-154.0000000000|50.0000000000] "m/s"  FC,ADC
 SG_ FC_Obj11_RelAy : 32|8@0+ (0.1000000000,-12.0000000000) [-12.0000000000|12.0000000000] "m/s2"  FC,ADC
 SG_ FC_Obj11_RelAx : 25|9@0+ (0.1000000000,-16.0000000000) [-16.0000000000|16.0000000000] "m/s2"  FC,ADC
 SG_ FC_Obj11_TypeProb : 31|6@0+ (2.0000000000,0.0000000000) [0.0000000000|100.0000000000] "%"  FC,ADC
 SG_ FC_Obj11_Type : 19|4@0+ (1.0000000000,0.0000000000) [0.0000000000|15.0000000000] ""  FC,ADC
 SG_ FC_Obj11_Track_Age : 314|16@0+ (1.0000000000,0.0000000000) [0.0000000000|65535.0000000000] ""  FC,ADC
 SG_ FC_Obj11_Track_ID : 3|8@0+ (1.0000000000,0.0000000000) [0.0000000000|255.0000000000] ""  FC,ADC

BO_ 369 FC_171: 64 FC
 SG_ FC_Obj12WSInfoPosType : 133|4@0+ (1.0000000000,0.0000000000) [0.0000000000|15.0000000000] ""  FC,ADC
 SG_ FC_CRCCheck_171 : 503|16@0+ (1.0000000000,0.0000000000) [0.0000000000|65535.0000000000] ""  FC,ADC
 SG_ FC_RollingCounter_171 : 491|4@0+ (1.0000000000,0.0000000000) [0.0000000000|15.0000000000] ""  FC,ADC
 SG_ FC_Obj12_Img2dBox_RightDown_V : 288|12@0+ (1.0000000000,0.0000000000) [0.0000000000|3000.0000000000] "pix"  FC,ADC
 SG_ FC_Obj12_Img2dBox_LeftTop_V : 284|12@0+ (1.0000000000,0.0000000000) [0.0000000000|3000.0000000000] "pix"  FC,ADC
 SG_ FC_Obj12_Img2dBox_RightDown_U : 264|12@0+ (1.0000000000,0.0000000000) [0.0000000000|4095.0000000000] "pix"  FC,ADC
 SG_ FC_Obj12_Img2dBox_LeftTop_U : 260|12@0+ (1.0000000000,0.0000000000) [0.0000000000|4095.0000000000] "pix"  FC,ADC
 SG_ FC_Obj12_TurnLight : 262|2@0+ (1.0000000000,0.0000000000) [0.0000000000|3.0000000000] ""  FC,ADC
 SG_ FC_Obj12_valid : 263|1@0+ (1.0000000000,0.0000000000) [0.0000000000|1.0000000000] ""  FC,ADC
 SG_ FC_Obj12_Vy_Vnce : 241|10@0+ (0.1250000000,-64.0000000000) [-64.0000000000|63.8750000000] "m/s"  FC,ADC
 SG_ FC_Obj12_Vx_Vnce : 237|12@0+ (0.0625000000,-128.0000000000) [-128.0000000000|127.9375000000] "m/s"  FC,ADC
 SG_ FC_Obj12_CenterAngle : 230|9@0+ (0.0100000000,-1.5700000000) [-1.5700000000|1.5700000000] ""  FC,ADC
 SG_ FC_Obj12_DistInLane : 209|11@0+ (0.0100000000,-10.0000000000) [-10.0000000000|10.0000000000] ""  FC,ADC
 SG_ FC_Obj12_objCutInLane : 211|2@0+ (1.0000000000,0.0000000000) [0.0000000000|2.0000000000] ""  FC,ADC
 SG_ FC_Obj12_objCutInFlag : 201|2@0+ (1.0000000000,0.0000000000) [0.0000000000|2.0000000000] ""  FC,ADC
 SG_ FC_Obj12_CornerPoint_y : 199|14@0+ (0.0100000000,-80.0000000000) [-80.0000000000|80.0000000000] ""  FC,ADC
 SG_ FC_Obj12_CornerPoint_x : 182|15@0+ (0.0100000000,0.0000000000) [0.0000000000|200.0000000000] ""  FC,ADC
 SG_ FC_Obj12_LaneAssignment : 169|3@0+ (1.0000000000,0.0000000000) [0.0000000000|7.0000000000] ""  FC,ADC
 SG_ FC_Obj12_MotionType : 172|3@0+ (1.0000000000,0.0000000000) [0.0000000000|4.0000000000] ""  FC,ADC
 SG_ FC_obj12_Brakelight_Info : 173|1@0+ (1.0000000000,0.0000000000) [0.0000000000|1.0000000000] ""  FC,ADC
 SG_ FC_Obj12_Width : 155|11@0+ (0.0100000000,0.0000000000) [0.0000000000|12.0000000000] "m"  FC,ADC
 SG_ FC_Obj12_Length : 148|9@0+ (0.0500000000,0.0000000000) [0.0000000000|25.5000000000] "m"  FC,ADC
 SG_ FC_Obj12_Height : 141|9@0+ (0.0100000000,0.0000000000) [0.0000000000|5.1100000000] "m"  FC,ADC
 SG_ FC_Obj12_HeadOrientation : 129|4@0+ (1.0000000000,0.0000000000) [0.0000000000|15.0000000000] ""  FC,ADC
 SG_ FC_Obj12_HeadingAngle : 308|10@0+ (0.0100000000,-3.1400000000) [-3.1400000000|3.1400000000] "rad"  FC,ADC
 SG_ FC_Obj12_ExistProb : 112|6@0+ (2.0000000000,0.0000000000) [0.0000000000|100.0000000000] "%"  FC,ADC
 SG_ FC_Obj12_Dy_Vnce : 106|10@0+ (0.0200000000,0.0000000000) [0.0000000000|20.0000000000] "m2"  FC,ADC
 SG_ FC_Obj12_Dy : 88|14@0+ (0.0100000000,-80.0000000000) [-80.0000000000|80.0000000000] "m"  FC,ADC
 SG_ FC_Obj12_Dx_Vnce : 86|14@0+ (0.0500000000,0.0000000000) [0.0000000000|50.0000000000] "m2"  FC,ADC
 SG_ FC_Obj12_Dx : 66|12@0+ (0.0500000000,0.0000000000) [0.0000000000|204.7000000000] "m"  FC,ADC
 SG_ FC_Obj12_RelVy : 60|10@0+ (0.1000000000,-50.0000000000) [-50.0000000000|50.0000000000] "m/s"  FC,ADC
 SG_ FC_Obj12_RelVx : 40|12@0+ (0.1000000000,-154.0000000000) [-154.0000000000|50.0000000000] "m/s"  FC,ADC
 SG_ FC_Obj12_RelAy : 32|8@0+ (0.1000000000,-12.0000000000) [-12.0000000000|12.0000000000] "m/s2"  FC,ADC
 SG_ FC_Obj12_RelAx : 25|9@0+ (0.1000000000,-16.0000000000) [-16.0000000000|16.0000000000] "m/s2"  FC,ADC
 SG_ FC_Obj12_TypeProb : 31|6@0+ (2.0000000000,0.0000000000) [0.0000000000|100.0000000000] "%"  FC,ADC
 SG_ FC_Obj12_Type : 19|4@0+ (1.0000000000,0.0000000000) [0.0000000000|15.0000000000] ""  FC,ADC
 SG_ FC_Obj12_Track_Age : 314|16@0+ (1.0000000000,0.0000000000) [0.0000000000|65535.0000000000] ""  FC,ADC
 SG_ FC_Obj12_Track_ID : 3|8@0+ (1.0000000000,0.0000000000) [0.0000000000|255.0000000000] ""  FC,ADC

BO_ 370 FC_172: 64 FC
 SG_ FC_Obj13WSInfoPosType : 133|4@0+ (1.0000000000,0.0000000000) [0.0000000000|15.0000000000] ""  FC,ADC
 SG_ FC_CRCCheck_172 : 503|16@0+ (1.0000000000,0.0000000000) [0.0000000000|65535.0000000000] ""  FC,ADC
 SG_ FC_RollingCounter_172 : 491|4@0+ (1.0000000000,0.0000000000) [0.0000000000|15.0000000000] ""  FC,ADC
 SG_ FC_Obj13_Img2dBox_RightDown_V : 288|12@0+ (1.0000000000,0.0000000000) [0.0000000000|3000.0000000000] "pix"  FC,ADC
 SG_ FC_Obj13_Img2dBox_LeftTop_V : 284|12@0+ (1.0000000000,0.0000000000) [0.0000000000|3000.0000000000] "pix"  FC,ADC
 SG_ FC_Obj13_Img2dBox_RightDown_U : 264|12@0+ (1.0000000000,0.0000000000) [0.0000000000|4095.0000000000] "pix"  FC,ADC
 SG_ FC_Obj13_Img2dBox_LeftTop_U : 260|12@0+ (1.0000000000,0.0000000000) [0.0000000000|4095.0000000000] "pix"  FC,ADC
 SG_ FC_Obj13_TurnLight : 262|2@0+ (1.0000000000,0.0000000000) [0.0000000000|3.0000000000] ""  FC,ADC
 SG_ FC_Obj13_valid : 263|1@0+ (1.0000000000,0.0000000000) [0.0000000000|1.0000000000] ""  FC,ADC
 SG_ FC_Obj13_Vy_Vnce : 241|10@0+ (0.1250000000,-64.0000000000) [-64.0000000000|63.8750000000] "m/s"  FC,ADC
 SG_ FC_Obj13_Vx_Vnce : 237|12@0+ (0.0625000000,-128.0000000000) [-128.0000000000|127.9375000000] "m/s"  FC,ADC
 SG_ FC_Obj13_CenterAngle : 230|9@0+ (0.0100000000,-1.5700000000) [-1.5700000000|1.5700000000] ""  FC,ADC
 SG_ FC_Obj13_DistInLane : 209|11@0+ (0.0100000000,-10.0000000000) [-10.0000000000|10.0000000000] ""  FC,ADC
 SG_ FC_Obj13_objCutInLane : 211|2@0+ (1.0000000000,0.0000000000) [0.0000000000|2.0000000000] ""  FC,ADC
 SG_ FC_Obj13_objCutInFlag : 201|2@0+ (1.0000000000,0.0000000000) [0.0000000000|2.0000000000] ""  FC,ADC
 SG_ FC_Obj13_CornerPoint_y : 199|14@0+ (0.0100000000,-80.0000000000) [-80.0000000000|80.0000000000] ""  FC,ADC
 SG_ FC_Obj13_CornerPoint_x : 182|15@0+ (0.0100000000,0.0000000000) [0.0000000000|200.0000000000] ""  FC,ADC
 SG_ FC_Obj13_LaneAssignment : 169|3@0+ (1.0000000000,0.0000000000) [0.0000000000|7.0000000000] ""  FC,ADC
 SG_ FC_Obj13_MotionType : 172|3@0+ (1.0000000000,0.0000000000) [0.0000000000|4.0000000000] ""  FC,ADC
 SG_ FC_obj13_Brakelight_Info : 173|1@0+ (1.0000000000,0.0000000000) [0.0000000000|1.0000000000] ""  FC,ADC
 SG_ FC_Obj13_Width : 155|11@0+ (0.0100000000,0.0000000000) [0.0000000000|12.0000000000] "m"  FC,ADC
 SG_ FC_Obj13_Length : 148|9@0+ (0.0500000000,0.0000000000) [0.0000000000|25.5000000000] "m"  FC,ADC
 SG_ FC_Obj13_Height : 141|9@0+ (0.0100000000,0.0000000000) [0.0000000000|5.1100000000] "m"  FC,ADC
 SG_ FC_Obj13_HeadOrientation : 129|4@0+ (1.0000000000,0.0000000000) [0.0000000000|15.0000000000] ""  FC,ADC
 SG_ FC_Obj13_HeadingAngle : 308|10@0+ (0.0100000000,-3.1400000000) [-3.1400000000|3.1400000000] "rad"  FC,ADC
 SG_ FC_Obj13_ExistProb : 112|6@0+ (2.0000000000,0.0000000000) [0.0000000000|100.0000000000] "%"  FC,ADC
 SG_ FC_Obj13_Dy_Vnce : 106|10@0+ (0.0200000000,0.0000000000) [0.0000000000|20.0000000000] "m2"  FC,ADC
 SG_ FC_Obj13_Dy : 88|14@0+ (0.0100000000,-80.0000000000) [-80.0000000000|80.0000000000] "m"  FC,ADC
 SG_ FC_Obj13_Dx_Vnce : 86|14@0+ (0.0500000000,0.0000000000) [0.0000000000|50.0000000000] "m2"  FC,ADC
 SG_ FC_Obj13_Dx : 66|12@0+ (0.0500000000,0.0000000000) [0.0000000000|204.7000000000] "m"  FC,ADC
 SG_ FC_Obj13_RelVy : 60|10@0+ (0.1000000000,-50.0000000000) [-50.0000000000|50.0000000000] "m/s"  FC,ADC
 SG_ FC_Obj13_RelVx : 40|12@0+ (0.1000000000,-154.0000000000) [-154.0000000000|50.0000000000] "m/s"  FC,ADC
 SG_ FC_Obj13_RelAy : 32|8@0+ (0.1000000000,-12.0000000000) [-12.0000000000|12.0000000000] "m/s2"  FC,ADC
 SG_ FC_Obj13_RelAx : 25|9@0+ (0.1000000000,-16.0000000000) [-16.0000000000|16.0000000000] "m/s2"  FC,ADC
 SG_ FC_Obj13_TypeProb : 31|6@0+ (2.0000000000,0.0000000000) [0.0000000000|100.0000000000] "%"  FC,ADC
 SG_ FC_Obj13_Type : 19|4@0+ (1.0000000000,0.0000000000) [0.0000000000|15.0000000000] ""  FC,ADC
 SG_ FC_Obj13_Track_Age : 314|16@0+ (1.0000000000,0.0000000000) [0.0000000000|65535.0000000000] ""  FC,ADC
 SG_ FC_Obj13_Track_ID : 3|8@0+ (1.0000000000,0.0000000000) [0.0000000000|255.0000000000] ""  FC,ADC

BO_ 371 FC_173: 64 FC
 SG_ FC_Obj14WSInfoPosType : 133|4@0+ (1.0000000000,0.0000000000) [0.0000000000|15.0000000000] ""  FC,ADC
 SG_ FC_CRCCheck_173 : 503|16@0+ (1.0000000000,0.0000000000) [0.0000000000|65535.0000000000] ""  FC,ADC
 SG_ FC_RollingCounter_173 : 491|4@0+ (1.0000000000,0.0000000000) [0.0000000000|15.0000000000] ""  FC,ADC
 SG_ FC_Obj14_Img2dBox_RightDown_V : 288|12@0+ (1.0000000000,0.0000000000) [0.0000000000|3000.0000000000] "pix"  FC,ADC
 SG_ FC_Obj14_Img2dBox_LeftTop_V : 284|12@0+ (1.0000000000,0.0000000000) [0.0000000000|3000.0000000000] "pix"  FC,ADC
 SG_ FC_Obj14_Img2dBox_RightDown_U : 264|12@0+ (1.0000000000,0.0000000000) [0.0000000000|4095.0000000000] "pix"  FC,ADC
 SG_ FC_Obj14_Img2dBox_LeftTop_U : 260|12@0+ (1.0000000000,0.0000000000) [0.0000000000|4095.0000000000] "pix"  FC,ADC
 SG_ FC_Obj14_TurnLight : 262|2@0+ (1.0000000000,0.0000000000) [0.0000000000|3.0000000000] ""  FC,ADC
 SG_ FC_Obj14_valid : 263|1@0+ (1.0000000000,0.0000000000) [0.0000000000|1.0000000000] ""  FC,ADC
 SG_ FC_Obj14_Vy_Vnce : 241|10@0+ (0.1250000000,-64.0000000000) [-64.0000000000|63.8750000000] "m/s"  FC,ADC
 SG_ FC_Obj14_Vx_Vnce : 237|12@0+ (0.0625000000,-128.0000000000) [-128.0000000000|127.9375000000] "m/s"  FC,ADC
 SG_ FC_Obj14_CenterAngle : 230|9@0+ (0.0100000000,-1.5700000000) [-1.5700000000|1.5700000000] ""  FC,ADC
 SG_ FC_Obj14_DistInLane : 209|11@0+ (0.0100000000,-10.0000000000) [-10.0000000000|10.0000000000] ""  FC,ADC
 SG_ FC_Obj14_objCutInLane : 211|2@0+ (1.0000000000,0.0000000000) [0.0000000000|2.0000000000] ""  FC,ADC
 SG_ FC_Obj14_objCutInFlag : 201|2@0+ (1.0000000000,0.0000000000) [0.0000000000|2.0000000000] ""  FC,ADC
 SG_ FC_Obj14_CornerPoint_y : 199|14@0+ (0.0100000000,-80.0000000000) [-80.0000000000|80.0000000000] ""  FC,ADC
 SG_ FC_Obj14_CornerPoint_x : 182|15@0+ (0.0100000000,0.0000000000) [0.0000000000|200.0000000000] ""  FC,ADC
 SG_ FC_Obj14_LaneAssignment : 169|3@0+ (1.0000000000,0.0000000000) [0.0000000000|7.0000000000] ""  FC,ADC
 SG_ FC_Obj14_MotionType : 172|3@0+ (1.0000000000,0.0000000000) [0.0000000000|4.0000000000] ""  FC,ADC
 SG_ FC_obj14_Brakelight_Info : 173|1@0+ (1.0000000000,0.0000000000) [0.0000000000|1.0000000000] ""  FC,ADC
 SG_ FC_Obj14_Width : 155|11@0+ (0.0100000000,0.0000000000) [0.0000000000|12.0000000000] "m"  FC,ADC
 SG_ FC_Obj14_Length : 148|9@0+ (0.0500000000,0.0000000000) [0.0000000000|25.5000000000] "m"  FC,ADC
 SG_ FC_Obj14_Height : 141|9@0+ (0.0100000000,0.0000000000) [0.0000000000|5.1100000000] "m"  FC,ADC
 SG_ FC_Obj14_HeadOrientation : 129|4@0+ (1.0000000000,0.0000000000) [0.0000000000|15.0000000000] ""  FC,ADC
 SG_ FC_Obj14_HeadingAngle : 308|10@0+ (0.0100000000,-3.1400000000) [-3.1400000000|3.1400000000] "rad"  FC,ADC
 SG_ FC_Obj14_ExistProb : 112|6@0+ (2.0000000000,0.0000000000) [0.0000000000|100.0000000000] "%"  FC,ADC
 SG_ FC_Obj14_Dy_Vnce : 106|10@0+ (0.0200000000,0.0000000000) [0.0000000000|20.0000000000] "m2"  FC,ADC
 SG_ FC_Obj14_Dy : 88|14@0+ (0.0100000000,-80.0000000000) [-80.0000000000|80.0000000000] "m"  FC,ADC
 SG_ FC_Obj14_Dx_Vnce : 86|14@0+ (0.0500000000,0.0000000000) [0.0000000000|50.0000000000] "m2"  FC,ADC
 SG_ FC_Obj14_Dx : 66|12@0+ (0.0500000000,0.0000000000) [0.0000000000|204.7000000000] "m"  FC,ADC
 SG_ FC_Obj14_RelVy : 60|10@0+ (0.1000000000,-50.0000000000) [-50.0000000000|50.0000000000] "m/s"  FC,ADC
 SG_ FC_Obj14_RelVx : 40|12@0+ (0.1000000000,-154.0000000000) [-154.0000000000|50.0000000000] "m/s"  FC,ADC
 SG_ FC_Obj14_RelAy : 32|8@0+ (0.1000000000,-12.0000000000) [-12.0000000000|12.0000000000] "m/s2"  FC,ADC
 SG_ FC_Obj14_RelAx : 25|9@0+ (0.1000000000,-16.0000000000) [-16.0000000000|16.0000000000] "m/s2"  FC,ADC
 SG_ FC_Obj14_TypeProb : 31|6@0+ (2.0000000000,0.0000000000) [0.0000000000|100.0000000000] "%"  FC,ADC
 SG_ FC_Obj14_Type : 19|4@0+ (1.0000000000,0.0000000000) [0.0000000000|15.0000000000] ""  FC,ADC
 SG_ FC_Obj14_Track_Age : 314|16@0+ (1.0000000000,0.0000000000) [0.0000000000|65535.0000000000] ""  FC,ADC
 SG_ FC_Obj14_Track_ID : 3|8@0+ (1.0000000000,0.0000000000) [0.0000000000|255.0000000000] ""  FC,ADC

BO_ 372 FC_174: 64 FC
 SG_ FC_Obj15WSInfoPosType : 133|4@0+ (1.0000000000,0.0000000000) [0.0000000000|15.0000000000] ""  FC,ADC
 SG_ FC_CRCCheck_174 : 503|16@0+ (1.0000000000,0.0000000000) [0.0000000000|65535.0000000000] ""  FC,ADC
 SG_ FC_RollingCounter_174 : 491|4@0+ (1.0000000000,0.0000000000) [0.0000000000|15.0000000000] ""  FC,ADC
 SG_ FC_Obj15_Img2dBox_RightDown_V : 288|12@0+ (1.0000000000,0.0000000000) [0.0000000000|3000.0000000000] "pix"  FC,ADC
 SG_ FC_Obj15_Img2dBox_LeftTop_V : 284|12@0+ (1.0000000000,0.0000000000) [0.0000000000|3000.0000000000] "pix"  FC,ADC
 SG_ FC_Obj15_Img2dBox_RightDown_U : 264|12@0+ (1.0000000000,0.0000000000) [0.0000000000|4095.0000000000] "pix"  FC,ADC
 SG_ FC_Obj15_Img2dBox_LeftTop_U : 260|12@0+ (1.0000000000,0.0000000000) [0.0000000000|4095.0000000000] "pix"  FC,ADC
 SG_ FC_Obj15_TurnLight : 262|2@0+ (1.0000000000,0.0000000000) [0.0000000000|3.0000000000] ""  FC,ADC
 SG_ FC_Obj15_valid : 263|1@0+ (1.0000000000,0.0000000000) [0.0000000000|1.0000000000] ""  FC,ADC
 SG_ FC_Obj15_Vy_Vnce : 241|10@0+ (0.1250000000,-64.0000000000) [-64.0000000000|63.8750000000] "m/s"  FC,ADC
 SG_ FC_Obj15_Vx_Vnce : 237|12@0+ (0.0625000000,-128.0000000000) [-128.0000000000|127.9375000000] "m/s"  FC,ADC
 SG_ FC_Obj15_CenterAngle : 230|9@0+ (0.0100000000,-1.5700000000) [-1.5700000000|1.5700000000] ""  FC,ADC
 SG_ FC_Obj15_DistInLane : 209|11@0+ (0.0100000000,-10.0000000000) [-10.0000000000|10.0000000000] ""  FC,ADC
 SG_ FC_Obj15_objCutInLane : 211|2@0+ (1.0000000000,0.0000000000) [0.0000000000|2.0000000000] ""  FC,ADC
 SG_ FC_Obj15_objCutInFlag : 201|2@0+ (1.0000000000,0.0000000000) [0.0000000000|2.0000000000] ""  FC,ADC
 SG_ FC_Obj15_CornerPoint_y : 199|14@0+ (0.0100000000,-80.0000000000) [-80.0000000000|80.0000000000] ""  FC,ADC
 SG_ FC_Obj15_CornerPoint_x : 182|15@0+ (0.0100000000,0.0000000000) [0.0000000000|200.0000000000] ""  FC,ADC
 SG_ FC_Obj15_LaneAssignment : 169|3@0+ (1.0000000000,0.0000000000) [0.0000000000|7.0000000000] ""  FC,ADC
 SG_ FC_Obj15_MotionType : 172|3@0+ (1.0000000000,0.0000000000) [0.0000000000|4.0000000000] ""  FC,ADC
 SG_ FC_obj15_Brakelight_Info : 173|1@0+ (1.0000000000,0.0000000000) [0.0000000000|1.0000000000] ""  FC,ADC
 SG_ FC_Obj15_Width : 155|11@0+ (0.0100000000,0.0000000000) [0.0000000000|12.0000000000] "m"  FC,ADC
 SG_ FC_Obj15_Length : 148|9@0+ (0.0500000000,0.0000000000) [0.0000000000|25.5000000000] "m"  FC,ADC
 SG_ FC_Obj15_Height : 141|9@0+ (0.0100000000,0.0000000000) [0.0000000000|5.1100000000] "m"  FC,ADC
 SG_ FC_Obj15_HeadOrientation : 129|4@0+ (1.0000000000,0.0000000000) [0.0000000000|15.0000000000] ""  FC,ADC
 SG_ FC_Obj15_HeadingAngle : 308|10@0+ (0.0100000000,-3.1400000000) [-3.1400000000|3.1400000000] "rad"  FC,ADC
 SG_ FC_Obj15_ExistProb : 112|6@0+ (2.0000000000,0.0000000000) [0.0000000000|100.0000000000] "%"  FC,ADC
 SG_ FC_Obj15_Dy_Vnce : 106|10@0+ (0.0200000000,0.0000000000) [0.0000000000|20.0000000000] "m2"  FC,ADC
 SG_ FC_Obj15_Dy : 88|14@0+ (0.0100000000,-80.0000000000) [-80.0000000000|80.0000000000] "m"  FC,ADC
 SG_ FC_Obj15_Dx_Vnce : 86|14@0+ (0.0500000000,0.0000000000) [0.0000000000|50.0000000000] "m2"  FC,ADC
 SG_ FC_Obj15_Dx : 66|12@0+ (0.0500000000,0.0000000000) [0.0000000000|204.7000000000] "m"  FC,ADC
 SG_ FC_Obj15_RelVy : 60|10@0+ (0.1000000000,-50.0000000000) [-50.0000000000|50.0000000000] "m/s"  FC,ADC
 SG_ FC_Obj15_RelVx : 40|12@0+ (0.1000000000,-154.0000000000) [-154.0000000000|50.0000000000] "m/s"  FC,ADC
 SG_ FC_Obj15_RelAy : 32|8@0+ (0.1000000000,-12.0000000000) [-12.0000000000|12.0000000000] "m/s2"  FC,ADC
 SG_ FC_Obj15_RelAx : 25|9@0+ (0.1000000000,-16.0000000000) [-16.0000000000|16.0000000000] "m/s2"  FC,ADC
 SG_ FC_Obj15_TypeProb : 31|6@0+ (2.0000000000,0.0000000000) [0.0000000000|100.0000000000] "%"  FC,ADC
 SG_ FC_Obj15_Type : 19|4@0+ (1.0000000000,0.0000000000) [0.0000000000|15.0000000000] ""  FC,ADC
 SG_ FC_Obj15_Track_Age : 314|16@0+ (1.0000000000,0.0000000000) [0.0000000000|65535.0000000000] ""  FC,ADC
 SG_ FC_Obj15_Track_ID : 3|8@0+ (1.0000000000,0.0000000000) [0.0000000000|255.0000000000] ""  FC,ADC

CM_ BO_ 288  " ";
CM_ SG_ 288 FR_CRCCheck_120  " ";
CM_ SG_ 288 FR_RollingCounter_120  " ";
CM_ SG_ 288 FR_OBJ32_HeightGround  "反射点最强点距离地面的高度 ";
CM_ SG_ 288 FR_OBJ32_MotionStatusConf  " ";
CM_ SG_ 288 FR_OBJ32_ClassConf  " ";
CM_ SG_ 288 FR_OBJ32_MotionStatus  " ";
CM_ SG_ 288 FR_OBJ32_Location  " ";
CM_ SG_ 288 FR_OBJ32_Measured  " ";
CM_ SG_ 288 FR_OBJ32_valid  " ";
CM_ SG_ 288 FR_OBJ32_Track_Age  " ";
CM_ SG_ 288 FR_OBJ32_Track_ID  " ";
CM_ SG_ 288 FR_OBJ32_ObstacleProb  " ";
CM_ SG_ 288 FR_OBJ32_ExistProb  " ";
CM_ SG_ 288 FR_OBJ32_RelAx  " ";
CM_ SG_ 288 FR_OBJ32_RelAy  " ";
CM_ SG_ 288 FR_OBJ32_RelVx_std  " ";
CM_ SG_ 288 FR_OBJ32_RelVx  " ";
CM_ SG_ 288 FR_OBJ32_RelVy_std  " ";
CM_ SG_ 288 FR_OBJ32_RelVy  " ";
CM_ SG_ 288 FR_OBJ32_Dx_Vnce  " ";
CM_ SG_ 288 FR_OBJ32_Dx  " ";
CM_ SG_ 288 FR_OBJ32_Dy_Vnce  " ";
CM_ SG_ 288 FR_OBJ32_Dy  " ";
CM_ SG_ 288 FR_OBJ32_HeadingAngle  " ";
CM_ SG_ 288 FR_OBJ32_Length  " ";
CM_ SG_ 288 FR_OBJ32_Height  " ";
CM_ SG_ 288 FR_OBJ32_Width  " ";
CM_ SG_ 288 FR_OBJ32_Class  " ";
CM_ SG_ 288 FR_OBJ31_HeightGround  "反射点最强点距离地面的高度 ";
CM_ SG_ 288 FR_OBJ31_MotionStatusConf  " ";
CM_ SG_ 288 FR_OBJ31_ClassConf  " ";
CM_ SG_ 288 FR_OBJ31_MotionStatus  " ";
CM_ SG_ 288 FR_OBJ31_Location  " ";
CM_ SG_ 288 FR_OBJ31_Measured  " ";
CM_ SG_ 288 FR_Obj31_valid  " ";
CM_ SG_ 288 FR_OBJ31_Track_Age  " ";
CM_ SG_ 288 FR_OBJ31_Track_ID  " ";
CM_ SG_ 288 FR_OBJ31_ObstacleProb  " ";
CM_ SG_ 288 FR_OBJ31_ExistProb  " ";
CM_ SG_ 288 FR_OBJ31_RelAx  " ";
CM_ SG_ 288 FR_OBJ31_RelAy  " ";
CM_ SG_ 288 FR_OBJ31_RelVx_std  " ";
CM_ SG_ 288 FR_OBJ31_RelVx  " ";
CM_ SG_ 288 FR_OBJ31_RelVy_std  " ";
CM_ SG_ 288 FR_OBJ31_RelVy  " ";
CM_ SG_ 288 FR_OBJ31_Dx_Vnce  " ";
CM_ SG_ 288 FR_OBJ31_Dx  " ";
CM_ SG_ 288 FR_OBJ31_Dy_Vnce  " ";
CM_ SG_ 288 FR_OBJ31_Dy  " ";
CM_ SG_ 288 FR_OBJ31_HeadingAngle  " ";
CM_ SG_ 288 FR_OBJ31_Length  " ";
CM_ SG_ 288 FR_OBJ31_Height  " ";
CM_ SG_ 288 FR_OBJ31_Width  " ";
CM_ SG_ 288 FR_OBJ31_Class  " ";

CM_ BO_ 310  " ";
CM_ SG_ 310 FR_CRCCheck_136  " ";
CM_ SG_ 310 FR_RollingCounter_136  " ";
CM_ SG_ 310 FR_FrameCount  " ";
CM_ SG_ 310 FR_MisAlignment  " ";
CM_ SG_ 310 FR_WorkMode  " ";
CM_ SG_ 310 FR_RadarFailureStatus  " ";
CM_ SG_ 310 FR_FRadarCalibrationStatus  " ";
CM_ SG_ 310 FR_Frametime  " ";
CM_ SG_ 310 FR_ObjCount  " ";

CM_ BO_ 312  " ";
CM_ SG_ 312 DiffTime_Time_uS  " ";
CM_ SG_ 312 FR_TiOut  " ";
CM_ SG_ 312 FR_TiLeap  " ";
CM_ SG_ 312 FR_TiBas  " ";
CM_ SG_ 312 FR_TiStamp  " ";

CM_ BO_ 320  " ";
CM_ SG_ 320 FR_DTC2_Status  "DTC上传 ";
CM_ SG_ 320 FR_DTC2_LowByte  "DTC上传 ";
CM_ SG_ 320 FR_DTC2_MiddByte  "DTC上传 ";
CM_ SG_ 320 FR_DTC2_HighByte  "DTC上传 ";
CM_ SG_ 320 FR_DTC1_Status  "DTC上传 ";
CM_ SG_ 320 FR_DTC1_LowByte  "DTC上传 ";
CM_ SG_ 320 FR_DTC1_MiddByte  "DTC上传 ";
CM_ SG_ 320 FR_DTC1_HighByte  "DTC上传 ";

CM_ BO_ 336  "1-4对应左、右、左左、右右车道线
5、6对应左、右路沿
7、8对应匝道 ";
CM_ SG_ 336 FC_CRCCheck_150  " ";
CM_ SG_ 336 FC_RollingCounter_150  " ";
CM_ SG_ 336 FC_Line_2_exist_prob  " ";
CM_ SG_ 336 FC_Line_2_RMSE  " ";
CM_ SG_ 336 FC_Line_2_ParseConf  " ";
CM_ SG_ 336 FC_Line_2_MeasureType  " ";
CM_ SG_ 336 FC_Line_2_ModelC3  " ";
CM_ SG_ 336 FC_Line_2_ModelC2  " ";
CM_ SG_ 336 FC_Line_2_ModelC1  " ";
CM_ SG_ 336 FC_Line_2_ModelC0  " ";
CM_ SG_ 336 FC_Line_2_dx_End  " ";
CM_ SG_ 336 FC_Line_2_dx_Start  " ";
CM_ SG_ 336 FC_Line_2_Width  " ";
CM_ SG_ 336 FC_Line_2_color  " ";
CM_ SG_ 336 FC_Line_2_Id  " ";
CM_ SG_ 336 FC_Line_2_TypeConfidence  " ";
CM_ SG_ 336 FC_Line_2_Type  " ";
CM_ SG_ 336 FC_Line_1_exist_prob  " ";
CM_ SG_ 336 FC_Line_1_RMSE  " ";
CM_ SG_ 336 FC_Line_1_ParseConf  " ";
CM_ SG_ 336 FC_Line_1_MeasureType  " ";
CM_ SG_ 336 FC_Line_1_ModelC3  " ";
CM_ SG_ 336 FC_Line_1_ModelC2  " ";
CM_ SG_ 336 FC_Line_1_ModelC1  " ";
CM_ SG_ 336 FC_Line_1_ModelC0  " ";
CM_ SG_ 336 FC_Line_1_dx_End  " ";
CM_ SG_ 336 FC_Line_1_dx_Start  " ";
CM_ SG_ 336 FC_Line_1_Width  " ";
CM_ SG_ 336 FC_Line_1_color  " ";
CM_ SG_ 336 FC_Line_1_Id  " ";
CM_ SG_ 336 FC_Line_1_TypeConfidence  " ";
CM_ SG_ 336 FC_Line_1_Type  " ";

CM_ BO_ 337  " ";
CM_ SG_ 337 FC_CRCCheck_151  " ";
CM_ SG_ 337 FC_RollingCounter_151  " ";
CM_ SG_ 337 FC_Line_4_exist_prob  " ";
CM_ SG_ 337 FC_Line_4_RMSE  " ";
CM_ SG_ 337 FC_Line_4_ParseConf  " ";
CM_ SG_ 337 FC_Line_4_MeasureType  " ";
CM_ SG_ 337 FC_Line_4_ModelC3  " ";
CM_ SG_ 337 FC_Line_4_ModelC2  " ";
CM_ SG_ 337 FC_Line_4_ModelC1  " ";
CM_ SG_ 337 FC_Line_4_ModelC0  " ";
CM_ SG_ 337 FC_Line_4_dx_End  " ";
CM_ SG_ 337 FC_Line_4_dx_Start  " ";
CM_ SG_ 337 FC_Line_4_Width  " ";
CM_ SG_ 337 FC_Line_4_color  " ";
CM_ SG_ 337 FC_Line_4_Id  " ";
CM_ SG_ 337 FC_Line_4_TypeConfidence  " ";
CM_ SG_ 337 FC_Line_4_Type  " ";
CM_ SG_ 337 FC_Line_3_exist_prob  " ";
CM_ SG_ 337 FC_Line_3_RMSE  " ";
CM_ SG_ 337 FC_Line_3_ParseConf  " ";
CM_ SG_ 337 FC_Line_3_MeasureType  " ";
CM_ SG_ 337 FC_Line_3_ModelC3  " ";
CM_ SG_ 337 FC_Line_3_ModelC2  " ";
CM_ SG_ 337 FC_Line_3_ModelC1  " ";
CM_ SG_ 337 FC_Line_3_ModelC0  " ";
CM_ SG_ 337 FC_Line_3_dx_End  " ";
CM_ SG_ 337 FC_Line_3_dx_Start  " ";
CM_ SG_ 337 FC_Line_3_Width  " ";
CM_ SG_ 337 FC_Line_3_color  " ";
CM_ SG_ 337 FC_Line_3_Id  " ";
CM_ SG_ 337 FC_Line_3_TypeConfidence  " ";
CM_ SG_ 337 FC_Line_3_Type  " ";

CM_ BO_ 338  " ";
CM_ SG_ 338 FC_CRCCheck_152  " ";
CM_ SG_ 338 FC_RollingCounter_152  " ";
CM_ SG_ 338 FC_Line_6_exist_prob  " ";
CM_ SG_ 338 FC_Line_6_RMSE  " ";
CM_ SG_ 338 FC_Line_6_ParseConf  " ";
CM_ SG_ 338 FC_Line_6_MeasureType  " ";
CM_ SG_ 338 FC_Line_6_ModelC3  " ";
CM_ SG_ 338 FC_Line_6_ModelC2  " ";
CM_ SG_ 338 FC_Line_6_ModelC1  " ";
CM_ SG_ 338 FC_Line_6_ModelC0  " ";
CM_ SG_ 338 FC_Line_6_dx_End  " ";
CM_ SG_ 338 FC_Line_6_dx_Start  " ";
CM_ SG_ 338 FC_Line_6_Width  " ";
CM_ SG_ 338 FC_Line_6_color  " ";
CM_ SG_ 338 FC_Line_6_Id  " ";
CM_ SG_ 338 FC_Line_6_TypeConfidence  " ";
CM_ SG_ 338 FC_Line_6_Type  " ";
CM_ SG_ 338 FC_Line_5_exist_prob  " ";
CM_ SG_ 338 FC_Line_5_RMSE  " ";
CM_ SG_ 338 FC_Line_5_ParseConf  " ";
CM_ SG_ 338 FC_Line_5_MeasureType  " ";
CM_ SG_ 338 FC_Line_5_ModelC3  " ";
CM_ SG_ 338 FC_Line_5_ModelC2  " ";
CM_ SG_ 338 FC_Line_5_ModelC1  " ";
CM_ SG_ 338 FC_Line_5_ModelC0  " ";
CM_ SG_ 338 FC_Line_5_dx_End  " ";
CM_ SG_ 338 FC_Line_5_dx_Start  " ";
CM_ SG_ 338 FC_Line_5_Width  " ";
CM_ SG_ 338 FC_Line_5_color  " ";
CM_ SG_ 338 FC_Line_5_Id  " ";
CM_ SG_ 338 FC_Line_5_TypeConfidence  " ";
CM_ SG_ 338 FC_Line_5_Type  " ";

CM_ BO_ 339  " ";
CM_ SG_ 339 FC_CRCCheck_153  " ";
CM_ SG_ 339 FC_RollingCounter_153  " ";
CM_ SG_ 339 FC_Line_8_exist_prob  " ";
CM_ SG_ 339 FC_Line_8_RMSE  " ";
CM_ SG_ 339 FC_Line_8_ParseConf  " ";
CM_ SG_ 339 FC_Line_8_MeasureType  " ";
CM_ SG_ 339 FC_Line_8_ModelC3  " ";
CM_ SG_ 339 FC_Line_8_ModelC2  " ";
CM_ SG_ 339 FC_Line_8_ModelC1  " ";
CM_ SG_ 339 FC_Line_8_ModelC0  " ";
CM_ SG_ 339 FC_Line_8_dx_End  " ";
CM_ SG_ 339 FC_Line_8_dx_Start  " ";
CM_ SG_ 339 FC_Line_8_Width  " ";
CM_ SG_ 339 FC_Line_8_color  " ";
CM_ SG_ 339 FC_Line_8_Id  " ";
CM_ SG_ 339 FC_Line_8_TypeConfidence  " ";
CM_ SG_ 339 FC_Line_8_Type  " ";
CM_ SG_ 339 FC_Line_7_exist_prob  " ";
CM_ SG_ 339 FC_Line_7_RMSE  " ";
CM_ SG_ 339 FC_Line_7_ParseConf  " ";
CM_ SG_ 339 FC_Line_7_MeasureType  " ";
CM_ SG_ 339 FC_Line_7_ModelC3  " ";
CM_ SG_ 339 FC_Line_7_ModelC2  " ";
CM_ SG_ 339 FC_Line_7_ModelC1  " ";
CM_ SG_ 339 FC_Line_7_ModelC0  " ";
CM_ SG_ 339 FC_Line_7_dx_End  " ";
CM_ SG_ 339 FC_Line_7_dx_Start  " ";
CM_ SG_ 339 FC_Line_7_Width  " ";
CM_ SG_ 339 FC_Line_7_color  " ";
CM_ SG_ 339 FC_Line_7_Id  " ";
CM_ SG_ 339 FC_Line_7_TypeConfidence  " ";
CM_ SG_ 339 FC_Line_7_Type  " ";

CM_ BO_ 340  " ";
CM_ SG_ 340 FC_CRCCheck_154  " ";
CM_ SG_ 340 FC_RollingCounter_154  " ";
CM_ SG_ 340 FC_LineMCUTiStamp  " ";
CM_ SG_ 340 FC_LineTiOut  " ";
CM_ SG_ 340 FC_LineTiLeap  " ";
CM_ SG_ 340 FC_LineTiBas  " ";
CM_ SG_ 340 FC_LineTiStamp  " ";
CM_ SG_ 340 FC_WeatherType  " ";
CM_ SG_ 340 FC_RCrossPiont_StartEnd  " ";
CM_ SG_ 340 FC_RCrossPiont_DivMer  " ";
CM_ SG_ 340 FC_RCrossPiont_ExistProb  " ";
CM_ SG_ 340 FC_RCrossPiont_Dy  " ";
CM_ SG_ 340 FC_RCrossPoint_DX  " ";
CM_ SG_ 340 FC_LCrossPiont_StartEnd  " ";
CM_ SG_ 340 FC_LCrossPiont_DivMer  " ";
CM_ SG_ 340 FC_LCrossPiont_ExistProb  " ";
CM_ SG_ 340 FC_LCrossPiont_Dy  " ";
CM_ SG_ 340 FC_LCrossPoint_DX  " ";

CM_ BO_ 352  " ";
CM_ SG_ 352 FC_Obj1WSInfoPosType  " ";
CM_ SG_ 352 FC_CRCCheck_160  " ";
CM_ SG_ 352 FC_RollingCounter_160  " ";
CM_ SG_ 352 FC_Obj1_Img2dBox_RightDown_V  " ";
CM_ SG_ 352 FC_Obj1_Img2dBox_LeftTop_V  " ";
CM_ SG_ 352 FC_Obj1_Img2dBox_RightDown_U  " ";
CM_ SG_ 352 FC_Obj1_Img2dBox_LeftTop_U  " ";
CM_ SG_ 352 FC_Obj1_TurnLight  " ";
CM_ SG_ 352 FC_Obj1_valid  "未收敛目标，输出invalid状态，输出valid状态，信号必须是可性的 ";
CM_ SG_ 352 FC_Obj1_Vy_Vnce  " ";
CM_ SG_ 352 FC_Obj1_Vx_Vnce  " ";
CM_ SG_ 352 FC_Obj1_CenterAngle  " ";
CM_ SG_ 352 FC_Obj1_DistInLane  " ";
CM_ SG_ 352 FC_Obj1_objCutInLane  " ";
CM_ SG_ 352 FC_Obj1_objCutInFlag  " ";
CM_ SG_ 352 FC_Obj1_CornerPoint_y  " ";
CM_ SG_ 352 FC_Obj1_CornerPoint_x  " ";
CM_ SG_ 352 FC_Obj1_LaneAssignment  " ";
CM_ SG_ 352 FC_Obj1_MotionType  " ";
CM_ SG_ 352 FC_obj1_Brakelight_Info  " ";
CM_ SG_ 352 FC_Obj1_Width  " ";
CM_ SG_ 352 FC_Obj1_Length  " ";
CM_ SG_ 352 FC_Obj1_Height  " ";
CM_ SG_ 352 FC_Obj1_HeadOrientation  " ";
CM_ SG_ 352 FC_Obj1_HeadingAngle  " ";
CM_ SG_ 352 FC_Obj1_ExistProb  " ";
CM_ SG_ 352 FC_Obj1_Dy_Vnce  " ";
CM_ SG_ 352 FC_Obj1_Dy  " ";
CM_ SG_ 352 FC_Obj1_Dx_Vnce  " ";
CM_ SG_ 352 FC_Obj1_Dx  " ";
CM_ SG_ 352 FC_Obj1_RelVy  " ";
CM_ SG_ 352 FC_Obj1_RelVx  " ";
CM_ SG_ 352 FC_Obj1_RelAy  " ";
CM_ SG_ 352 FC_Obj1_RelAx  " ";
CM_ SG_ 352 FC_Obj1_TypeProb  " ";
CM_ SG_ 352 FC_Obj1_Type  " ";
CM_ SG_ 352 FC_Obj1_Track_Age  " ";
CM_ SG_ 352 FC_Obj1_Track_ID  " ";

CM_ BO_ 353  " ";
CM_ SG_ 353 FC_Obj2WSInfoPosType  " ";
CM_ SG_ 353 FC_CRCCheck_161  " ";
CM_ SG_ 353 FC_RollingCounter_161  " ";
CM_ SG_ 353 FC_Obj2_Img2dBox_RightDown_V  " ";
CM_ SG_ 353 FC_Obj2_Img2dBox_LeftTop_V  " ";
CM_ SG_ 353 FC_Obj2_Img2dBox_RightDown_U  " ";
CM_ SG_ 353 FC_Obj2_Img2dBox_LeftTop_U  " ";
CM_ SG_ 353 FC_Obj2_TurnLight  " ";
CM_ SG_ 353 FC_Obj2_valid  "未收敛目标，输出invalid状态，输出valid状态，信号必须是可性的 ";
CM_ SG_ 353 FC_Obj2_Vy_Vnce  " ";
CM_ SG_ 353 FC_Obj2_Vx_Vnce  " ";
CM_ SG_ 353 FC_Obj2_CenterAngle  " ";
CM_ SG_ 353 FC_Obj2_DistInLane  " ";
CM_ SG_ 353 FC_Obj2_objCutInLane  " ";
CM_ SG_ 353 FC_Obj2_objCutInFlag  " ";
CM_ SG_ 353 FC_Obj2_CornerPoint_y  " ";
CM_ SG_ 353 FC_Obj2_CornerPoint_x  " ";
CM_ SG_ 353 FC_Obj2_LaneAssignment  " ";
CM_ SG_ 353 FC_Obj2_MotionType  " ";
CM_ SG_ 353 FC_obj2_Brakelight_Info  " ";
CM_ SG_ 353 FC_Obj2_Width  " ";
CM_ SG_ 353 FC_Obj2_Length  " ";
CM_ SG_ 353 FC_Obj2_Height  " ";
CM_ SG_ 353 FC_Obj2_HeadOrientation  " ";
CM_ SG_ 353 FC_Obj2_HeadingAngle  " ";
CM_ SG_ 353 FC_Obj2_ExistProb  " ";
CM_ SG_ 353 FC_Obj2_Dy_Vnce  " ";
CM_ SG_ 353 FC_Obj2_Dy  " ";
CM_ SG_ 353 FC_Obj2_Dx_Vnce  " ";
CM_ SG_ 353 FC_Obj2_Dx  " ";
CM_ SG_ 353 FC_Obj2_RelVy  " ";
CM_ SG_ 353 FC_Obj2_RelVx  " ";
CM_ SG_ 353 FC_Obj2_RelAy  " ";
CM_ SG_ 353 FC_Obj2_RelAx  " ";
CM_ SG_ 353 FC_Obj2_TypeProb  " ";
CM_ SG_ 353 FC_Obj2_Type  " ";
CM_ SG_ 353 FC_Obj2_Track_Age  " ";
CM_ SG_ 353 FC_Obj2_Track_ID  " ";

CM_ BO_ 354  " ";
CM_ SG_ 354 FC_Obj3WSInfoPosType  " ";
CM_ SG_ 354 FC_CRCCheck_162  " ";
CM_ SG_ 354 FC_RollingCounter_162  " ";
CM_ SG_ 354 FC_Obj3_Img2dBox_RightDown_V  " ";
CM_ SG_ 354 FC_Obj3_Img2dBox_LeftTop_V  " ";
CM_ SG_ 354 FC_Obj3_Img2dBox_RightDown_U  " ";
CM_ SG_ 354 FC_Obj3_Img2dBox_LeftTop_U  " ";
CM_ SG_ 354 FC_Obj3_TurnLight  " ";
CM_ SG_ 354 FC_Obj3_valid  "未收敛目标，输出invalid状态，输出valid状态，信号必须是可性的 ";
CM_ SG_ 354 FC_Obj3_Vy_Vnce  " ";
CM_ SG_ 354 FC_Obj3_Vx_Vnce  " ";
CM_ SG_ 354 FC_Obj3_CenterAngle  " ";
CM_ SG_ 354 FC_Obj3_DistInLane  " ";
CM_ SG_ 354 FC_Obj3_objCutInLane  " ";
CM_ SG_ 354 FC_Obj3_objCutInFlag  " ";
CM_ SG_ 354 FC_Obj3_CornerPoint_y  " ";
CM_ SG_ 354 FC_Obj3_CornerPoint_x  " ";
CM_ SG_ 354 FC_Obj3_LaneAssignment  " ";
CM_ SG_ 354 FC_Obj3_MotionType  " ";
CM_ SG_ 354 FC_obj3_Brakelight_Info  " ";
CM_ SG_ 354 FC_Obj3_Width  " ";
CM_ SG_ 354 FC_Obj3_Length  " ";
CM_ SG_ 354 FC_Obj3_Height  " ";
CM_ SG_ 354 FC_Obj3_HeadOrientation  " ";
CM_ SG_ 354 FC_Obj3_HeadingAngle  " ";
CM_ SG_ 354 FC_Obj3_ExistProb  " ";
CM_ SG_ 354 FC_Obj3_Dy_Vnce  " ";
CM_ SG_ 354 FC_Obj3_Dy  " ";
CM_ SG_ 354 FC_Obj3_Dx_Vnce  " ";
CM_ SG_ 354 FC_Obj3_Dx  " ";
CM_ SG_ 354 FC_Obj3_RelVy  " ";
CM_ SG_ 354 FC_Obj3_RelVx  " ";
CM_ SG_ 354 FC_Obj3_RelAy  " ";
CM_ SG_ 354 FC_Obj3_RelAx  " ";
CM_ SG_ 354 FC_Obj3_TypeProb  " ";
CM_ SG_ 354 FC_Obj3_Type  " ";
CM_ SG_ 354 FC_Obj3_Track_Age  " ";
CM_ SG_ 354 FC_Obj3_Track_ID  " ";

CM_ BO_ 355  " ";
CM_ SG_ 355 FC_Obj4WSInfoPosType  " ";
CM_ SG_ 355 FC_CRCCheck_163  " ";
CM_ SG_ 355 FC_RollingCounter_163  " ";
CM_ SG_ 355 FC_Obj4_Img2dBox_RightDown_V  " ";
CM_ SG_ 355 FC_Obj4_Img2dBox_LeftTop_V  " ";
CM_ SG_ 355 FC_Obj4_Img2dBox_RightDown_U  " ";
CM_ SG_ 355 FC_Obj4_Img2dBox_LeftTop_U  " ";
CM_ SG_ 355 FC_Obj4_TurnLight  " ";
CM_ SG_ 355 FC_Obj4_valid  "未收敛目标，输出invalid状态，输出valid状态，信号必须是可性的 ";
CM_ SG_ 355 FC_Obj4_Vy_Vnce  " ";
CM_ SG_ 355 FC_Obj4_Vx_Vnce  " ";
CM_ SG_ 355 FC_Obj4_CenterAngle  " ";
CM_ SG_ 355 FC_Obj4_DistInLane  " ";
CM_ SG_ 355 FC_Obj4_objCutInLane  " ";
CM_ SG_ 355 FC_Obj4_objCutInFlag  " ";
CM_ SG_ 355 FC_Obj4_CornerPoint_y  " ";
CM_ SG_ 355 FC_Obj4_CornerPoint_x  " ";
CM_ SG_ 355 FC_Obj4_LaneAssignment  " ";
CM_ SG_ 355 FC_Obj4_MotionType  " ";
CM_ SG_ 355 FC_obj4_Brakelight_Info  " ";
CM_ SG_ 355 FC_Obj4_Width  " ";
CM_ SG_ 355 FC_Obj4_Length  " ";
CM_ SG_ 355 FC_Obj4_Height  " ";
CM_ SG_ 355 FC_Obj4_HeadOrientation  " ";
CM_ SG_ 355 FC_Obj4_HeadingAngle  " ";
CM_ SG_ 355 FC_Obj4_ExistProb  " ";
CM_ SG_ 355 FC_Obj4_Dy_Vnce  " ";
CM_ SG_ 355 FC_Obj4_Dy  " ";
CM_ SG_ 355 FC_Obj4_Dx_Vnce  " ";
CM_ SG_ 355 FC_Obj4_Dx  " ";
CM_ SG_ 355 FC_Obj4_RelVy  " ";
CM_ SG_ 355 FC_Obj4_RelVx  " ";
CM_ SG_ 355 FC_Obj4_RelAy  " ";
CM_ SG_ 355 FC_Obj4_RelAx  " ";
CM_ SG_ 355 FC_Obj4_TypeProb  " ";
CM_ SG_ 355 FC_Obj4_Type  " ";
CM_ SG_ 355 FC_Obj4_Track_Age  " ";
CM_ SG_ 355 FC_Obj4_Track_ID  " ";

CM_ BO_ 356  " ";
CM_ SG_ 356 FC_Obj5WSInfoPosType  " ";
CM_ SG_ 356 FC_CRCCheck_164  " ";
CM_ SG_ 356 FC_RollingCounter_164  " ";
CM_ SG_ 356 FC_Obj5_Img2dBox_RightDown_V  " ";
CM_ SG_ 356 FC_Obj5_Img2dBox_LeftTop_V  " ";
CM_ SG_ 356 FC_Obj5_Img2dBox_RightDown_U  " ";
CM_ SG_ 356 FC_Obj5_Img2dBox_LeftTop_U  " ";
CM_ SG_ 356 FC_Obj5_TurnLight  " ";
CM_ SG_ 356 FC_Obj5_valid  "未收敛目标，输出invalid状态，输出valid状态，信号必须是可性的 ";
CM_ SG_ 356 FC_Obj5_Vy_Vnce  " ";
CM_ SG_ 356 FC_Obj5_Vx_Vnce  " ";
CM_ SG_ 356 FC_Obj5_CenterAngle  " ";
CM_ SG_ 356 FC_Obj5_DistInLane  " ";
CM_ SG_ 356 FC_Obj5_objCutInLane  " ";
CM_ SG_ 356 FC_Obj5_objCutInFlag  " ";
CM_ SG_ 356 FC_Obj5_CornerPoint_y  " ";
CM_ SG_ 356 FC_Obj5_CornerPoint_x  " ";
CM_ SG_ 356 FC_Obj5_LaneAssignment  " ";
CM_ SG_ 356 FC_Obj5_MotionType  " ";
CM_ SG_ 356 FC_obj5_Brakelight_Info  " ";
CM_ SG_ 356 FC_Obj5_Width  " ";
CM_ SG_ 356 FC_Obj5_Length  " ";
CM_ SG_ 356 FC_Obj5_Height  " ";
CM_ SG_ 356 FC_Obj5_HeadOrientation  " ";
CM_ SG_ 356 FC_Obj5_HeadingAngle  " ";
CM_ SG_ 356 FC_Obj5_ExistProb  " ";
CM_ SG_ 356 FC_Obj5_Dy_Vnce  " ";
CM_ SG_ 356 FC_Obj5_Dy  " ";
CM_ SG_ 356 FC_Obj5_Dx_Vnce  " ";
CM_ SG_ 356 FC_Obj5_Dx  " ";
CM_ SG_ 356 FC_Obj5_RelVy  " ";
CM_ SG_ 356 FC_Obj5_RelVx  " ";
CM_ SG_ 356 FC_Obj5_RelAy  " ";
CM_ SG_ 356 FC_Obj5_RelAx  " ";
CM_ SG_ 356 FC_Obj5_TypeProb  " ";
CM_ SG_ 356 FC_Obj5_Type  " ";
CM_ SG_ 356 FC_Obj5_Track_Age  " ";
CM_ SG_ 356 FC_Obj5_Track_ID  " ";

CM_ BO_ 357  " ";
CM_ SG_ 357 FC_Obj6WSInfoPosType  " ";
CM_ SG_ 357 FC_CRCCheck_165  " ";
CM_ SG_ 357 FC_RollingCounter_165  " ";
CM_ SG_ 357 FC_Obj6_Img2dBox_RightDown_V  " ";
CM_ SG_ 357 FC_Obj6_Img2dBox_LeftTop_V  " ";
CM_ SG_ 357 FC_Obj6_Img2dBox_RightDown_U  " ";
CM_ SG_ 357 FC_Obj6_Img2dBox_LeftTop_U  " ";
CM_ SG_ 357 FC_Obj6_TurnLight  " ";
CM_ SG_ 357 FC_Obj6_valid  "未收敛目标，输出invalid状态，输出valid状态，信号必须是可性的 ";
CM_ SG_ 357 FC_Obj6_Vy_Vnce  " ";
CM_ SG_ 357 FC_Obj6_Vx_Vnce  " ";
CM_ SG_ 357 FC_Obj6_CenterAngle  " ";
CM_ SG_ 357 FC_Obj6_DistInLane  " ";
CM_ SG_ 357 FC_Obj6_objCutInLane  " ";
CM_ SG_ 357 FC_Obj6_objCutInFlag  " ";
CM_ SG_ 357 FC_Obj6_CornerPoint_y  " ";
CM_ SG_ 357 FC_Obj6_CornerPoint_x  " ";
CM_ SG_ 357 FC_Obj6_LaneAssignment  " ";
CM_ SG_ 357 FC_Obj6_MotionType  " ";
CM_ SG_ 357 FC_obj6_Brakelight_Info  " ";
CM_ SG_ 357 FC_Obj6_Width  " ";
CM_ SG_ 357 FC_Obj6_Length  " ";
CM_ SG_ 357 FC_Obj6_Height  " ";
CM_ SG_ 357 FC_Obj6_HeadOrientation  " ";
CM_ SG_ 357 FC_Obj6_HeadingAngle  " ";
CM_ SG_ 357 FC_Obj6_ExistProb  " ";
CM_ SG_ 357 FC_Obj6_Dy_Vnce  " ";
CM_ SG_ 357 FC_Obj6_Dy  " ";
CM_ SG_ 357 FC_Obj6_Dx_Vnce  " ";
CM_ SG_ 357 FC_Obj6_Dx  " ";
CM_ SG_ 357 FC_Obj6_RelVy  " ";
CM_ SG_ 357 FC_Obj6_RelVx  " ";
CM_ SG_ 357 FC_Obj6_RelAy  " ";
CM_ SG_ 357 FC_Obj6_RelAx  " ";
CM_ SG_ 357 FC_Obj6_TypeProb  " ";
CM_ SG_ 357 FC_Obj6_Type  " ";
CM_ SG_ 357 FC_Obj6_Track_Age  " ";
CM_ SG_ 357 FC_Obj6_Track_ID  " ";

CM_ BO_ 358  " ";
CM_ SG_ 358 FC_Obj7WSInfoPosType  " ";
CM_ SG_ 358 FC_CRCCheck_166  " ";
CM_ SG_ 358 FC_RollingCounter_166  " ";
CM_ SG_ 358 FC_Obj7_Img2dBox_RightDown_V  " ";
CM_ SG_ 358 FC_Obj7_Img2dBox_LeftTop_V  " ";
CM_ SG_ 358 FC_Obj7_Img2dBox_RightDown_U  " ";
CM_ SG_ 358 FC_Obj7_Img2dBox_LeftTop_U  " ";
CM_ SG_ 358 FC_Obj7_TurnLight  " ";
CM_ SG_ 358 FC_Obj7_valid  "未收敛目标，输出invalid状态，输出valid状态，信号必须是可性的 ";
CM_ SG_ 358 FC_Obj7_Vy_Vnce  " ";
CM_ SG_ 358 FC_Obj7_Vx_Vnce  " ";
CM_ SG_ 358 FC_Obj7_CenterAngle  " ";
CM_ SG_ 358 FC_Obj7_DistInLane  " ";
CM_ SG_ 358 FC_Obj7_objCutInLane  " ";
CM_ SG_ 358 FC_Obj7_objCutInFlag  " ";
CM_ SG_ 358 FC_Obj7_CornerPoint_y  " ";
CM_ SG_ 358 FC_Obj7_CornerPoint_x  " ";
CM_ SG_ 358 FC_Obj7_LaneAssignment  " ";
CM_ SG_ 358 FC_Obj7_MotionType  " ";
CM_ SG_ 358 FC_obj7_Brakelight_Info  " ";
CM_ SG_ 358 FC_Obj7_Width  " ";
CM_ SG_ 358 FC_Obj7_Length  " ";
CM_ SG_ 358 FC_Obj7_Height  " ";
CM_ SG_ 358 FC_Obj7_HeadOrientation  " ";
CM_ SG_ 358 FC_Obj7_HeadingAngle  " ";
CM_ SG_ 358 FC_Obj7_ExistProb  " ";
CM_ SG_ 358 FC_Obj7_Dy_Vnce  " ";
CM_ SG_ 358 FC_Obj7_Dy  " ";
CM_ SG_ 358 FC_Obj7_Dx_Vnce  " ";
CM_ SG_ 358 FC_Obj7_Dx  " ";
CM_ SG_ 358 FC_Obj7_RelVy  " ";
CM_ SG_ 358 FC_Obj7_RelVx  " ";
CM_ SG_ 358 FC_Obj7_RelAy  " ";
CM_ SG_ 358 FC_Obj7_RelAx  " ";
CM_ SG_ 358 FC_Obj7_TypeProb  " ";
CM_ SG_ 358 FC_Obj7_Type  " ";
CM_ SG_ 358 FC_Obj7_Track_Age  " ";
CM_ SG_ 358 FC_Obj7_Track_ID  " ";

CM_ BO_ 359  " ";
CM_ SG_ 359 FC_Obj8WSInfoPosType  " ";
CM_ SG_ 359 FC_CRCCheck_167  " ";
CM_ SG_ 359 FC_RollingCounter_167  " ";
CM_ SG_ 359 FC_Obj8_Img2dBox_RightDown_V  " ";
CM_ SG_ 359 FC_Obj8_Img2dBox_LeftTop_V  " ";
CM_ SG_ 359 FC_Obj8_Img2dBox_RightDown_U  " ";
CM_ SG_ 359 FC_Obj8_Img2dBox_LeftTop_U  " ";
CM_ SG_ 359 FC_Obj8_TurnLight  " ";
CM_ SG_ 359 FC_Obj8_valid  "未收敛目标，输出invalid状态，输出valid状态，信号必须是可性的 ";
CM_ SG_ 359 FC_Obj8_Vy_Vnce  " ";
CM_ SG_ 359 FC_Obj8_Vx_Vnce  " ";
CM_ SG_ 359 FC_Obj8_CenterAngle  " ";
CM_ SG_ 359 FC_Obj8_DistInLane  " ";
CM_ SG_ 359 FC_Obj8_objCutInLane  " ";
CM_ SG_ 359 FC_Obj8_objCutInFlag  " ";
CM_ SG_ 359 FC_Obj8_CornerPoint_y  " ";
CM_ SG_ 359 FC_Obj8_CornerPoint_x  " ";
CM_ SG_ 359 FC_Obj8_LaneAssignment  " ";
CM_ SG_ 359 FC_Obj8_MotionType  " ";
CM_ SG_ 359 FC_obj8_Brakelight_Info  " ";
CM_ SG_ 359 FC_Obj8_Width  " ";
CM_ SG_ 359 FC_Obj8_Length  " ";
CM_ SG_ 359 FC_Obj8_Height  " ";
CM_ SG_ 359 FC_Obj8_HeadOrientation  " ";
CM_ SG_ 359 FC_Obj8_HeadingAngle  " ";
CM_ SG_ 359 FC_Obj8_ExistProb  " ";
CM_ SG_ 359 FC_Obj8_Dy_Vnce  " ";
CM_ SG_ 359 FC_Obj8_Dy  " ";
CM_ SG_ 359 FC_Obj8_Dx_Vnce  " ";
CM_ SG_ 359 FC_Obj8_Dx  " ";
CM_ SG_ 359 FC_Obj8_RelVy  " ";
CM_ SG_ 359 FC_Obj8_RelVx  " ";
CM_ SG_ 359 FC_Obj8_RelAy  " ";
CM_ SG_ 359 FC_Obj8_RelAx  " ";
CM_ SG_ 359 FC_Obj8_TypeProb  " ";
CM_ SG_ 359 FC_Obj8_Type  " ";
CM_ SG_ 359 FC_Obj8_Track_Age  " ";
CM_ SG_ 359 FC_Obj8_Track_ID  " ";

CM_ BO_ 360  " ";
CM_ SG_ 360 FC_Obj9WSInfoPosType  " ";
CM_ SG_ 360 FC_CRCCheck_168  " ";
CM_ SG_ 360 FC_RollingCounter_168  " ";
CM_ SG_ 360 FC_Obj9_Img2dBox_RightDown_V  " ";
CM_ SG_ 360 FC_Obj9_Img2dBox_LeftTop_V  " ";
CM_ SG_ 360 FC_Obj9_Img2dBox_RightDown_U  " ";
CM_ SG_ 360 FC_Obj9_Img2dBox_LeftTop_U  " ";
CM_ SG_ 360 FC_Obj9_TurnLight  " ";
CM_ SG_ 360 FC_Obj9_valid  "未收敛目标，输出invalid状态，输出valid状态，信号必须是可性的 ";
CM_ SG_ 360 FC_Obj9_Vy_Vnce  " ";
CM_ SG_ 360 FC_Obj9_Vx_Vnce  " ";
CM_ SG_ 360 FC_Obj9_CenterAngle  " ";
CM_ SG_ 360 FC_Obj9_DistInLane  " ";
CM_ SG_ 360 FC_Obj9_objCutInLane  " ";
CM_ SG_ 360 FC_Obj9_objCutInFlag  " ";
CM_ SG_ 360 FC_Obj9_CornerPoint_y  " ";
CM_ SG_ 360 FC_Obj9_CornerPoint_x  " ";
CM_ SG_ 360 FC_Obj9_LaneAssignment  " ";
CM_ SG_ 360 FC_Obj9_MotionType  " ";
CM_ SG_ 360 FC_obj9_Brakelight_Info  " ";
CM_ SG_ 360 FC_Obj9_Width  " ";
CM_ SG_ 360 FC_Obj9_Length  " ";
CM_ SG_ 360 FC_Obj9_Height  " ";
CM_ SG_ 360 FC_Obj9_HeadOrientation  " ";
CM_ SG_ 360 FC_Obj9_HeadingAngle  " ";
CM_ SG_ 360 FC_Obj9_ExistProb  " ";
CM_ SG_ 360 FC_Obj9_Dy_Vnce  " ";
CM_ SG_ 360 FC_Obj9_Dy  " ";
CM_ SG_ 360 FC_Obj9_Dx_Vnce  " ";
CM_ SG_ 360 FC_Obj9_Dx  " ";
CM_ SG_ 360 FC_Obj9_RelVy  " ";
CM_ SG_ 360 FC_Obj9_RelVx  " ";
CM_ SG_ 360 FC_Obj9_RelAy  " ";
CM_ SG_ 360 FC_Obj9_RelAx  " ";
CM_ SG_ 360 FC_Obj9_TypeProb  " ";
CM_ SG_ 360 FC_Obj9_Type  " ";
CM_ SG_ 360 FC_Obj9_Track_Age  " ";
CM_ SG_ 360 FC_Obj9_Track_ID  " ";

CM_ BO_ 361  " ";
CM_ SG_ 361 FC_Obj10WSInfoPosType  " ";
CM_ SG_ 361 FC_CRCCheck_169  " ";
CM_ SG_ 361 FC_RollingCounter_169  " ";
CM_ SG_ 361 FC_Obj10_Img2dBox_RightDown_V  " ";
CM_ SG_ 361 FC_Obj10_Img2dBox_LeftTop_V  " ";
CM_ SG_ 361 FC_Obj10_Img2dBox_RightDown_U  " ";
CM_ SG_ 361 FC_Obj10_Img2dBox_LeftTop_U  " ";
CM_ SG_ 361 FC_Obj10_TurnLight  " ";
CM_ SG_ 361 FC_Obj10_valid  "未收敛目标，输出invalid状态，输出valid状态，信号必须是可性的 ";
CM_ SG_ 361 FC_Obj10_Vy_Vnce  " ";
CM_ SG_ 361 FC_Obj10_Vx_Vnce  " ";
CM_ SG_ 361 FC_Obj10_CenterAngle  " ";
CM_ SG_ 361 FC_Obj10_DistInLane  " ";
CM_ SG_ 361 FC_Obj10_objCutInLane  " ";
CM_ SG_ 361 FC_Obj10_objCutInFlag  " ";
CM_ SG_ 361 FC_Obj10_CornerPoint_y  " ";
CM_ SG_ 361 FC_Obj10_CornerPoint_x  " ";
CM_ SG_ 361 FC_Obj10_LaneAssignment  " ";
CM_ SG_ 361 FC_Obj10_MotionType  " ";
CM_ SG_ 361 FC_obj10_Brakelight_Info  " ";
CM_ SG_ 361 FC_Obj10_Width  " ";
CM_ SG_ 361 FC_Obj10_Length  " ";
CM_ SG_ 361 FC_Obj10_Height  " ";
CM_ SG_ 361 FC_Obj10_HeadOrientation  " ";
CM_ SG_ 361 FC_Obj10_HeadingAngle  " ";
CM_ SG_ 361 FC_Obj10_ExistProb  " ";
CM_ SG_ 361 FC_Obj10_Dy_Vnce  " ";
CM_ SG_ 361 FC_Obj10_Dy  " ";
CM_ SG_ 361 FC_Obj10_Dx_Vnce  " ";
CM_ SG_ 361 FC_Obj10_Dx  " ";
CM_ SG_ 361 FC_Obj10_RelVy  " ";
CM_ SG_ 361 FC_Obj10_RelVx  " ";
CM_ SG_ 361 FC_Obj10_RelAy  " ";
CM_ SG_ 361 FC_Obj10_RelAx  " ";
CM_ SG_ 361 FC_Obj10_TypeProb  " ";
CM_ SG_ 361 FC_Obj10_Type  " ";
CM_ SG_ 361 FC_Obj10_Track_Age  " ";
CM_ SG_ 361 FC_Obj10_Track_ID  " ";

CM_ BO_ 368  " ";
CM_ SG_ 368 FC_Obj11WSInfoPosType  " ";
CM_ SG_ 368 FC_CRCCheck_170  " ";
CM_ SG_ 368 FC_RollingCounter_170  " ";
CM_ SG_ 368 FC_Obj11_Img2dBox_RightDown_V  " ";
CM_ SG_ 368 FC_Obj11_Img2dBox_LeftTop_V  " ";
CM_ SG_ 368 FC_Obj11_Img2dBox_RightDown_U  " ";
CM_ SG_ 368 FC_Obj11_Img2dBox_LeftTop_U  " ";
CM_ SG_ 368 FC_Obj11_TurnLight  " ";
CM_ SG_ 368 FC_Obj11_valid  "未收敛目标，输出invalid状态，输出valid状态，信号必须是可性的 ";
CM_ SG_ 368 FC_Obj11_Vy_Vnce  " ";
CM_ SG_ 368 FC_Obj11_Vx_Vnce  " ";
CM_ SG_ 368 FC_Obj11_CenterAngle  " ";
CM_ SG_ 368 FC_Obj11_DistInLane  " ";
CM_ SG_ 368 FC_Obj11_objCutInLane  " ";
CM_ SG_ 368 FC_Obj11_objCutInFlag  " ";
CM_ SG_ 368 FC_Obj11_CornerPoint_y  " ";
CM_ SG_ 368 FC_Obj11_CornerPoint_x  " ";
CM_ SG_ 368 FC_Obj11_LaneAssignment  " ";
CM_ SG_ 368 FC_Obj11_MotionType  " ";
CM_ SG_ 368 FC_obj11_Brakelight_Info  " ";
CM_ SG_ 368 FC_Obj11_Width  " ";
CM_ SG_ 368 FC_Obj11_Length  " ";
CM_ SG_ 368 FC_Obj11_Height  " ";
CM_ SG_ 368 FC_Obj11_HeadOrientation  " ";
CM_ SG_ 368 FC_Obj11_HeadingAngle  " ";
CM_ SG_ 368 FC_Obj11_ExistProb  " ";
CM_ SG_ 368 FC_Obj11_Dy_Vnce  " ";
CM_ SG_ 368 FC_Obj11_Dy  " ";
CM_ SG_ 368 FC_Obj11_Dx_Vnce  " ";
CM_ SG_ 368 FC_Obj11_Dx  " ";
CM_ SG_ 368 FC_Obj11_RelVy  " ";
CM_ SG_ 368 FC_Obj11_RelVx  " ";
CM_ SG_ 368 FC_Obj11_RelAy  " ";
CM_ SG_ 368 FC_Obj11_RelAx  " ";
CM_ SG_ 368 FC_Obj11_TypeProb  " ";
CM_ SG_ 368 FC_Obj11_Type  " ";
CM_ SG_ 368 FC_Obj11_Track_Age  " ";
CM_ SG_ 368 FC_Obj11_Track_ID  " ";

CM_ BO_ 369  " ";
CM_ SG_ 369 FC_Obj12WSInfoPosType  " ";
CM_ SG_ 369 FC_CRCCheck_171  " ";
CM_ SG_ 369 FC_RollingCounter_171  " ";
CM_ SG_ 369 FC_Obj12_Img2dBox_RightDown_V  " ";
CM_ SG_ 369 FC_Obj12_Img2dBox_LeftTop_V  " ";
CM_ SG_ 369 FC_Obj12_Img2dBox_RightDown_U  " ";
CM_ SG_ 369 FC_Obj12_Img2dBox_LeftTop_U  " ";
CM_ SG_ 369 FC_Obj12_TurnLight  " ";
CM_ SG_ 369 FC_Obj12_valid  "未收敛目标，输出invalid状态，输出valid状态，信号必须是可性的 ";
CM_ SG_ 369 FC_Obj12_Vy_Vnce  " ";
CM_ SG_ 369 FC_Obj12_Vx_Vnce  " ";
CM_ SG_ 369 FC_Obj12_CenterAngle  " ";
CM_ SG_ 369 FC_Obj12_DistInLane  " ";
CM_ SG_ 369 FC_Obj12_objCutInLane  " ";
CM_ SG_ 369 FC_Obj12_objCutInFlag  " ";
CM_ SG_ 369 FC_Obj12_CornerPoint_y  " ";
CM_ SG_ 369 FC_Obj12_CornerPoint_x  " ";
CM_ SG_ 369 FC_Obj12_LaneAssignment  " ";
CM_ SG_ 369 FC_Obj12_MotionType  " ";
CM_ SG_ 369 FC_obj12_Brakelight_Info  " ";
CM_ SG_ 369 FC_Obj12_Width  " ";
CM_ SG_ 369 FC_Obj12_Length  " ";
CM_ SG_ 369 FC_Obj12_Height  " ";
CM_ SG_ 369 FC_Obj12_HeadOrientation  " ";
CM_ SG_ 369 FC_Obj12_HeadingAngle  " ";
CM_ SG_ 369 FC_Obj12_ExistProb  " ";
CM_ SG_ 369 FC_Obj12_Dy_Vnce  " ";
CM_ SG_ 369 FC_Obj12_Dy  " ";
CM_ SG_ 369 FC_Obj12_Dx_Vnce  " ";
CM_ SG_ 369 FC_Obj12_Dx  " ";
CM_ SG_ 369 FC_Obj12_RelVy  " ";
CM_ SG_ 369 FC_Obj12_RelVx  " ";
CM_ SG_ 369 FC_Obj12_RelAy  " ";
CM_ SG_ 369 FC_Obj12_RelAx  " ";
CM_ SG_ 369 FC_Obj12_TypeProb  " ";
CM_ SG_ 369 FC_Obj12_Type  " ";
CM_ SG_ 369 FC_Obj12_Track_Age  " ";
CM_ SG_ 369 FC_Obj12_Track_ID  " ";

CM_ BO_ 370  " ";
CM_ SG_ 370 FC_Obj13WSInfoPosType  " ";
CM_ SG_ 370 FC_CRCCheck_172  " ";
CM_ SG_ 370 FC_RollingCounter_172  " ";
CM_ SG_ 370 FC_Obj13_Img2dBox_RightDown_V  " ";
CM_ SG_ 370 FC_Obj13_Img2dBox_LeftTop_V  " ";
CM_ SG_ 370 FC_Obj13_Img2dBox_RightDown_U  " ";
CM_ SG_ 370 FC_Obj13_Img2dBox_LeftTop_U  " ";
CM_ SG_ 370 FC_Obj13_TurnLight  " ";
CM_ SG_ 370 FC_Obj13_valid  "未收敛目标，输出invalid状态，输出valid状态，信号必须是可性的 ";
CM_ SG_ 370 FC_Obj13_Vy_Vnce  " ";
CM_ SG_ 370 FC_Obj13_Vx_Vnce  " ";
CM_ SG_ 370 FC_Obj13_CenterAngle  " ";
CM_ SG_ 370 FC_Obj13_DistInLane  " ";
CM_ SG_ 370 FC_Obj13_objCutInLane  " ";
CM_ SG_ 370 FC_Obj13_objCutInFlag  " ";
CM_ SG_ 370 FC_Obj13_CornerPoint_y  " ";
CM_ SG_ 370 FC_Obj13_CornerPoint_x  " ";
CM_ SG_ 370 FC_Obj13_LaneAssignment  " ";
CM_ SG_ 370 FC_Obj13_MotionType  " ";
CM_ SG_ 370 FC_obj13_Brakelight_Info  " ";
CM_ SG_ 370 FC_Obj13_Width  " ";
CM_ SG_ 370 FC_Obj13_Length  " ";
CM_ SG_ 370 FC_Obj13_Height  " ";
CM_ SG_ 370 FC_Obj13_HeadOrientation  " ";
CM_ SG_ 370 FC_Obj13_HeadingAngle  " ";
CM_ SG_ 370 FC_Obj13_ExistProb  " ";
CM_ SG_ 370 FC_Obj13_Dy_Vnce  " ";
CM_ SG_ 370 FC_Obj13_Dy  " ";
CM_ SG_ 370 FC_Obj13_Dx_Vnce  " ";
CM_ SG_ 370 FC_Obj13_Dx  " ";
CM_ SG_ 370 FC_Obj13_RelVy  " ";
CM_ SG_ 370 FC_Obj13_RelVx  " ";
CM_ SG_ 370 FC_Obj13_RelAy  " ";
CM_ SG_ 370 FC_Obj13_RelAx  " ";
CM_ SG_ 370 FC_Obj13_TypeProb  " ";
CM_ SG_ 370 FC_Obj13_Type  " ";
CM_ SG_ 370 FC_Obj13_Track_Age  " ";
CM_ SG_ 370 FC_Obj13_Track_ID  " ";

CM_ BO_ 371  " ";
CM_ SG_ 371 FC_Obj14WSInfoPosType  " ";
CM_ SG_ 371 FC_CRCCheck_173  " ";
CM_ SG_ 371 FC_RollingCounter_173  " ";
CM_ SG_ 371 FC_Obj14_Img2dBox_RightDown_V  " ";
CM_ SG_ 371 FC_Obj14_Img2dBox_LeftTop_V  " ";
CM_ SG_ 371 FC_Obj14_Img2dBox_RightDown_U  " ";
CM_ SG_ 371 FC_Obj14_Img2dBox_LeftTop_U  " ";
CM_ SG_ 371 FC_Obj14_TurnLight  " ";
CM_ SG_ 371 FC_Obj14_valid  "未收敛目标，输出invalid状态，输出valid状态，信号必须是可性的 ";
CM_ SG_ 371 FC_Obj14_Vy_Vnce  " ";
CM_ SG_ 371 FC_Obj14_Vx_Vnce  " ";
CM_ SG_ 371 FC_Obj14_CenterAngle  " ";
CM_ SG_ 371 FC_Obj14_DistInLane  " ";
CM_ SG_ 371 FC_Obj14_objCutInLane  " ";
CM_ SG_ 371 FC_Obj14_objCutInFlag  " ";
CM_ SG_ 371 FC_Obj14_CornerPoint_y  " ";
CM_ SG_ 371 FC_Obj14_CornerPoint_x  " ";
CM_ SG_ 371 FC_Obj14_LaneAssignment  " ";
CM_ SG_ 371 FC_Obj14_MotionType  " ";
CM_ SG_ 371 FC_obj14_Brakelight_Info  " ";
CM_ SG_ 371 FC_Obj14_Width  " ";
CM_ SG_ 371 FC_Obj14_Length  " ";
CM_ SG_ 371 FC_Obj14_Height  " ";
CM_ SG_ 371 FC_Obj14_HeadOrientation  " ";
CM_ SG_ 371 FC_Obj14_HeadingAngle  " ";
CM_ SG_ 371 FC_Obj14_ExistProb  " ";
CM_ SG_ 371 FC_Obj14_Dy_Vnce  " ";
CM_ SG_ 371 FC_Obj14_Dy  " ";
CM_ SG_ 371 FC_Obj14_Dx_Vnce  " ";
CM_ SG_ 371 FC_Obj14_Dx  " ";
CM_ SG_ 371 FC_Obj14_RelVy  " ";
CM_ SG_ 371 FC_Obj14_RelVx  " ";
CM_ SG_ 371 FC_Obj14_RelAy  " ";
CM_ SG_ 371 FC_Obj14_RelAx  " ";
CM_ SG_ 371 FC_Obj14_TypeProb  " ";
CM_ SG_ 371 FC_Obj14_Type  " ";
CM_ SG_ 371 FC_Obj14_Track_Age  " ";
CM_ SG_ 371 FC_Obj14_Track_ID  " ";

CM_ BO_ 372  " ";
CM_ SG_ 372 FC_Obj15WSInfoPosType  " ";
CM_ SG_ 372 FC_CRCCheck_174  " ";
CM_ SG_ 372 FC_RollingCounter_174  " ";
CM_ SG_ 372 FC_Obj15_Img2dBox_RightDown_V  " ";
CM_ SG_ 372 FC_Obj15_Img2dBox_LeftTop_V  " ";
CM_ SG_ 372 FC_Obj15_Img2dBox_RightDown_U  " ";
CM_ SG_ 372 FC_Obj15_Img2dBox_LeftTop_U  " ";
CM_ SG_ 372 FC_Obj15_TurnLight  " ";
CM_ SG_ 372 FC_Obj15_valid  "未收敛目标，输出invalid状态，输出valid状态，信号必须是可性的 ";
CM_ SG_ 372 FC_Obj15_Vy_Vnce  " ";
CM_ SG_ 372 FC_Obj15_Vx_Vnce  " ";
CM_ SG_ 372 FC_Obj15_CenterAngle  " ";
CM_ SG_ 372 FC_Obj15_DistInLane  " ";
CM_ SG_ 372 FC_Obj15_objCutInLane  " ";
CM_ SG_ 372 FC_Obj15_objCutInFlag  " ";
CM_ SG_ 372 FC_Obj15_CornerPoint_y  " ";
CM_ SG_ 372 FC_Obj15_CornerPoint_x  " ";
CM_ SG_ 372 FC_Obj15_LaneAssignment  " ";
CM_ SG_ 372 FC_Obj15_MotionType  " ";
CM_ SG_ 372 FC_obj15_Brakelight_Info  " ";
CM_ SG_ 372 FC_Obj15_Width  " ";
CM_ SG_ 372 FC_Obj15_Length  " ";
CM_ SG_ 372 FC_Obj15_Height  " ";
CM_ SG_ 372 FC_Obj15_HeadOrientation  " ";
CM_ SG_ 372 FC_Obj15_HeadingAngle  " ";
CM_ SG_ 372 FC_Obj15_ExistProb  " ";
CM_ SG_ 372 FC_Obj15_Dy_Vnce  " ";
CM_ SG_ 372 FC_Obj15_Dy  " ";
CM_ SG_ 372 FC_Obj15_Dx_Vnce  " ";
CM_ SG_ 372 FC_Obj15_Dx  " ";
CM_ SG_ 372 FC_Obj15_RelVy  " ";
CM_ SG_ 372 FC_Obj15_RelVx  " ";
CM_ SG_ 372 FC_Obj15_RelAy  " ";
CM_ SG_ 372 FC_Obj15_RelAx  " ";
CM_ SG_ 372 FC_Obj15_TypeProb  " ";
CM_ SG_ 372 FC_Obj15_Type  " ";
CM_ SG_ 372 FC_Obj15_Track_Age  " ";
CM_ SG_ 372 FC_Obj15_Track_ID  " ";

BA_DEF_ SG_  "GenSigStartValue" INT 0 0;
BA_DEF_ SG_  "GenSigInvalidValue" STRING  ;
BA_DEF_ SG_  "GenSigCycleTime" INT 0 0;
BA_DEF_ SG_  "GenSigSendType" ENUM  "Cyclic","OnWrite","OnWriteWithRepetition","OnChange","OnChangeWithRepetition","IfActive","IfActiveWithRepetition","NoSigSendType","NotUsed","NotUsed","NotUsed","NotUsed","NotUsed";
BA_DEF_ BO_  "GenMsgSendType" ENUM  "Cyclic","Event","NotUsed","NotUsed","NotUsed","Cyclic","NotUsed","IfActive","NoMsgSendType","NotUsed";
BA_DEF_ BO_  "GenMsgILSupport" ENUM  "No","Yes";
BA_DEF_ BO_  "GenMsgCycleTime" INT 0 65535;
BA_DEF_ BO_  "CANFD_BRS" ENUM  "0","1";
BA_DEF_ BO_  "VFrameFormat" ENUM  "StandardCAN","ExtendedCAN","reserved","reserved","reserved","reserved","reserved","reserved","reserved","reserved","reserved","reserved","reserved","reserved","StandardCAN_FD","ExtendedCAN_FD";
BA_DEF_DEF_  "GenSigStartValue" 0;
BA_DEF_DEF_  "GenSigInvalidValue" "/";
BA_DEF_DEF_  "GenSigCycleTime" 0;
BA_DEF_DEF_  "GenSigSendType" "Cyclic";
BA_DEF_DEF_  "GenMsgSendType" "NoMsgSendType";
BA_DEF_DEF_  "GenMsgILSupport" "Yes";
BA_DEF_DEF_  "GenMsgCycleTime" 0;
BA_DEF_DEF_  "CANFD_BRS" "1";
BA_DEF_DEF_  "VFrameFormat" "StandardCAN";
BA_ "GenMsgCycleTime" BO_ 288 70;
BA_ "GenMsgSendType" BO_ 288 0;
BA_ "VFrameFormat" BO_ 288 14;
BA_ "GenMsgCycleTime" BO_ 310 50;
BA_ "GenMsgSendType" BO_ 310 0;
BA_ "VFrameFormat" BO_ 310 14;
BA_ "GenMsgCycleTime" BO_ 312 70;
BA_ "GenMsgSendType" BO_ 312 0;
BA_ "VFrameFormat" BO_ 312 14;
BA_ "GenMsgCycleTime" BO_ 320 500;
BA_ "GenMsgSendType" BO_ 320 0;
BA_ "VFrameFormat" BO_ 320 14;
BA_ "GenMsgCycleTime" BO_ 336 30;
BA_ "GenMsgSendType" BO_ 336 0;
BA_ "VFrameFormat" BO_ 336 14;
BA_ "GenMsgCycleTime" BO_ 337 30;
BA_ "GenMsgSendType" BO_ 337 0;
BA_ "VFrameFormat" BO_ 337 14;
BA_ "GenMsgCycleTime" BO_ 338 30;
BA_ "GenMsgSendType" BO_ 338 0;
BA_ "VFrameFormat" BO_ 338 14;
BA_ "GenMsgCycleTime" BO_ 339 30;
BA_ "GenMsgSendType" BO_ 339 0;
BA_ "VFrameFormat" BO_ 339 14;
BA_ "GenMsgCycleTime" BO_ 340 30;
BA_ "GenMsgSendType" BO_ 340 0;
BA_ "VFrameFormat" BO_ 340 14;
BA_ "GenMsgCycleTime" BO_ 352 60;
BA_ "GenMsgSendType" BO_ 352 0;
BA_ "VFrameFormat" BO_ 352 14;
BA_ "GenMsgCycleTime" BO_ 353 60;
BA_ "GenMsgSendType" BO_ 353 0;
BA_ "VFrameFormat" BO_ 353 14;
BA_ "GenMsgCycleTime" BO_ 354 60;
BA_ "GenMsgSendType" BO_ 354 0;
BA_ "VFrameFormat" BO_ 354 14;
BA_ "GenMsgCycleTime" BO_ 355 60;
BA_ "GenMsgSendType" BO_ 355 0;
BA_ "VFrameFormat" BO_ 355 14;
BA_ "GenMsgCycleTime" BO_ 356 60;
BA_ "GenMsgSendType" BO_ 356 0;
BA_ "VFrameFormat" BO_ 356 14;
BA_ "GenMsgCycleTime" BO_ 357 60;
BA_ "GenMsgSendType" BO_ 357 0;
BA_ "VFrameFormat" BO_ 357 14;
BA_ "GenMsgCycleTime" BO_ 358 60;
BA_ "GenMsgSendType" BO_ 358 0;
BA_ "VFrameFormat" BO_ 358 14;
BA_ "GenMsgCycleTime" BO_ 359 60;
BA_ "GenMsgSendType" BO_ 359 0;
BA_ "VFrameFormat" BO_ 359 14;
BA_ "GenMsgCycleTime" BO_ 360 60;
BA_ "GenMsgSendType" BO_ 360 0;
BA_ "VFrameFormat" BO_ 360 14;
BA_ "GenMsgCycleTime" BO_ 361 60;
BA_ "GenMsgSendType" BO_ 361 0;
BA_ "VFrameFormat" BO_ 361 14;
BA_ "GenMsgCycleTime" BO_ 368 60;
BA_ "GenMsgSendType" BO_ 368 0;
BA_ "VFrameFormat" BO_ 368 14;
BA_ "GenMsgCycleTime" BO_ 369 60;
BA_ "GenMsgSendType" BO_ 369 0;
BA_ "VFrameFormat" BO_ 369 14;
BA_ "GenMsgCycleTime" BO_ 370 60;
BA_ "GenMsgSendType" BO_ 370 0;
BA_ "VFrameFormat" BO_ 370 14;
BA_ "GenMsgCycleTime" BO_ 371 60;
BA_ "GenMsgSendType" BO_ 371 0;
BA_ "VFrameFormat" BO_ 371 14;
BA_ "GenMsgCycleTime" BO_ 372 60;
BA_ "GenMsgSendType" BO_ 372 0;
BA_ "VFrameFormat" BO_ 372 14;

BA_ "GenSigCycleTime" SG_ 288 FR_CRCCheck_120 70;
BA_ "GenSigCycleTime" SG_ 288 FR_RollingCounter_120 70;
BA_ "GenSigCycleTime" SG_ 288 FR_OBJ32_HeightGround 70;
BA_ "GenSigCycleTime" SG_ 288 FR_OBJ32_MotionStatusConf 70;
BA_ "GenSigCycleTime" SG_ 288 FR_OBJ32_ClassConf 70;
BA_ "GenSigCycleTime" SG_ 288 FR_OBJ32_MotionStatus 70;
BA_ "GenSigCycleTime" SG_ 288 FR_OBJ32_Location 70;
BA_ "GenSigCycleTime" SG_ 288 FR_OBJ32_Measured 70;
BA_ "GenSigCycleTime" SG_ 288 FR_OBJ32_valid 70;
BA_ "GenSigCycleTime" SG_ 288 FR_OBJ32_Track_Age 70;
BA_ "GenSigCycleTime" SG_ 288 FR_OBJ32_Track_ID 70;
BA_ "GenSigInvalidValue" SG_ 288 FR_OBJ32_Track_ID "0";
BA_ "GenSigCycleTime" SG_ 288 FR_OBJ32_ObstacleProb 70;
BA_ "GenSigCycleTime" SG_ 288 FR_OBJ32_ExistProb 70;
BA_ "GenSigCycleTime" SG_ 288 FR_OBJ32_RelAx 70;
BA_ "GenSigCycleTime" SG_ 288 FR_OBJ32_RelAy 70;
BA_ "GenSigCycleTime" SG_ 288 FR_OBJ32_RelVx_std 70;
BA_ "GenSigInvalidValue" SG_ 288 FR_OBJ32_RelVx_std "4095";
BA_ "GenSigCycleTime" SG_ 288 FR_OBJ32_RelVx 70;
BA_ "GenSigCycleTime" SG_ 288 FR_OBJ32_RelVy_std 70;
BA_ "GenSigInvalidValue" SG_ 288 FR_OBJ32_RelVy_std "1023";
BA_ "GenSigCycleTime" SG_ 288 FR_OBJ32_RelVy 70;
BA_ "GenSigCycleTime" SG_ 288 FR_OBJ32_Dx_Vnce 70;
BA_ "GenSigInvalidValue" SG_ 288 FR_OBJ32_Dx_Vnce "16383";
BA_ "GenSigCycleTime" SG_ 288 FR_OBJ32_Dx 70;
BA_ "GenSigCycleTime" SG_ 288 FR_OBJ32_Dy_Vnce 70;
BA_ "GenSigInvalidValue" SG_ 288 FR_OBJ32_Dy_Vnce "1023";
BA_ "GenSigCycleTime" SG_ 288 FR_OBJ32_Dy 70;
BA_ "GenSigCycleTime" SG_ 288 FR_OBJ32_HeadingAngle 70;
BA_ "GenSigCycleTime" SG_ 288 FR_OBJ32_Length 70;
BA_ "GenSigCycleTime" SG_ 288 FR_OBJ32_Height 70;
BA_ "GenSigCycleTime" SG_ 288 FR_OBJ32_Width 70;
BA_ "GenSigCycleTime" SG_ 288 FR_OBJ32_Class 70;
BA_ "GenSigCycleTime" SG_ 288 FR_OBJ31_HeightGround 70;
BA_ "GenSigCycleTime" SG_ 288 FR_OBJ31_MotionStatusConf 70;
BA_ "GenSigCycleTime" SG_ 288 FR_OBJ31_ClassConf 70;
BA_ "GenSigCycleTime" SG_ 288 FR_OBJ31_MotionStatus 70;
BA_ "GenSigCycleTime" SG_ 288 FR_OBJ31_Location 70;
BA_ "GenSigCycleTime" SG_ 288 FR_OBJ31_Measured 70;
BA_ "GenSigCycleTime" SG_ 288 FR_Obj31_valid 70;
BA_ "GenSigCycleTime" SG_ 288 FR_OBJ31_Track_Age 70;
BA_ "GenSigCycleTime" SG_ 288 FR_OBJ31_Track_ID 70;
BA_ "GenSigInvalidValue" SG_ 288 FR_OBJ31_Track_ID "0";
BA_ "GenSigCycleTime" SG_ 288 FR_OBJ31_ObstacleProb 70;
BA_ "GenSigCycleTime" SG_ 288 FR_OBJ31_ExistProb 70;
BA_ "GenSigCycleTime" SG_ 288 FR_OBJ31_RelAx 70;
BA_ "GenSigCycleTime" SG_ 288 FR_OBJ31_RelAy 70;
BA_ "GenSigCycleTime" SG_ 288 FR_OBJ31_RelVx_std 70;
BA_ "GenSigInvalidValue" SG_ 288 FR_OBJ31_RelVx_std "4095";
BA_ "GenSigCycleTime" SG_ 288 FR_OBJ31_RelVx 70;
BA_ "GenSigCycleTime" SG_ 288 FR_OBJ31_RelVy_std 70;
BA_ "GenSigInvalidValue" SG_ 288 FR_OBJ31_RelVy_std "1023";
BA_ "GenSigCycleTime" SG_ 288 FR_OBJ31_RelVy 70;
BA_ "GenSigCycleTime" SG_ 288 FR_OBJ31_Dx_Vnce 70;
BA_ "GenSigInvalidValue" SG_ 288 FR_OBJ31_Dx_Vnce "16383";
BA_ "GenSigCycleTime" SG_ 288 FR_OBJ31_Dx 70;
BA_ "GenSigCycleTime" SG_ 288 FR_OBJ31_Dy_Vnce 70;
BA_ "GenSigInvalidValue" SG_ 288 FR_OBJ31_Dy_Vnce "1023";
BA_ "GenSigCycleTime" SG_ 288 FR_OBJ31_Dy 70;
BA_ "GenSigCycleTime" SG_ 288 FR_OBJ31_HeadingAngle 70;
BA_ "GenSigCycleTime" SG_ 288 FR_OBJ31_Length 70;
BA_ "GenSigCycleTime" SG_ 288 FR_OBJ31_Height 70;
BA_ "GenSigCycleTime" SG_ 288 FR_OBJ31_Width 70;
BA_ "GenSigCycleTime" SG_ 288 FR_OBJ31_Class 70;

BA_ "GenSigCycleTime" SG_ 310 FR_CRCCheck_136 50;
BA_ "GenSigCycleTime" SG_ 310 FR_RollingCounter_136 50;
BA_ "GenSigCycleTime" SG_ 310 FR_FrameCount 50;
BA_ "GenSigCycleTime" SG_ 310 FR_MisAlignment 50;
BA_ "GenSigCycleTime" SG_ 310 FR_WorkMode 50;
BA_ "GenSigCycleTime" SG_ 310 FR_RadarFailureStatus 50;
BA_ "GenSigInvalidValue" SG_ 310 FR_RadarFailureStatus "7";
BA_ "GenSigCycleTime" SG_ 310 FR_FRadarCalibrationStatus 50;
BA_ "GenSigInvalidValue" SG_ 310 FR_FRadarCalibrationStatus "3";
BA_ "GenSigCycleTime" SG_ 310 FR_Frametime 50;
BA_ "GenSigCycleTime" SG_ 310 FR_ObjCount 50;

BA_ "GenSigCycleTime" SG_ 312 ADC_CRCCheck_138 70;
BA_ "GenSigCycleTime" SG_ 312 ADC_RollingCounter_138 70;
BA_ "GenSigCycleTime" SG_ 312 DiffTime_Time_uS 70;
BA_ "GenSigCycleTime" SG_ 312 FR_TiOut 70;
BA_ "GenSigCycleTime" SG_ 312 FR_TiLeap 70;
BA_ "GenSigCycleTime" SG_ 312 FR_TiBas 70;
BA_ "GenSigCycleTime" SG_ 312 FR_TiStamp 70;

BA_ "GenSigCycleTime" SG_ 320 FR_DTC2_Status 500;
BA_ "GenSigCycleTime" SG_ 320 FR_DTC2_LowByte 500;
BA_ "GenSigCycleTime" SG_ 320 FR_DTC2_MiddByte 500;
BA_ "GenSigCycleTime" SG_ 320 FR_DTC2_HighByte 500;
BA_ "GenSigCycleTime" SG_ 320 FR_DTC1_Status 500;
BA_ "GenSigCycleTime" SG_ 320 FR_DTC1_LowByte 500;
BA_ "GenSigCycleTime" SG_ 320 FR_DTC1_MiddByte 500;
BA_ "GenSigCycleTime" SG_ 320 FR_DTC1_HighByte 500;

BA_ "GenSigCycleTime" SG_ 336 FC_CRCCheck_150 30;
BA_ "GenSigCycleTime" SG_ 336 FC_RollingCounter_150 30;
BA_ "GenSigCycleTime" SG_ 336 FC_Line_2_exist_prob 30;
BA_ "GenSigCycleTime" SG_ 336 FC_Line_2_RMSE 30;
BA_ "GenSigCycleTime" SG_ 336 FC_Line_2_ParseConf 30;
BA_ "GenSigCycleTime" SG_ 336 FC_Line_2_MeasureType 30;
BA_ "GenSigCycleTime" SG_ 336 FC_Line_2_ModelC3 30;
BA_ "GenSigStartValue" SG_ 336 FC_Line_2_ModelC3 2048.000000;
BA_ "GenSigCycleTime" SG_ 336 FC_Line_2_ModelC2 30;
BA_ "GenSigStartValue" SG_ 336 FC_Line_2_ModelC2 12288.000000;
BA_ "GenSigCycleTime" SG_ 336 FC_Line_2_ModelC1 30;
BA_ "GenSigStartValue" SG_ 336 FC_Line_2_ModelC1 3277.000000;
BA_ "GenSigCycleTime" SG_ 336 FC_Line_2_ModelC0 30;
BA_ "GenSigCycleTime" SG_ 336 FC_Line_2_dx_End 30;
BA_ "GenSigCycleTime" SG_ 336 FC_Line_2_dx_Start 30;
BA_ "GenSigCycleTime" SG_ 336 FC_Line_2_Width 30;
BA_ "GenSigCycleTime" SG_ 336 FC_Line_2_color 30;
BA_ "GenSigCycleTime" SG_ 336 FC_Line_2_Id 30;
BA_ "GenSigStartValue" SG_ 336 FC_Line_2_Id 1.000000;
BA_ "GenSigCycleTime" SG_ 336 FC_Line_2_TypeConfidence 30;
BA_ "GenSigCycleTime" SG_ 336 FC_Line_2_Type 30;
BA_ "GenSigCycleTime" SG_ 336 FC_Line_1_exist_prob 30;
BA_ "GenSigCycleTime" SG_ 336 FC_Line_1_RMSE 30;
BA_ "GenSigCycleTime" SG_ 336 FC_Line_1_ParseConf 30;
BA_ "GenSigCycleTime" SG_ 336 FC_Line_1_MeasureType 30;
BA_ "GenSigCycleTime" SG_ 336 FC_Line_1_ModelC3 30;
BA_ "GenSigStartValue" SG_ 336 FC_Line_1_ModelC3 2048.000000;
BA_ "GenSigCycleTime" SG_ 336 FC_Line_1_ModelC2 30;
BA_ "GenSigStartValue" SG_ 336 FC_Line_1_ModelC2 12288.000000;
BA_ "GenSigCycleTime" SG_ 336 FC_Line_1_ModelC1 30;
BA_ "GenSigStartValue" SG_ 336 FC_Line_1_ModelC1 3277.000000;
BA_ "GenSigCycleTime" SG_ 336 FC_Line_1_ModelC0 30;
BA_ "GenSigCycleTime" SG_ 336 FC_Line_1_dx_End 30;
BA_ "GenSigCycleTime" SG_ 336 FC_Line_1_dx_Start 30;
BA_ "GenSigCycleTime" SG_ 336 FC_Line_1_Width 30;
BA_ "GenSigCycleTime" SG_ 336 FC_Line_1_color 30;
BA_ "GenSigCycleTime" SG_ 336 FC_Line_1_Id 30;
BA_ "GenSigStartValue" SG_ 336 FC_Line_1_Id 1.000000;
BA_ "GenSigCycleTime" SG_ 336 FC_Line_1_TypeConfidence 30;
BA_ "GenSigCycleTime" SG_ 336 FC_Line_1_Type 30;

BA_ "GenSigCycleTime" SG_ 337 FC_CRCCheck_151 30;
BA_ "GenSigCycleTime" SG_ 337 FC_RollingCounter_151 30;
BA_ "GenSigCycleTime" SG_ 337 FC_Line_4_exist_prob 30;
BA_ "GenSigCycleTime" SG_ 337 FC_Line_4_RMSE 30;
BA_ "GenSigCycleTime" SG_ 337 FC_Line_4_ParseConf 30;
BA_ "GenSigCycleTime" SG_ 337 FC_Line_4_MeasureType 30;
BA_ "GenSigCycleTime" SG_ 337 FC_Line_4_ModelC3 30;
BA_ "GenSigStartValue" SG_ 337 FC_Line_4_ModelC3 2048.000000;
BA_ "GenSigCycleTime" SG_ 337 FC_Line_4_ModelC2 30;
BA_ "GenSigStartValue" SG_ 337 FC_Line_4_ModelC2 12288.000000;
BA_ "GenSigCycleTime" SG_ 337 FC_Line_4_ModelC1 30;
BA_ "GenSigStartValue" SG_ 337 FC_Line_4_ModelC1 3277.000000;
BA_ "GenSigCycleTime" SG_ 337 FC_Line_4_ModelC0 30;
BA_ "GenSigCycleTime" SG_ 337 FC_Line_4_dx_End 30;
BA_ "GenSigCycleTime" SG_ 337 FC_Line_4_dx_Start 30;
BA_ "GenSigCycleTime" SG_ 337 FC_Line_4_Width 30;
BA_ "GenSigCycleTime" SG_ 337 FC_Line_4_color 30;
BA_ "GenSigCycleTime" SG_ 337 FC_Line_4_Id 30;
BA_ "GenSigStartValue" SG_ 337 FC_Line_4_Id 1.000000;
BA_ "GenSigCycleTime" SG_ 337 FC_Line_4_TypeConfidence 30;
BA_ "GenSigCycleTime" SG_ 337 FC_Line_4_Type 30;
BA_ "GenSigCycleTime" SG_ 337 FC_Line_3_exist_prob 30;
BA_ "GenSigCycleTime" SG_ 337 FC_Line_3_RMSE 30;
BA_ "GenSigCycleTime" SG_ 337 FC_Line_3_ParseConf 30;
BA_ "GenSigCycleTime" SG_ 337 FC_Line_3_MeasureType 30;
BA_ "GenSigCycleTime" SG_ 337 FC_Line_3_ModelC3 30;
BA_ "GenSigStartValue" SG_ 337 FC_Line_3_ModelC3 2048.000000;
BA_ "GenSigCycleTime" SG_ 337 FC_Line_3_ModelC2 30;
BA_ "GenSigStartValue" SG_ 337 FC_Line_3_ModelC2 12288.000000;
BA_ "GenSigCycleTime" SG_ 337 FC_Line_3_ModelC1 30;
BA_ "GenSigStartValue" SG_ 337 FC_Line_3_ModelC1 3277.000000;
BA_ "GenSigCycleTime" SG_ 337 FC_Line_3_ModelC0 30;
BA_ "GenSigCycleTime" SG_ 337 FC_Line_3_dx_End 30;
BA_ "GenSigCycleTime" SG_ 337 FC_Line_3_dx_Start 30;
BA_ "GenSigCycleTime" SG_ 337 FC_Line_3_Width 30;
BA_ "GenSigCycleTime" SG_ 337 FC_Line_3_color 30;
BA_ "GenSigCycleTime" SG_ 337 FC_Line_3_Id 30;
BA_ "GenSigStartValue" SG_ 337 FC_Line_3_Id 1.000000;
BA_ "GenSigCycleTime" SG_ 337 FC_Line_3_TypeConfidence 30;
BA_ "GenSigCycleTime" SG_ 337 FC_Line_3_Type 30;

BA_ "GenSigCycleTime" SG_ 338 FC_CRCCheck_152 30;
BA_ "GenSigCycleTime" SG_ 338 FC_RollingCounter_152 30;
BA_ "GenSigCycleTime" SG_ 338 FC_Line_6_exist_prob 30;
BA_ "GenSigCycleTime" SG_ 338 FC_Line_6_RMSE 30;
BA_ "GenSigCycleTime" SG_ 338 FC_Line_6_ParseConf 30;
BA_ "GenSigCycleTime" SG_ 338 FC_Line_6_MeasureType 30;
BA_ "GenSigCycleTime" SG_ 338 FC_Line_6_ModelC3 30;
BA_ "GenSigStartValue" SG_ 338 FC_Line_6_ModelC3 2048.000000;
BA_ "GenSigCycleTime" SG_ 338 FC_Line_6_ModelC2 30;
BA_ "GenSigStartValue" SG_ 338 FC_Line_6_ModelC2 12288.000000;
BA_ "GenSigCycleTime" SG_ 338 FC_Line_6_ModelC1 30;
BA_ "GenSigStartValue" SG_ 338 FC_Line_6_ModelC1 3277.000000;
BA_ "GenSigCycleTime" SG_ 338 FC_Line_6_ModelC0 30;
BA_ "GenSigCycleTime" SG_ 338 FC_Line_6_dx_End 30;
BA_ "GenSigCycleTime" SG_ 338 FC_Line_6_dx_Start 30;
BA_ "GenSigCycleTime" SG_ 338 FC_Line_6_Width 30;
BA_ "GenSigCycleTime" SG_ 338 FC_Line_6_color 30;
BA_ "GenSigCycleTime" SG_ 338 FC_Line_6_Id 30;
BA_ "GenSigStartValue" SG_ 338 FC_Line_6_Id 1.000000;
BA_ "GenSigCycleTime" SG_ 338 FC_Line_6_TypeConfidence 30;
BA_ "GenSigCycleTime" SG_ 338 FC_Line_6_Type 30;
BA_ "GenSigCycleTime" SG_ 338 FC_Line_5_exist_prob 30;
BA_ "GenSigCycleTime" SG_ 338 FC_Line_5_RMSE 30;
BA_ "GenSigCycleTime" SG_ 338 FC_Line_5_ParseConf 30;
BA_ "GenSigCycleTime" SG_ 338 FC_Line_5_MeasureType 30;
BA_ "GenSigCycleTime" SG_ 338 FC_Line_5_ModelC3 30;
BA_ "GenSigStartValue" SG_ 338 FC_Line_5_ModelC3 2048.000000;
BA_ "GenSigCycleTime" SG_ 338 FC_Line_5_ModelC2 30;
BA_ "GenSigStartValue" SG_ 338 FC_Line_5_ModelC2 12288.000000;
BA_ "GenSigCycleTime" SG_ 338 FC_Line_5_ModelC1 30;
BA_ "GenSigStartValue" SG_ 338 FC_Line_5_ModelC1 3277.000000;
BA_ "GenSigCycleTime" SG_ 338 FC_Line_5_ModelC0 30;
BA_ "GenSigCycleTime" SG_ 338 FC_Line_5_dx_End 30;
BA_ "GenSigCycleTime" SG_ 338 FC_Line_5_dx_Start 30;
BA_ "GenSigCycleTime" SG_ 338 FC_Line_5_Width 30;
BA_ "GenSigCycleTime" SG_ 338 FC_Line_5_color 30;
BA_ "GenSigCycleTime" SG_ 338 FC_Line_5_Id 30;
BA_ "GenSigStartValue" SG_ 338 FC_Line_5_Id 1.000000;
BA_ "GenSigCycleTime" SG_ 338 FC_Line_5_TypeConfidence 30;
BA_ "GenSigCycleTime" SG_ 338 FC_Line_5_Type 30;

BA_ "GenSigCycleTime" SG_ 339 FC_CRCCheck_153 30;
BA_ "GenSigCycleTime" SG_ 339 FC_RollingCounter_153 30;
BA_ "GenSigCycleTime" SG_ 339 FC_Line_8_exist_prob 30;
BA_ "GenSigCycleTime" SG_ 339 FC_Line_8_RMSE 30;
BA_ "GenSigCycleTime" SG_ 339 FC_Line_8_ParseConf 30;
BA_ "GenSigCycleTime" SG_ 339 FC_Line_8_MeasureType 30;
BA_ "GenSigCycleTime" SG_ 339 FC_Line_8_ModelC3 30;
BA_ "GenSigStartValue" SG_ 339 FC_Line_8_ModelC3 2048.000000;
BA_ "GenSigCycleTime" SG_ 339 FC_Line_8_ModelC2 30;
BA_ "GenSigStartValue" SG_ 339 FC_Line_8_ModelC2 12288.000000;
BA_ "GenSigCycleTime" SG_ 339 FC_Line_8_ModelC1 30;
BA_ "GenSigStartValue" SG_ 339 FC_Line_8_ModelC1 3277.000000;
BA_ "GenSigCycleTime" SG_ 339 FC_Line_8_ModelC0 30;
BA_ "GenSigCycleTime" SG_ 339 FC_Line_8_dx_End 30;
BA_ "GenSigCycleTime" SG_ 339 FC_Line_8_dx_Start 30;
BA_ "GenSigCycleTime" SG_ 339 FC_Line_8_Width 30;
BA_ "GenSigCycleTime" SG_ 339 FC_Line_8_color 30;
BA_ "GenSigCycleTime" SG_ 339 FC_Line_8_Id 30;
BA_ "GenSigStartValue" SG_ 339 FC_Line_8_Id 1.000000;
BA_ "GenSigCycleTime" SG_ 339 FC_Line_8_TypeConfidence 30;
BA_ "GenSigCycleTime" SG_ 339 FC_Line_8_Type 30;
BA_ "GenSigCycleTime" SG_ 339 FC_Line_7_exist_prob 30;
BA_ "GenSigCycleTime" SG_ 339 FC_Line_7_RMSE 30;
BA_ "GenSigCycleTime" SG_ 339 FC_Line_7_ParseConf 30;
BA_ "GenSigCycleTime" SG_ 339 FC_Line_7_MeasureType 30;
BA_ "GenSigCycleTime" SG_ 339 FC_Line_7_ModelC3 30;
BA_ "GenSigStartValue" SG_ 339 FC_Line_7_ModelC3 2048.000000;
BA_ "GenSigCycleTime" SG_ 339 FC_Line_7_ModelC2 30;
BA_ "GenSigStartValue" SG_ 339 FC_Line_7_ModelC2 12288.000000;
BA_ "GenSigCycleTime" SG_ 339 FC_Line_7_ModelC1 30;
BA_ "GenSigStartValue" SG_ 339 FC_Line_7_ModelC1 3277.000000;
BA_ "GenSigCycleTime" SG_ 339 FC_Line_7_ModelC0 30;
BA_ "GenSigCycleTime" SG_ 339 FC_Line_7_dx_End 30;
BA_ "GenSigCycleTime" SG_ 339 FC_Line_7_dx_Start 30;
BA_ "GenSigCycleTime" SG_ 339 FC_Line_7_Width 30;
BA_ "GenSigCycleTime" SG_ 339 FC_Line_7_color 30;
BA_ "GenSigCycleTime" SG_ 339 FC_Line_7_Id 30;
BA_ "GenSigStartValue" SG_ 339 FC_Line_7_Id 1.000000;
BA_ "GenSigCycleTime" SG_ 339 FC_Line_7_TypeConfidence 30;
BA_ "GenSigCycleTime" SG_ 339 FC_Line_7_Type 30;

BA_ "GenSigCycleTime" SG_ 340 FC_CRCCheck_154 30;
BA_ "GenSigCycleTime" SG_ 340 FC_RollingCounter_154 30;
BA_ "GenSigCycleTime" SG_ 340 FC_LineMCUTiStamp 30;
BA_ "GenSigCycleTime" SG_ 340 FC_LineTiOut 30;
BA_ "GenSigCycleTime" SG_ 340 FC_LineTiLeap 30;
BA_ "GenSigCycleTime" SG_ 340 FC_LineTiBas 30;
BA_ "GenSigCycleTime" SG_ 340 FC_LineTiStamp 30;
BA_ "GenSigCycleTime" SG_ 340 FC_WeatherType 30;
BA_ "GenSigInvalidValue" SG_ 340 FC_WeatherType "15";
BA_ "GenSigCycleTime" SG_ 340 FC_RCrossPiont_StartEnd 30;
BA_ "GenSigCycleTime" SG_ 340 FC_RCrossPiont_DivMer 30;
BA_ "GenSigCycleTime" SG_ 340 FC_RCrossPiont_ExistProb 30;
BA_ "GenSigCycleTime" SG_ 340 FC_RCrossPiont_Dy 30;
BA_ "GenSigStartValue" SG_ 340 FC_RCrossPiont_Dy 500.000000;
BA_ "GenSigCycleTime" SG_ 340 FC_RCrossPoint_DX 30;
BA_ "GenSigCycleTime" SG_ 340 FC_LCrossPiont_StartEnd 30;
BA_ "GenSigCycleTime" SG_ 340 FC_LCrossPiont_DivMer 30;
BA_ "GenSigCycleTime" SG_ 340 FC_LCrossPiont_ExistProb 30;
BA_ "GenSigCycleTime" SG_ 340 FC_LCrossPiont_Dy 30;
BA_ "GenSigStartValue" SG_ 340 FC_LCrossPiont_Dy 500.000000;
BA_ "GenSigCycleTime" SG_ 340 FC_LCrossPoint_DX 30;

BA_ "GenSigCycleTime" SG_ 352 FC_Obj1WSInfoPosType 60;
BA_ "GenSigCycleTime" SG_ 352 FC_CRCCheck_160 60;
BA_ "GenSigCycleTime" SG_ 352 FC_RollingCounter_160 60;
BA_ "GenSigCycleTime" SG_ 352 FC_Obj1_Img2dBox_RightDown_V 60;
BA_ "GenSigCycleTime" SG_ 352 FC_Obj1_Img2dBox_LeftTop_V 60;
BA_ "GenSigCycleTime" SG_ 352 FC_Obj1_Img2dBox_RightDown_U 60;
BA_ "GenSigCycleTime" SG_ 352 FC_Obj1_Img2dBox_LeftTop_U 60;
BA_ "GenSigCycleTime" SG_ 352 FC_Obj1_TurnLight 60;
BA_ "GenSigCycleTime" SG_ 352 FC_Obj1_valid 60;
BA_ "GenSigCycleTime" SG_ 352 FC_Obj1_Vy_Vnce 60;
BA_ "GenSigCycleTime" SG_ 352 FC_Obj1_Vx_Vnce 60;
BA_ "GenSigCycleTime" SG_ 352 FC_Obj1_CenterAngle 60;
BA_ "GenSigCycleTime" SG_ 352 FC_Obj1_DistInLane 60;
BA_ "GenSigCycleTime" SG_ 352 FC_Obj1_objCutInLane 60;
BA_ "GenSigCycleTime" SG_ 352 FC_Obj1_objCutInFlag 60;
BA_ "GenSigCycleTime" SG_ 352 FC_Obj1_CornerPoint_y 60;
BA_ "GenSigCycleTime" SG_ 352 FC_Obj1_CornerPoint_x 60;
BA_ "GenSigCycleTime" SG_ 352 FC_Obj1_LaneAssignment 60;
BA_ "GenSigCycleTime" SG_ 352 FC_Obj1_MotionType 60;
BA_ "GenSigCycleTime" SG_ 352 FC_obj1_Brakelight_Info 60;
BA_ "GenSigCycleTime" SG_ 352 FC_Obj1_Width 60;
BA_ "GenSigCycleTime" SG_ 352 FC_Obj1_Length 60;
BA_ "GenSigCycleTime" SG_ 352 FC_Obj1_Height 60;
BA_ "GenSigCycleTime" SG_ 352 FC_Obj1_HeadOrientation 60;
BA_ "GenSigCycleTime" SG_ 352 FC_Obj1_HeadingAngle 60;
BA_ "GenSigCycleTime" SG_ 352 FC_Obj1_ExistProb 60;
BA_ "GenSigCycleTime" SG_ 352 FC_Obj1_Dy_Vnce 60;
BA_ "GenSigCycleTime" SG_ 352 FC_Obj1_Dy 60;
BA_ "GenSigCycleTime" SG_ 352 FC_Obj1_Dx_Vnce 60;
BA_ "GenSigCycleTime" SG_ 352 FC_Obj1_Dx 60;
BA_ "GenSigCycleTime" SG_ 352 FC_Obj1_RelVy 60;
BA_ "GenSigCycleTime" SG_ 352 FC_Obj1_RelVx 60;
BA_ "GenSigCycleTime" SG_ 352 FC_Obj1_RelAy 60;
BA_ "GenSigCycleTime" SG_ 352 FC_Obj1_RelAx 60;
BA_ "GenSigCycleTime" SG_ 352 FC_Obj1_TypeProb 60;
BA_ "GenSigCycleTime" SG_ 352 FC_Obj1_Type 60;
BA_ "GenSigCycleTime" SG_ 352 FC_Obj1_Track_Age 60;
BA_ "GenSigCycleTime" SG_ 352 FC_Obj1_Track_ID 60;

BA_ "GenSigCycleTime" SG_ 353 FC_Obj2WSInfoPosType 60;
BA_ "GenSigCycleTime" SG_ 353 FC_CRCCheck_161 60;
BA_ "GenSigCycleTime" SG_ 353 FC_RollingCounter_161 60;
BA_ "GenSigCycleTime" SG_ 353 FC_Obj2_Img2dBox_RightDown_V 60;
BA_ "GenSigCycleTime" SG_ 353 FC_Obj2_Img2dBox_LeftTop_V 60;
BA_ "GenSigCycleTime" SG_ 353 FC_Obj2_Img2dBox_RightDown_U 60;
BA_ "GenSigCycleTime" SG_ 353 FC_Obj2_Img2dBox_LeftTop_U 60;
BA_ "GenSigCycleTime" SG_ 353 FC_Obj2_TurnLight 60;
BA_ "GenSigCycleTime" SG_ 353 FC_Obj2_valid 60;
BA_ "GenSigCycleTime" SG_ 353 FC_Obj2_Vy_Vnce 60;
BA_ "GenSigCycleTime" SG_ 353 FC_Obj2_Vx_Vnce 60;
BA_ "GenSigCycleTime" SG_ 353 FC_Obj2_CenterAngle 60;
BA_ "GenSigCycleTime" SG_ 353 FC_Obj2_DistInLane 60;
BA_ "GenSigCycleTime" SG_ 353 FC_Obj2_objCutInLane 60;
BA_ "GenSigCycleTime" SG_ 353 FC_Obj2_objCutInFlag 60;
BA_ "GenSigCycleTime" SG_ 353 FC_Obj2_CornerPoint_y 60;
BA_ "GenSigCycleTime" SG_ 353 FC_Obj2_CornerPoint_x 60;
BA_ "GenSigCycleTime" SG_ 353 FC_Obj2_LaneAssignment 60;
BA_ "GenSigCycleTime" SG_ 353 FC_Obj2_MotionType 60;
BA_ "GenSigCycleTime" SG_ 353 FC_obj2_Brakelight_Info 60;
BA_ "GenSigCycleTime" SG_ 353 FC_Obj2_Width 60;
BA_ "GenSigCycleTime" SG_ 353 FC_Obj2_Length 60;
BA_ "GenSigCycleTime" SG_ 353 FC_Obj2_Height 60;
BA_ "GenSigCycleTime" SG_ 353 FC_Obj2_HeadOrientation 60;
BA_ "GenSigCycleTime" SG_ 353 FC_Obj2_HeadingAngle 60;
BA_ "GenSigCycleTime" SG_ 353 FC_Obj2_ExistProb 60;
BA_ "GenSigCycleTime" SG_ 353 FC_Obj2_Dy_Vnce 60;
BA_ "GenSigCycleTime" SG_ 353 FC_Obj2_Dy 60;
BA_ "GenSigCycleTime" SG_ 353 FC_Obj2_Dx_Vnce 60;
BA_ "GenSigCycleTime" SG_ 353 FC_Obj2_Dx 60;
BA_ "GenSigCycleTime" SG_ 353 FC_Obj2_RelVy 60;
BA_ "GenSigCycleTime" SG_ 353 FC_Obj2_RelVx 60;
BA_ "GenSigCycleTime" SG_ 353 FC_Obj2_RelAy 60;
BA_ "GenSigCycleTime" SG_ 353 FC_Obj2_RelAx 60;
BA_ "GenSigCycleTime" SG_ 353 FC_Obj2_TypeProb 60;
BA_ "GenSigCycleTime" SG_ 353 FC_Obj2_Type 60;
BA_ "GenSigCycleTime" SG_ 353 FC_Obj2_Track_Age 60;
BA_ "GenSigCycleTime" SG_ 353 FC_Obj2_Track_ID 60;

BA_ "GenSigCycleTime" SG_ 354 FC_Obj3WSInfoPosType 60;
BA_ "GenSigCycleTime" SG_ 354 FC_CRCCheck_162 60;
BA_ "GenSigCycleTime" SG_ 354 FC_RollingCounter_162 60;
BA_ "GenSigCycleTime" SG_ 354 FC_Obj3_Img2dBox_RightDown_V 60;
BA_ "GenSigCycleTime" SG_ 354 FC_Obj3_Img2dBox_LeftTop_V 60;
BA_ "GenSigCycleTime" SG_ 354 FC_Obj3_Img2dBox_RightDown_U 60;
BA_ "GenSigCycleTime" SG_ 354 FC_Obj3_Img2dBox_LeftTop_U 60;
BA_ "GenSigCycleTime" SG_ 354 FC_Obj3_TurnLight 60;
BA_ "GenSigCycleTime" SG_ 354 FC_Obj3_valid 60;
BA_ "GenSigCycleTime" SG_ 354 FC_Obj3_Vy_Vnce 60;
BA_ "GenSigCycleTime" SG_ 354 FC_Obj3_Vx_Vnce 60;
BA_ "GenSigCycleTime" SG_ 354 FC_Obj3_CenterAngle 60;
BA_ "GenSigCycleTime" SG_ 354 FC_Obj3_DistInLane 60;
BA_ "GenSigCycleTime" SG_ 354 FC_Obj3_objCutInLane 60;
BA_ "GenSigCycleTime" SG_ 354 FC_Obj3_objCutInFlag 60;
BA_ "GenSigCycleTime" SG_ 354 FC_Obj3_CornerPoint_y 60;
BA_ "GenSigCycleTime" SG_ 354 FC_Obj3_CornerPoint_x 60;
BA_ "GenSigCycleTime" SG_ 354 FC_Obj3_LaneAssignment 60;
BA_ "GenSigCycleTime" SG_ 354 FC_Obj3_MotionType 60;
BA_ "GenSigCycleTime" SG_ 354 FC_obj3_Brakelight_Info 60;
BA_ "GenSigCycleTime" SG_ 354 FC_Obj3_Width 60;
BA_ "GenSigCycleTime" SG_ 354 FC_Obj3_Length 60;
BA_ "GenSigCycleTime" SG_ 354 FC_Obj3_Height 60;
BA_ "GenSigCycleTime" SG_ 354 FC_Obj3_HeadOrientation 60;
BA_ "GenSigCycleTime" SG_ 354 FC_Obj3_HeadingAngle 60;
BA_ "GenSigCycleTime" SG_ 354 FC_Obj3_ExistProb 60;
BA_ "GenSigCycleTime" SG_ 354 FC_Obj3_Dy_Vnce 60;
BA_ "GenSigCycleTime" SG_ 354 FC_Obj3_Dy 60;
BA_ "GenSigCycleTime" SG_ 354 FC_Obj3_Dx_Vnce 60;
BA_ "GenSigCycleTime" SG_ 354 FC_Obj3_Dx 60;
BA_ "GenSigCycleTime" SG_ 354 FC_Obj3_RelVy 60;
BA_ "GenSigCycleTime" SG_ 354 FC_Obj3_RelVx 60;
BA_ "GenSigCycleTime" SG_ 354 FC_Obj3_RelAy 60;
BA_ "GenSigCycleTime" SG_ 354 FC_Obj3_RelAx 60;
BA_ "GenSigCycleTime" SG_ 354 FC_Obj3_TypeProb 60;
BA_ "GenSigCycleTime" SG_ 354 FC_Obj3_Type 60;
BA_ "GenSigCycleTime" SG_ 354 FC_Obj3_Track_Age 60;
BA_ "GenSigCycleTime" SG_ 354 FC_Obj3_Track_ID 60;

BA_ "GenSigCycleTime" SG_ 355 FC_Obj4WSInfoPosType 60;
BA_ "GenSigCycleTime" SG_ 355 FC_CRCCheck_163 60;
BA_ "GenSigCycleTime" SG_ 355 FC_RollingCounter_163 60;
BA_ "GenSigCycleTime" SG_ 355 FC_Obj4_Img2dBox_RightDown_V 60;
BA_ "GenSigCycleTime" SG_ 355 FC_Obj4_Img2dBox_LeftTop_V 60;
BA_ "GenSigCycleTime" SG_ 355 FC_Obj4_Img2dBox_RightDown_U 60;
BA_ "GenSigCycleTime" SG_ 355 FC_Obj4_Img2dBox_LeftTop_U 60;
BA_ "GenSigCycleTime" SG_ 355 FC_Obj4_TurnLight 60;
BA_ "GenSigCycleTime" SG_ 355 FC_Obj4_valid 60;
BA_ "GenSigCycleTime" SG_ 355 FC_Obj4_Vy_Vnce 60;
BA_ "GenSigCycleTime" SG_ 355 FC_Obj4_Vx_Vnce 60;
BA_ "GenSigCycleTime" SG_ 355 FC_Obj4_CenterAngle 60;
BA_ "GenSigCycleTime" SG_ 355 FC_Obj4_DistInLane 60;
BA_ "GenSigCycleTime" SG_ 355 FC_Obj4_objCutInLane 60;
BA_ "GenSigCycleTime" SG_ 355 FC_Obj4_objCutInFlag 60;
BA_ "GenSigCycleTime" SG_ 355 FC_Obj4_CornerPoint_y 60;
BA_ "GenSigCycleTime" SG_ 355 FC_Obj4_CornerPoint_x 60;
BA_ "GenSigCycleTime" SG_ 355 FC_Obj4_LaneAssignment 60;
BA_ "GenSigCycleTime" SG_ 355 FC_Obj4_MotionType 60;
BA_ "GenSigCycleTime" SG_ 355 FC_obj4_Brakelight_Info 60;
BA_ "GenSigCycleTime" SG_ 355 FC_Obj4_Width 60;
BA_ "GenSigCycleTime" SG_ 355 FC_Obj4_Length 60;
BA_ "GenSigCycleTime" SG_ 355 FC_Obj4_Height 60;
BA_ "GenSigCycleTime" SG_ 355 FC_Obj4_HeadOrientation 60;
BA_ "GenSigCycleTime" SG_ 355 FC_Obj4_HeadingAngle 60;
BA_ "GenSigCycleTime" SG_ 355 FC_Obj4_ExistProb 60;
BA_ "GenSigCycleTime" SG_ 355 FC_Obj4_Dy_Vnce 60;
BA_ "GenSigCycleTime" SG_ 355 FC_Obj4_Dy 60;
BA_ "GenSigCycleTime" SG_ 355 FC_Obj4_Dx_Vnce 60;
BA_ "GenSigCycleTime" SG_ 355 FC_Obj4_Dx 60;
BA_ "GenSigCycleTime" SG_ 355 FC_Obj4_RelVy 60;
BA_ "GenSigCycleTime" SG_ 355 FC_Obj4_RelVx 60;
BA_ "GenSigCycleTime" SG_ 355 FC_Obj4_RelAy 60;
BA_ "GenSigCycleTime" SG_ 355 FC_Obj4_RelAx 60;
BA_ "GenSigCycleTime" SG_ 355 FC_Obj4_TypeProb 60;
BA_ "GenSigCycleTime" SG_ 355 FC_Obj4_Type 60;
BA_ "GenSigCycleTime" SG_ 355 FC_Obj4_Track_Age 60;
BA_ "GenSigCycleTime" SG_ 355 FC_Obj4_Track_ID 60;

BA_ "GenSigCycleTime" SG_ 356 FC_Obj5WSInfoPosType 60;
BA_ "GenSigCycleTime" SG_ 356 FC_CRCCheck_164 60;
BA_ "GenSigCycleTime" SG_ 356 FC_RollingCounter_164 60;
BA_ "GenSigCycleTime" SG_ 356 FC_Obj5_Img2dBox_RightDown_V 60;
BA_ "GenSigCycleTime" SG_ 356 FC_Obj5_Img2dBox_LeftTop_V 60;
BA_ "GenSigCycleTime" SG_ 356 FC_Obj5_Img2dBox_RightDown_U 60;
BA_ "GenSigCycleTime" SG_ 356 FC_Obj5_Img2dBox_LeftTop_U 60;
BA_ "GenSigCycleTime" SG_ 356 FC_Obj5_TurnLight 60;
BA_ "GenSigCycleTime" SG_ 356 FC_Obj5_valid 60;
BA_ "GenSigCycleTime" SG_ 356 FC_Obj5_Vy_Vnce 60;
BA_ "GenSigCycleTime" SG_ 356 FC_Obj5_Vx_Vnce 60;
BA_ "GenSigCycleTime" SG_ 356 FC_Obj5_CenterAngle 60;
BA_ "GenSigCycleTime" SG_ 356 FC_Obj5_DistInLane 60;
BA_ "GenSigCycleTime" SG_ 356 FC_Obj5_objCutInLane 60;
BA_ "GenSigCycleTime" SG_ 356 FC_Obj5_objCutInFlag 60;
BA_ "GenSigCycleTime" SG_ 356 FC_Obj5_CornerPoint_y 60;
BA_ "GenSigCycleTime" SG_ 356 FC_Obj5_CornerPoint_x 60;
BA_ "GenSigCycleTime" SG_ 356 FC_Obj5_LaneAssignment 60;
BA_ "GenSigCycleTime" SG_ 356 FC_Obj5_MotionType 60;
BA_ "GenSigCycleTime" SG_ 356 FC_obj5_Brakelight_Info 60;
BA_ "GenSigCycleTime" SG_ 356 FC_Obj5_Width 60;
BA_ "GenSigCycleTime" SG_ 356 FC_Obj5_Length 60;
BA_ "GenSigCycleTime" SG_ 356 FC_Obj5_Height 60;
BA_ "GenSigCycleTime" SG_ 356 FC_Obj5_HeadOrientation 60;
BA_ "GenSigCycleTime" SG_ 356 FC_Obj5_HeadingAngle 60;
BA_ "GenSigCycleTime" SG_ 356 FC_Obj5_ExistProb 60;
BA_ "GenSigCycleTime" SG_ 356 FC_Obj5_Dy_Vnce 60;
BA_ "GenSigCycleTime" SG_ 356 FC_Obj5_Dy 60;
BA_ "GenSigCycleTime" SG_ 356 FC_Obj5_Dx_Vnce 60;
BA_ "GenSigCycleTime" SG_ 356 FC_Obj5_Dx 60;
BA_ "GenSigCycleTime" SG_ 356 FC_Obj5_RelVy 60;
BA_ "GenSigCycleTime" SG_ 356 FC_Obj5_RelVx 60;
BA_ "GenSigCycleTime" SG_ 356 FC_Obj5_RelAy 60;
BA_ "GenSigCycleTime" SG_ 356 FC_Obj5_RelAx 60;
BA_ "GenSigCycleTime" SG_ 356 FC_Obj5_TypeProb 60;
BA_ "GenSigCycleTime" SG_ 356 FC_Obj5_Type 60;
BA_ "GenSigCycleTime" SG_ 356 FC_Obj5_Track_Age 60;
BA_ "GenSigCycleTime" SG_ 356 FC_Obj5_Track_ID 60;

BA_ "GenSigCycleTime" SG_ 357 FC_Obj6WSInfoPosType 60;
BA_ "GenSigCycleTime" SG_ 357 FC_CRCCheck_165 60;
BA_ "GenSigCycleTime" SG_ 357 FC_RollingCounter_165 60;
BA_ "GenSigCycleTime" SG_ 357 FC_Obj6_Img2dBox_RightDown_V 60;
BA_ "GenSigCycleTime" SG_ 357 FC_Obj6_Img2dBox_LeftTop_V 60;
BA_ "GenSigCycleTime" SG_ 357 FC_Obj6_Img2dBox_RightDown_U 60;
BA_ "GenSigCycleTime" SG_ 357 FC_Obj6_Img2dBox_LeftTop_U 60;
BA_ "GenSigCycleTime" SG_ 357 FC_Obj6_TurnLight 60;
BA_ "GenSigCycleTime" SG_ 357 FC_Obj6_valid 60;
BA_ "GenSigCycleTime" SG_ 357 FC_Obj6_Vy_Vnce 60;
BA_ "GenSigCycleTime" SG_ 357 FC_Obj6_Vx_Vnce 60;
BA_ "GenSigCycleTime" SG_ 357 FC_Obj6_CenterAngle 60;
BA_ "GenSigCycleTime" SG_ 357 FC_Obj6_DistInLane 60;
BA_ "GenSigCycleTime" SG_ 357 FC_Obj6_objCutInLane 60;
BA_ "GenSigCycleTime" SG_ 357 FC_Obj6_objCutInFlag 60;
BA_ "GenSigCycleTime" SG_ 357 FC_Obj6_CornerPoint_y 60;
BA_ "GenSigCycleTime" SG_ 357 FC_Obj6_CornerPoint_x 60;
BA_ "GenSigCycleTime" SG_ 357 FC_Obj6_LaneAssignment 60;
BA_ "GenSigCycleTime" SG_ 357 FC_Obj6_MotionType 60;
BA_ "GenSigCycleTime" SG_ 357 FC_obj6_Brakelight_Info 60;
BA_ "GenSigCycleTime" SG_ 357 FC_Obj6_Width 60;
BA_ "GenSigCycleTime" SG_ 357 FC_Obj6_Length 60;
BA_ "GenSigCycleTime" SG_ 357 FC_Obj6_Height 60;
BA_ "GenSigCycleTime" SG_ 357 FC_Obj6_HeadOrientation 60;
BA_ "GenSigCycleTime" SG_ 357 FC_Obj6_HeadingAngle 60;
BA_ "GenSigCycleTime" SG_ 357 FC_Obj6_ExistProb 60;
BA_ "GenSigCycleTime" SG_ 357 FC_Obj6_Dy_Vnce 60;
BA_ "GenSigCycleTime" SG_ 357 FC_Obj6_Dy 60;
BA_ "GenSigCycleTime" SG_ 357 FC_Obj6_Dx_Vnce 60;
BA_ "GenSigCycleTime" SG_ 357 FC_Obj6_Dx 60;
BA_ "GenSigCycleTime" SG_ 357 FC_Obj6_RelVy 60;
BA_ "GenSigCycleTime" SG_ 357 FC_Obj6_RelVx 60;
BA_ "GenSigCycleTime" SG_ 357 FC_Obj6_RelAy 60;
BA_ "GenSigCycleTime" SG_ 357 FC_Obj6_RelAx 60;
BA_ "GenSigCycleTime" SG_ 357 FC_Obj6_TypeProb 60;
BA_ "GenSigCycleTime" SG_ 357 FC_Obj6_Type 60;
BA_ "GenSigCycleTime" SG_ 357 FC_Obj6_Track_Age 60;
BA_ "GenSigCycleTime" SG_ 357 FC_Obj6_Track_ID 60;

BA_ "GenSigCycleTime" SG_ 358 FC_Obj7WSInfoPosType 60;
BA_ "GenSigCycleTime" SG_ 358 FC_CRCCheck_166 60;
BA_ "GenSigCycleTime" SG_ 358 FC_RollingCounter_166 60;
BA_ "GenSigCycleTime" SG_ 358 FC_Obj7_Img2dBox_RightDown_V 60;
BA_ "GenSigCycleTime" SG_ 358 FC_Obj7_Img2dBox_LeftTop_V 60;
BA_ "GenSigCycleTime" SG_ 358 FC_Obj7_Img2dBox_RightDown_U 60;
BA_ "GenSigCycleTime" SG_ 358 FC_Obj7_Img2dBox_LeftTop_U 60;
BA_ "GenSigCycleTime" SG_ 358 FC_Obj7_TurnLight 60;
BA_ "GenSigCycleTime" SG_ 358 FC_Obj7_valid 60;
BA_ "GenSigCycleTime" SG_ 358 FC_Obj7_Vy_Vnce 60;
BA_ "GenSigCycleTime" SG_ 358 FC_Obj7_Vx_Vnce 60;
BA_ "GenSigCycleTime" SG_ 358 FC_Obj7_CenterAngle 60;
BA_ "GenSigCycleTime" SG_ 358 FC_Obj7_DistInLane 60;
BA_ "GenSigCycleTime" SG_ 358 FC_Obj7_objCutInLane 60;
BA_ "GenSigCycleTime" SG_ 358 FC_Obj7_objCutInFlag 60;
BA_ "GenSigCycleTime" SG_ 358 FC_Obj7_CornerPoint_y 60;
BA_ "GenSigCycleTime" SG_ 358 FC_Obj7_CornerPoint_x 60;
BA_ "GenSigCycleTime" SG_ 358 FC_Obj7_LaneAssignment 60;
BA_ "GenSigCycleTime" SG_ 358 FC_Obj7_MotionType 60;
BA_ "GenSigCycleTime" SG_ 358 FC_obj7_Brakelight_Info 60;
BA_ "GenSigCycleTime" SG_ 358 FC_Obj7_Width 60;
BA_ "GenSigCycleTime" SG_ 358 FC_Obj7_Length 60;
BA_ "GenSigCycleTime" SG_ 358 FC_Obj7_Height 60;
BA_ "GenSigCycleTime" SG_ 358 FC_Obj7_HeadOrientation 60;
BA_ "GenSigCycleTime" SG_ 358 FC_Obj7_HeadingAngle 60;
BA_ "GenSigCycleTime" SG_ 358 FC_Obj7_ExistProb 60;
BA_ "GenSigCycleTime" SG_ 358 FC_Obj7_Dy_Vnce 60;
BA_ "GenSigCycleTime" SG_ 358 FC_Obj7_Dy 60;
BA_ "GenSigCycleTime" SG_ 358 FC_Obj7_Dx_Vnce 60;
BA_ "GenSigCycleTime" SG_ 358 FC_Obj7_Dx 60;
BA_ "GenSigCycleTime" SG_ 358 FC_Obj7_RelVy 60;
BA_ "GenSigCycleTime" SG_ 358 FC_Obj7_RelVx 60;
BA_ "GenSigCycleTime" SG_ 358 FC_Obj7_RelAy 60;
BA_ "GenSigCycleTime" SG_ 358 FC_Obj7_RelAx 60;
BA_ "GenSigCycleTime" SG_ 358 FC_Obj7_TypeProb 60;
BA_ "GenSigCycleTime" SG_ 358 FC_Obj7_Type 60;
BA_ "GenSigCycleTime" SG_ 358 FC_Obj7_Track_Age 60;
BA_ "GenSigCycleTime" SG_ 358 FC_Obj7_Track_ID 60;

BA_ "GenSigCycleTime" SG_ 359 FC_Obj8WSInfoPosType 60;
BA_ "GenSigCycleTime" SG_ 359 FC_CRCCheck_167 60;
BA_ "GenSigCycleTime" SG_ 359 FC_RollingCounter_167 60;
BA_ "GenSigCycleTime" SG_ 359 FC_Obj8_Img2dBox_RightDown_V 60;
BA_ "GenSigCycleTime" SG_ 359 FC_Obj8_Img2dBox_LeftTop_V 60;
BA_ "GenSigCycleTime" SG_ 359 FC_Obj8_Img2dBox_RightDown_U 60;
BA_ "GenSigCycleTime" SG_ 359 FC_Obj8_Img2dBox_LeftTop_U 60;
BA_ "GenSigCycleTime" SG_ 359 FC_Obj8_TurnLight 60;
BA_ "GenSigCycleTime" SG_ 359 FC_Obj8_valid 60;
BA_ "GenSigCycleTime" SG_ 359 FC_Obj8_Vy_Vnce 60;
BA_ "GenSigCycleTime" SG_ 359 FC_Obj8_Vx_Vnce 60;
BA_ "GenSigCycleTime" SG_ 359 FC_Obj8_CenterAngle 60;
BA_ "GenSigCycleTime" SG_ 359 FC_Obj8_DistInLane 60;
BA_ "GenSigCycleTime" SG_ 359 FC_Obj8_objCutInLane 60;
BA_ "GenSigCycleTime" SG_ 359 FC_Obj8_objCutInFlag 60;
BA_ "GenSigCycleTime" SG_ 359 FC_Obj8_CornerPoint_y 60;
BA_ "GenSigCycleTime" SG_ 359 FC_Obj8_CornerPoint_x 60;
BA_ "GenSigCycleTime" SG_ 359 FC_Obj8_LaneAssignment 60;
BA_ "GenSigCycleTime" SG_ 359 FC_Obj8_MotionType 60;
BA_ "GenSigCycleTime" SG_ 359 FC_obj8_Brakelight_Info 60;
BA_ "GenSigCycleTime" SG_ 359 FC_Obj8_Width 60;
BA_ "GenSigCycleTime" SG_ 359 FC_Obj8_Length 60;
BA_ "GenSigCycleTime" SG_ 359 FC_Obj8_Height 60;
BA_ "GenSigCycleTime" SG_ 359 FC_Obj8_HeadOrientation 60;
BA_ "GenSigCycleTime" SG_ 359 FC_Obj8_HeadingAngle 60;
BA_ "GenSigCycleTime" SG_ 359 FC_Obj8_ExistProb 60;
BA_ "GenSigCycleTime" SG_ 359 FC_Obj8_Dy_Vnce 60;
BA_ "GenSigCycleTime" SG_ 359 FC_Obj8_Dy 60;
BA_ "GenSigCycleTime" SG_ 359 FC_Obj8_Dx_Vnce 60;
BA_ "GenSigCycleTime" SG_ 359 FC_Obj8_Dx 60;
BA_ "GenSigCycleTime" SG_ 359 FC_Obj8_RelVy 60;
BA_ "GenSigCycleTime" SG_ 359 FC_Obj8_RelVx 60;
BA_ "GenSigCycleTime" SG_ 359 FC_Obj8_RelAy 60;
BA_ "GenSigCycleTime" SG_ 359 FC_Obj8_RelAx 60;
BA_ "GenSigCycleTime" SG_ 359 FC_Obj8_TypeProb 60;
BA_ "GenSigCycleTime" SG_ 359 FC_Obj8_Type 60;
BA_ "GenSigCycleTime" SG_ 359 FC_Obj8_Track_Age 60;
BA_ "GenSigCycleTime" SG_ 359 FC_Obj8_Track_ID 60;

BA_ "GenSigCycleTime" SG_ 360 FC_Obj9WSInfoPosType 60;
BA_ "GenSigCycleTime" SG_ 360 FC_CRCCheck_168 60;
BA_ "GenSigCycleTime" SG_ 360 FC_RollingCounter_168 60;
BA_ "GenSigCycleTime" SG_ 360 FC_Obj9_Img2dBox_RightDown_V 60;
BA_ "GenSigCycleTime" SG_ 360 FC_Obj9_Img2dBox_LeftTop_V 60;
BA_ "GenSigCycleTime" SG_ 360 FC_Obj9_Img2dBox_RightDown_U 60;
BA_ "GenSigCycleTime" SG_ 360 FC_Obj9_Img2dBox_LeftTop_U 60;
BA_ "GenSigCycleTime" SG_ 360 FC_Obj9_TurnLight 60;
BA_ "GenSigCycleTime" SG_ 360 FC_Obj9_valid 60;
BA_ "GenSigCycleTime" SG_ 360 FC_Obj9_Vy_Vnce 60;
BA_ "GenSigCycleTime" SG_ 360 FC_Obj9_Vx_Vnce 60;
BA_ "GenSigCycleTime" SG_ 360 FC_Obj9_CenterAngle 60;
BA_ "GenSigCycleTime" SG_ 360 FC_Obj9_DistInLane 60;
BA_ "GenSigCycleTime" SG_ 360 FC_Obj9_objCutInLane 60;
BA_ "GenSigCycleTime" SG_ 360 FC_Obj9_objCutInFlag 60;
BA_ "GenSigCycleTime" SG_ 360 FC_Obj9_CornerPoint_y 60;
BA_ "GenSigCycleTime" SG_ 360 FC_Obj9_CornerPoint_x 60;
BA_ "GenSigCycleTime" SG_ 360 FC_Obj9_LaneAssignment 60;
BA_ "GenSigCycleTime" SG_ 360 FC_Obj9_MotionType 60;
BA_ "GenSigCycleTime" SG_ 360 FC_obj9_Brakelight_Info 60;
BA_ "GenSigCycleTime" SG_ 360 FC_Obj9_Width 60;
BA_ "GenSigCycleTime" SG_ 360 FC_Obj9_Length 60;
BA_ "GenSigCycleTime" SG_ 360 FC_Obj9_Height 60;
BA_ "GenSigCycleTime" SG_ 360 FC_Obj9_HeadOrientation 60;
BA_ "GenSigCycleTime" SG_ 360 FC_Obj9_HeadingAngle 60;
BA_ "GenSigCycleTime" SG_ 360 FC_Obj9_ExistProb 60;
BA_ "GenSigCycleTime" SG_ 360 FC_Obj9_Dy_Vnce 60;
BA_ "GenSigCycleTime" SG_ 360 FC_Obj9_Dy 60;
BA_ "GenSigCycleTime" SG_ 360 FC_Obj9_Dx_Vnce 60;
BA_ "GenSigCycleTime" SG_ 360 FC_Obj9_Dx 60;
BA_ "GenSigCycleTime" SG_ 360 FC_Obj9_RelVy 60;
BA_ "GenSigCycleTime" SG_ 360 FC_Obj9_RelVx 60;
BA_ "GenSigCycleTime" SG_ 360 FC_Obj9_RelAy 60;
BA_ "GenSigCycleTime" SG_ 360 FC_Obj9_RelAx 60;
BA_ "GenSigCycleTime" SG_ 360 FC_Obj9_TypeProb 60;
BA_ "GenSigCycleTime" SG_ 360 FC_Obj9_Type 60;
BA_ "GenSigCycleTime" SG_ 360 FC_Obj9_Track_Age 60;
BA_ "GenSigCycleTime" SG_ 360 FC_Obj9_Track_ID 60;

BA_ "GenSigCycleTime" SG_ 361 FC_Obj10WSInfoPosType 60;
BA_ "GenSigCycleTime" SG_ 361 FC_CRCCheck_169 60;
BA_ "GenSigCycleTime" SG_ 361 FC_RollingCounter_169 60;
BA_ "GenSigCycleTime" SG_ 361 FC_Obj10_Img2dBox_RightDown_V 60;
BA_ "GenSigCycleTime" SG_ 361 FC_Obj10_Img2dBox_LeftTop_V 60;
BA_ "GenSigCycleTime" SG_ 361 FC_Obj10_Img2dBox_RightDown_U 60;
BA_ "GenSigCycleTime" SG_ 361 FC_Obj10_Img2dBox_LeftTop_U 60;
BA_ "GenSigCycleTime" SG_ 361 FC_Obj10_TurnLight 60;
BA_ "GenSigCycleTime" SG_ 361 FC_Obj10_valid 60;
BA_ "GenSigCycleTime" SG_ 361 FC_Obj10_Vy_Vnce 60;
BA_ "GenSigCycleTime" SG_ 361 FC_Obj10_Vx_Vnce 60;
BA_ "GenSigCycleTime" SG_ 361 FC_Obj10_CenterAngle 60;
BA_ "GenSigCycleTime" SG_ 361 FC_Obj10_DistInLane 60;
BA_ "GenSigCycleTime" SG_ 361 FC_Obj10_objCutInLane 60;
BA_ "GenSigCycleTime" SG_ 361 FC_Obj10_objCutInFlag 60;
BA_ "GenSigCycleTime" SG_ 361 FC_Obj10_CornerPoint_y 60;
BA_ "GenSigCycleTime" SG_ 361 FC_Obj10_CornerPoint_x 60;
BA_ "GenSigCycleTime" SG_ 361 FC_Obj10_LaneAssignment 60;
BA_ "GenSigCycleTime" SG_ 361 FC_Obj10_MotionType 60;
BA_ "GenSigCycleTime" SG_ 361 FC_obj10_Brakelight_Info 60;
BA_ "GenSigCycleTime" SG_ 361 FC_Obj10_Width 60;
BA_ "GenSigCycleTime" SG_ 361 FC_Obj10_Length 60;
BA_ "GenSigCycleTime" SG_ 361 FC_Obj10_Height 60;
BA_ "GenSigCycleTime" SG_ 361 FC_Obj10_HeadOrientation 60;
BA_ "GenSigCycleTime" SG_ 361 FC_Obj10_HeadingAngle 60;
BA_ "GenSigCycleTime" SG_ 361 FC_Obj10_ExistProb 60;
BA_ "GenSigCycleTime" SG_ 361 FC_Obj10_Dy_Vnce 60;
BA_ "GenSigCycleTime" SG_ 361 FC_Obj10_Dy 60;
BA_ "GenSigCycleTime" SG_ 361 FC_Obj10_Dx_Vnce 60;
BA_ "GenSigCycleTime" SG_ 361 FC_Obj10_Dx 60;
BA_ "GenSigCycleTime" SG_ 361 FC_Obj10_RelVy 60;
BA_ "GenSigCycleTime" SG_ 361 FC_Obj10_RelVx 60;
BA_ "GenSigCycleTime" SG_ 361 FC_Obj10_RelAy 60;
BA_ "GenSigCycleTime" SG_ 361 FC_Obj10_RelAx 60;
BA_ "GenSigCycleTime" SG_ 361 FC_Obj10_TypeProb 60;
BA_ "GenSigCycleTime" SG_ 361 FC_Obj10_Type 60;
BA_ "GenSigCycleTime" SG_ 361 FC_Obj10_Track_Age 60;
BA_ "GenSigCycleTime" SG_ 361 FC_Obj10_Track_ID 60;

BA_ "GenSigCycleTime" SG_ 368 FC_Obj11WSInfoPosType 60;
BA_ "GenSigCycleTime" SG_ 368 FC_CRCCheck_170 60;
BA_ "GenSigCycleTime" SG_ 368 FC_RollingCounter_170 60;
BA_ "GenSigCycleTime" SG_ 368 FC_Obj11_Img2dBox_RightDown_V 60;
BA_ "GenSigCycleTime" SG_ 368 FC_Obj11_Img2dBox_LeftTop_V 60;
BA_ "GenSigCycleTime" SG_ 368 FC_Obj11_Img2dBox_RightDown_U 60;
BA_ "GenSigCycleTime" SG_ 368 FC_Obj11_Img2dBox_LeftTop_U 60;
BA_ "GenSigCycleTime" SG_ 368 FC_Obj11_TurnLight 60;
BA_ "GenSigCycleTime" SG_ 368 FC_Obj11_valid 60;
BA_ "GenSigCycleTime" SG_ 368 FC_Obj11_Vy_Vnce 60;
BA_ "GenSigCycleTime" SG_ 368 FC_Obj11_Vx_Vnce 60;
BA_ "GenSigCycleTime" SG_ 368 FC_Obj11_CenterAngle 60;
BA_ "GenSigCycleTime" SG_ 368 FC_Obj11_DistInLane 60;
BA_ "GenSigCycleTime" SG_ 368 FC_Obj11_objCutInLane 60;
BA_ "GenSigCycleTime" SG_ 368 FC_Obj11_objCutInFlag 60;
BA_ "GenSigCycleTime" SG_ 368 FC_Obj11_CornerPoint_y 60;
BA_ "GenSigCycleTime" SG_ 368 FC_Obj11_CornerPoint_x 60;
BA_ "GenSigCycleTime" SG_ 368 FC_Obj11_LaneAssignment 60;
BA_ "GenSigCycleTime" SG_ 368 FC_Obj11_MotionType 60;
BA_ "GenSigCycleTime" SG_ 368 FC_obj11_Brakelight_Info 60;
BA_ "GenSigCycleTime" SG_ 368 FC_Obj11_Width 60;
BA_ "GenSigCycleTime" SG_ 368 FC_Obj11_Length 60;
BA_ "GenSigCycleTime" SG_ 368 FC_Obj11_Height 60;
BA_ "GenSigCycleTime" SG_ 368 FC_Obj11_HeadOrientation 60;
BA_ "GenSigCycleTime" SG_ 368 FC_Obj11_HeadingAngle 60;
BA_ "GenSigCycleTime" SG_ 368 FC_Obj11_ExistProb 60;
BA_ "GenSigCycleTime" SG_ 368 FC_Obj11_Dy_Vnce 60;
BA_ "GenSigCycleTime" SG_ 368 FC_Obj11_Dy 60;
BA_ "GenSigCycleTime" SG_ 368 FC_Obj11_Dx_Vnce 60;
BA_ "GenSigCycleTime" SG_ 368 FC_Obj11_Dx 60;
BA_ "GenSigCycleTime" SG_ 368 FC_Obj11_RelVy 60;
BA_ "GenSigCycleTime" SG_ 368 FC_Obj11_RelVx 60;
BA_ "GenSigCycleTime" SG_ 368 FC_Obj11_RelAy 60;
BA_ "GenSigCycleTime" SG_ 368 FC_Obj11_RelAx 60;
BA_ "GenSigCycleTime" SG_ 368 FC_Obj11_TypeProb 60;
BA_ "GenSigCycleTime" SG_ 368 FC_Obj11_Type 60;
BA_ "GenSigCycleTime" SG_ 368 FC_Obj11_Track_Age 60;
BA_ "GenSigCycleTime" SG_ 368 FC_Obj11_Track_ID 60;

BA_ "GenSigCycleTime" SG_ 369 FC_Obj12WSInfoPosType 60;
BA_ "GenSigCycleTime" SG_ 369 FC_CRCCheck_171 60;
BA_ "GenSigCycleTime" SG_ 369 FC_RollingCounter_171 60;
BA_ "GenSigCycleTime" SG_ 369 FC_Obj12_Img2dBox_RightDown_V 60;
BA_ "GenSigCycleTime" SG_ 369 FC_Obj12_Img2dBox_LeftTop_V 60;
BA_ "GenSigCycleTime" SG_ 369 FC_Obj12_Img2dBox_RightDown_U 60;
BA_ "GenSigCycleTime" SG_ 369 FC_Obj12_Img2dBox_LeftTop_U 60;
BA_ "GenSigCycleTime" SG_ 369 FC_Obj12_TurnLight 60;
BA_ "GenSigCycleTime" SG_ 369 FC_Obj12_valid 60;
BA_ "GenSigCycleTime" SG_ 369 FC_Obj12_Vy_Vnce 60;
BA_ "GenSigCycleTime" SG_ 369 FC_Obj12_Vx_Vnce 60;
BA_ "GenSigCycleTime" SG_ 369 FC_Obj12_CenterAngle 60;
BA_ "GenSigCycleTime" SG_ 369 FC_Obj12_DistInLane 60;
BA_ "GenSigCycleTime" SG_ 369 FC_Obj12_objCutInLane 60;
BA_ "GenSigCycleTime" SG_ 369 FC_Obj12_objCutInFlag 60;
BA_ "GenSigCycleTime" SG_ 369 FC_Obj12_CornerPoint_y 60;
BA_ "GenSigCycleTime" SG_ 369 FC_Obj12_CornerPoint_x 60;
BA_ "GenSigCycleTime" SG_ 369 FC_Obj12_LaneAssignment 60;
BA_ "GenSigCycleTime" SG_ 369 FC_Obj12_MotionType 60;
BA_ "GenSigCycleTime" SG_ 369 FC_obj12_Brakelight_Info 60;
BA_ "GenSigCycleTime" SG_ 369 FC_Obj12_Width 60;
BA_ "GenSigCycleTime" SG_ 369 FC_Obj12_Length 60;
BA_ "GenSigCycleTime" SG_ 369 FC_Obj12_Height 60;
BA_ "GenSigCycleTime" SG_ 369 FC_Obj12_HeadOrientation 60;
BA_ "GenSigCycleTime" SG_ 369 FC_Obj12_HeadingAngle 60;
BA_ "GenSigCycleTime" SG_ 369 FC_Obj12_ExistProb 60;
BA_ "GenSigCycleTime" SG_ 369 FC_Obj12_Dy_Vnce 60;
BA_ "GenSigCycleTime" SG_ 369 FC_Obj12_Dy 60;
BA_ "GenSigCycleTime" SG_ 369 FC_Obj12_Dx_Vnce 60;
BA_ "GenSigCycleTime" SG_ 369 FC_Obj12_Dx 60;
BA_ "GenSigCycleTime" SG_ 369 FC_Obj12_RelVy 60;
BA_ "GenSigCycleTime" SG_ 369 FC_Obj12_RelVx 60;
BA_ "GenSigCycleTime" SG_ 369 FC_Obj12_RelAy 60;
BA_ "GenSigCycleTime" SG_ 369 FC_Obj12_RelAx 60;
BA_ "GenSigCycleTime" SG_ 369 FC_Obj12_TypeProb 60;
BA_ "GenSigCycleTime" SG_ 369 FC_Obj12_Type 60;
BA_ "GenSigCycleTime" SG_ 369 FC_Obj12_Track_Age 60;
BA_ "GenSigCycleTime" SG_ 369 FC_Obj12_Track_ID 60;

BA_ "GenSigCycleTime" SG_ 370 FC_Obj13WSInfoPosType 60;
BA_ "GenSigCycleTime" SG_ 370 FC_CRCCheck_172 60;
BA_ "GenSigCycleTime" SG_ 370 FC_RollingCounter_172 60;
BA_ "GenSigCycleTime" SG_ 370 FC_Obj13_Img2dBox_RightDown_V 60;
BA_ "GenSigCycleTime" SG_ 370 FC_Obj13_Img2dBox_LeftTop_V 60;
BA_ "GenSigCycleTime" SG_ 370 FC_Obj13_Img2dBox_RightDown_U 60;
BA_ "GenSigCycleTime" SG_ 370 FC_Obj13_Img2dBox_LeftTop_U 60;
BA_ "GenSigCycleTime" SG_ 370 FC_Obj13_TurnLight 60;
BA_ "GenSigCycleTime" SG_ 370 FC_Obj13_valid 60;
BA_ "GenSigCycleTime" SG_ 370 FC_Obj13_Vy_Vnce 60;
BA_ "GenSigCycleTime" SG_ 370 FC_Obj13_Vx_Vnce 60;
BA_ "GenSigCycleTime" SG_ 370 FC_Obj13_CenterAngle 60;
BA_ "GenSigCycleTime" SG_ 370 FC_Obj13_DistInLane 60;
BA_ "GenSigCycleTime" SG_ 370 FC_Obj13_objCutInLane 60;
BA_ "GenSigCycleTime" SG_ 370 FC_Obj13_objCutInFlag 60;
BA_ "GenSigCycleTime" SG_ 370 FC_Obj13_CornerPoint_y 60;
BA_ "GenSigCycleTime" SG_ 370 FC_Obj13_CornerPoint_x 60;
BA_ "GenSigCycleTime" SG_ 370 FC_Obj13_LaneAssignment 60;
BA_ "GenSigCycleTime" SG_ 370 FC_Obj13_MotionType 60;
BA_ "GenSigCycleTime" SG_ 370 FC_obj13_Brakelight_Info 60;
BA_ "GenSigCycleTime" SG_ 370 FC_Obj13_Width 60;
BA_ "GenSigCycleTime" SG_ 370 FC_Obj13_Length 60;
BA_ "GenSigCycleTime" SG_ 370 FC_Obj13_Height 60;
BA_ "GenSigCycleTime" SG_ 370 FC_Obj13_HeadOrientation 60;
BA_ "GenSigCycleTime" SG_ 370 FC_Obj13_HeadingAngle 60;
BA_ "GenSigCycleTime" SG_ 370 FC_Obj13_ExistProb 60;
BA_ "GenSigCycleTime" SG_ 370 FC_Obj13_Dy_Vnce 60;
BA_ "GenSigCycleTime" SG_ 370 FC_Obj13_Dy 60;
BA_ "GenSigCycleTime" SG_ 370 FC_Obj13_Dx_Vnce 60;
BA_ "GenSigCycleTime" SG_ 370 FC_Obj13_Dx 60;
BA_ "GenSigCycleTime" SG_ 370 FC_Obj13_RelVy 60;
BA_ "GenSigCycleTime" SG_ 370 FC_Obj13_RelVx 60;
BA_ "GenSigCycleTime" SG_ 370 FC_Obj13_RelAy 60;
BA_ "GenSigCycleTime" SG_ 370 FC_Obj13_RelAx 60;
BA_ "GenSigCycleTime" SG_ 370 FC_Obj13_TypeProb 60;
BA_ "GenSigCycleTime" SG_ 370 FC_Obj13_Type 60;
BA_ "GenSigCycleTime" SG_ 370 FC_Obj13_Track_Age 60;
BA_ "GenSigCycleTime" SG_ 370 FC_Obj13_Track_ID 60;

BA_ "GenSigCycleTime" SG_ 371 FC_Obj14WSInfoPosType 60;
BA_ "GenSigCycleTime" SG_ 371 FC_CRCCheck_173 60;
BA_ "GenSigCycleTime" SG_ 371 FC_RollingCounter_173 60;
BA_ "GenSigCycleTime" SG_ 371 FC_Obj14_Img2dBox_RightDown_V 60;
BA_ "GenSigCycleTime" SG_ 371 FC_Obj14_Img2dBox_LeftTop_V 60;
BA_ "GenSigCycleTime" SG_ 371 FC_Obj14_Img2dBox_RightDown_U 60;
BA_ "GenSigCycleTime" SG_ 371 FC_Obj14_Img2dBox_LeftTop_U 60;
BA_ "GenSigCycleTime" SG_ 371 FC_Obj14_TurnLight 60;
BA_ "GenSigCycleTime" SG_ 371 FC_Obj14_valid 60;
BA_ "GenSigCycleTime" SG_ 371 FC_Obj14_Vy_Vnce 60;
BA_ "GenSigCycleTime" SG_ 371 FC_Obj14_Vx_Vnce 60;
BA_ "GenSigCycleTime" SG_ 371 FC_Obj14_CenterAngle 60;
BA_ "GenSigCycleTime" SG_ 371 FC_Obj14_DistInLane 60;
BA_ "GenSigCycleTime" SG_ 371 FC_Obj14_objCutInLane 60;
BA_ "GenSigCycleTime" SG_ 371 FC_Obj14_objCutInFlag 60;
BA_ "GenSigCycleTime" SG_ 371 FC_Obj14_CornerPoint_y 60;
BA_ "GenSigCycleTime" SG_ 371 FC_Obj14_CornerPoint_x 60;
BA_ "GenSigCycleTime" SG_ 371 FC_Obj14_LaneAssignment 60;
BA_ "GenSigCycleTime" SG_ 371 FC_Obj14_MotionType 60;
BA_ "GenSigCycleTime" SG_ 371 FC_obj14_Brakelight_Info 60;
BA_ "GenSigCycleTime" SG_ 371 FC_Obj14_Width 60;
BA_ "GenSigCycleTime" SG_ 371 FC_Obj14_Length 60;
BA_ "GenSigCycleTime" SG_ 371 FC_Obj14_Height 60;
BA_ "GenSigCycleTime" SG_ 371 FC_Obj14_HeadOrientation 60;
BA_ "GenSigCycleTime" SG_ 371 FC_Obj14_HeadingAngle 60;
BA_ "GenSigCycleTime" SG_ 371 FC_Obj14_ExistProb 60;
BA_ "GenSigCycleTime" SG_ 371 FC_Obj14_Dy_Vnce 60;
BA_ "GenSigCycleTime" SG_ 371 FC_Obj14_Dy 60;
BA_ "GenSigCycleTime" SG_ 371 FC_Obj14_Dx_Vnce 60;
BA_ "GenSigCycleTime" SG_ 371 FC_Obj14_Dx 60;
BA_ "GenSigCycleTime" SG_ 371 FC_Obj14_RelVy 60;
BA_ "GenSigCycleTime" SG_ 371 FC_Obj14_RelVx 60;
BA_ "GenSigCycleTime" SG_ 371 FC_Obj14_RelAy 60;
BA_ "GenSigCycleTime" SG_ 371 FC_Obj14_RelAx 60;
BA_ "GenSigCycleTime" SG_ 371 FC_Obj14_TypeProb 60;
BA_ "GenSigCycleTime" SG_ 371 FC_Obj14_Type 60;
BA_ "GenSigCycleTime" SG_ 371 FC_Obj14_Track_Age 60;
BA_ "GenSigCycleTime" SG_ 371 FC_Obj14_Track_ID 60;

BA_ "GenSigCycleTime" SG_ 372 FC_Obj15WSInfoPosType 60;
BA_ "GenSigCycleTime" SG_ 372 FC_CRCCheck_174 60;
BA_ "GenSigCycleTime" SG_ 372 FC_RollingCounter_174 60;
BA_ "GenSigCycleTime" SG_ 372 FC_Obj15_Img2dBox_RightDown_V 60;
BA_ "GenSigCycleTime" SG_ 372 FC_Obj15_Img2dBox_LeftTop_V 60;
BA_ "GenSigCycleTime" SG_ 372 FC_Obj15_Img2dBox_RightDown_U 60;
BA_ "GenSigCycleTime" SG_ 372 FC_Obj15_Img2dBox_LeftTop_U 60;
BA_ "GenSigCycleTime" SG_ 372 FC_Obj15_TurnLight 60;
BA_ "GenSigCycleTime" SG_ 372 FC_Obj15_valid 60;
BA_ "GenSigCycleTime" SG_ 372 FC_Obj15_Vy_Vnce 60;
BA_ "GenSigCycleTime" SG_ 372 FC_Obj15_Vx_Vnce 60;
BA_ "GenSigCycleTime" SG_ 372 FC_Obj15_CenterAngle 60;
BA_ "GenSigCycleTime" SG_ 372 FC_Obj15_DistInLane 60;
BA_ "GenSigCycleTime" SG_ 372 FC_Obj15_objCutInLane 60;
BA_ "GenSigCycleTime" SG_ 372 FC_Obj15_objCutInFlag 60;
BA_ "GenSigCycleTime" SG_ 372 FC_Obj15_CornerPoint_y 60;
BA_ "GenSigCycleTime" SG_ 372 FC_Obj15_CornerPoint_x 60;
BA_ "GenSigCycleTime" SG_ 372 FC_Obj15_LaneAssignment 60;
BA_ "GenSigCycleTime" SG_ 372 FC_Obj15_MotionType 60;
BA_ "GenSigCycleTime" SG_ 372 FC_obj15_Brakelight_Info 60;
BA_ "GenSigCycleTime" SG_ 372 FC_Obj15_Width 60;
BA_ "GenSigCycleTime" SG_ 372 FC_Obj15_Length 60;
BA_ "GenSigCycleTime" SG_ 372 FC_Obj15_Height 60;
BA_ "GenSigCycleTime" SG_ 372 FC_Obj15_HeadOrientation 60;
BA_ "GenSigCycleTime" SG_ 372 FC_Obj15_HeadingAngle 60;
BA_ "GenSigCycleTime" SG_ 372 FC_Obj15_ExistProb 60;
BA_ "GenSigCycleTime" SG_ 372 FC_Obj15_Dy_Vnce 60;
BA_ "GenSigCycleTime" SG_ 372 FC_Obj15_Dy 60;
BA_ "GenSigCycleTime" SG_ 372 FC_Obj15_Dx_Vnce 60;
BA_ "GenSigCycleTime" SG_ 372 FC_Obj15_Dx 60;
BA_ "GenSigCycleTime" SG_ 372 FC_Obj15_RelVy 60;
BA_ "GenSigCycleTime" SG_ 372 FC_Obj15_RelVx 60;
BA_ "GenSigCycleTime" SG_ 372 FC_Obj15_RelAy 60;
BA_ "GenSigCycleTime" SG_ 372 FC_Obj15_RelAx 60;
BA_ "GenSigCycleTime" SG_ 372 FC_Obj15_TypeProb 60;
BA_ "GenSigCycleTime" SG_ 372 FC_Obj15_Type 60;
BA_ "GenSigCycleTime" SG_ 372 FC_Obj15_Track_Age 60;
BA_ "GenSigCycleTime" SG_ 372 FC_Obj15_Track_ID 60;

VAL_ 288 FR_OBJ32_MotionStatus 0 "unknown" 1 "moving " 2 "stopped" 3 "stationary" 4 "crossing" 5 "reserve;";
VAL_ 288 FR_OBJ32_Location 0 "unknown" 1 "Left Lane" 2 "Right  Lane" 3 "Ego Lane";
VAL_ 288 FR_OBJ32_Measured 0 "unknown" 1 "Measured" 2 "Predicted" 3 "Reserved";
VAL_ 288 FR_OBJ32_valid 0 "";
VAL_ 288 FR_OBJ32_Class 0 "Not Detected" 1 "car" 2 "truck" 3 "bicycle/motorbike" 4 "pedestrian" 5 "general" 6 "animal" 7 "uncertain";
VAL_ 288 FR_OBJ31_MotionStatus 0 "unknown" 1 "moving " 2 "stopped" 3 "stationary" 4 "crossing" 5 "reserve;";
VAL_ 288 FR_OBJ31_Location 0 "unknown" 1 "Left Lane" 2 "Right  Lane" 3 "Ego Lane";
VAL_ 288 FR_OBJ31_Measured 0 "unknown" 1 "Measured" 2 "Predicted" 3 "Reserved";
VAL_ 288 FR_Obj31_valid 0 "";
VAL_ 288 FR_OBJ31_Class 0 "Not Detected" 1 "car" 2 "truck" 3 "bicycle/motorbike" 4 "pedestrian" 5 "general" 6 "animal" 7 "uncertain";

VAL_ 310 FR_MisAlignment 0 "";
VAL_ 310 FR_WorkMode 0 "";
VAL_ 310 FR_RadarFailureStatus 0 " no failure" 1 "fullBlind" 2 "" 3 "reversible failure" 4 " irrversible failure" 5 "vehicle information failure
0x6-0x7=Reserevd";
VAL_ 310 FR_FRadarCalibrationStatus 0 " Calibration is ok" 1 " Calibration In Process" 2 " Calibration never done" 3 "  Calibration Failed";

VAL_ 312 FR_TiOut 0 "no timeout" 1 "timeout";

VAL_ 336 FC_Line_2_MeasureType 0 "unknow" 1 "virtual_paral" 2 "measured_paral" 3 "virtual" 4 "measured";
VAL_ 336 FC_Line_2_color 0 "Not Detected" 1 "white" 2 "yellow" 3 "white plus yellow" 4 "unknown" 5 "reserved" 6 "reserved" 7 "Invalid";
VAL_ 336 FC_Line_2_Type 0 " solid" 1 "dashed" 2 "double_dashed_dashed" 3 "double_dashed_solid" 4 "double_ solid_ dashed" 5 "double_ solid_ solid" 6 " multiple（Eu&USA）" 7 "multiple_warning（Eu&USA）" 8 "car_pool" 9 "asphalt_joint（USA）" 10 "Bot-Dott（USA）" 11 " road_edge" 12 "guardrail" 13 "curbstone" 14 "wall" 15 "traffic_cone" 16 "delineator_post" 17 "parking_car" 18 "unknown_raised" 19 "fishbone_solid" 20 "unknown" 21 "line_diversion_inside" 22 "line_diversion_outside" 23 "line-ramp" 24 "fishbone_ dashed" 25 "reserved";
VAL_ 336 FC_Line_1_MeasureType 0 "unknow" 1 "virtual_paral" 2 "measured_paral" 3 "virtual" 4 "measured";
VAL_ 336 FC_Line_1_color 0 "Not Detected" 1 "white" 2 "yellow" 3 "white plus yellow" 4 "unknown" 5 "reserved" 6 "reserved" 7 "Invalid";
VAL_ 336 FC_Line_1_Type 0 " solid" 1 "dashed" 2 "double_dashed_dashed" 3 "double_dashed_solid" 4 "double_ solid_ dashed" 5 "double_ solid_ solid" 6 " multiple（Eu&USA）" 7 "multiple_warning（Eu&USA）" 8 "car_pool" 9 "asphalt_joint（USA）" 10 "Bot-Dott（USA）" 11 " road_edge" 12 "guardrail" 13 "curbstone" 14 "wall" 15 "traffic_cone" 16 "delineator_post" 17 "parking_car" 18 "unknown_raised" 19 "fishbone_solid" 20 "unknown" 21 "line_diversion_inside" 22 "line_diversion_outside" 23 "line-ramp" 24 "fishbone_ dashed" 25 "reserved";

VAL_ 337 FC_Line_4_MeasureType 0 "unknow" 1 "virtual_paral" 2 "measured_paral" 3 "virtual" 4 "measured";
VAL_ 337 FC_Line_4_color 0 "Not Detected" 1 "white" 2 "yellow" 3 "white plus yellow" 4 "unknown" 5 "reserved" 6 "reserved" 7 "Invalid";
VAL_ 337 FC_Line_4_Type 0 " solid" 1 "dashed" 2 "double_dashed_dashed" 3 "double_dashed_solid" 4 "double_ solid_ dashed" 5 "double_ solid_ solid" 6 " multiple（Eu&USA）" 7 "multiple_warning（Eu&USA）" 8 "car_pool" 9 "asphalt_joint（USA）" 10 "Bot-Dott（USA）" 11 " road_edge" 12 "guardrail" 13 "curbstone" 14 "wall" 15 "traffic_cone" 16 "delineator_post" 17 "parking_car" 18 "unknown_raised" 19 "fishbone_solid" 20 "unknown" 21 "line_diversion_inside" 22 "line_diversion_outside" 23 "line-ramp" 24 "fishbone_ dashed" 25 "reserved";
VAL_ 337 FC_Line_3_MeasureType 0 "unknow" 1 "virtual_paral" 2 "measured_paral" 3 "virtual" 4 "measured";
VAL_ 337 FC_Line_3_color 0 "Not Detected" 1 "white" 2 "yellow" 3 "white plus yellow" 4 "unknown" 5 "reserved" 6 "reserved" 7 "Invalid";
VAL_ 337 FC_Line_3_Type 0 " solid" 1 "dashed" 2 "double_dashed_dashed" 3 "double_dashed_solid" 4 "double_ solid_ dashed" 5 "double_ solid_ solid" 6 " multiple（Eu&USA）" 7 "multiple_warning（Eu&USA）" 8 "car_pool" 9 "asphalt_joint（USA）" 10 "Bot-Dott（USA）" 11 " road_edge" 12 "guardrail" 13 "curbstone" 14 "wall" 15 "traffic_cone" 16 "delineator_post" 17 "parking_car" 18 "unknown_raised" 19 "fishbone_solid" 20 "unknown" 21 "line_diversion_inside" 22 "line_diversion_outside" 23 "line-ramp" 24 "fishbone_ dashed" 25 "reserved";

VAL_ 338 FC_Line_6_MeasureType 0 "unknow" 1 "virtual_paral" 2 "measured_paral" 3 "virtual" 4 "measured";
VAL_ 338 FC_Line_6_color 0 "Not Detected" 1 "white" 2 "yellow" 3 "white plus yellow" 4 "unknown" 5 "reserved" 6 "reserved" 7 "Invalid";
VAL_ 338 FC_Line_6_Type 0 " solid" 1 "dashed" 2 "double_dashed_dashed" 3 "double_dashed_solid" 4 "double_ solid_ dashed" 5 "double_ solid_ solid" 6 " multiple（Eu&USA）" 7 "multiple_warning（Eu&USA）" 8 "car_pool" 9 "asphalt_joint（USA）" 10 "Bot-Dott（USA）" 11 " road_edge" 12 "guardrail" 13 "curbstone" 14 "wall" 15 "traffic_cone" 16 "delineator_post" 17 "parking_car" 18 "unknown_raised" 19 "fishbone_solid" 20 "unknown" 21 "line_diversion_inside" 22 "line_diversion_outside" 23 "line-ramp" 24 "fishbone_ dashed" 25 "reserved";
VAL_ 338 FC_Line_5_MeasureType 0 "unknow" 1 "virtual_paral" 2 "measured_paral" 3 "virtual" 4 "measured";
VAL_ 338 FC_Line_5_color 0 "Not Detected" 1 "white" 2 "yellow" 3 "white plus yellow" 4 "unknown" 5 "reserved" 6 "reserved" 7 "Invalid";
VAL_ 338 FC_Line_5_Type 0 " solid" 1 "dashed" 2 "double_dashed_dashed" 3 "double_dashed_solid" 4 "double_ solid_ dashed" 5 "double_ solid_ solid" 6 " multiple（Eu&USA）" 7 "multiple_warning（Eu&USA）" 8 "car_pool" 9 "asphalt_joint（USA）" 10 "Bot-Dott（USA）" 11 " road_edge" 12 "guardrail" 13 "curbstone" 14 "wall" 15 "traffic_cone" 16 "delineator_post" 17 "parking_car" 18 "unknown_raised" 19 "fishbone_solid" 20 "unknown" 21 "line_diversion_inside" 22 "line_diversion_outside" 23 "line-ramp" 24 "fishbone_ dashed" 25 "reserved";

VAL_ 339 FC_Line_8_MeasureType 0 "unknow" 1 "virtual_paral" 2 "measured_paral" 3 "virtual" 4 "measured";
VAL_ 339 FC_Line_8_color 0 "Not Detected" 1 "white" 2 "yellow" 3 "white plus yellow" 4 "unknown" 5 "reserved" 6 "reserved" 7 "Invalid";
VAL_ 339 FC_Line_8_Type 0 " solid" 1 "dashed" 2 "double_dashed_dashed" 3 "double_dashed_solid" 4 "double_ solid_ dashed" 5 "double_ solid_ solid" 6 " multiple（Eu&USA）" 7 "multiple_warning（Eu&USA）" 8 "car_pool" 9 "asphalt_joint（USA）" 10 "Bot-Dott（USA）" 11 " road_edge" 12 "guardrail" 13 "curbstone" 14 "wall" 15 "traffic_cone" 16 "delineator_post" 17 "parking_car" 18 "unknown_raised" 19 "fishbone_solid" 20 "unknown" 21 "line_diversion_inside" 22 "line_diversion_outside" 23 "line-ramp" 24 "fishbone_ dashed" 25 "reserved";
VAL_ 339 FC_Line_7_MeasureType 0 "unknow" 1 "virtual_paral" 2 "measured_paral" 3 "virtual" 4 "measured";
VAL_ 339 FC_Line_7_color 0 "Not Detected" 1 "white" 2 "yellow" 3 "white plus yellow" 4 "unknown" 5 "reserved" 6 "reserved" 7 "Invalid";
VAL_ 339 FC_Line_7_Type 0 " solid" 1 "dashed" 2 "double_dashed_dashed" 3 "double_dashed_solid" 4 "double_ solid_ dashed" 5 "double_ solid_ solid" 6 " multiple（Eu&USA）" 7 "multiple_warning（Eu&USA）" 8 "car_pool" 9 "asphalt_joint（USA）" 10 "Bot-Dott（USA）" 11 " road_edge" 12 "guardrail" 13 "curbstone" 14 "wall" 15 "traffic_cone" 16 "delineator_post" 17 "parking_car" 18 "unknown_raised" 19 "fishbone_solid" 20 "unknown" 21 "line_diversion_inside" 22 "line_diversion_outside" 23 "line-ramp" 24 "fishbone_ dashed" 25 "reserved";

VAL_ 340 FC_LineTiOut 0 "no timeout" 1 "timeout";
VAL_ 340 FC_WeatherType 0 "Sunny" 1 "Cloudy" 2 "Rainy" 3 "Snowy" 4 "HeavyRain" 5 "Other" 15 "Invalid" 7 " Reserved;";
VAL_ 340 FC_RCrossPiont_StartEnd 0 "默认;
0x1=起始点;
0x2=终止点;
0x3=reserved;";
VAL_ 340 FC_RCrossPiont_DivMer 0 "默认;
0x1=分裂;
0x2=合并;
0x3=reserved;";
VAL_ 340 FC_LCrossPiont_StartEnd 0 "默认;
0x1=起始点;
0x2=终止点;
0x3=reserved;";
VAL_ 340 FC_LCrossPiont_DivMer 0 "默认;
0x1=分裂;
0x2=合并;
0x3=reserved;";

VAL_ 352 FC_Obj1WSInfoPosType 0 "Unknown" 1 "RearLeft" 2 "RearCenter" 3 "RearRgiht" 4 "FrontLeft" 5 "FrontCenter" 6 "FrontRgiht" 7 "LeftCenter" 8 "RgihtCenter" 9 "Center" 10 "预留;";
VAL_ 352 FC_Obj1_TurnLight 0 "";
VAL_ 352 FC_Obj1_valid 0 "";
VAL_ 352 FC_Obj1_objCutInLane 0 "invalid" 1 "measured;
0x2=predicted;";
VAL_ 352 FC_Obj1_objCutInFlag 0 "invalid" 1 "cutin_hostLane" 2 "cutin_fov";
VAL_ 352 FC_Obj1_LaneAssignment 0 "UNKNOWN    
1=LEFT_LEFT    
2=LEFT    
3=HOST    
4=RIGHT     
5=RIGHT_RIGHT
0x6-0x7=Reserved";
VAL_ 352 FC_Obj1_MotionType 0 "Unknown" 1 "Moving" 2 "Stationary" 3 "Stopped" 4 "Moving Slowly";
VAL_ 352 FC_obj1_Brakelight_Info 0 "off" 1 "on ";
VAL_ 352 FC_Obj1_HeadOrientation 0 "Unknown" 1 "Head Front" 2 "Head Left Front" 3 "Head Left" 4 "Head Left Back" 5 "Head Back" 6 "Head Right Back" 7 "Head Right" 8 "Head right front" 9 "Reserved";
VAL_ 352 FC_Obj1_Type 0 "Not Detected;
0x1=car" 2 "truck" 3 "bicycle/motorbike" 4 "pedestrian" 5 "general" 6 "animal" 7 "uncertain" 8 " bus; 
 0x9~0xF = Reserved;";

VAL_ 353 FC_Obj2WSInfoPosType 0 "Unknown" 1 "RearLeft" 2 "RearCenter" 3 "RearRgiht" 4 "FrontLeft" 5 "FrontCenter" 6 "FrontRgiht" 7 "LeftCenter" 8 "RgihtCenter" 9 "Center" 10 "预留;";
VAL_ 353 FC_Obj2_TurnLight 0 "";
VAL_ 353 FC_Obj2_valid 0 "";
VAL_ 353 FC_Obj2_objCutInLane 0 "invalid" 1 "measured;
0x2=predicted;";
VAL_ 353 FC_Obj2_objCutInFlag 0 "invalid" 1 "cutin_hostLane" 2 "cutin_fov";
VAL_ 353 FC_Obj2_LaneAssignment 0 "UNKNOWN    
1=LEFT_LEFT    
2=LEFT    
3=HOST    
4=RIGHT     
5=RIGHT_RIGHT
0x6-0x7=Reserved";
VAL_ 353 FC_Obj2_MotionType 0 "Unknown" 1 "Moving" 2 "Stationary" 3 "Stopped" 4 "Moving Slowly";
VAL_ 353 FC_obj2_Brakelight_Info 0 "off" 1 "on ";
VAL_ 353 FC_Obj2_HeadOrientation 0 "Unknown" 1 "Head Front" 2 "Head Left Front" 3 "Head Left" 4 "Head Left Back" 5 "Head Back" 6 "Head Right Back" 7 "Head Right" 8 "Head right front" 9 "Reserved";
VAL_ 353 FC_Obj2_Type 0 "Not Detected;
0x1=car" 2 "truck" 3 "bicycle/motorbike" 4 "pedestrian" 5 "general" 6 "animal" 7 "uncertain" 8 " bus; 
 0x9~0xF = Reserved;";

VAL_ 354 FC_Obj3WSInfoPosType 0 "Unknown" 1 "RearLeft" 2 "RearCenter" 3 "RearRgiht" 4 "FrontLeft" 5 "FrontCenter" 6 "FrontRgiht" 7 "LeftCenter" 8 "RgihtCenter" 9 "Center" 10 "预留;";
VAL_ 354 FC_Obj3_TurnLight 0 "";
VAL_ 354 FC_Obj3_valid 0 "";
VAL_ 354 FC_Obj3_objCutInLane 0 "invalid" 1 "measured;
0x2=predicted;";
VAL_ 354 FC_Obj3_objCutInFlag 0 "invalid" 1 "cutin_hostLane" 2 "cutin_fov";
VAL_ 354 FC_Obj3_LaneAssignment 0 "UNKNOWN    
1=LEFT_LEFT    
2=LEFT    
3=HOST    
4=RIGHT     
5=RIGHT_RIGHT
0x6-0x7=Reserved";
VAL_ 354 FC_Obj3_MotionType 0 "Unknown" 1 "Moving" 2 "Stationary" 3 "Stopped" 4 "Moving Slowly";
VAL_ 354 FC_obj3_Brakelight_Info 0 "off" 1 "on ";
VAL_ 354 FC_Obj3_HeadOrientation 0 "Unknown" 1 "Head Front" 2 "Head Left Front" 3 "Head Left" 4 "Head Left Back" 5 "Head Back" 6 "Head Right Back" 7 "Head Right" 8 "Head right front" 9 "Reserved";
VAL_ 354 FC_Obj3_Type 0 "Not Detected;
0x1=car" 2 "truck" 3 "bicycle/motorbike" 4 "pedestrian" 5 "general" 6 "animal" 7 "uncertain" 8 " bus; 
 0x9~0xF = Reserved;";

VAL_ 355 FC_Obj4WSInfoPosType 0 "Unknown" 1 "RearLeft" 2 "RearCenter" 3 "RearRgiht" 4 "FrontLeft" 5 "FrontCenter" 6 "FrontRgiht" 7 "LeftCenter" 8 "RgihtCenter" 9 "Center" 10 "预留;";
VAL_ 355 FC_Obj4_TurnLight 0 "";
VAL_ 355 FC_Obj4_valid 0 "";
VAL_ 355 FC_Obj4_objCutInLane 0 "invalid" 1 "measured;
0x2=predicted;";
VAL_ 355 FC_Obj4_objCutInFlag 0 "invalid" 1 "cutin_hostLane" 2 "cutin_fov";
VAL_ 355 FC_Obj4_LaneAssignment 0 "UNKNOWN    
1=LEFT_LEFT    
2=LEFT    
3=HOST    
4=RIGHT     
5=RIGHT_RIGHT
0x6-0x7=Reserved";
VAL_ 355 FC_Obj4_MotionType 0 "Unknown" 1 "Moving" 2 "Stationary" 3 "Stopped" 4 "Moving Slowly";
VAL_ 355 FC_obj4_Brakelight_Info 0 "off" 1 "on ";
VAL_ 355 FC_Obj4_HeadOrientation 0 "Unknown" 1 "Head Front" 2 "Head Left Front" 3 "Head Left" 4 "Head Left Back" 5 "Head Back" 6 "Head Right Back" 7 "Head Right" 8 "Head right front" 9 "Reserved";
VAL_ 355 FC_Obj4_Type 0 "Not Detected;
0x1=car" 2 "truck" 3 "bicycle/motorbike" 4 "pedestrian" 5 "general" 6 "animal" 7 "uncertain" 8 " bus; 
 0x9~0xF = Reserved;";

VAL_ 356 FC_Obj5WSInfoPosType 0 "Unknown" 1 "RearLeft" 2 "RearCenter" 3 "RearRgiht" 4 "FrontLeft" 5 "FrontCenter" 6 "FrontRgiht" 7 "LeftCenter" 8 "RgihtCenter" 9 "Center" 10 "预留;";
VAL_ 356 FC_Obj5_TurnLight 0 "";
VAL_ 356 FC_Obj5_valid 0 "";
VAL_ 356 FC_Obj5_objCutInLane 0 "invalid" 1 "measured;
0x2=predicted;";
VAL_ 356 FC_Obj5_objCutInFlag 0 "invalid" 1 "cutin_hostLane" 2 "cutin_fov";
VAL_ 356 FC_Obj5_LaneAssignment 0 "UNKNOWN    
1=LEFT_LEFT    
2=LEFT    
3=HOST    
4=RIGHT     
5=RIGHT_RIGHT
0x6-0x7=Reserved";
VAL_ 356 FC_Obj5_MotionType 0 "Unknown" 1 "Moving" 2 "Stationary" 3 "Stopped" 4 "Moving Slowly";
VAL_ 356 FC_obj5_Brakelight_Info 0 "off" 1 "on ";
VAL_ 356 FC_Obj5_HeadOrientation 0 "Unknown" 1 "Head Front" 2 "Head Left Front" 3 "Head Left" 4 "Head Left Back" 5 "Head Back" 6 "Head Right Back" 7 "Head Right" 8 "Head right front" 9 "Reserved";
VAL_ 356 FC_Obj5_Type 0 "Not Detected;
0x1=car" 2 "truck" 3 "bicycle/motorbike" 4 "pedestrian" 5 "general" 6 "animal" 7 "uncertain" 8 " bus; 
 0x9~0xF = Reserved;";

VAL_ 357 FC_Obj6WSInfoPosType 0 "Unknown" 1 "RearLeft" 2 "RearCenter" 3 "RearRgiht" 4 "FrontLeft" 5 "FrontCenter" 6 "FrontRgiht" 7 "LeftCenter" 8 "RgihtCenter" 9 "Center" 10 "预留;";
VAL_ 357 FC_Obj6_TurnLight 0 "";
VAL_ 357 FC_Obj6_valid 0 "";
VAL_ 357 FC_Obj6_objCutInLane 0 "invalid" 1 "measured;
0x2=predicted;";
VAL_ 357 FC_Obj6_objCutInFlag 0 "invalid" 1 "cutin_hostLane" 2 "cutin_fov";
VAL_ 357 FC_Obj6_LaneAssignment 0 "UNKNOWN    
1=LEFT_LEFT    
2=LEFT    
3=HOST    
4=RIGHT     
5=RIGHT_RIGHT
0x6-0x7=Reserved";
VAL_ 357 FC_Obj6_MotionType 0 "Unknown" 1 "Moving" 2 "Stationary" 3 "Stopped" 4 "Moving Slowly";
VAL_ 357 FC_obj6_Brakelight_Info 0 "off" 1 "on ";
VAL_ 357 FC_Obj6_HeadOrientation 0 "Unknown" 1 "Head Front" 2 "Head Left Front" 3 "Head Left" 4 "Head Left Back" 5 "Head Back" 6 "Head Right Back" 7 "Head Right" 8 "Head right front" 9 "Reserved";
VAL_ 357 FC_Obj6_Type 0 "Not Detected;
0x1=car" 2 "truck" 3 "bicycle/motorbike" 4 "pedestrian" 5 "general" 6 "animal" 7 "uncertain" 8 " bus; 
 0x9~0xF = Reserved;";

VAL_ 358 FC_Obj7WSInfoPosType 0 "Unknown" 1 "RearLeft" 2 "RearCenter" 3 "RearRgiht" 4 "FrontLeft" 5 "FrontCenter" 6 "FrontRgiht" 7 "LeftCenter" 8 "RgihtCenter" 9 "Center" 10 "预留;";
VAL_ 358 FC_Obj7_TurnLight 0 "";
VAL_ 358 FC_Obj7_valid 0 "";
VAL_ 358 FC_Obj7_objCutInLane 0 "invalid" 1 "measured;
0x2=predicted;";
VAL_ 358 FC_Obj7_objCutInFlag 0 "invalid" 1 "cutin_hostLane" 2 "cutin_fov";
VAL_ 358 FC_Obj7_LaneAssignment 0 "UNKNOWN    
1=LEFT_LEFT    
2=LEFT    
3=HOST    
4=RIGHT     
5=RIGHT_RIGHT
0x6-0x7=Reserved";
VAL_ 358 FC_Obj7_MotionType 0 "Unknown" 1 "Moving" 2 "Stationary" 3 "Stopped" 4 "Moving Slowly";
VAL_ 358 FC_obj7_Brakelight_Info 0 "off" 1 "on ";
VAL_ 358 FC_Obj7_HeadOrientation 0 "Unknown" 1 "Head Front" 2 "Head Left Front" 3 "Head Left" 4 "Head Left Back" 5 "Head Back" 6 "Head Right Back" 7 "Head Right" 8 "Head right front" 9 "Reserved";
VAL_ 358 FC_Obj7_Type 0 "Not Detected;
0x1=car" 2 "truck" 3 "bicycle/motorbike" 4 "pedestrian" 5 "general" 6 "animal" 7 "uncertain" 8 " bus; 
 0x9~0xF = Reserved;";

VAL_ 359 FC_Obj8WSInfoPosType 0 "Unknown" 1 "RearLeft" 2 "RearCenter" 3 "RearRgiht" 4 "FrontLeft" 5 "FrontCenter" 6 "FrontRgiht" 7 "LeftCenter" 8 "RgihtCenter" 9 "Center" 10 "预留;";
VAL_ 359 FC_Obj8_TurnLight 0 "";
VAL_ 359 FC_Obj8_valid 0 "";
VAL_ 359 FC_Obj8_objCutInLane 0 "invalid" 1 "measured;
0x2=predicted;";
VAL_ 359 FC_Obj8_objCutInFlag 0 "invalid" 1 "cutin_hostLane" 2 "cutin_fov";
VAL_ 359 FC_Obj8_LaneAssignment 0 "UNKNOWN    
1=LEFT_LEFT    
2=LEFT    
3=HOST    
4=RIGHT     
5=RIGHT_RIGHT
0x6-0x7=Reserved";
VAL_ 359 FC_Obj8_MotionType 0 "Unknown" 1 "Moving" 2 "Stationary" 3 "Stopped" 4 "Moving Slowly";
VAL_ 359 FC_obj8_Brakelight_Info 0 "off" 1 "on ";
VAL_ 359 FC_Obj8_HeadOrientation 0 "Unknown" 1 "Head Front" 2 "Head Left Front" 3 "Head Left" 4 "Head Left Back" 5 "Head Back" 6 "Head Right Back" 7 "Head Right" 8 "Head right front" 9 "Reserved";
VAL_ 359 FC_Obj8_Type 0 "Not Detected;
0x1=car" 2 "truck" 3 "bicycle/motorbike" 4 "pedestrian" 5 "general" 6 "animal" 7 "uncertain" 8 " bus; 
 0x9~0xF = Reserved;";

VAL_ 360 FC_Obj9WSInfoPosType 0 "Unknown" 1 "RearLeft" 2 "RearCenter" 3 "RearRgiht" 4 "FrontLeft" 5 "FrontCenter" 6 "FrontRgiht" 7 "LeftCenter" 8 "RgihtCenter" 9 "Center" 10 "预留;";
VAL_ 360 FC_Obj9_TurnLight 0 "";
VAL_ 360 FC_Obj9_valid 0 "";
VAL_ 360 FC_Obj9_objCutInLane 0 "invalid" 1 "measured;
0x2=predicted;";
VAL_ 360 FC_Obj9_objCutInFlag 0 "invalid" 1 "cutin_hostLane" 2 "cutin_fov";
VAL_ 360 FC_Obj9_LaneAssignment 0 "UNKNOWN    
1=LEFT_LEFT    
2=LEFT    
3=HOST    
4=RIGHT     
5=RIGHT_RIGHT
0x6-0x7=Reserved";
VAL_ 360 FC_Obj9_MotionType 0 "Unknown" 1 "Moving" 2 "Stationary" 3 "Stopped" 4 "Moving Slowly";
VAL_ 360 FC_obj9_Brakelight_Info 0 "off" 1 "on ";
VAL_ 360 FC_Obj9_HeadOrientation 0 "Unknown" 1 "Head Front" 2 "Head Left Front" 3 "Head Left" 4 "Head Left Back" 5 "Head Back" 6 "Head Right Back" 7 "Head Right" 8 "Head right front" 9 "Reserved";
VAL_ 360 FC_Obj9_Type 0 "Not Detected;
0x1=car" 2 "truck" 3 "bicycle/motorbike" 4 "pedestrian" 5 "general" 6 "animal" 7 "uncertain" 8 " bus; 
 0x9~0xF = Reserved;";

VAL_ 361 FC_Obj10WSInfoPosType 0 "Unknown" 1 "RearLeft" 2 "RearCenter" 3 "RearRgiht" 4 "FrontLeft" 5 "FrontCenter" 6 "FrontRgiht" 7 "LeftCenter" 8 "RgihtCenter" 9 "Center" 10 "预留;";
VAL_ 361 FC_Obj10_TurnLight 0 "";
VAL_ 361 FC_Obj10_valid 0 "";
VAL_ 361 FC_Obj10_objCutInLane 0 "invalid" 1 "measured;
0x2=predicted;";
VAL_ 361 FC_Obj10_objCutInFlag 0 "invalid" 1 "cutin_hostLane" 2 "cutin_fov";
VAL_ 361 FC_Obj10_LaneAssignment 0 "UNKNOWN    
1=LEFT_LEFT    
2=LEFT    
3=HOST    
4=RIGHT     
5=RIGHT_RIGHT
0x6-0x7=Reserved";
VAL_ 361 FC_Obj10_MotionType 0 "Unknown" 1 "Moving" 2 "Stationary" 3 "Stopped" 4 "Moving Slowly";
VAL_ 361 FC_obj10_Brakelight_Info 0 "off" 1 "on ";
VAL_ 361 FC_Obj10_HeadOrientation 0 "Unknown" 1 "Head Front" 2 "Head Left Front" 3 "Head Left" 4 "Head Left Back" 5 "Head Back" 6 "Head Right Back" 7 "Head Right" 8 "Head right front" 9 "Reserved";
VAL_ 361 FC_Obj10_Type 0 "Not Detected;
0x1=car" 2 "truck" 3 "bicycle/motorbike" 4 "pedestrian" 5 "general" 6 "animal" 7 "uncertain" 8 " bus; 
 0x9~0xF = Reserved;";

VAL_ 368 FC_Obj11WSInfoPosType 0 "Unknown" 1 "RearLeft" 2 "RearCenter" 3 "RearRgiht" 4 "FrontLeft" 5 "FrontCenter" 6 "FrontRgiht" 7 "LeftCenter" 8 "RgihtCenter" 9 "Center" 10 "预留;";
VAL_ 368 FC_Obj11_TurnLight 0 "";
VAL_ 368 FC_Obj11_valid 0 "";
VAL_ 368 FC_Obj11_objCutInLane 0 "invalid" 1 "measured;
0x2=predicted;";
VAL_ 368 FC_Obj11_objCutInFlag 0 "invalid" 1 "cutin_hostLane" 2 "cutin_fov";
VAL_ 368 FC_Obj11_LaneAssignment 0 "UNKNOWN    
1=LEFT_LEFT    
2=LEFT    
3=HOST    
4=RIGHT     
5=RIGHT_RIGHT
0x6-0x7=Reserved";
VAL_ 368 FC_Obj11_MotionType 0 "Unknown" 1 "Moving" 2 "Stationary" 3 "Stopped" 4 "Moving Slowly";
VAL_ 368 FC_obj11_Brakelight_Info 0 "off" 1 "on ";
VAL_ 368 FC_Obj11_HeadOrientation 0 "Unknown" 1 "Head Front" 2 "Head Left Front" 3 "Head Left" 4 "Head Left Back" 5 "Head Back" 6 "Head Right Back" 7 "Head Right" 8 "Head right front" 9 "Reserved";
VAL_ 368 FC_Obj11_Type 0 "Not Detected;
0x1=car" 2 "truck" 3 "bicycle/motorbike" 4 "pedestrian" 5 "general" 6 "animal" 7 "uncertain" 8 " bus; 
 0x9~0xF = Reserved;";

VAL_ 369 FC_Obj12WSInfoPosType 0 "Unknown" 1 "RearLeft" 2 "RearCenter" 3 "RearRgiht" 4 "FrontLeft" 5 "FrontCenter" 6 "FrontRgiht" 7 "LeftCenter" 8 "RgihtCenter" 9 "Center" 10 "预留;";
VAL_ 369 FC_Obj12_TurnLight 0 "";
VAL_ 369 FC_Obj12_valid 0 "";
VAL_ 369 FC_Obj12_objCutInLane 0 "invalid" 1 "measured;
0x2=predicted;";
VAL_ 369 FC_Obj12_objCutInFlag 0 "invalid" 1 "cutin_hostLane" 2 "cutin_fov";
VAL_ 369 FC_Obj12_LaneAssignment 0 "UNKNOWN    
1=LEFT_LEFT    
2=LEFT    
3=HOST    
4=RIGHT     
5=RIGHT_RIGHT
0x6-0x7=Reserved";
VAL_ 369 FC_Obj12_MotionType 0 "Unknown" 1 "Moving" 2 "Stationary" 3 "Stopped" 4 "Moving Slowly";
VAL_ 369 FC_obj12_Brakelight_Info 0 "off" 1 "on ";
VAL_ 369 FC_Obj12_HeadOrientation 0 "Unknown" 1 "Head Front" 2 "Head Left Front" 3 "Head Left" 4 "Head Left Back" 5 "Head Back" 6 "Head Right Back" 7 "Head Right" 8 "Head right front" 9 "Reserved";
VAL_ 369 FC_Obj12_Type 0 "Not Detected;
0x1=car" 2 "truck" 3 "bicycle/motorbike" 4 "pedestrian" 5 "general" 6 "animal" 7 "uncertain" 8 " bus; 
 0x9~0xF = Reserved;";

VAL_ 370 FC_Obj13WSInfoPosType 0 "Unknown" 1 "RearLeft" 2 "RearCenter" 3 "RearRgiht" 4 "FrontLeft" 5 "FrontCenter" 6 "FrontRgiht" 7 "LeftCenter" 8 "RgihtCenter" 9 "Center" 10 "预留;";
VAL_ 370 FC_Obj13_TurnLight 0 "";
VAL_ 370 FC_Obj13_valid 0 "";
VAL_ 370 FC_Obj13_objCutInLane 0 "invalid" 1 "measured;
0x2=predicted;";
VAL_ 370 FC_Obj13_objCutInFlag 0 "invalid" 1 "cutin_hostLane" 2 "cutin_fov";
VAL_ 370 FC_Obj13_LaneAssignment 0 "UNKNOWN    
1=LEFT_LEFT    
2=LEFT    
3=HOST    
4=RIGHT     
5=RIGHT_RIGHT
0x6-0x7=Reserved";
VAL_ 370 FC_Obj13_MotionType 0 "Unknown" 1 "Moving" 2 "Stationary" 3 "Stopped" 4 "Moving Slowly";
VAL_ 370 FC_obj13_Brakelight_Info 0 "off" 1 "on ";
VAL_ 370 FC_Obj13_HeadOrientation 0 "Unknown" 1 "Head Front" 2 "Head Left Front" 3 "Head Left" 4 "Head Left Back" 5 "Head Back" 6 "Head Right Back" 7 "Head Right" 8 "Head right front" 9 "Reserved";
VAL_ 370 FC_Obj13_Type 0 "Not Detected;
0x1=car" 2 "truck" 3 "bicycle/motorbike" 4 "pedestrian" 5 "general" 6 "animal" 7 "uncertain" 8 " bus; 
 0x9~0xF = Reserved;";

VAL_ 371 FC_Obj14WSInfoPosType 0 "Unknown" 1 "RearLeft" 2 "RearCenter" 3 "RearRgiht" 4 "FrontLeft" 5 "FrontCenter" 6 "FrontRgiht" 7 "LeftCenter" 8 "RgihtCenter" 9 "Center" 10 "预留;";
VAL_ 371 FC_Obj14_TurnLight 0 "";
VAL_ 371 FC_Obj14_valid 0 "";
VAL_ 371 FC_Obj14_objCutInLane 0 "invalid" 1 "measured;
0x2=predicted;";
VAL_ 371 FC_Obj14_objCutInFlag 0 "invalid" 1 "cutin_hostLane" 2 "cutin_fov";
VAL_ 371 FC_Obj14_LaneAssignment 0 "UNKNOWN    
1=LEFT_LEFT    
2=LEFT    
3=HOST    
4=RIGHT     
5=RIGHT_RIGHT
0x6-0x7=Reserved";
VAL_ 371 FC_Obj14_MotionType 0 "Unknown" 1 "Moving" 2 "Stationary" 3 "Stopped" 4 "Moving Slowly";
VAL_ 371 FC_obj14_Brakelight_Info 0 "off" 1 "on ";
VAL_ 371 FC_Obj14_HeadOrientation 0 "Unknown" 1 "Head Front" 2 "Head Left Front" 3 "Head Left" 4 "Head Left Back" 5 "Head Back" 6 "Head Right Back" 7 "Head Right" 8 "Head right front" 9 "Reserved";
VAL_ 371 FC_Obj14_Type 0 "Not Detected;
0x1=car" 2 "truck" 3 "bicycle/motorbike" 4 "pedestrian" 5 "general" 6 "animal" 7 "uncertain" 8 " bus; 
 0x9~0xF = Reserved;";

VAL_ 372 FC_Obj15WSInfoPosType 0 "Unknown" 1 "RearLeft" 2 "RearCenter" 3 "RearRgiht" 4 "FrontLeft" 5 "FrontCenter" 6 "FrontRgiht" 7 "LeftCenter" 8 "RgihtCenter" 9 "Center" 10 "预留;";
VAL_ 372 FC_Obj15_TurnLight 0 "";
VAL_ 372 FC_Obj15_valid 0 "";
VAL_ 372 FC_Obj15_objCutInLane 0 "invalid" 1 "measured;
0x2=predicted;";
VAL_ 372 FC_Obj15_objCutInFlag 0 "invalid" 1 "cutin_hostLane" 2 "cutin_fov";
VAL_ 372 FC_Obj15_LaneAssignment 0 "UNKNOWN    
1=LEFT_LEFT    
2=LEFT    
3=HOST    
4=RIGHT     
5=RIGHT_RIGHT
0x6-0x7=Reserved";
VAL_ 372 FC_Obj15_MotionType 0 "Unknown" 1 "Moving" 2 "Stationary" 3 "Stopped" 4 "Moving Slowly";
VAL_ 372 FC_obj15_Brakelight_Info 0 "off" 1 "on ";
VAL_ 372 FC_Obj15_HeadOrientation 0 "Unknown" 1 "Head Front" 2 "Head Left Front" 3 "Head Left" 4 "Head Left Back" 5 "Head Back" 6 "Head Right Back" 7 "Head Right" 8 "Head right front" 9 "Reserved";
VAL_ 372 FC_Obj15_Type 0 "Not Detected;
0x1=car" 2 "truck" 3 "bicycle/motorbike" 4 "pedestrian" 5 "general" 6 "animal" 7 "uncertain" 8 " bus; 
 0x9~0xF = Reserved;";
