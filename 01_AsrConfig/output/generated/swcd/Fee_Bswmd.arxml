AUTOSAR XML (schema 4-0-3)
package /AUTOSAR_Fee/BswModuleDescriptions
  bsw module description Fee: module-id=21, provided-entrys=[Fee_Init, Fee_MainFunction]
    bsw internal behavior InternalBehavior_0
      bsw called entity Fee_Init: implemented-entry=Fee_Init
      bsw schedulable entity Fee_MainFunction: implemented-entry=Fee_MainFunction
      bsw timing event TimingEvent_MainFunction: starts-on-event=Fee_MainFunction, period=0.01
package /AUTOSAR_Fee/BswModuleEntrys
  bsw module entry Fee_Init: service-id=0, is-reentrant=false, is-synchronous=true, call-type=REGULAR, execution-context=UNSPECIFIED, sw-service-impl-policy=STANDARD
  bsw module entry Fee_MainFunction: service-id=18, is-reentrant=false, is-synchronous=true, call-type=SCHEDULED, execution-context=TASK, sw-service-impl-policy=STANDARD
package /Fee_Aurix2GAS422/Implementations
  bsw implementation BswImplementation_0: programming-language=C, sw-version=20.0.2, vendor-id=17, ar-release-version=4.2.2, behavior=InternalBehavior_0, vendor-specific-module-def=Fee
    code-descriptors:
      code Files: artifact-descriptors=[{short-label=make::Fee_defs.mak, category=SWMAKE}, {short-label=make::Fee_rules.mak, category=SWMAKE}]
    resource consumption ResourceConsumption
      11 x memory section:
        FEE_CODE: sw-addrmethod=CODE, symbol=CODE
        CODE_ASIL_B_LOCAL: alignment=UNSPECIFIED, options=[coreLocal, safetyAsilB], sw-addrmethod=CODE_ASIL_B_LOCAL
        JOBENDNOTIF_CODE_ASIL_B_LOCAL: alignment=UNSPECIFIED, options=[coreLocal, safetyAsilB], sw-addrmethod=CODE_ASIL_B_LOCAL
        JOBERRNOTIF_CODE_ASIL_B_LOCAL: alignment=UNSPECIFIED, options=[coreLocal, safetyAsilB], sw-addrmethod=CODE_ASIL_B_LOCAL
        ILLEGALNOTIF_CODE_ASIL_B_LOCAL: alignment=UNSPECIFIED, options=[coreLocal, safetyAsilB], sw-addrmethod=CODE_ASIL_B_LOCAL
        ERASEERRORNOTI_CODE_ASIL_B_LOCAL: alignment=UNSPECIFIED, options=[coreLocal, safetyAsilB], sw-addrmethod=CODE_ASIL_B_LOCAL
        PROGERRORNOTI_CODE_ASIL_B_LOCAL: alignment=UNSPECIFIED, options=[coreLocal, safetyAsilB], sw-addrmethod=CODE_ASIL_B_LOCAL
        VAR_CLEARED_ASIL_B_LOCAL_UNSPECIFIED: alignment=UNSPECIFIED, options=[coreLocal, safetyAsilB], sw-addrmethod=VAR_CLEARED_ASIL_B_LOCAL
        VAR_CLEARED_ASIL_B_LOCAL_32: alignment=32, options=[coreLocal, safetyAsilB], sw-addrmethod=VAR_CLEARED_ASIL_B_LOCAL
        CONST_ASIL_B_LOCAL_32: alignment=32, options=[coreLocal, safetyAsilB], sw-addrmethod=CONST_ASIL_B_LOCAL
        CONFIG_DATA_ASIL_B_LOCAL_UNSPECIFIED: alignment=UNSPECIFIED, options=[coreLocal, safetyAsilB], sw-addrmethod=CONFIG_DATA_ASIL_B_LOCAL
      section name prefix FEE
