AUTOSAR XML (schema 4-2-1)
package /CanSystem
  system CanSystem
    system mapping EBConnectionEditorMappings
      sw-mappings:
        swc to ecu mapping EBConnectionEditorSwcMappings: component=[TopLevelComposition.DevelopmentErrorTracer_Prototype, TopLevelComposition.BswM_Prototype], ecu-instance=EcuTestNode
package /DemoApplication/SwComponentTypes
  composition sw component type TopLevelComposition
    component BswM_Prototype: type=BswM
    component DevelopmentErrorTracer_Prototype: type=DevelopmentErrorTracer
    connect BswM_Prototype.BswM_ModeSwitchPort_BswMSwitchPort_Rte -> SWC_CyclicCounter.ModeSwitchPort_BSWM_COMBINEDACTION_BswMMode_PortInterfaces_BswMMode
    connect DevelopmentErrorTracer_Prototype.DS_SWC_0 -> SWC_CyclicCounter.R_CyclicCounterDet
