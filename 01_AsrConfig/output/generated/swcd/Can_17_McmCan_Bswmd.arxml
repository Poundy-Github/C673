AUTOSAR XML (schema 4-0-3)
package /AUTOSAR_Can/BswModuleDescriptions
  bsw module description Can_17_McmCan: module-id=80, provided-entrys=[Can_17_McmCan_Init, Can_17_McmCan_MainFunction_Mode]
    bsw internal behavior InternalBehavior_0
      exclusive area CanWrMO
      exclusive area IcomMsgCntrVal
      bsw called entity Can_17_McmCan_Init: can-enter-exclusive-area=[CanWrMO, IcomMsgCntrVal], implemented-entry=Can_17_McmCan_Init
      bsw schedulable entity Can_17_McmCan_MainFunction_Mode: implemented-entry=Can_17_McmCan_MainFunction_Mode
      bsw timing event TimingEvent_MainFunction_Mode: starts-on-event=Can_17_McmCan_MainFunction_Mode, period=0.005
package /AUTOSAR_Can/BswModuleEntrys
  bsw module entry Can_17_McmCan_Init: service-id=0, is-reentrant=false, is-synchronous=true, call-type=REGULAR, execution-context=UNSPECIFIED, sw-service-impl-policy=STANDARD
  bsw module entry Can_17_McmCan_MainFunction_Mode: service-id=12, is-reentrant=false, is-synchronous=true, call-type=SCHEDULED, execution-context=TASK, sw-service-impl-policy=STANDARD
package /Can_Aurix2GAS422/Implementations
  bsw implementation BswImplementation_0: programming-language=C, sw-version=20.0.2, vendor-id=17, ar-release-version=4.2.2, behavior=InternalBehavior_0, vendor-specific-module-def=Can
    code-descriptors:
      code Files: artifact-descriptors=[{short-label=make::Can_defs.mak, category=SWMAKE}, {short-label=make::Can_rules.mak, category=SWMAKE}]
    resource consumption ResourceConsumption
      21 x memory section, all with alignment=UNSPECIFIED:
        VAR_CLEARED_QM_CORE0_UNSPECIFIED: sw-addrmethod=VAR_CLEARED
        VAR_INIT_QM_CORE0_UNSPECIFIED: sw-addrmethod=VAR_INIT
        VAR_CLEARED_QM_CORE1_UNSPECIFIED: sw-addrmethod=VAR_CLEARED
        VAR_INIT_QM_CORE1_UNSPECIFIED: sw-addrmethod=VAR_INIT
        VAR_CLEARED_QM_CORE2_UNSPECIFIED: sw-addrmethod=VAR_CLEARED
        VAR_INIT_QM_CORE2_UNSPECIFIED: sw-addrmethod=VAR_INIT
        VAR_CLEARED_QM_CORE3_UNSPECIFIED: sw-addrmethod=VAR_CLEARED
        VAR_INIT_QM_CORE3_UNSPECIFIED: sw-addrmethod=VAR_INIT
        VAR_CLEARED_QM_GLOBAL_UNSPECIFIED: sw-addrmethod=VAR_CLEARED
        CONST_QM_GLOBAL_UNSPECIFIED: sw-addrmethod=CONST
        CONST_QM_CORE{0..3}_UNSPECIFIED: sw-addrmethod=CONST
        CONFIG_DATA_QM_GLOBAL_UNSPECIFIED: sw-addrmethod=CONFIG_DATA
        CONFIG_DATA_QM_CORE{0..3}_UNSPECIFIED: sw-addrmethod=CONFIG_DATA
        CODE_QM_GLOBAL: sw-addrmethod=CODE
        CODE: sw-addrmethod=CODE
      section name prefix CAN_17_MCMCAN
