AUTOSAR XML (schema 4-0-3)
package /AUTOSAR_StbM/PortInterfaces
  client server interface StbM_GlobalTime_Slave_StbMSynchronizedTimeBase_0: is-service=true
    4 x operation, all with possible-error=[E_OK, E_NOT_OK]:
      GetCurrentTime
        arg timeStampPtr: type=StbM_TimeStampType, direction=OUT
        arg userDataPtr: type=StbM_UserDataType, direction=OUT
      GetRateDeviation
        arg rateDeviation: type=StbM_RateDeviationType, direction=OUT
      GetTimeBaseStatus
        arg syncTimeBaseStatusPtr: type=StbM_TimeBaseStatusType, direction=OUT
        arg offsetTimeBaseStatusPtr: type=StbM_TimeBaseStatusType, direction=OUT
      GetTimeLeap
        arg timeJump: type=StbM_TimeDiffType, direction=OUT
    error E_OK: error-code=0
    error E_NOT_OK: error-code=1
