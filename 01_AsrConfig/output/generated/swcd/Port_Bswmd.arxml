AUTOSAR XML (schema 4-0-3)
package /AUTOSAR_Port/BswModuleDescriptions
  bsw module description Port: module-id=124, provided-entrys=Port_Init
    bsw internal behavior InternalBehavior_0
      bsw called entity Port_Init: implemented-entry=Port_Init
package /AUTOSAR_Port/BswModuleEntrys
  bsw module entry Port_Init: service-id=1000, is-reentrant=false, is-synchronous=true, call-type=REGULAR, execution-context=UNSPECIFIED, sw-service-impl-policy=STANDARD
package /Port_Aurix2GAS422/Implementations
  bsw implementation BswImplementation_0: programming-language=C, sw-version=20.0.1, vendor-id=17, ar-release-version=4.2.2, behavior=InternalBehavior_0, vendor-specific-module-def=Port
    code-descriptors:
      code Files
        artifact-descriptors:
          short-label=make::Port_defs.mak, category=SWMAKE
          short-label=make::Port_rules.mak, category=SWMAKE
    resource consumption ResourceConsumption
      5 x memory section, all with options=safetyAsilB:
        VAR_CLEARED_ASIL_B_GLOBAL_8: alignment=8, sw-addrmethod=VAR_CLEARED_ASIL_B
        VAR_CLEARED_ASIL_B_GLOBAL_32: alignment=32, sw-addrmethod=VAR_CLEARED_ASIL_B
        CONST_ASIL_B_GLOBAL_16: alignment=16, sw-addrmethod=CONST_ASIL_B
        CONFIG_DATA_ASIL_B_GLOBAL_UNSPECIFIED: alignment=UNSPECIFIED, sw-addrmethod=CONFIG_DATA_ASIL_B
        CODE_ASIL_B_GLOBAL: alignment=UNSPECIFIED, sw-addrmethod=CODE_ASIL_B
      section name prefix PORT
