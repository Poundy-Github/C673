AUTOSAR XML (schema 4-0-3)
package /AUTOSAR_Dma/BswModuleDescriptions
  bsw module description Dma: module-id=255, provided-entrys=Dma_Init
    bsw internal behavior InternalBehavior_0
      exclusive area ChannelConfigUpdate
      bsw called entity Dma_Init: can-enter-exclusive-area=ChannelConfigUpdate, implemented-entry=Dma_Init
package /AUTOSAR_Dma/BswModuleEntrys
  bsw module entry Dma_Init: service-id=1000, is-reentrant=false, is-synchronous=true, call-type=REGULAR, execution-context=UNSPECIFIED, sw-service-impl-policy=STANDARD
package /Dma_Aurix2GAS422/Implementations
  bsw implementation BswImplementation_0: programming-language=C, sw-version=20.0.2, vendor-id=17, ar-release-version=4.2.2, behavior=InternalBehavior_0, vendor-specific-module-def=Dma
    code-descriptors:
      code Files: artifact-descriptors=[{short-label=make::Dma_defs.mak, category=SWMAKE}, {short-label=make::Dma_rules.mak, category=SWMAKE}]
    resource consumption ResourceConsumption
      17 x memory section, all with options=safetyAsilB:
        VAR_CLEARED_ASIL_B_GLOBAL_32: alignment=32, sw-addrmethod=VAR_CLEARED_ASIL_B
        VAR_CLEARED_ASIL_B_GLOBAL_8: alignment=8, sw-addrmethod=VAR_CLEARED_ASIL_B
        CODE_ASIL_B_GLOBAL: alignment=UNSPECIFIED, sw-addrmethod=CODE_ASIL_B
        CONST_ASIL_B_GLOBAL_32: alignment=32, sw-addrmethod=CONST_ASIL_B
        CONFIG_DATA_ASIL_B_CORE0_256: alignment=256, sw-addrmethod=CONFIG_DATA_ASIL_B
        CONFIG_DATA_ASIL_B_CORE0_UNSPECIFIED: alignment=UNSPECIFIED, sw-addrmethod=CONFIG_DATA_ASIL_B
        VAR_CLEARED_ASIL_B_CORE0_8: alignment=8, sw-addrmethod=VAR_CLEARED_ASIL_B
        CONFIG_DATA_ASIL_B_CORE1_256: alignment=256, sw-addrmethod=CONFIG_DATA_ASIL_B
        CONFIG_DATA_ASIL_B_CORE1_UNSPECIFIED: alignment=UNSPECIFIED, sw-addrmethod=CONFIG_DATA_ASIL_B
        VAR_CLEARED_ASIL_B_CORE1_8: alignment=8, sw-addrmethod=VAR_CLEARED_ASIL_B
        CONFIG_DATA_ASIL_B_CORE2_256: alignment=256, sw-addrmethod=CONFIG_DATA_ASIL_B
        CONFIG_DATA_ASIL_B_CORE2_UNSPECIFIED: alignment=UNSPECIFIED, sw-addrmethod=CONFIG_DATA_ASIL_B
        VAR_CLEARED_ASIL_B_CORE2_8: alignment=8, sw-addrmethod=VAR_CLEARED_ASIL_B
        CONFIG_DATA_ASIL_B_CORE3_256: alignment=256, sw-addrmethod=CONFIG_DATA_ASIL_B
        CONFIG_DATA_ASIL_B_CORE3_UNSPECIFIED: alignment=UNSPECIFIED, sw-addrmethod=CONFIG_DATA_ASIL_B
        VAR_CLEARED_ASIL_B_CORE3_8: alignment=8, sw-addrmethod=VAR_CLEARED_ASIL_B
        CONFIG_DATA_ASIL_B_GLOBAL_UNSPECIFIED: alignment=UNSPECIFIED, sw-addrmethod=CONFIG_DATA_ASIL_B
      section name prefix DMA
