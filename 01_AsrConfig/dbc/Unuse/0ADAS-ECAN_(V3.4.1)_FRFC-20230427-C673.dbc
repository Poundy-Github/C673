VERSION ""

NS_ :

BS_:
BU_: FR FC ADC
BO_ 273 FR_111: 64 FR
 SG_ FR_OBJ2_Ax : 482|7@0+ (0.2000000000,-13.0000000000) [-13.0000000000|12.6000000000] "m/s2"  FR,ADC,FC
 SG_ FR_OBJ2_Ay : 473|7@0+ (0.2000000000,-13.0000000000) [-13.0000000000|12.6000000000] "m/s2"  FR,ADC,FC
 SG_ FR_OBJ2_Vx : 466|9@0+ (0.2000000000,-51.0000000000) [-51.0000000000|51.2000000000] "m/s"  FR,ADC,FC
 SG_ FR_OBJ2_Vy : 459|9@0+ (0.2000000000,-51.0000000000) [-51.0000000000|51.2000000000] "m/s"  FR,ADC,FC
 SG_ FR_OBJ1_Ax : 450|7@0+ (0.2000000000,-13.0000000000) [-13.0000000000|12.6000000000] "m/s2"  FR,ADC,FC
 SG_ FR_OBJ1_Ay : 441|7@0+ (0.2000000000,-13.0000000000) [-13.0000000000|12.6000000000] "m/s2"  FR,ADC,FC
 SG_ FR_OBJ1_Vx : 434|9@0+ (0.2000000000,-51.0000000000) [-51.0000000000|51.2000000000] "m/s"  FR,ADC,FC
 SG_ FR_OBJ1_Vy : 427|9@0+ (0.2000000000,-51.0000000000) [-51.0000000000|51.2000000000] "m/s"  FR,ADC,FC
 SG_ FR_OBJ2_FeaturePoint : 431|4@0+ (1.0000000000,0.0000000000) [0.0000000000|9.0000000000] "-"  FR,ADC,FC
 SG_ FR_OBJ1_FeaturePoint : 419|4@0+ (1.0000000000,0.0000000000) [0.0000000000|9.0000000000] "-"  FR,ADC,FC
 SG_ FR_CRCCheck_111 : 503|16@0+ (1.0000000000,0.0000000000) [0.0000000000|65535.0000000000] ""  FR,ADC,FC
 SG_ FR_RollingCounter_111 : 491|4@0+ (1.0000000000,0.0000000000) [0.0000000000|15.0000000000] ""  FR,ADC,FC
 SG_ FR_OBJ2_HeightGround : 211|9@0+ (0.1000000000,0.0000000000) [0.0000000000|51.1000000000] "m"  FR,ADC,FC
 SG_ FR_OBJ2_MotionStatusConf : 397|6@0+ (2.0000000000,0.0000000000) [0.0000000000|63.0000000000] "-"  FR,ADC,FC
 SG_ FR_OBJ2_ClassConf : 377|6@0+ (2.0000000000,0.0000000000) [0.0000000000|63.0000000000] "-"  FR,ADC,FC
 SG_ FR_OBJ2_MotionStatus : 370|3@0+ (1.0000000000,0.0000000000) [0.0000000000|7.0000000000] ""  FR,ADC,FC
 SG_ FR_OBJ2_Location : 375|2@0+ (1.0000000000,0.0000000000) [0.0000000000|3.0000000000] ""  FR,ADC,FC
 SG_ FR_OBJ2_Measured : 363|2@0+ (1.0000000000,0.0000000000) [0.0000000000|3.0000000000] ""  FR,ADC,FC
 SG_ FR_OBJ2_valid : 366|1@0+ (1.0000000000,0.0000000000) [0.0000000000|1.0000000000] ""  FR,ADC,FC
 SG_ FR_OBJ2_Track_Age : 359|8@0+ (1.0000000000,0.0000000000) [0.0000000000|255.0000000000] ""  FR,ADC,FC
 SG_ FR_OBJ2_Track_ID : 351|8@0+ (1.0000000000,0.0000000000) [0.0000000000|255.0000000000] ""  FR,ADC,FC
 SG_ FR_OBJ2_ObstacleProb : 341|6@0+ (2.0000000000,0.0000000000) [0.0000000000|100.0000000000] "%"  FR,ADC,FC
 SG_ FR_OBJ2_ExistProb : 331|6@0+ (2.0000000000,0.0000000000) [0.0000000000|100.0000000000] "%"  FR,ADC,FC
 SG_ FR_OBJ2_RelAx : 325|10@0+ (0.0312500000,-16.0000000000) [-16.0000000000|15.9687500000] "m/s2"  FR,ADC,FC
 SG_ FR_OBJ2_RelAy : 318|9@0+ (0.0625000000,-16.0000000000) [-16.0000000000|15.9375000000] "m/s2"  FR,ADC,FC
 SG_ FR_OBJ2_RelVx_std : 298|12@0+ (0.0625000000,0.0000000000) [0.0000000000|255.9375000000] "m/s"  FR,ADC,FC
 SG_ FR_OBJ2_RelVx : 294|12@0+ (0.0625000000,-128.0000000000) [-128.0000000000|127.9375000000] "m/s"  FR,ADC,FC
 SG_ FR_OBJ2_RelVy_std : 272|10@0+ (0.1250000000,0.0000000000) [0.0000000000|127.8750000000] "m/s"  FR,ADC,FC
 SG_ FR_OBJ2_RelVy : 266|10@0+ (0.1250000000,-64.0000000000) [-64.0000000000|63.8750000000] "m/s"  FR,ADC,FC
 SG_ FR_OBJ2_Dx_Vnce : 248|14@0+ (0.0500000000,0.0000000000) [0.0000000000|50.0000000000] "m2"  FR,ADC,FC
 SG_ FR_OBJ2_Dx : 245|13@0+ (0.0625000000,-100.0000000000) [-100.0000000000|411.9375000000] "m"  FR,ADC,FC
 SG_ FR_OBJ2_Dy_Vnce : 239|10@0+ (0.0200000000,0.0000000000) [0.0000000000|20.0000000000] "m2"  FR,ADC,FC
 SG_ FR_OBJ2_Dy : 218|11@0+ (0.1250000000,-128.0000000000) [-128.0000000000|127.8750000000] "m"  FR,ADC,FC
 SG_ FR_OBJ2_HeadingAngle : 413|10@0+ (0.0100000000,-3.1400000000) [-3.1400000000|3.1400000000] "rad"  FR,ADC,FC
 SG_ FR_OBJ2_Length : 204|9@0+ (0.0500000000,0.0000000000) [0.0000000000|25.5000000000] "m"  FR,ADC,FC
 SG_ FR_OBJ2_Height : 197|9@0+ (0.0100000000,0.0000000000) [0.0000000000|5.1100000000] "m"  FR,ADC,FC
 SG_ FR_OBJ2_Width : 176|11@0+ (0.0100000000,0.0000000000) [0.0000000000|12.0000000000] "m"  FR,ADC,FC
 SG_ FR_OBJ2_Class : 179|3@0+ (1.0000000000,0.0000000000) [0.0000000000|7.0000000000] ""  FR,ADC,FC
 SG_ FR_OBJ1_HeightGround : 39|9@0+ (0.1000000000,0.0000000000) [0.0000000000|51.1000000000] "m"  FR,ADC,FC
 SG_ FR_OBJ1_MotionStatusConf : 387|6@0+ (2.0000000000,0.0000000000) [0.0000000000|63.0000000000] "-"  FR,ADC,FC
 SG_ FR_OBJ1_ClassConf : 383|6@0+ (2.0000000000,0.0000000000) [0.0000000000|63.0000000000] "-"  FR,ADC,FC
 SG_ FR_OBJ1_MotionStatus : 373|3@0+ (1.0000000000,0.0000000000) [0.0000000000|7.0000000000] ""  FR,ADC,FC
 SG_ FR_OBJ1_Location : 361|2@0+ (1.0000000000,0.0000000000) [0.0000000000|3.0000000000] ""  FR,ADC,FC
 SG_ FR_OBJ1_Measured : 365|2@0+ (1.0000000000,0.0000000000) [0.0000000000|3.0000000000] ""  FR,ADC,FC
 SG_ FR_OBJ1_valid : 367|1@0+ (1.0000000000,0.0000000000) [0.0000000000|1.0000000000] ""  FR,ADC,FC
 SG_ FR_OBJ1_Track_Age : 171|8@0+ (1.0000000000,0.0000000000) [0.0000000000|255.0000000000] ""  FR,ADC,FC
 SG_ FR_OBJ1_Track_ID : 163|8@0+ (1.0000000000,0.0000000000) [0.0000000000|255.0000000000] ""  FR,ADC,FC
 SG_ FR_OBJ1_ObstacleProb : 153|6@0+ (2.0000000000,0.0000000000) [0.0000000000|100.0000000000] "%"  FR,ADC,FC
 SG_ FR_OBJ1_ExistProb : 159|6@0+ (2.0000000000,0.0000000000) [0.0000000000|100.0000000000] "%"  FR,ADC,FC
 SG_ FR_OBJ1_RelAx : 137|10@0+ (0.0312500000,-16.0000000000) [-16.0000000000|15.9687500000] "m/s2"  FR,ADC,FC
 SG_ FR_OBJ1_RelAy : 130|9@0+ (0.0625000000,-16.0000000000) [-16.0000000000|15.9375000000] "m/s2"  FR,ADC,FC
 SG_ FR_OBJ1_RelVx_std : 126|12@0+ (0.0625000000,0.0000000000) [0.0000000000|255.9375000000] "m/s"  FR,ADC,FC
 SG_ FR_OBJ1_RelVx : 106|12@0+ (0.0625000000,-128.0000000000) [-128.0000000000|127.9375000000] "m/s"  FR,ADC,FC
 SG_ FR_OBJ1_RelVy_std : 100|10@0+ (0.1250000000,0.0000000000) [0.0000000000|127.8750000000] "m/s"  FR,ADC,FC
 SG_ FR_OBJ1_RelVy : 94|10@0+ (0.1250000000,-64.0000000000) [-64.0000000000|63.8750000000] "m/s"  FR,ADC,FC
 SG_ FR_OBJ1_Dx_Vnce : 76|14@0+ (0.0500000000,0.0000000000) [0.0000000000|50.0000000000] "m2"  FR,ADC,FC
 SG_ FR_OBJ1_Dx : 57|13@0+ (0.0625000000,-100.0000000000) [-100.0000000000|411.9375000000] "m"  FR,ADC,FC
 SG_ FR_OBJ1_Dy_Vnce : 51|10@0+ (0.0200000000,0.0000000000) [0.0000000000|20.0000000000] "m2"  FR,ADC,FC
 SG_ FR_OBJ1_Dy : 46|11@0+ (0.1250000000,-128.0000000000) [-128.0000000000|127.8750000000] "m"  FR,ADC,FC
 SG_ FR_OBJ1_HeadingAngle : 407|10@0+ (0.0100000000,-3.1400000000) [-3.1400000000|3.1400000000] "rad"  FR,ADC,FC
 SG_ FR_OBJ1_Length : 16|9@0+ (0.0500000000,0.0000000000) [0.0000000000|25.5000000000] "m"  FR,ADC,FC
 SG_ FR_OBJ1_Height : 9|9@0+ (0.0100000000,0.0000000000) [0.0000000000|5.1100000000] "m"  FR,ADC,FC
 SG_ FR_OBJ1_Width : 4|11@0+ (0.0100000000,0.0000000000) [0.0000000000|12.0000000000] "m"  FR,ADC,FC
 SG_ FR_OBJ1_Class : 7|3@0+ (1.0000000000,0.0000000000) [0.0000000000|7.0000000000] ""  FR,ADC,FC

BO_ 274 FR_112: 64 FR
 SG_ FR_OBJ4_Ax : 482|7@0+ (0.2000000000,-13.0000000000) [-13.0000000000|12.6000000000] "m/s2"  FR,ADC,FC
 SG_ FR_OBJ4_Ay : 473|7@0+ (0.2000000000,-13.0000000000) [-13.0000000000|12.6000000000] "m/s2"  FR,ADC,FC
 SG_ FR_OBJ4_Vx : 466|9@0+ (0.2000000000,-51.0000000000) [-51.0000000000|51.2000000000] "m/s"  FR,ADC,FC
 SG_ FR_OBJ4_Vy : 459|9@0+ (0.2000000000,-51.0000000000) [-51.0000000000|51.2000000000] "m/s"  FR,ADC,FC
 SG_ FR_OBJ3_Ax : 450|7@0+ (0.2000000000,-13.0000000000) [-13.0000000000|12.6000000000] "m/s2"  FR,ADC,FC
 SG_ FR_OBJ3_Ay : 441|7@0+ (0.2000000000,-13.0000000000) [-13.0000000000|12.6000000000] "m/s2"  FR,ADC,FC
 SG_ FR_OBJ3_Vx : 434|9@0+ (0.2000000000,-51.0000000000) [-51.0000000000|51.2000000000] "m/s"  FR,ADC,FC
 SG_ FR_OBJ3_Vy : 427|9@0+ (0.2000000000,-51.0000000000) [-51.0000000000|51.2000000000] "m/s"  FR,ADC,FC
 SG_ FR_OBJ4_FeaturePoint : 431|4@0+ (1.0000000000,0.0000000000) [0.0000000000|9.0000000000] "-"  FR,ADC,FC
 SG_ FR_OBJ3_FeaturePoint : 419|4@0+ (1.0000000000,0.0000000000) [0.0000000000|9.0000000000] "-"  FR,ADC,FC
 SG_ FR_CRCCheck_112 : 503|16@0+ (1.0000000000,0.0000000000) [0.0000000000|65535.0000000000] ""  FR,ADC,FC
 SG_ FR_RollingCounter_112 : 491|4@0+ (1.0000000000,0.0000000000) [0.0000000000|15.0000000000] ""  FR,ADC,FC
 SG_ FR_OBJ4_HeightGround : 211|9@0+ (0.1000000000,0.0000000000) [0.0000000000|51.1000000000] "m"  FR,ADC,FC
 SG_ FR_OBJ4_MotionStatusConf : 397|6@0+ (2.0000000000,0.0000000000) [0.0000000000|63.0000000000] "-"  FR,ADC,FC
 SG_ FR_OBJ4_ClassConf : 377|6@0+ (2.0000000000,0.0000000000) [0.0000000000|63.0000000000] "-"  FR,ADC,FC
 SG_ FR_OBJ4_MotionStatus : 370|3@0+ (1.0000000000,0.0000000000) [0.0000000000|7.0000000000] ""  FR,ADC,FC
 SG_ FR_OBJ4_Location : 375|2@0+ (1.0000000000,0.0000000000) [0.0000000000|3.0000000000] ""  FR,ADC,FC
 SG_ FR_OBJ4_Measured : 363|2@0+ (1.0000000000,0.0000000000) [0.0000000000|3.0000000000] ""  FR,ADC,FC
 SG_ FR_OBJ4_valid : 366|1@0+ (1.0000000000,0.0000000000) [0.0000000000|1.0000000000] ""  FR,ADC,FC
 SG_ FR_OBJ4_Track_Age : 359|8@0+ (1.0000000000,0.0000000000) [0.0000000000|255.0000000000] ""  FR,ADC,FC
 SG_ FR_OBJ4_Track_ID : 351|8@0+ (1.0000000000,0.0000000000) [0.0000000000|255.0000000000] ""  FR,ADC,FC
 SG_ FR_OBJ4_ObstacleProb : 341|6@0+ (2.0000000000,0.0000000000) [0.0000000000|100.0000000000] "%"  FR,ADC,FC
 SG_ FR_OBJ4_ExistProb : 331|6@0+ (2.0000000000,0.0000000000) [0.0000000000|100.0000000000] "%"  FR,ADC,FC
 SG_ FR_OBJ4_RelAx : 325|10@0+ (0.0312500000,-16.0000000000) [-16.0000000000|15.9687500000] "m/s2"  FR,ADC,FC
 SG_ FR_OBJ4_RelAy : 318|9@0+ (0.0625000000,-16.0000000000) [-16.0000000000|15.9375000000] "m/s2"  FR,ADC,FC
 SG_ FR_OBJ4_RelVx_std : 298|12@0+ (0.0625000000,0.0000000000) [0.0000000000|255.9375000000] "m/s"  FR,ADC,FC
 SG_ FR_OBJ4_RelVx : 294|12@0+ (0.0625000000,-128.0000000000) [-128.0000000000|127.9375000000] "m/s"  FR,ADC,FC
 SG_ FR_OBJ4_RelVy_std : 272|10@0+ (0.1250000000,0.0000000000) [0.0000000000|127.8750000000] "m/s"  FR,ADC,FC
 SG_ FR_OBJ4_RelVy : 266|10@0+ (0.1250000000,-64.0000000000) [-64.0000000000|63.8750000000] "m/s"  FR,ADC,FC
 SG_ FR_OBJ4_Dx_Vnce : 248|14@0+ (0.0500000000,0.0000000000) [0.0000000000|50.0000000000] "m2"  FR,ADC,FC
 SG_ FR_OBJ4_Dx : 245|13@0+ (0.0625000000,-100.0000000000) [-100.0000000000|411.9375000000] "m"  FR,ADC,FC
 SG_ FR_OBJ4_Dy_Vnce : 239|10@0+ (0.0200000000,0.0000000000) [0.0000000000|20.0000000000] "m2"  FR,ADC,FC
 SG_ FR_OBJ4_Dy : 218|11@0+ (0.1250000000,-128.0000000000) [-128.0000000000|127.8750000000] "m"  FR,ADC,FC
 SG_ FR_OBJ4_HeadingAngle : 413|10@0+ (0.0100000000,-3.1400000000) [-3.1400000000|3.1400000000] "rad"  FR,ADC,FC
 SG_ FR_OBJ4_Length : 204|9@0+ (0.0500000000,0.0000000000) [0.0000000000|25.5000000000] "m"  FR,ADC,FC
 SG_ FR_OBJ4_Height : 197|9@0+ (0.0100000000,0.0000000000) [0.0000000000|5.1100000000] "m"  FR,ADC,FC
 SG_ FR_OBJ4_Width : 176|11@0+ (0.0100000000,0.0000000000) [0.0000000000|12.0000000000] "m"  FR,ADC,FC
 SG_ FR_OBJ4_Class : 179|3@0+ (1.0000000000,0.0000000000) [0.0000000000|7.0000000000] ""  FR,ADC,FC
 SG_ FR_OBJ3_HeightGround : 39|9@0+ (0.1000000000,0.0000000000) [0.0000000000|51.1000000000] "m"  FR,ADC,FC
 SG_ FR_OBJ3_MotionStatusConf : 387|6@0+ (2.0000000000,0.0000000000) [0.0000000000|63.0000000000] "-"  FR,ADC,FC
 SG_ FR_OBJ3_ClassConf : 383|6@0+ (2.0000000000,0.0000000000) [0.0000000000|63.0000000000] "-"  FR,ADC,FC
 SG_ FR_OBJ3_MotionStatus : 373|3@0+ (1.0000000000,0.0000000000) [0.0000000000|7.0000000000] ""  FR,ADC,FC
 SG_ FR_OBJ3_Location : 361|2@0+ (1.0000000000,0.0000000000) [0.0000000000|3.0000000000] ""  FR,ADC,FC
 SG_ FR_OBJ3_Measured : 365|2@0+ (1.0000000000,0.0000000000) [0.0000000000|3.0000000000] ""  FR,ADC,FC
 SG_ FR_OBJ3_valid : 367|1@0+ (1.0000000000,0.0000000000) [0.0000000000|1.0000000000] ""  FR,ADC,FC
 SG_ FR_OBJ3_Track_Age : 171|8@0+ (1.0000000000,0.0000000000) [0.0000000000|255.0000000000] ""  FR,ADC,FC
 SG_ FR_OBJ3_Track_ID : 163|8@0+ (1.0000000000,0.0000000000) [0.0000000000|255.0000000000] ""  FR,ADC,FC
 SG_ FR_OBJ3_ObstacleProb : 153|6@0+ (2.0000000000,0.0000000000) [0.0000000000|100.0000000000] "%"  FR,ADC,FC
 SG_ FR_OBJ3_ExistProb : 159|6@0+ (2.0000000000,0.0000000000) [0.0000000000|100.0000000000] "%"  FR,ADC,FC
 SG_ FR_OBJ3_RelAx : 137|10@0+ (0.0312500000,-16.0000000000) [-16.0000000000|15.9687500000] "m/s2"  FR,ADC,FC
 SG_ FR_OBJ3_RelAy : 130|9@0+ (0.0625000000,-16.0000000000) [-16.0000000000|15.9375000000] "m/s2"  FR,ADC,FC
 SG_ FR_OBJ3_RelVx_std : 126|12@0+ (0.0625000000,0.0000000000) [0.0000000000|255.9375000000] "m/s"  FR,ADC,FC
 SG_ FR_OBJ3_RelVx : 106|12@0+ (0.0625000000,-128.0000000000) [-128.0000000000|127.9375000000] "m/s"  FR,ADC,FC
 SG_ FR_OBJ3_RelVy_std : 100|10@0+ (0.1250000000,0.0000000000) [0.0000000000|127.8750000000] "m/s"  FR,ADC,FC
 SG_ FR_OBJ3_RelVy : 94|10@0+ (0.1250000000,-64.0000000000) [-64.0000000000|63.8750000000] "m/s"  FR,ADC,FC
 SG_ FR_OBJ3_Dx_Vnce : 76|14@0+ (0.0500000000,0.0000000000) [0.0000000000|50.0000000000] "m2"  FR,ADC,FC
 SG_ FR_OBJ3_Dx : 57|13@0+ (0.0625000000,-100.0000000000) [-100.0000000000|411.9375000000] "m"  FR,ADC,FC
 SG_ FR_OBJ3_Dy_Vnce : 51|10@0+ (0.0200000000,0.0000000000) [0.0000000000|20.0000000000] "m2"  FR,ADC,FC
 SG_ FR_OBJ3_Dy : 46|11@0+ (0.1250000000,-128.0000000000) [-128.0000000000|127.8750000000] "m"  FR,ADC,FC
 SG_ FR_OBJ3_HeadingAngle : 407|10@0+ (0.0100000000,-3.1400000000) [-3.1400000000|3.1400000000] "rad"  FR,ADC,FC
 SG_ FR_OBJ3_Length : 16|9@0+ (0.0500000000,0.0000000000) [0.0000000000|25.5000000000] "m"  FR,ADC,FC
 SG_ FR_OBJ3_Height : 9|9@0+ (0.0100000000,0.0000000000) [0.0000000000|5.1100000000] "m"  FR,ADC,FC
 SG_ FR_OBJ3_Width : 4|11@0+ (0.0100000000,0.0000000000) [0.0000000000|12.0000000000] "m"  FR,ADC,FC
 SG_ FR_OBJ3_Class : 7|3@0+ (1.0000000000,0.0000000000) [0.0000000000|7.0000000000] ""  FR,ADC,FC

BO_ 275 FR_113: 64 FR
 SG_ FR_OBJ6_Ax : 482|7@0+ (0.2000000000,-13.0000000000) [-13.0000000000|12.6000000000] "m/s2"  FR,ADC,FC
 SG_ FR_OBJ6_Ay : 473|7@0+ (0.2000000000,-13.0000000000) [-13.0000000000|12.6000000000] "m/s2"  FR,ADC,FC
 SG_ FR_OBJ6_Vx : 466|9@0+ (0.2000000000,-51.0000000000) [-51.0000000000|51.2000000000] "m/s"  FR,ADC,FC
 SG_ FR_OBJ6_Vy : 459|9@0+ (0.2000000000,-51.0000000000) [-51.0000000000|51.2000000000] "m/s"  FR,ADC,FC
 SG_ FR_OBJ5_Ax : 450|7@0+ (0.2000000000,-13.0000000000) [-13.0000000000|12.6000000000] "m/s2"  FR,ADC,FC
 SG_ FR_OBJ5_Ay : 441|7@0+ (0.2000000000,-13.0000000000) [-13.0000000000|12.6000000000] "m/s2"  FR,ADC,FC
 SG_ FR_OBJ5_Vx : 434|9@0+ (0.2000000000,-51.0000000000) [-51.0000000000|51.2000000000] "m/s"  FR,ADC,FC
 SG_ FR_OBJ5_Vy : 427|9@0+ (0.2000000000,-51.0000000000) [-51.0000000000|51.2000000000] "m/s"  FR,ADC,FC
 SG_ FR_OBJ6_FeaturePoint : 431|4@0+ (1.0000000000,0.0000000000) [0.0000000000|9.0000000000] "-"  FR,ADC,FC
 SG_ FR_OBJ5_FeaturePoint : 419|4@0+ (1.0000000000,0.0000000000) [0.0000000000|9.0000000000] "-"  FR,ADC,FC
 SG_ FR_CRCCheck_113 : 503|16@0+ (1.0000000000,0.0000000000) [0.0000000000|65535.0000000000] ""  FR,ADC,FC
 SG_ FR_RollingCounter_113 : 491|4@0+ (1.0000000000,0.0000000000) [0.0000000000|15.0000000000] ""  FR,ADC,FC
 SG_ FR_OBJ6_HeightGround : 211|9@0+ (0.1000000000,0.0000000000) [0.0000000000|51.1000000000] "m"  FR,ADC,FC
 SG_ FR_OBJ6_MotionStatusConf : 397|6@0+ (2.0000000000,0.0000000000) [0.0000000000|63.0000000000] "-"  FR,ADC,FC
 SG_ FR_OBJ6_ClassConf : 377|6@0+ (2.0000000000,0.0000000000) [0.0000000000|63.0000000000] "-"  FR,ADC,FC
 SG_ FR_OBJ6_MotionStatus : 370|3@0+ (1.0000000000,0.0000000000) [0.0000000000|7.0000000000] ""  FR,ADC,FC
 SG_ FR_OBJ6_Location : 375|2@0+ (1.0000000000,0.0000000000) [0.0000000000|3.0000000000] ""  FR,ADC,FC
 SG_ FR_OBJ6_Measured : 363|2@0+ (1.0000000000,0.0000000000) [0.0000000000|3.0000000000] ""  FR,ADC,FC
 SG_ FR_OBJ6_valid : 366|1@0+ (1.0000000000,0.0000000000) [0.0000000000|1.0000000000] ""  FR,ADC,FC
 SG_ FR_OBJ6_Track_Age : 359|8@0+ (1.0000000000,0.0000000000) [0.0000000000|255.0000000000] ""  FR,ADC,FC
 SG_ FR_OBJ6_Track_ID : 351|8@0+ (1.0000000000,0.0000000000) [0.0000000000|255.0000000000] ""  FR,ADC,FC
 SG_ FR_OBJ6_ObstacleProb : 341|6@0+ (2.0000000000,0.0000000000) [0.0000000000|100.0000000000] "%"  FR,ADC,FC
 SG_ FR_OBJ6_ExistProb : 331|6@0+ (2.0000000000,0.0000000000) [0.0000000000|100.0000000000] "%"  FR,ADC,FC
 SG_ FR_OBJ6_RelAx : 325|10@0+ (0.0312500000,-16.0000000000) [-16.0000000000|15.9687500000] "m/s2"  FR,ADC,FC
 SG_ FR_OBJ6_RelAy : 318|9@0+ (0.0625000000,-16.0000000000) [-16.0000000000|15.9375000000] "m/s2"  FR,ADC,FC
 SG_ FR_OBJ6_RelVx_std : 298|12@0+ (0.0625000000,0.0000000000) [0.0000000000|255.9375000000] "m/s"  FR,ADC,FC
 SG_ FR_OBJ6_RelVx : 294|12@0+ (0.0625000000,-128.0000000000) [-128.0000000000|127.9375000000] "m/s"  FR,ADC,FC
 SG_ FR_OBJ6_RelVy_std : 272|10@0+ (0.1250000000,0.0000000000) [0.0000000000|127.8750000000] "m/s"  FR,ADC,FC
 SG_ FR_OBJ6_RelVy : 266|10@0+ (0.1250000000,-64.0000000000) [-64.0000000000|63.8750000000] "m/s"  FR,ADC,FC
 SG_ FR_OBJ6_Dx_Vnce : 248|14@0+ (0.0500000000,0.0000000000) [0.0000000000|50.0000000000] "m2"  FR,ADC,FC
 SG_ FR_OBJ6_Dx : 245|13@0+ (0.0625000000,-100.0000000000) [-100.0000000000|411.9375000000] "m"  FR,ADC,FC
 SG_ FR_OBJ6_Dy_Vnce : 239|10@0+ (0.0200000000,0.0000000000) [0.0000000000|20.0000000000] "m2"  FR,ADC,FC
 SG_ FR_OBJ6_Dy : 218|11@0+ (0.1250000000,-128.0000000000) [-128.0000000000|127.8750000000] "m"  FR,ADC,FC
 SG_ FR_OBJ6_HeadingAngle : 413|10@0+ (0.0100000000,-3.1400000000) [-3.1400000000|3.1400000000] "rad"  FR,ADC,FC
 SG_ FR_OBJ6_Length : 204|9@0+ (0.0500000000,0.0000000000) [0.0000000000|25.5000000000] "m"  FR,ADC,FC
 SG_ FR_OBJ6_Height : 197|9@0+ (0.0100000000,0.0000000000) [0.0000000000|5.1100000000] "m"  FR,ADC,FC
 SG_ FR_OBJ6_Width : 176|11@0+ (0.0100000000,0.0000000000) [0.0000000000|12.0000000000] "m"  FR,ADC,FC
 SG_ FR_OBJ6_Class : 179|3@0+ (1.0000000000,0.0000000000) [0.0000000000|7.0000000000] ""  FR,ADC,FC
 SG_ FR_OBJ5_HeightGround : 39|9@0+ (0.1000000000,0.0000000000) [0.0000000000|51.1000000000] "m"  FR,ADC,FC
 SG_ FR_OBJ5_MotionStatusConf : 387|6@0+ (2.0000000000,0.0000000000) [0.0000000000|63.0000000000] "-"  FR,ADC,FC
 SG_ FR_OBJ5_ClassConf : 383|6@0+ (2.0000000000,0.0000000000) [0.0000000000|63.0000000000] "-"  FR,ADC,FC
 SG_ FR_OBJ5_MotionStatus : 373|3@0+ (1.0000000000,0.0000000000) [0.0000000000|7.0000000000] ""  FR,ADC,FC
 SG_ FR_OBJ5_Location : 361|2@0+ (1.0000000000,0.0000000000) [0.0000000000|3.0000000000] ""  FR,ADC,FC
 SG_ FR_OBJ5_Measured : 365|2@0+ (1.0000000000,0.0000000000) [0.0000000000|3.0000000000] ""  FR,ADC,FC
 SG_ FR_OBJ5_valid : 367|1@0+ (1.0000000000,0.0000000000) [0.0000000000|1.0000000000] ""  FR,ADC,FC
 SG_ FR_OBJ5_Track_Age : 171|8@0+ (1.0000000000,0.0000000000) [0.0000000000|255.0000000000] ""  FR,ADC,FC
 SG_ FR_OBJ5_Track_ID : 163|8@0+ (1.0000000000,0.0000000000) [0.0000000000|255.0000000000] ""  FR,ADC,FC
 SG_ FR_OBJ5_ObstacleProb : 153|6@0+ (2.0000000000,0.0000000000) [0.0000000000|100.0000000000] "%"  FR,ADC,FC
 SG_ FR_OBJ5_ExistProb : 159|6@0+ (2.0000000000,0.0000000000) [0.0000000000|100.0000000000] "%"  FR,ADC,FC
 SG_ FR_OBJ5_RelAx : 137|10@0+ (0.0312500000,-16.0000000000) [-16.0000000000|15.9687500000] "m/s2"  FR,ADC,FC
 SG_ FR_OBJ5_RelAy : 130|9@0+ (0.0625000000,-16.0000000000) [-16.0000000000|15.9375000000] "m/s2"  FR,ADC,FC
 SG_ FR_OBJ5_RelVx_std : 126|12@0+ (0.0625000000,0.0000000000) [0.0000000000|255.9375000000] "m/s"  FR,ADC,FC
 SG_ FR_OBJ5_RelVx : 106|12@0+ (0.0625000000,-128.0000000000) [-128.0000000000|127.9375000000] "m/s"  FR,ADC,FC
 SG_ FR_OBJ5_RelVy_std : 100|10@0+ (0.1250000000,0.0000000000) [0.0000000000|127.8750000000] "m/s"  FR,ADC,FC
 SG_ FR_OBJ5_RelVy : 94|10@0+ (0.1250000000,-64.0000000000) [-64.0000000000|63.8750000000] "m/s"  FR,ADC,FC
 SG_ FR_OBJ5_Dx_Vnce : 76|14@0+ (0.0500000000,0.0000000000) [0.0000000000|50.0000000000] "m2"  FR,ADC,FC
 SG_ FR_OBJ5_Dx : 57|13@0+ (0.0625000000,-100.0000000000) [-100.0000000000|411.9375000000] "m"  FR,ADC,FC
 SG_ FR_OBJ5_Dy_Vnce : 51|10@0+ (0.0200000000,0.0000000000) [0.0000000000|20.0000000000] "m2"  FR,ADC,FC
 SG_ FR_OBJ5_Dy : 46|11@0+ (0.1250000000,-128.0000000000) [-128.0000000000|127.8750000000] "m"  FR,ADC,FC
 SG_ FR_OBJ5_HeadingAngle : 407|10@0+ (0.0100000000,-3.1400000000) [-3.1400000000|3.1400000000] "rad"  FR,ADC,FC
 SG_ FR_OBJ5_Length : 16|9@0+ (0.0500000000,0.0000000000) [0.0000000000|25.5000000000] "m"  FR,ADC,FC
 SG_ FR_OBJ5_Height : 9|9@0+ (0.0100000000,0.0000000000) [0.0000000000|5.1100000000] "m"  FR,ADC,FC
 SG_ FR_OBJ5_Width : 4|11@0+ (0.0100000000,0.0000000000) [0.0000000000|12.0000000000] "m"  FR,ADC,FC
 SG_ FR_OBJ5_Class : 7|3@0+ (1.0000000000,0.0000000000) [0.0000000000|7.0000000000] ""  FR,ADC,FC

BO_ 276 FR_114: 64 FR
 SG_ FR_OBJ8_Ax : 482|7@0+ (0.2000000000,-13.0000000000) [-13.0000000000|12.6000000000] "m/s2"  FR,ADC,FC
 SG_ FR_OBJ8_Ay : 473|7@0+ (0.2000000000,-13.0000000000) [-13.0000000000|12.6000000000] "m/s2"  FR,ADC,FC
 SG_ FR_OBJ8_Vx : 466|9@0+ (0.2000000000,-51.0000000000) [-51.0000000000|51.2000000000] "m/s"  FR,ADC,FC
 SG_ FR_OBJ8_Vy : 459|9@0+ (0.2000000000,-51.0000000000) [-51.0000000000|51.2000000000] "m/s"  FR,ADC,FC
 SG_ FR_OBJ7_Ax : 450|7@0+ (0.2000000000,-13.0000000000) [-13.0000000000|12.6000000000] "m/s2"  FR,ADC,FC
 SG_ FR_OBJ7_Ay : 441|7@0+ (0.2000000000,-13.0000000000) [-13.0000000000|12.6000000000] "m/s2"  FR,ADC,FC
 SG_ FR_OBJ7_Vx : 434|9@0+ (0.2000000000,-51.0000000000) [-51.0000000000|51.2000000000] "m/s"  FR,ADC,FC
 SG_ FR_OBJ7_Vy : 427|9@0+ (0.2000000000,-51.0000000000) [-51.0000000000|51.2000000000] "m/s"  FR,ADC,FC
 SG_ FR_OBJ8_FeaturePoint : 431|4@0+ (1.0000000000,0.0000000000) [0.0000000000|9.0000000000] "-"  FR,ADC,FC
 SG_ FR_OBJ7_FeaturePoint : 419|4@0+ (1.0000000000,0.0000000000) [0.0000000000|9.0000000000] "-"  FR,ADC,FC
 SG_ FR_CRCCheck_114 : 503|16@0+ (1.0000000000,0.0000000000) [0.0000000000|65535.0000000000] ""  FR,ADC,FC
 SG_ FR_RollingCounter_114 : 491|4@0+ (1.0000000000,0.0000000000) [0.0000000000|15.0000000000] ""  FR,ADC,FC
 SG_ FR_OBJ8_HeightGround : 211|9@0+ (0.1000000000,0.0000000000) [0.0000000000|51.1000000000] "m"  FR,ADC,FC
 SG_ FR_OBJ8_MotionStatusConf : 397|6@0+ (2.0000000000,0.0000000000) [0.0000000000|63.0000000000] "-"  FR,ADC,FC
 SG_ FR_OBJ8_ClassConf : 377|6@0+ (2.0000000000,0.0000000000) [0.0000000000|63.0000000000] "-"  FR,ADC,FC
 SG_ FR_OBJ8_MotionStatus : 370|3@0+ (1.0000000000,0.0000000000) [0.0000000000|7.0000000000] ""  FR,ADC,FC
 SG_ FR_OBJ8_Location : 375|2@0+ (1.0000000000,0.0000000000) [0.0000000000|3.0000000000] ""  FR,ADC,FC
 SG_ FR_OBJ8_Measured : 363|2@0+ (1.0000000000,0.0000000000) [0.0000000000|3.0000000000] ""  FR,ADC,FC
 SG_ FR_OBJ8_valid : 366|1@0+ (1.0000000000,0.0000000000) [0.0000000000|1.0000000000] ""  FR,ADC,FC
 SG_ FR_OBJ8_Track_Age : 359|8@0+ (1.0000000000,0.0000000000) [0.0000000000|255.0000000000] ""  FR,ADC,FC
 SG_ FR_OBJ8_Track_ID : 351|8@0+ (1.0000000000,0.0000000000) [0.0000000000|255.0000000000] ""  FR,ADC,FC
 SG_ FR_OBJ8_ObstacleProb : 341|6@0+ (2.0000000000,0.0000000000) [0.0000000000|100.0000000000] "%"  FR,ADC,FC
 SG_ FR_OBJ8_ExistProb : 331|6@0+ (2.0000000000,0.0000000000) [0.0000000000|100.0000000000] "%"  FR,ADC,FC
 SG_ FR_OBJ8_RelAx : 325|10@0+ (0.0312500000,-16.0000000000) [-16.0000000000|15.9687500000] "m/s2"  FR,ADC,FC
 SG_ FR_OBJ8_RelAy : 318|9@0+ (0.0625000000,-16.0000000000) [-16.0000000000|15.9375000000] "m/s2"  FR,ADC,FC
 SG_ FR_OBJ8_RelVx_std : 298|12@0+ (0.0625000000,0.0000000000) [0.0000000000|255.9375000000] "m/s"  FR,ADC,FC
 SG_ FR_OBJ8_RelVx : 294|12@0+ (0.0625000000,-128.0000000000) [-128.0000000000|127.9375000000] "m/s"  FR,ADC,FC
 SG_ FR_OBJ8_RelVy_std : 272|10@0+ (0.1250000000,0.0000000000) [0.0000000000|127.8750000000] "m/s"  FR,ADC,FC
 SG_ FR_OBJ8_RelVy : 266|10@0+ (0.1250000000,-64.0000000000) [-64.0000000000|63.8750000000] "m/s"  FR,ADC,FC
 SG_ FR_OBJ8_Dx_Vnce : 248|14@0+ (0.0500000000,0.0000000000) [0.0000000000|50.0000000000] "m2"  FR,ADC,FC
 SG_ FR_OBJ8_Dx : 245|13@0+ (0.0625000000,-100.0000000000) [-100.0000000000|411.9375000000] "m"  FR,ADC,FC
 SG_ FR_OBJ8_Dy_Vnce : 239|10@0+ (0.0200000000,0.0000000000) [0.0000000000|20.0000000000] "m2"  FR,ADC,FC
 SG_ FR_OBJ8_Dy : 218|11@0+ (0.1250000000,-128.0000000000) [-128.0000000000|127.8750000000] "m"  FR,ADC,FC
 SG_ FR_OBJ8_HeadingAngle : 413|10@0+ (0.0100000000,-3.1400000000) [-3.1400000000|3.1400000000] "rad"  FR,ADC,FC
 SG_ FR_OBJ8_Length : 204|9@0+ (0.0500000000,0.0000000000) [0.0000000000|25.5000000000] "m"  FR,ADC,FC
 SG_ FR_OBJ8_Height : 197|9@0+ (0.0100000000,0.0000000000) [0.0000000000|5.1100000000] "m"  FR,ADC,FC
 SG_ FR_OBJ8_Width : 176|11@0+ (0.0100000000,0.0000000000) [0.0000000000|12.0000000000] "m"  FR,ADC,FC
 SG_ FR_OBJ8_Class : 179|3@0+ (1.0000000000,0.0000000000) [0.0000000000|7.0000000000] ""  FR,ADC,FC
 SG_ FR_OBJ7_HeightGround : 39|9@0+ (0.1000000000,0.0000000000) [0.0000000000|51.1000000000] "m"  FR,ADC,FC
 SG_ FR_OBJ7_MotionStatusConf : 387|6@0+ (2.0000000000,0.0000000000) [0.0000000000|63.0000000000] "-"  FR,ADC,FC
 SG_ FR_OBJ7_ClassConf : 383|6@0+ (2.0000000000,0.0000000000) [0.0000000000|63.0000000000] "-"  FR,ADC,FC
 SG_ FR_OBJ7_MotionStatus : 373|3@0+ (1.0000000000,0.0000000000) [0.0000000000|7.0000000000] ""  FR,ADC,FC
 SG_ FR_OBJ7_Location : 361|2@0+ (1.0000000000,0.0000000000) [0.0000000000|3.0000000000] ""  FR,ADC,FC
 SG_ FR_OBJ7_Measured : 365|2@0+ (1.0000000000,0.0000000000) [0.0000000000|3.0000000000] ""  FR,ADC,FC
 SG_ FR_OBJ7_valid : 367|1@0+ (1.0000000000,0.0000000000) [0.0000000000|1.0000000000] ""  FR,ADC,FC
 SG_ FR_OBJ7_Track_Age : 171|8@0+ (1.0000000000,0.0000000000) [0.0000000000|255.0000000000] ""  FR,ADC,FC
 SG_ FR_OBJ7_Track_ID : 163|8@0+ (1.0000000000,0.0000000000) [0.0000000000|255.0000000000] ""  FR,ADC,FC
 SG_ FR_OBJ7_ObstacleProb : 153|6@0+ (2.0000000000,0.0000000000) [0.0000000000|100.0000000000] "%"  FR,ADC,FC
 SG_ FR_OBJ7_ExistProb : 159|6@0+ (2.0000000000,0.0000000000) [0.0000000000|100.0000000000] "%"  FR,ADC,FC
 SG_ FR_OBJ7_RelAx : 137|10@0+ (0.0312500000,-16.0000000000) [-16.0000000000|15.9687500000] "m/s2"  FR,ADC,FC
 SG_ FR_OBJ7_RelAy : 130|9@0+ (0.0625000000,-16.0000000000) [-16.0000000000|15.9375000000] "m/s2"  FR,ADC,FC
 SG_ FR_OBJ7_RelVx_std : 126|12@0+ (0.0625000000,0.0000000000) [0.0000000000|255.9375000000] "m/s"  FR,ADC,FC
 SG_ FR_OBJ7_RelVx : 106|12@0+ (0.0625000000,-128.0000000000) [-128.0000000000|127.9375000000] "m/s"  FR,ADC,FC
 SG_ FR_OBJ7_RelVy_std : 100|10@0+ (0.1250000000,0.0000000000) [0.0000000000|127.8750000000] "m/s"  FR,ADC,FC
 SG_ FR_OBJ7_RelVy : 94|10@0+ (0.1250000000,-64.0000000000) [-64.0000000000|63.8750000000] "m/s"  FR,ADC,FC
 SG_ FR_OBJ7_Dx_Vnce : 76|14@0+ (0.0500000000,0.0000000000) [0.0000000000|50.0000000000] "m2"  FR,ADC,FC
 SG_ FR_OBJ7_Dx : 57|13@0+ (0.0625000000,-100.0000000000) [-100.0000000000|411.9375000000] "m"  FR,ADC,FC
 SG_ FR_OBJ7_Dy_Vnce : 51|10@0+ (0.0200000000,0.0000000000) [0.0000000000|20.0000000000] "m2"  FR,ADC,FC
 SG_ FR_OBJ7_Dy : 46|11@0+ (0.1250000000,-128.0000000000) [-128.0000000000|127.8750000000] "m"  FR,ADC,FC
 SG_ FR_OBJ7_HeadingAngle : 407|10@0+ (0.0100000000,-3.1400000000) [-3.1400000000|3.1400000000] "rad"  FR,ADC,FC
 SG_ FR_OBJ7_Length : 16|9@0+ (0.0500000000,0.0000000000) [0.0000000000|25.5000000000] "m"  FR,ADC,FC
 SG_ FR_OBJ7_Height : 9|9@0+ (0.0100000000,0.0000000000) [0.0000000000|5.1100000000] "m"  FR,ADC,FC
 SG_ FR_OBJ7_Width : 4|11@0+ (0.0100000000,0.0000000000) [0.0000000000|12.0000000000] "m"  FR,ADC,FC
 SG_ FR_OBJ7_Class : 7|3@0+ (1.0000000000,0.0000000000) [0.0000000000|7.0000000000] ""  FR,ADC,FC

BO_ 277 FR_115: 64 FR
 SG_ FR_OBJ10_Ax : 482|7@0+ (0.2000000000,-13.0000000000) [-13.0000000000|12.6000000000] "m/s2"  FR,ADC,FC
 SG_ FR_OBJ10_Ay : 473|7@0+ (0.2000000000,-13.0000000000) [-13.0000000000|12.6000000000] "m/s2"  FR,ADC,FC
 SG_ FR_OBJ10_Vx : 466|9@0+ (0.2000000000,-51.0000000000) [-51.0000000000|51.2000000000] "m/s"  FR,ADC,FC
 SG_ FR_OBJ10_Vy : 459|9@0+ (0.2000000000,-51.0000000000) [-51.0000000000|51.2000000000] "m/s"  FR,ADC,FC
 SG_ FR_OBJ9_Ax : 450|7@0+ (0.2000000000,-13.0000000000) [-13.0000000000|12.6000000000] "m/s2"  FR,ADC,FC
 SG_ FR_OBJ9_Ay : 441|7@0+ (0.2000000000,-13.0000000000) [-13.0000000000|12.6000000000] "m/s2"  FR,ADC,FC
 SG_ FR_OBJ9_Vx : 434|9@0+ (0.2000000000,-51.0000000000) [-51.0000000000|51.2000000000] "m/s"  FR,ADC,FC
 SG_ FR_OBJ9_Vy : 427|9@0+ (0.2000000000,-51.0000000000) [-51.0000000000|51.2000000000] "m/s"  FR,ADC,FC
 SG_ FR_OBJ10_FeaturePoint : 431|4@0+ (1.0000000000,0.0000000000) [0.0000000000|9.0000000000] "-"  FR,ADC,FC
 SG_ FR_OBJ9_FeaturePoint : 419|4@0+ (1.0000000000,0.0000000000) [0.0000000000|9.0000000000] "-"  FR,ADC,FC
 SG_ FR_CRCCheck_115 : 503|16@0+ (1.0000000000,0.0000000000) [0.0000000000|65535.0000000000] ""  FR,ADC,FC
 SG_ FR_RollingCounter_115 : 491|4@0+ (1.0000000000,0.0000000000) [0.0000000000|15.0000000000] ""  FR,ADC,FC
 SG_ FR_OBJ10_HeightGround : 211|9@0+ (0.1000000000,0.0000000000) [0.0000000000|51.1000000000] "m"  FR,ADC,FC
 SG_ FR_OBJ10_MotionStatusConf : 397|6@0+ (2.0000000000,0.0000000000) [0.0000000000|63.0000000000] "-"  FR,ADC,FC
 SG_ FR_OBJ10_ClassConf : 377|6@0+ (2.0000000000,0.0000000000) [0.0000000000|63.0000000000] "-"  FR,ADC,FC
 SG_ FR_OBJ10_MotionStatus : 370|3@0+ (1.0000000000,0.0000000000) [0.0000000000|7.0000000000] ""  FR,ADC,FC
 SG_ FR_OBJ10_Location : 375|2@0+ (1.0000000000,0.0000000000) [0.0000000000|3.0000000000] ""  FR,ADC,FC
 SG_ FR_OBJ10_Measured : 363|2@0+ (1.0000000000,0.0000000000) [0.0000000000|3.0000000000] ""  FR,ADC,FC
 SG_ FR_OBJ10_valid : 366|1@0+ (1.0000000000,0.0000000000) [0.0000000000|1.0000000000] ""  FR,ADC,FC
 SG_ FR_OBJ10_Track_Age : 359|8@0+ (1.0000000000,0.0000000000) [0.0000000000|255.0000000000] ""  FR,ADC,FC
 SG_ FR_OBJ10_Track_ID : 351|8@0+ (1.0000000000,0.0000000000) [0.0000000000|255.0000000000] ""  FR,ADC,FC
 SG_ FR_OBJ10_ObstacleProb : 341|6@0+ (2.0000000000,0.0000000000) [0.0000000000|100.0000000000] "%"  FR,ADC,FC
 SG_ FR_OBJ10_ExistProb : 331|6@0+ (2.0000000000,0.0000000000) [0.0000000000|100.0000000000] "%"  FR,ADC,FC
 SG_ FR_OBJ10_RelAx : 325|10@0+ (0.0312500000,-16.0000000000) [-16.0000000000|15.9687500000] "m/s2"  FR,ADC,FC
 SG_ FR_OBJ10_RelAy : 318|9@0+ (0.0625000000,-16.0000000000) [-16.0000000000|15.9375000000] "m/s2"  FR,ADC,FC
 SG_ FR_OBJ10_RelVx_std : 298|12@0+ (0.0625000000,0.0000000000) [0.0000000000|255.9375000000] "m/s"  FR,ADC,FC
 SG_ FR_OBJ10_RelVx : 294|12@0+ (0.0625000000,-128.0000000000) [-128.0000000000|127.9375000000] "m/s"  FR,ADC,FC
 SG_ FR_OBJ10_RelVy_std : 272|10@0+ (0.1250000000,0.0000000000) [0.0000000000|127.8750000000] "m/s"  FR,ADC,FC
 SG_ FR_OBJ10_RelVy : 266|10@0+ (0.1250000000,-64.0000000000) [-64.0000000000|63.8750000000] "m/s"  FR,ADC,FC
 SG_ FR_OBJ10_Dx_Vnce : 248|14@0+ (0.0500000000,0.0000000000) [0.0000000000|50.0000000000] "m2"  FR,ADC,FC
 SG_ FR_OBJ10_Dx : 245|13@0+ (0.0625000000,-100.0000000000) [-100.0000000000|411.9375000000] "m"  FR,ADC,FC
 SG_ FR_OBJ10_Dy_Vnce : 239|10@0+ (0.0200000000,0.0000000000) [0.0000000000|20.0000000000] "m2"  FR,ADC,FC
 SG_ FR_OBJ10_Dy : 218|11@0+ (0.1250000000,-128.0000000000) [-128.0000000000|127.8750000000] "m"  FR,ADC,FC
 SG_ FR_OBJ10_HeadingAngle : 413|10@0+ (0.0100000000,-3.1400000000) [-3.1400000000|3.1400000000] "rad"  FR,ADC,FC
 SG_ FR_OBJ10_Length : 204|9@0+ (0.0500000000,0.0000000000) [0.0000000000|25.5000000000] "m"  FR,ADC,FC
 SG_ FR_OBJ10_Height : 197|9@0+ (0.0100000000,0.0000000000) [0.0000000000|5.1100000000] "m"  FR,ADC,FC
 SG_ FR_OBJ10_Width : 176|11@0+ (0.0100000000,0.0000000000) [0.0000000000|12.0000000000] "m"  FR,ADC,FC
 SG_ FR_OBJ10_Class : 179|3@0+ (1.0000000000,0.0000000000) [0.0000000000|7.0000000000] ""  FR,ADC,FC
 SG_ FR_OBJ9_HeightGround : 39|9@0+ (0.1000000000,0.0000000000) [0.0000000000|51.1000000000] "m"  FR,ADC,FC
 SG_ FR_OBJ9_MotionStatusConf : 387|6@0+ (2.0000000000,0.0000000000) [0.0000000000|63.0000000000] "-"  FR,ADC,FC
 SG_ FR_OBJ9_ClassConf : 383|6@0+ (2.0000000000,0.0000000000) [0.0000000000|63.0000000000] "-"  FR,ADC,FC
 SG_ FR_OBJ9_MotionStatus : 373|3@0+ (1.0000000000,0.0000000000) [0.0000000000|7.0000000000] ""  FR,ADC,FC
 SG_ FR_OBJ9_Location : 361|2@0+ (1.0000000000,0.0000000000) [0.0000000000|3.0000000000] ""  FR,ADC,FC
 SG_ FR_OBJ9_Measured : 365|2@0+ (1.0000000000,0.0000000000) [0.0000000000|3.0000000000] ""  FR,ADC,FC
 SG_ FR_OBJ9_valid : 367|1@0+ (1.0000000000,0.0000000000) [0.0000000000|1.0000000000] ""  FR,ADC,FC
 SG_ FR_OBJ9_Track_Age : 171|8@0+ (1.0000000000,0.0000000000) [0.0000000000|255.0000000000] ""  FR,ADC,FC
 SG_ FR_OBJ9_Track_ID : 163|8@0+ (1.0000000000,0.0000000000) [0.0000000000|255.0000000000] ""  FR,ADC,FC
 SG_ FR_OBJ9_ObstacleProb : 153|6@0+ (2.0000000000,0.0000000000) [0.0000000000|100.0000000000] "%"  FR,ADC,FC
 SG_ FR_OBJ9_ExistProb : 159|6@0+ (2.0000000000,0.0000000000) [0.0000000000|100.0000000000] "%"  FR,ADC,FC
 SG_ FR_OBJ9_RelAx : 137|10@0+ (0.0312500000,-16.0000000000) [-16.0000000000|15.9687500000] "m/s2"  FR,ADC,FC
 SG_ FR_OBJ9_RelAy : 130|9@0+ (0.0625000000,-16.0000000000) [-16.0000000000|15.9375000000] "m/s2"  FR,ADC,FC
 SG_ FR_OBJ9_RelVx_std : 126|12@0+ (0.0625000000,0.0000000000) [0.0000000000|255.9375000000] "m/s"  FR,ADC,FC
 SG_ FR_OBJ9_RelVx : 106|12@0+ (0.0625000000,-128.0000000000) [-128.0000000000|127.9375000000] "m/s"  FR,ADC,FC
 SG_ FR_OBJ9_RelVy_std : 100|10@0+ (0.1250000000,0.0000000000) [0.0000000000|127.8750000000] "m/s"  FR,ADC,FC
 SG_ FR_OBJ9_RelVy : 94|10@0+ (0.1250000000,-64.0000000000) [-64.0000000000|63.8750000000] "m/s"  FR,ADC,FC
 SG_ FR_OBJ9_Dx_Vnce : 76|14@0+ (0.0500000000,0.0000000000) [0.0000000000|50.0000000000] "m2"  FR,ADC,FC
 SG_ FR_OBJ9_Dx : 57|13@0+ (0.0625000000,-100.0000000000) [-100.0000000000|411.9375000000] "m"  FR,ADC,FC
 SG_ FR_OBJ9_Dy_Vnce : 51|10@0+ (0.0200000000,0.0000000000) [0.0000000000|20.0000000000] "m2"  FR,ADC,FC
 SG_ FR_OBJ9_Dy : 46|11@0+ (0.1250000000,-128.0000000000) [-128.0000000000|127.8750000000] "m"  FR,ADC,FC
 SG_ FR_OBJ9_HeadingAngle : 407|10@0+ (0.0100000000,-3.1400000000) [-3.1400000000|3.1400000000] "rad"  FR,ADC,FC
 SG_ FR_OBJ9_Length : 16|9@0+ (0.0500000000,0.0000000000) [0.0000000000|25.5000000000] "m"  FR,ADC,FC
 SG_ FR_OBJ9_Height : 9|9@0+ (0.0100000000,0.0000000000) [0.0000000000|5.1100000000] "m"  FR,ADC,FC
 SG_ FR_OBJ9_Width : 4|11@0+ (0.0100000000,0.0000000000) [0.0000000000|12.0000000000] "m"  FR,ADC,FC
 SG_ FR_OBJ9_Class : 7|3@0+ (1.0000000000,0.0000000000) [0.0000000000|7.0000000000] ""  FR,ADC,FC

BO_ 278 FR_116: 64 FR
 SG_ FR_OBJ12_Ax : 482|7@0+ (0.2000000000,-13.0000000000) [-13.0000000000|12.6000000000] "m/s2"  FR,ADC,FC
 SG_ FR_OBJ12_Ay : 473|7@0+ (0.2000000000,-13.0000000000) [-13.0000000000|12.6000000000] "m/s2"  FR,ADC,FC
 SG_ FR_OBJ12_Vx : 466|9@0+ (0.2000000000,-51.0000000000) [-51.0000000000|51.2000000000] "m/s"  FR,ADC,FC
 SG_ FR_OBJ12_Vy : 459|9@0+ (0.2000000000,-51.0000000000) [-51.0000000000|51.2000000000] "m/s"  FR,ADC,FC
 SG_ FR_OBJ11_Ax : 450|7@0+ (0.2000000000,-13.0000000000) [-13.0000000000|12.6000000000] "m/s2"  FR,ADC,FC
 SG_ FR_OBJ11_Ay : 441|7@0+ (0.2000000000,-13.0000000000) [-13.0000000000|12.6000000000] "m/s2"  FR,ADC,FC
 SG_ FR_OBJ11_Vx : 434|9@0+ (0.2000000000,-51.0000000000) [-51.0000000000|51.2000000000] "m/s"  FR,ADC,FC
 SG_ FR_OBJ11_Vy : 427|9@0+ (0.2000000000,-51.0000000000) [-51.0000000000|51.2000000000] "m/s"  FR,ADC,FC
 SG_ FR_OBJ12_FeaturePoint : 431|4@0+ (1.0000000000,0.0000000000) [0.0000000000|9.0000000000] "-"  FR,ADC,FC
 SG_ FR_OBJ11_FeaturePoint : 419|4@0+ (1.0000000000,0.0000000000) [0.0000000000|9.0000000000] "-"  FR,ADC,FC
 SG_ FR_CRCCheck_116 : 503|16@0+ (1.0000000000,0.0000000000) [0.0000000000|65535.0000000000] ""  FR,ADC,FC
 SG_ FR_RollingCounter_116 : 491|4@0+ (1.0000000000,0.0000000000) [0.0000000000|15.0000000000] ""  FR,ADC,FC
 SG_ FR_OBJ12_HeightGround : 211|9@0+ (0.1000000000,0.0000000000) [0.0000000000|51.1000000000] "m"  FR,ADC,FC
 SG_ FR_OBJ12_MotionStatusConf : 397|6@0+ (2.0000000000,0.0000000000) [0.0000000000|63.0000000000] "-"  FR,ADC,FC
 SG_ FR_OBJ12_ClassConf : 377|6@0+ (2.0000000000,0.0000000000) [0.0000000000|63.0000000000] "-"  FR,ADC,FC
 SG_ FR_OBJ12_MotionStatus : 370|3@0+ (1.0000000000,0.0000000000) [0.0000000000|7.0000000000] ""  FR,ADC,FC
 SG_ FR_OBJ12_Location : 375|2@0+ (1.0000000000,0.0000000000) [0.0000000000|3.0000000000] ""  FR,ADC,FC
 SG_ FR_OBJ12_Measured : 363|2@0+ (1.0000000000,0.0000000000) [0.0000000000|3.0000000000] ""  FR,ADC,FC
 SG_ FR_OBJ12_valid : 366|1@0+ (1.0000000000,0.0000000000) [0.0000000000|1.0000000000] ""  FR,ADC,FC
 SG_ FR_OBJ12_Track_Age : 359|8@0+ (1.0000000000,0.0000000000) [0.0000000000|255.0000000000] ""  FR,ADC,FC
 SG_ FR_OBJ12_Track_ID : 351|8@0+ (1.0000000000,0.0000000000) [0.0000000000|255.0000000000] ""  FR,ADC,FC
 SG_ FR_OBJ12_ObstacleProb : 341|6@0+ (2.0000000000,0.0000000000) [0.0000000000|100.0000000000] "%"  FR,ADC,FC
 SG_ FR_OBJ12_ExistProb : 331|6@0+ (2.0000000000,0.0000000000) [0.0000000000|100.0000000000] "%"  FR,ADC,FC
 SG_ FR_OBJ12_RelAx : 325|10@0+ (0.0312500000,-16.0000000000) [-16.0000000000|15.9687500000] "m/s2"  FR,ADC,FC
 SG_ FR_OBJ12_RelAy : 318|9@0+ (0.0625000000,-16.0000000000) [-16.0000000000|15.9375000000] "m/s2"  FR,ADC,FC
 SG_ FR_OBJ12_RelVx_std : 298|12@0+ (0.0625000000,0.0000000000) [0.0000000000|255.9375000000] "m/s"  FR,ADC,FC
 SG_ FR_OBJ12_RelVx : 294|12@0+ (0.0625000000,-128.0000000000) [-128.0000000000|127.9375000000] "m/s"  FR,ADC,FC
 SG_ FR_OBJ12_RelVy_std : 272|10@0+ (0.1250000000,0.0000000000) [0.0000000000|127.8750000000] "m/s"  FR,ADC,FC
 SG_ FR_OBJ12_RelVy : 266|10@0+ (0.1250000000,-64.0000000000) [-64.0000000000|63.8750000000] "m/s"  FR,ADC,FC
 SG_ FR_OBJ12_Dx_Vnce : 248|14@0+ (0.0500000000,0.0000000000) [0.0000000000|50.0000000000] "m2"  FR,ADC,FC
 SG_ FR_OBJ12_Dx : 245|13@0+ (0.0625000000,-100.0000000000) [-100.0000000000|411.9375000000] "m"  FR,ADC,FC
 SG_ FR_OBJ12_Dy_Vnce : 239|10@0+ (0.0200000000,0.0000000000) [0.0000000000|20.0000000000] "m2"  FR,ADC,FC
 SG_ FR_OBJ12_Dy : 218|11@0+ (0.1250000000,-128.0000000000) [-128.0000000000|127.8750000000] "m"  FR,ADC,FC
 SG_ FR_OBJ12_HeadingAngle : 413|10@0+ (0.0100000000,-3.1400000000) [-3.1400000000|3.1400000000] "rad"  FR,ADC,FC
 SG_ FR_OBJ12_Length : 204|9@0+ (0.0500000000,0.0000000000) [0.0000000000|25.5000000000] "m"  FR,ADC,FC
 SG_ FR_OBJ12_Height : 197|9@0+ (0.0100000000,0.0000000000) [0.0000000000|5.1100000000] "m"  FR,ADC,FC
 SG_ FR_OBJ12_Width : 176|11@0+ (0.0100000000,0.0000000000) [0.0000000000|12.0000000000] "m"  FR,ADC,FC
 SG_ FR_OBJ12_Class : 179|3@0+ (1.0000000000,0.0000000000) [0.0000000000|7.0000000000] ""  FR,ADC,FC
 SG_ FR_OBJ11_HeightGround : 39|9@0+ (0.1000000000,0.0000000000) [0.0000000000|51.1000000000] "m"  FR,ADC,FC
 SG_ FR_OBJ11_MotionStatusConf : 387|6@0+ (2.0000000000,0.0000000000) [0.0000000000|63.0000000000] "-"  FR,ADC,FC
 SG_ FR_OBJ11_ClassConf : 383|6@0+ (2.0000000000,0.0000000000) [0.0000000000|63.0000000000] "-"  FR,ADC,FC
 SG_ FR_OBJ11_MotionStatus : 373|3@0+ (1.0000000000,0.0000000000) [0.0000000000|7.0000000000] ""  FR,ADC,FC
 SG_ FR_OBJ11_Location : 361|2@0+ (1.0000000000,0.0000000000) [0.0000000000|3.0000000000] ""  FR,ADC,FC
 SG_ FR_OBJ11_Measured : 365|2@0+ (1.0000000000,0.0000000000) [0.0000000000|3.0000000000] ""  FR,ADC,FC
 SG_ FR_OBJ11_valid : 367|1@0+ (1.0000000000,0.0000000000) [0.0000000000|1.0000000000] ""  FR,ADC,FC
 SG_ FR_OBJ11_Track_Age : 171|8@0+ (1.0000000000,0.0000000000) [0.0000000000|255.0000000000] ""  FR,ADC,FC
 SG_ FR_OBJ11_Track_ID : 163|8@0+ (1.0000000000,0.0000000000) [0.0000000000|255.0000000000] ""  FR,ADC,FC
 SG_ FR_OBJ11_ObstacleProb : 153|6@0+ (2.0000000000,0.0000000000) [0.0000000000|100.0000000000] "%"  FR,ADC,FC
 SG_ FR_OBJ11_ExistProb : 159|6@0+ (2.0000000000,0.0000000000) [0.0000000000|100.0000000000] "%"  FR,ADC,FC
 SG_ FR_OBJ11_RelAx : 137|10@0+ (0.0312500000,-16.0000000000) [-16.0000000000|15.9687500000] "m/s2"  FR,ADC,FC
 SG_ FR_OBJ11_RelAy : 130|9@0+ (0.0625000000,-16.0000000000) [-16.0000000000|15.9375000000] "m/s2"  FR,ADC,FC
 SG_ FR_OBJ11_RelVx_std : 126|12@0+ (0.0625000000,0.0000000000) [0.0000000000|255.9375000000] "m/s"  FR,ADC,FC
 SG_ FR_OBJ11_RelVx : 106|12@0+ (0.0625000000,-128.0000000000) [-128.0000000000|127.9375000000] "m/s"  FR,ADC,FC
 SG_ FR_OBJ11_RelVy_std : 100|10@0+ (0.1250000000,0.0000000000) [0.0000000000|127.8750000000] "m/s"  FR,ADC,FC
 SG_ FR_OBJ11_RelVy : 94|10@0+ (0.1250000000,-64.0000000000) [-64.0000000000|63.8750000000] "m/s"  FR,ADC,FC
 SG_ FR_OBJ11_Dx_Vnce : 76|14@0+ (0.0500000000,0.0000000000) [0.0000000000|50.0000000000] "m2"  FR,ADC,FC
 SG_ FR_OBJ11_Dx : 57|13@0+ (0.0625000000,-100.0000000000) [-100.0000000000|411.9375000000] "m"  FR,ADC,FC
 SG_ FR_OBJ11_Dy_Vnce : 51|10@0+ (0.0200000000,0.0000000000) [0.0000000000|20.0000000000] "m2"  FR,ADC,FC
 SG_ FR_OBJ11_Dy : 46|11@0+ (0.1250000000,-128.0000000000) [-128.0000000000|127.8750000000] "m"  FR,ADC,FC
 SG_ FR_OBJ11_HeadingAngle : 407|10@0+ (0.0100000000,-3.1400000000) [-3.1400000000|3.1400000000] "rad"  FR,ADC,FC
 SG_ FR_OBJ11_Length : 16|9@0+ (0.0500000000,0.0000000000) [0.0000000000|25.5000000000] "m"  FR,ADC,FC
 SG_ FR_OBJ11_Height : 9|9@0+ (0.0100000000,0.0000000000) [0.0000000000|5.1100000000] "m"  FR,ADC,FC
 SG_ FR_OBJ11_Width : 4|11@0+ (0.0100000000,0.0000000000) [0.0000000000|12.0000000000] "m"  FR,ADC,FC
 SG_ FR_OBJ11_Class : 7|3@0+ (1.0000000000,0.0000000000) [0.0000000000|7.0000000000] ""  FR,ADC,FC

BO_ 279 FR_117: 64 FR
 SG_ FR_OBJ14_Ax : 482|7@0+ (0.2000000000,-13.0000000000) [-13.0000000000|12.6000000000] "m/s2"  FR,ADC,FC
 SG_ FR_OBJ14_Ay : 473|7@0+ (0.2000000000,-13.0000000000) [-13.0000000000|12.6000000000] "m/s2"  FR,ADC,FC
 SG_ FR_OBJ14_Vx : 466|9@0+ (0.2000000000,-51.0000000000) [-51.0000000000|51.2000000000] "m/s"  FR,ADC,FC
 SG_ FR_OBJ14_Vy : 459|9@0+ (0.2000000000,-51.0000000000) [-51.0000000000|51.2000000000] "m/s"  FR,ADC,FC
 SG_ FR_OBJ13_Ax : 450|7@0+ (0.2000000000,-13.0000000000) [-13.0000000000|12.6000000000] "m/s2"  FR,ADC,FC
 SG_ FR_OBJ13_Ay : 441|7@0+ (0.2000000000,-13.0000000000) [-13.0000000000|12.6000000000] "m/s2"  FR,ADC,FC
 SG_ FR_OBJ13_Vx : 434|9@0+ (0.2000000000,-51.0000000000) [-51.0000000000|51.2000000000] "m/s"  FR,ADC,FC
 SG_ FR_OBJ13_Vy : 427|9@0+ (0.2000000000,-51.0000000000) [-51.0000000000|51.2000000000] "m/s"  FR,ADC,FC
 SG_ FR_OBJ14_FeaturePoint : 431|4@0+ (1.0000000000,0.0000000000) [0.0000000000|9.0000000000] "-"  FR,ADC,FC
 SG_ FR_OBJ13_FeaturePoint : 419|4@0+ (1.0000000000,0.0000000000) [0.0000000000|9.0000000000] "-"  FR,ADC,FC
 SG_ FR_CRCCheck_117 : 503|16@0+ (1.0000000000,0.0000000000) [0.0000000000|65535.0000000000] ""  FR,ADC,FC
 SG_ FR_RollingCounter_117 : 491|4@0+ (1.0000000000,0.0000000000) [0.0000000000|15.0000000000] ""  FR,ADC,FC
 SG_ FR_OBJ14_HeightGround : 211|9@0+ (0.1000000000,0.0000000000) [0.0000000000|51.1000000000] "m"  FR,ADC,FC
 SG_ FR_OBJ14_MotionStatusConf : 397|6@0+ (2.0000000000,0.0000000000) [0.0000000000|63.0000000000] "-"  FR,ADC,FC
 SG_ FR_OBJ14_ClassConf : 377|6@0+ (2.0000000000,0.0000000000) [0.0000000000|63.0000000000] "-"  FR,ADC,FC
 SG_ FR_OBJ14_MotionStatus : 370|3@0+ (1.0000000000,0.0000000000) [0.0000000000|7.0000000000] ""  FR,ADC,FC
 SG_ FR_OBJ14_Location : 375|2@0+ (1.0000000000,0.0000000000) [0.0000000000|3.0000000000] ""  FR,ADC,FC
 SG_ FR_OBJ14_Measured : 363|2@0+ (1.0000000000,0.0000000000) [0.0000000000|3.0000000000] ""  FR,ADC,FC
 SG_ FR_OBJ14_valid : 366|1@0+ (1.0000000000,0.0000000000) [0.0000000000|1.0000000000] ""  FR,ADC,FC
 SG_ FR_OBJ14_Track_Age : 359|8@0+ (1.0000000000,0.0000000000) [0.0000000000|255.0000000000] ""  FR,ADC,FC
 SG_ FR_OBJ14_Track_ID : 351|8@0+ (1.0000000000,0.0000000000) [0.0000000000|255.0000000000] ""  FR,ADC,FC
 SG_ FR_OBJ14_ObstacleProb : 341|6@0+ (2.0000000000,0.0000000000) [0.0000000000|100.0000000000] "%"  FR,ADC,FC
 SG_ FR_OBJ14_ExistProb : 331|6@0+ (2.0000000000,0.0000000000) [0.0000000000|100.0000000000] "%"  FR,ADC,FC
 SG_ FR_OBJ14_RelAx : 325|10@0+ (0.0312500000,-16.0000000000) [-16.0000000000|15.9687500000] "m/s2"  FR,ADC,FC
 SG_ FR_OBJ14_RelAy : 318|9@0+ (0.0625000000,-16.0000000000) [-16.0000000000|15.9375000000] "m/s2"  FR,ADC,FC
 SG_ FR_OBJ14_RelVx_std : 298|12@0+ (0.0625000000,0.0000000000) [0.0000000000|255.9375000000] "m/s"  FR,ADC,FC
 SG_ FR_OBJ14_RelVx : 294|12@0+ (0.0625000000,-128.0000000000) [-128.0000000000|127.9375000000] "m/s"  FR,ADC,FC
 SG_ FR_OBJ14_RelVy_std : 272|10@0+ (0.1250000000,0.0000000000) [0.0000000000|127.8750000000] "m/s"  FR,ADC,FC
 SG_ FR_OBJ14_RelVy : 266|10@0+ (0.1250000000,-64.0000000000) [-64.0000000000|63.8750000000] "m/s"  FR,ADC,FC
 SG_ FR_OBJ14_Dx_Vnce : 248|14@0+ (0.0500000000,0.0000000000) [0.0000000000|50.0000000000] "m2"  FR,ADC,FC
 SG_ FR_OBJ14_Dx : 245|13@0+ (0.0625000000,-100.0000000000) [-100.0000000000|411.9375000000] "m"  FR,ADC,FC
 SG_ FR_OBJ14_Dy_Vnce : 239|10@0+ (0.0200000000,0.0000000000) [0.0000000000|20.0000000000] "m2"  FR,ADC,FC
 SG_ FR_OBJ14_Dy : 218|11@0+ (0.1250000000,-128.0000000000) [-128.0000000000|127.8750000000] "m"  FR,ADC,FC
 SG_ FR_OBJ14_HeadingAngle : 413|10@0+ (0.0100000000,-3.1400000000) [-3.1400000000|3.1400000000] "rad"  FR,ADC,FC
 SG_ FR_OBJ14_Length : 204|9@0+ (0.0500000000,0.0000000000) [0.0000000000|25.5000000000] "m"  FR,ADC,FC
 SG_ FR_OBJ14_Height : 197|9@0+ (0.0100000000,0.0000000000) [0.0000000000|5.1100000000] "m"  FR,ADC,FC
 SG_ FR_OBJ14_Width : 176|11@0+ (0.0100000000,0.0000000000) [0.0000000000|12.0000000000] "m"  FR,ADC,FC
 SG_ FR_OBJ14_Class : 179|3@0+ (1.0000000000,0.0000000000) [0.0000000000|7.0000000000] ""  FR,ADC,FC
 SG_ FR_OBJ13_HeightGround : 39|9@0+ (0.1000000000,0.0000000000) [0.0000000000|51.1000000000] "m"  FR,ADC,FC
 SG_ FR_OBJ13_MotionStatusConf : 387|6@0+ (2.0000000000,0.0000000000) [0.0000000000|63.0000000000] "-"  FR,ADC,FC
 SG_ FR_OBJ13_ClassConf : 383|6@0+ (2.0000000000,0.0000000000) [0.0000000000|63.0000000000] "-"  FR,ADC,FC
 SG_ FR_OBJ13_MotionStatus : 373|3@0+ (1.0000000000,0.0000000000) [0.0000000000|7.0000000000] ""  FR,ADC,FC
 SG_ FR_OBJ13_Location : 361|2@0+ (1.0000000000,0.0000000000) [0.0000000000|3.0000000000] ""  FR,ADC,FC
 SG_ FR_OBJ13_Measured : 365|2@0+ (1.0000000000,0.0000000000) [0.0000000000|3.0000000000] ""  FR,ADC,FC
 SG_ FR_OBJ13_valid : 367|1@0+ (1.0000000000,0.0000000000) [0.0000000000|1.0000000000] ""  FR,ADC,FC
 SG_ FR_OBJ13_Track_Age : 171|8@0+ (1.0000000000,0.0000000000) [0.0000000000|255.0000000000] ""  FR,ADC,FC
 SG_ FR_OBJ13_Track_ID : 163|8@0+ (1.0000000000,0.0000000000) [0.0000000000|255.0000000000] ""  FR,ADC,FC
 SG_ FR_OBJ13_ObstacleProb : 153|6@0+ (2.0000000000,0.0000000000) [0.0000000000|100.0000000000] "%"  FR,ADC,FC
 SG_ FR_OBJ13_ExistProb : 159|6@0+ (2.0000000000,0.0000000000) [0.0000000000|100.0000000000] "%"  FR,ADC,FC
 SG_ FR_OBJ13_RelAx : 137|10@0+ (0.0312500000,-16.0000000000) [-16.0000000000|15.9687500000] "m/s2"  FR,ADC,FC
 SG_ FR_OBJ13_RelAy : 130|9@0+ (0.0625000000,-16.0000000000) [-16.0000000000|15.9375000000] "m/s2"  FR,ADC,FC
 SG_ FR_OBJ13_RelVx_std : 126|12@0+ (0.0625000000,0.0000000000) [0.0000000000|255.9375000000] "m/s"  FR,ADC,FC
 SG_ FR_OBJ13_RelVx : 106|12@0+ (0.0625000000,-128.0000000000) [-128.0000000000|127.9375000000] "m/s"  FR,ADC,FC
 SG_ FR_OBJ13_RelVy_std : 100|10@0+ (0.1250000000,0.0000000000) [0.0000000000|127.8750000000] "m/s"  FR,ADC,FC
 SG_ FR_OBJ13_RelVy : 94|10@0+ (0.1250000000,-64.0000000000) [-64.0000000000|63.8750000000] "m/s"  FR,ADC,FC
 SG_ FR_OBJ13_Dx_Vnce : 76|14@0+ (0.0500000000,0.0000000000) [0.0000000000|50.0000000000] "m2"  FR,ADC,FC
 SG_ FR_OBJ13_Dx : 57|13@0+ (0.0625000000,-100.0000000000) [-100.0000000000|411.9375000000] "m"  FR,ADC,FC
 SG_ FR_OBJ13_Dy_Vnce : 51|10@0+ (0.0200000000,0.0000000000) [0.0000000000|20.0000000000] "m2"  FR,ADC,FC
 SG_ FR_OBJ13_Dy : 46|11@0+ (0.1250000000,-128.0000000000) [-128.0000000000|127.8750000000] "m"  FR,ADC,FC
 SG_ FR_OBJ13_HeadingAngle : 407|10@0+ (0.0100000000,-3.1400000000) [-3.1400000000|3.1400000000] "rad"  FR,ADC,FC
 SG_ FR_OBJ13_Length : 16|9@0+ (0.0500000000,0.0000000000) [0.0000000000|25.5000000000] "m"  FR,ADC,FC
 SG_ FR_OBJ13_Height : 9|9@0+ (0.0100000000,0.0000000000) [0.0000000000|5.1100000000] "m"  FR,ADC,FC
 SG_ FR_OBJ13_Width : 4|11@0+ (0.0100000000,0.0000000000) [0.0000000000|12.0000000000] "m"  FR,ADC,FC
 SG_ FR_OBJ13_Class : 7|3@0+ (1.0000000000,0.0000000000) [0.0000000000|7.0000000000] ""  FR,ADC,FC

BO_ 280 FR_118: 64 FR
 SG_ FR_OBJ16_Ax : 482|7@0+ (0.2000000000,-13.0000000000) [-13.0000000000|12.6000000000] "m/s2"  FR,ADC,FC
 SG_ FR_OBJ16_Ay : 473|7@0+ (0.2000000000,-13.0000000000) [-13.0000000000|12.6000000000] "m/s2"  FR,ADC,FC
 SG_ FR_OBJ16_Vx : 466|9@0+ (0.2000000000,-51.0000000000) [-51.0000000000|51.2000000000] "m/s"  FR,ADC,FC
 SG_ FR_OBJ16_Vy : 459|9@0+ (0.2000000000,-51.0000000000) [-51.0000000000|51.2000000000] "m/s"  FR,ADC,FC
 SG_ FR_OBJ15_Ax : 450|7@0+ (0.2000000000,-13.0000000000) [-13.0000000000|12.6000000000] "m/s2"  FR,ADC,FC
 SG_ FR_OBJ15_Ay : 441|7@0+ (0.2000000000,-13.0000000000) [-13.0000000000|12.6000000000] "m/s2"  FR,ADC,FC
 SG_ FR_OBJ15_Vx : 434|9@0+ (0.2000000000,-51.0000000000) [-51.0000000000|51.2000000000] "m/s"  FR,ADC,FC
 SG_ FR_OBJ15_Vy : 427|9@0+ (0.2000000000,-51.0000000000) [-51.0000000000|51.2000000000] "m/s"  FR,ADC,FC
 SG_ FR_OBJ16_FeaturePoint : 431|4@0+ (1.0000000000,0.0000000000) [0.0000000000|9.0000000000] "-"  FR,ADC,FC
 SG_ FR_OBJ15_FeaturePoint : 419|4@0+ (1.0000000000,0.0000000000) [0.0000000000|9.0000000000] "-"  FR,ADC,FC
 SG_ FR_CRCCheck_118 : 503|16@0+ (1.0000000000,0.0000000000) [0.0000000000|65535.0000000000] ""  FR,ADC,FC
 SG_ FR_RollingCounter_118 : 491|4@0+ (1.0000000000,0.0000000000) [0.0000000000|15.0000000000] ""  FR,ADC,FC
 SG_ FR_OBJ16_HeightGround : 211|9@0+ (0.1000000000,0.0000000000) [0.0000000000|51.1000000000] "m"  FR,ADC,FC
 SG_ FR_OBJ16_MotionStatusConf : 397|6@0+ (2.0000000000,0.0000000000) [0.0000000000|63.0000000000] "-"  FR,ADC,FC
 SG_ FR_OBJ16_ClassConf : 377|6@0+ (2.0000000000,0.0000000000) [0.0000000000|63.0000000000] "-"  FR,ADC,FC
 SG_ FR_OBJ16_MotionStatus : 370|3@0+ (1.0000000000,0.0000000000) [0.0000000000|7.0000000000] ""  FR,ADC,FC
 SG_ FR_OBJ16_Location : 375|2@0+ (1.0000000000,0.0000000000) [0.0000000000|3.0000000000] ""  FR,ADC,FC
 SG_ FR_OBJ16_Measured : 363|2@0+ (1.0000000000,0.0000000000) [0.0000000000|3.0000000000] ""  FR,ADC,FC
 SG_ FR_OBJ16_valid : 366|1@0+ (1.0000000000,0.0000000000) [0.0000000000|1.0000000000] ""  FR,ADC,FC
 SG_ FR_OBJ16_Track_Age : 359|8@0+ (1.0000000000,0.0000000000) [0.0000000000|255.0000000000] ""  FR,ADC,FC
 SG_ FR_OBJ16_Track_ID : 351|8@0+ (1.0000000000,0.0000000000) [0.0000000000|255.0000000000] ""  FR,ADC,FC
 SG_ FR_OBJ16_ObstacleProb : 341|6@0+ (2.0000000000,0.0000000000) [0.0000000000|100.0000000000] "%"  FR,ADC,FC
 SG_ FR_OBJ16_ExistProb : 331|6@0+ (2.0000000000,0.0000000000) [0.0000000000|100.0000000000] "%"  FR,ADC,FC
 SG_ FR_OBJ16_RelAx : 325|10@0+ (0.0312500000,-16.0000000000) [-16.0000000000|15.9687500000] "m/s2"  FR,ADC,FC
 SG_ FR_OBJ16_RelAy : 318|9@0+ (0.0625000000,-16.0000000000) [-16.0000000000|15.9375000000] "m/s2"  FR,ADC,FC
 SG_ FR_OBJ16_RelVx_std : 298|12@0+ (0.0625000000,0.0000000000) [0.0000000000|255.9375000000] "m/s"  FR,ADC,FC
 SG_ FR_OBJ16_RelVx : 294|12@0+ (0.0625000000,-128.0000000000) [-128.0000000000|127.9375000000] "m/s"  FR,ADC,FC
 SG_ FR_OBJ16_RelVy_std : 272|10@0+ (0.1250000000,0.0000000000) [0.0000000000|127.8750000000] "m/s"  FR,ADC,FC
 SG_ FR_OBJ16_RelVy : 266|10@0+ (0.1250000000,-64.0000000000) [-64.0000000000|63.8750000000] "m/s"  FR,ADC,FC
 SG_ FR_OBJ16_Dx_Vnce : 248|14@0+ (0.0500000000,0.0000000000) [0.0000000000|50.0000000000] "m2"  FR,ADC,FC
 SG_ FR_OBJ16_Dx : 245|13@0+ (0.0625000000,-100.0000000000) [-100.0000000000|411.9375000000] "m"  FR,ADC,FC
 SG_ FR_OBJ16_Dy_Vnce : 239|10@0+ (0.0200000000,0.0000000000) [0.0000000000|20.0000000000] "m2"  FR,ADC,FC
 SG_ FR_OBJ16_Dy : 218|11@0+ (0.1250000000,-128.0000000000) [-128.0000000000|127.8750000000] "m"  FR,ADC,FC
 SG_ FR_OBJ16_HeadingAngle : 413|10@0+ (0.0100000000,-3.1400000000) [-3.1400000000|3.1400000000] "rad"  FR,ADC,FC
 SG_ FR_OBJ16_Length : 204|9@0+ (0.0500000000,0.0000000000) [0.0000000000|25.5000000000] "m"  FR,ADC,FC
 SG_ FR_OBJ16_Height : 197|9@0+ (0.0100000000,0.0000000000) [0.0000000000|5.1100000000] "m"  FR,ADC,FC
 SG_ FR_OBJ16_Width : 176|11@0+ (0.0100000000,0.0000000000) [0.0000000000|12.0000000000] "m"  FR,ADC,FC
 SG_ FR_OBJ16_Class : 179|3@0+ (1.0000000000,0.0000000000) [0.0000000000|7.0000000000] ""  FR,ADC,FC
 SG_ FR_OBJ15_HeightGround : 39|9@0+ (0.1000000000,0.0000000000) [0.0000000000|51.1000000000] "m"  FR,ADC,FC
 SG_ FR_OBJ15_MotionStatusConf : 387|6@0+ (2.0000000000,0.0000000000) [0.0000000000|63.0000000000] "-"  FR,ADC,FC
 SG_ FR_OBJ15_ClassConf : 383|6@0+ (2.0000000000,0.0000000000) [0.0000000000|63.0000000000] "-"  FR,ADC,FC
 SG_ FR_OBJ15_MotionStatus : 373|3@0+ (1.0000000000,0.0000000000) [0.0000000000|7.0000000000] ""  FR,ADC,FC
 SG_ FR_OBJ15_Location : 361|2@0+ (1.0000000000,0.0000000000) [0.0000000000|3.0000000000] ""  FR,ADC,FC
 SG_ FR_OBJ15_Measured : 365|2@0+ (1.0000000000,0.0000000000) [0.0000000000|3.0000000000] ""  FR,ADC,FC
 SG_ FR_OBJ15_valid : 367|1@0+ (1.0000000000,0.0000000000) [0.0000000000|1.0000000000] ""  FR,ADC,FC
 SG_ FR_OBJ15_Track_Age : 171|8@0+ (1.0000000000,0.0000000000) [0.0000000000|255.0000000000] ""  FR,ADC,FC
 SG_ FR_OBJ15_Track_ID : 163|8@0+ (1.0000000000,0.0000000000) [0.0000000000|255.0000000000] ""  FR,ADC,FC
 SG_ FR_OBJ15_ObstacleProb : 153|6@0+ (2.0000000000,0.0000000000) [0.0000000000|100.0000000000] "%"  FR,ADC,FC
 SG_ FR_OBJ15_ExistProb : 159|6@0+ (2.0000000000,0.0000000000) [0.0000000000|100.0000000000] "%"  FR,ADC,FC
 SG_ FR_OBJ15_RelAx : 137|10@0+ (0.0312500000,-16.0000000000) [-16.0000000000|15.9687500000] "m/s2"  FR,ADC,FC
 SG_ FR_OBJ15_RelAy : 130|9@0+ (0.0625000000,-16.0000000000) [-16.0000000000|15.9375000000] "m/s2"  FR,ADC,FC
 SG_ FR_OBJ15_RelVx_std : 126|12@0+ (0.0625000000,0.0000000000) [0.0000000000|255.9375000000] "m/s"  FR,ADC,FC
 SG_ FR_OBJ15_RelVx : 106|12@0+ (0.0625000000,-128.0000000000) [-128.0000000000|127.9375000000] "m/s"  FR,ADC,FC
 SG_ FR_OBJ15_RelVy_std : 100|10@0+ (0.1250000000,0.0000000000) [0.0000000000|127.8750000000] "m/s"  FR,ADC,FC
 SG_ FR_OBJ15_RelVy : 94|10@0+ (0.1250000000,-64.0000000000) [-64.0000000000|63.8750000000] "m/s"  FR,ADC,FC
 SG_ FR_OBJ15_Dx_Vnce : 76|14@0+ (0.0500000000,0.0000000000) [0.0000000000|50.0000000000] "m2"  FR,ADC,FC
 SG_ FR_OBJ15_Dx : 57|13@0+ (0.0625000000,-100.0000000000) [-100.0000000000|411.9375000000] "m"  FR,ADC,FC
 SG_ FR_OBJ15_Dy_Vnce : 51|10@0+ (0.0200000000,0.0000000000) [0.0000000000|20.0000000000] "m2"  FR,ADC,FC
 SG_ FR_OBJ15_Dy : 46|11@0+ (0.1250000000,-128.0000000000) [-128.0000000000|127.8750000000] "m"  FR,ADC,FC
 SG_ FR_OBJ15_HeadingAngle : 407|10@0+ (0.0100000000,-3.1400000000) [-3.1400000000|3.1400000000] "rad"  FR,ADC,FC
 SG_ FR_OBJ15_Length : 16|9@0+ (0.0500000000,0.0000000000) [0.0000000000|25.5000000000] "m"  FR,ADC,FC
 SG_ FR_OBJ15_Height : 9|9@0+ (0.0100000000,0.0000000000) [0.0000000000|5.1100000000] "m"  FR,ADC,FC
 SG_ FR_OBJ15_Width : 4|11@0+ (0.0100000000,0.0000000000) [0.0000000000|12.0000000000] "m"  FR,ADC,FC
 SG_ FR_OBJ15_Class : 7|3@0+ (1.0000000000,0.0000000000) [0.0000000000|7.0000000000] ""  FR,ADC,FC

BO_ 281 FR_119: 64 FR
 SG_ FR_OBJ18_Ax : 482|7@0+ (0.2000000000,-13.0000000000) [-13.0000000000|12.6000000000] "m/s2"  FR,ADC,FC
 SG_ FR_OBJ18_Ay : 473|7@0+ (0.2000000000,-13.0000000000) [-13.0000000000|12.6000000000] "m/s2"  FR,ADC,FC
 SG_ FR_OBJ18_Vx : 466|9@0+ (0.2000000000,-51.0000000000) [-51.0000000000|51.2000000000] "m/s"  FR,ADC,FC
 SG_ FR_OBJ18_Vy : 459|9@0+ (0.2000000000,-51.0000000000) [-51.0000000000|51.2000000000] "m/s"  FR,ADC,FC
 SG_ FR_OBJ17_Ax : 450|7@0+ (0.2000000000,-13.0000000000) [-13.0000000000|12.6000000000] "m/s2"  FR,ADC,FC
 SG_ FR_OBJ17_Ay : 441|7@0+ (0.2000000000,-13.0000000000) [-13.0000000000|12.6000000000] "m/s2"  FR,ADC,FC
 SG_ FR_OBJ17_Vx : 434|9@0+ (0.2000000000,-51.0000000000) [-51.0000000000|51.2000000000] "m/s"  FR,ADC,FC
 SG_ FR_OBJ17_Vy : 427|9@0+ (0.2000000000,-51.0000000000) [-51.0000000000|51.2000000000] "m/s"  FR,ADC,FC
 SG_ FR_OBJ18_FeaturePoint : 431|4@0+ (1.0000000000,0.0000000000) [0.0000000000|9.0000000000] "-"  FR,ADC,FC
 SG_ FR_OBJ17_FeaturePoint : 419|4@0+ (1.0000000000,0.0000000000) [0.0000000000|9.0000000000] "-"  FR,ADC,FC
 SG_ FR_CRCCheck_119 : 503|16@0+ (1.0000000000,0.0000000000) [0.0000000000|65535.0000000000] ""  FR,ADC,FC
 SG_ FR_RollingCounter_119 : 491|4@0+ (1.0000000000,0.0000000000) [0.0000000000|15.0000000000] ""  FR,ADC,FC
 SG_ FR_OBJ18_HeightGround : 211|9@0+ (0.1000000000,0.0000000000) [0.0000000000|51.1000000000] "m"  FR,ADC,FC
 SG_ FR_OBJ18_MotionStatusConf : 397|6@0+ (2.0000000000,0.0000000000) [0.0000000000|63.0000000000] "-"  FR,ADC,FC
 SG_ FR_OBJ18_ClassConf : 377|6@0+ (2.0000000000,0.0000000000) [0.0000000000|63.0000000000] "-"  FR,ADC,FC
 SG_ FR_OBJ18_MotionStatus : 370|3@0+ (1.0000000000,0.0000000000) [0.0000000000|7.0000000000] ""  FR,ADC,FC
 SG_ FR_OBJ18_Location : 375|2@0+ (1.0000000000,0.0000000000) [0.0000000000|3.0000000000] ""  FR,ADC,FC
 SG_ FR_OBJ18_Measured : 363|2@0+ (1.0000000000,0.0000000000) [0.0000000000|3.0000000000] ""  FR,ADC,FC
 SG_ FR_OBJ18_valid : 366|1@0+ (1.0000000000,0.0000000000) [0.0000000000|1.0000000000] ""  FR,ADC,FC
 SG_ FR_OBJ18_Track_Age : 359|8@0+ (1.0000000000,0.0000000000) [0.0000000000|255.0000000000] ""  FR,ADC,FC
 SG_ FR_OBJ18_Track_ID : 351|8@0+ (1.0000000000,0.0000000000) [0.0000000000|255.0000000000] ""  FR,ADC,FC
 SG_ FR_OBJ18_ObstacleProb : 341|6@0+ (2.0000000000,0.0000000000) [0.0000000000|100.0000000000] "%"  FR,ADC,FC
 SG_ FR_OBJ18_ExistProb : 331|6@0+ (2.0000000000,0.0000000000) [0.0000000000|100.0000000000] "%"  FR,ADC,FC
 SG_ FR_OBJ18_RelAx : 325|10@0+ (0.0312500000,-16.0000000000) [-16.0000000000|15.9687500000] "m/s2"  FR,ADC,FC
 SG_ FR_OBJ18_RelAy : 318|9@0+ (0.0625000000,-16.0000000000) [-16.0000000000|15.9375000000] "m/s2"  FR,ADC,FC
 SG_ FR_OBJ18_RelVx_std : 298|12@0+ (0.0625000000,0.0000000000) [0.0000000000|255.9375000000] "m/s"  FR,ADC,FC
 SG_ FR_OBJ18_RelVx : 294|12@0+ (0.0625000000,-128.0000000000) [-128.0000000000|127.9375000000] "m/s"  FR,ADC,FC
 SG_ FR_OBJ18_RelVy_std : 272|10@0+ (0.1250000000,0.0000000000) [0.0000000000|127.8750000000] "m/s"  FR,ADC,FC
 SG_ FR_OBJ18_RelVy : 266|10@0+ (0.1250000000,-64.0000000000) [-64.0000000000|63.8750000000] "m/s"  FR,ADC,FC
 SG_ FR_OBJ18_Dx_Vnce : 248|14@0+ (0.0500000000,0.0000000000) [0.0000000000|50.0000000000] "m2"  FR,ADC,FC
 SG_ FR_OBJ18_Dx : 245|13@0+ (0.0625000000,-100.0000000000) [-100.0000000000|411.9375000000] "m"  FR,ADC,FC
 SG_ FR_OBJ18_Dy_Vnce : 239|10@0+ (0.0200000000,0.0000000000) [0.0000000000|20.0000000000] "m2"  FR,ADC,FC
 SG_ FR_OBJ18_Dy : 218|11@0+ (0.1250000000,-128.0000000000) [-128.0000000000|127.8750000000] "m"  FR,ADC,FC
 SG_ FR_OBJ18_HeadingAngle : 413|10@0+ (0.0100000000,-3.1400000000) [-3.1400000000|3.1400000000] "rad"  FR,ADC,FC
 SG_ FR_OBJ18_Length : 204|9@0+ (0.0500000000,0.0000000000) [0.0000000000|25.5000000000] "m"  FR,ADC,FC
 SG_ FR_OBJ18_Height : 197|9@0+ (0.0100000000,0.0000000000) [0.0000000000|5.1100000000] "m"  FR,ADC,FC
 SG_ FR_OBJ18_Width : 176|11@0+ (0.0100000000,0.0000000000) [0.0000000000|12.0000000000] "m"  FR,ADC,FC
 SG_ FR_OBJ18_Class : 179|3@0+ (1.0000000000,0.0000000000) [0.0000000000|7.0000000000] ""  FR,ADC,FC
 SG_ FR_OBJ17_HeightGround : 39|9@0+ (0.1000000000,0.0000000000) [0.0000000000|51.1000000000] "m"  FR,ADC,FC
 SG_ FR_OBJ17_MotionStatusConf : 387|6@0+ (2.0000000000,0.0000000000) [0.0000000000|63.0000000000] "-"  FR,ADC,FC
 SG_ FR_OBJ17_ClassConf : 383|6@0+ (2.0000000000,0.0000000000) [0.0000000000|63.0000000000] "-"  FR,ADC,FC
 SG_ FR_OBJ17_MotionStatus : 373|3@0+ (1.0000000000,0.0000000000) [0.0000000000|7.0000000000] ""  FR,ADC,FC
 SG_ FR_OBJ17_Location : 361|2@0+ (1.0000000000,0.0000000000) [0.0000000000|3.0000000000] ""  FR,ADC,FC
 SG_ FR_OBJ17_Measured : 365|2@0+ (1.0000000000,0.0000000000) [0.0000000000|3.0000000000] ""  FR,ADC,FC
 SG_ FR_OBJ17_valid : 367|1@0+ (1.0000000000,0.0000000000) [0.0000000000|1.0000000000] ""  FR,ADC,FC
 SG_ FR_OBJ17_Track_Age : 171|8@0+ (1.0000000000,0.0000000000) [0.0000000000|255.0000000000] ""  FR,ADC,FC
 SG_ FR_OBJ17_Track_ID : 163|8@0+ (1.0000000000,0.0000000000) [0.0000000000|255.0000000000] ""  FR,ADC,FC
 SG_ FR_OBJ17_ObstacleProb : 153|6@0+ (2.0000000000,0.0000000000) [0.0000000000|100.0000000000] "%"  FR,ADC,FC
 SG_ FR_OBJ17_ExistProb : 159|6@0+ (2.0000000000,0.0000000000) [0.0000000000|100.0000000000] "%"  FR,ADC,FC
 SG_ FR_OBJ17_RelAx : 137|10@0+ (0.0312500000,-16.0000000000) [-16.0000000000|15.9687500000] "m/s2"  FR,ADC,FC
 SG_ FR_OBJ17_RelAy : 130|9@0+ (0.0625000000,-16.0000000000) [-16.0000000000|15.9375000000] "m/s2"  FR,ADC,FC
 SG_ FR_OBJ17_RelVx_std : 126|12@0+ (0.0625000000,0.0000000000) [0.0000000000|255.9375000000] "m/s"  FR,ADC,FC
 SG_ FR_OBJ17_RelVx : 106|12@0+ (0.0625000000,-128.0000000000) [-128.0000000000|127.9375000000] "m/s"  FR,ADC,FC
 SG_ FR_OBJ17_RelVy_std : 100|10@0+ (0.1250000000,0.0000000000) [0.0000000000|127.8750000000] "m/s"  FR,ADC,FC
 SG_ FR_OBJ17_RelVy : 94|10@0+ (0.1250000000,-64.0000000000) [-64.0000000000|63.8750000000] "m/s"  FR,ADC,FC
 SG_ FR_OBJ17_Dx_Vnce : 76|14@0+ (0.0500000000,0.0000000000) [0.0000000000|50.0000000000] "m2"  FR,ADC,FC
 SG_ FR_OBJ17_Dx : 57|13@0+ (0.0625000000,-100.0000000000) [-100.0000000000|411.9375000000] "m"  FR,ADC,FC
 SG_ FR_OBJ17_Dy_Vnce : 51|10@0+ (0.0200000000,0.0000000000) [0.0000000000|20.0000000000] "m2"  FR,ADC,FC
 SG_ FR_OBJ17_Dy : 46|11@0+ (0.1250000000,-128.0000000000) [-128.0000000000|127.8750000000] "m"  FR,ADC,FC
 SG_ FR_OBJ17_HeadingAngle : 407|10@0+ (0.0100000000,-3.1400000000) [-3.1400000000|3.1400000000] "rad"  FR,ADC,FC
 SG_ FR_OBJ17_Length : 16|9@0+ (0.0500000000,0.0000000000) [0.0000000000|25.5000000000] "m"  FR,ADC,FC
 SG_ FR_OBJ17_Height : 9|9@0+ (0.0100000000,0.0000000000) [0.0000000000|5.1100000000] "m"  FR,ADC,FC
 SG_ FR_OBJ17_Width : 4|11@0+ (0.0100000000,0.0000000000) [0.0000000000|12.0000000000] "m"  FR,ADC,FC
 SG_ FR_OBJ17_Class : 7|3@0+ (1.0000000000,0.0000000000) [0.0000000000|7.0000000000] ""  FR,ADC,FC

BO_ 282 FR_11A: 64 FR
 SG_ FR_OBJ20_Ax : 482|7@0+ (0.2000000000,-13.0000000000) [-13.0000000000|12.6000000000] "m/s2"  FR,ADC,FC
 SG_ FR_OBJ20_Ay : 473|7@0+ (0.2000000000,-13.0000000000) [-13.0000000000|12.6000000000] "m/s2"  FR,ADC,FC
 SG_ FR_OBJ20_Vx : 466|9@0+ (0.2000000000,-51.0000000000) [-51.0000000000|51.2000000000] "m/s"  FR,ADC,FC
 SG_ FR_OBJ20_Vy : 459|9@0+ (0.2000000000,-51.0000000000) [-51.0000000000|51.2000000000] "m/s"  FR,ADC,FC
 SG_ FR_OBJ19_Ax : 450|7@0+ (0.2000000000,-13.0000000000) [-13.0000000000|12.6000000000] "m/s2"  FR,ADC,FC
 SG_ FR_OBJ19_Ay : 441|7@0+ (0.2000000000,-13.0000000000) [-13.0000000000|12.6000000000] "m/s2"  FR,ADC,FC
 SG_ FR_OBJ19_Vx : 434|9@0+ (0.2000000000,-51.0000000000) [-51.0000000000|51.2000000000] "m/s"  FR,ADC,FC
 SG_ FR_OBJ19_Vy : 427|9@0+ (0.2000000000,-51.0000000000) [-51.0000000000|51.2000000000] "m/s"  FR,ADC,FC
 SG_ FR_OBJ20_FeaturePoint : 431|4@0+ (1.0000000000,0.0000000000) [0.0000000000|9.0000000000] "-"  FR,ADC,FC
 SG_ FR_OBJ19_FeaturePoint : 419|4@0+ (1.0000000000,0.0000000000) [0.0000000000|9.0000000000] "-"  FR,ADC,FC
 SG_ FR_CRCCheck_11A : 503|16@0+ (1.0000000000,0.0000000000) [0.0000000000|65535.0000000000] ""  FR,ADC,FC
 SG_ FR_RollingCounter_11A : 491|4@0+ (1.0000000000,0.0000000000) [0.0000000000|15.0000000000] ""  FR,ADC,FC
 SG_ FR_OBJ20_HeightGround : 211|9@0+ (0.1000000000,0.0000000000) [0.0000000000|51.1000000000] "m"  FR,ADC,FC
 SG_ FR_OBJ20_MotionStatusConf : 397|6@0+ (2.0000000000,0.0000000000) [0.0000000000|63.0000000000] "-"  FR,ADC,FC
 SG_ FR_OBJ20_ClassConf : 377|6@0+ (2.0000000000,0.0000000000) [0.0000000000|63.0000000000] "-"  FR,ADC,FC
 SG_ FR_OBJ20_MotionStatus : 370|3@0+ (1.0000000000,0.0000000000) [0.0000000000|7.0000000000] ""  FR,ADC,FC
 SG_ FR_OBJ20_Location : 375|2@0+ (1.0000000000,0.0000000000) [0.0000000000|3.0000000000] ""  FR,ADC,FC
 SG_ FR_OBJ20_Measured : 363|2@0+ (1.0000000000,0.0000000000) [0.0000000000|3.0000000000] ""  FR,ADC,FC
 SG_ FR_OBJ20_valid : 366|1@0+ (1.0000000000,0.0000000000) [0.0000000000|1.0000000000] ""  FR,ADC,FC
 SG_ FR_OBJ20_Track_Age : 359|8@0+ (1.0000000000,0.0000000000) [0.0000000000|255.0000000000] ""  FR,ADC,FC
 SG_ FR_OBJ20_Track_ID : 351|8@0+ (1.0000000000,0.0000000000) [0.0000000000|255.0000000000] ""  FR,ADC,FC
 SG_ FR_OBJ20_ObstacleProb : 341|6@0+ (2.0000000000,0.0000000000) [0.0000000000|100.0000000000] "%"  FR,ADC,FC
 SG_ FR_OBJ20_ExistProb : 331|6@0+ (2.0000000000,0.0000000000) [0.0000000000|100.0000000000] "%"  FR,ADC,FC
 SG_ FR_OBJ20_RelAx : 325|10@0+ (0.0312500000,-16.0000000000) [-16.0000000000|15.9687500000] "m/s2"  FR,ADC,FC
 SG_ FR_OBJ20_RelAy : 318|9@0+ (0.0625000000,-16.0000000000) [-16.0000000000|15.9375000000] "m/s2"  FR,ADC,FC
 SG_ FR_OBJ20_RelVx_std : 298|12@0+ (0.0625000000,0.0000000000) [0.0000000000|255.9375000000] "m/s"  FR,ADC,FC
 SG_ FR_OBJ20_RelVx : 294|12@0+ (0.0625000000,-128.0000000000) [-128.0000000000|127.9375000000] "m/s"  FR,ADC,FC
 SG_ FR_OBJ20_RelVy_std : 272|10@0+ (0.1250000000,0.0000000000) [0.0000000000|127.8750000000] "m/s"  FR,ADC,FC
 SG_ FR_OBJ20_RelVy : 266|10@0+ (0.1250000000,-64.0000000000) [-64.0000000000|63.8750000000] "m/s"  FR,ADC,FC
 SG_ FR_OBJ20_Dx_Vnce : 248|14@0+ (0.0500000000,0.0000000000) [0.0000000000|50.0000000000] "m2"  FR,ADC,FC
 SG_ FR_OBJ20_Dx : 245|13@0+ (0.0625000000,-100.0000000000) [-100.0000000000|411.9375000000] "m"  FR,ADC,FC
 SG_ FR_OBJ20_Dy_Vnce : 239|10@0+ (0.0200000000,0.0000000000) [0.0000000000|20.0000000000] "m2"  FR,ADC,FC
 SG_ FR_OBJ20_Dy : 218|11@0+ (0.1250000000,-128.0000000000) [-128.0000000000|127.8750000000] "m"  FR,ADC,FC
 SG_ FR_OBJ20_HeadingAngle : 413|10@0+ (0.0100000000,-3.1400000000) [-3.1400000000|3.1400000000] "rad"  FR,ADC,FC
 SG_ FR_OBJ20_Length : 204|9@0+ (0.0500000000,0.0000000000) [0.0000000000|25.5000000000] "m"  FR,ADC,FC
 SG_ FR_OBJ20_Height : 197|9@0+ (0.0100000000,0.0000000000) [0.0000000000|5.1100000000] "m"  FR,ADC,FC
 SG_ FR_OBJ20_Width : 176|11@0+ (0.0100000000,0.0000000000) [0.0000000000|12.0000000000] "m"  FR,ADC,FC
 SG_ FR_OBJ20_Class : 179|3@0+ (1.0000000000,0.0000000000) [0.0000000000|7.0000000000] ""  FR,ADC,FC
 SG_ FR_OBJ19_HeightGround : 39|9@0+ (0.1000000000,0.0000000000) [0.0000000000|51.1000000000] "m"  FR,ADC,FC
 SG_ FR_OBJ19_MotionStatusConf : 387|6@0+ (2.0000000000,0.0000000000) [0.0000000000|63.0000000000] "-"  FR,ADC,FC
 SG_ FR_OBJ19_ClassConf : 383|6@0+ (2.0000000000,0.0000000000) [0.0000000000|63.0000000000] "-"  FR,ADC,FC
 SG_ FR_OBJ19_MotionStatus : 373|3@0+ (1.0000000000,0.0000000000) [0.0000000000|7.0000000000] ""  FR,ADC,FC
 SG_ FR_OBJ19_Location : 361|2@0+ (1.0000000000,0.0000000000) [0.0000000000|3.0000000000] ""  FR,ADC,FC
 SG_ FR_OBJ19_Measured : 365|2@0+ (1.0000000000,0.0000000000) [0.0000000000|3.0000000000] ""  FR,ADC,FC
 SG_ FR_OBJ19_valid : 367|1@0+ (1.0000000000,0.0000000000) [0.0000000000|1.0000000000] ""  FR,ADC,FC
 SG_ FR_OBJ19_Track_Age : 171|8@0+ (1.0000000000,0.0000000000) [0.0000000000|255.0000000000] ""  FR,ADC,FC
 SG_ FR_OBJ19_Track_ID : 163|8@0+ (1.0000000000,0.0000000000) [0.0000000000|255.0000000000] ""  FR,ADC,FC
 SG_ FR_OBJ19_ObstacleProb : 153|6@0+ (2.0000000000,0.0000000000) [0.0000000000|100.0000000000] "%"  FR,ADC,FC
 SG_ FR_OBJ19_ExistProb : 159|6@0+ (2.0000000000,0.0000000000) [0.0000000000|100.0000000000] "%"  FR,ADC,FC
 SG_ FR_OBJ19_RelAx : 137|10@0+ (0.0312500000,-16.0000000000) [-16.0000000000|15.9687500000] "m/s2"  FR,ADC,FC
 SG_ FR_OBJ19_RelAy : 130|9@0+ (0.0625000000,-16.0000000000) [-16.0000000000|15.9375000000] "m/s2"  FR,ADC,FC
 SG_ FR_OBJ19_RelVx_std : 126|12@0+ (0.0625000000,0.0000000000) [0.0000000000|255.9375000000] "m/s"  FR,ADC,FC
 SG_ FR_OBJ19_RelVx : 106|12@0+ (0.0625000000,-128.0000000000) [-128.0000000000|127.9375000000] "m/s"  FR,ADC,FC
 SG_ FR_OBJ19_RelVy_std : 100|10@0+ (0.1250000000,0.0000000000) [0.0000000000|127.8750000000] "m/s"  FR,ADC,FC
 SG_ FR_OBJ19_RelVy : 94|10@0+ (0.1250000000,-64.0000000000) [-64.0000000000|63.8750000000] "m/s"  FR,ADC,FC
 SG_ FR_OBJ19_Dx_Vnce : 76|14@0+ (0.0500000000,0.0000000000) [0.0000000000|50.0000000000] "m2"  FR,ADC,FC
 SG_ FR_OBJ19_Dx : 57|13@0+ (0.0625000000,-100.0000000000) [-100.0000000000|411.9375000000] "m"  FR,ADC,FC
 SG_ FR_OBJ19_Dy_Vnce : 51|10@0+ (0.0200000000,0.0000000000) [0.0000000000|20.0000000000] "m2"  FR,ADC,FC
 SG_ FR_OBJ19_Dy : 46|11@0+ (0.1250000000,-128.0000000000) [-128.0000000000|127.8750000000] "m"  FR,ADC,FC
 SG_ FR_OBJ19_HeadingAngle : 407|10@0+ (0.0100000000,-3.1400000000) [-3.1400000000|3.1400000000] "rad"  FR,ADC,FC
 SG_ FR_OBJ19_Length : 16|9@0+ (0.0500000000,0.0000000000) [0.0000000000|25.5000000000] "m"  FR,ADC,FC
 SG_ FR_OBJ19_Height : 9|9@0+ (0.0100000000,0.0000000000) [0.0000000000|5.1100000000] "m"  FR,ADC,FC
 SG_ FR_OBJ19_Width : 4|11@0+ (0.0100000000,0.0000000000) [0.0000000000|12.0000000000] "m"  FR,ADC,FC
 SG_ FR_OBJ19_Class : 7|3@0+ (1.0000000000,0.0000000000) [0.0000000000|7.0000000000] ""  FR,ADC,FC

CM_ BO_ 273  " ";
CM_ SG_ 273 FR_OBJ2_Ax  " ";
CM_ SG_ 273 FR_OBJ2_Ay  " ";
CM_ SG_ 273 FR_OBJ2_Vx  " ";
CM_ SG_ 273 FR_OBJ2_Vy  " ";
CM_ SG_ 273 FR_OBJ1_Ax  " ";
CM_ SG_ 273 FR_OBJ1_Ay  " ";
CM_ SG_ 273 FR_OBJ1_Vx  " ";
CM_ SG_ 273 FR_OBJ1_Vy  " ";
CM_ SG_ 273 FR_OBJ2_FeaturePoint  " ";
CM_ SG_ 273 FR_OBJ1_FeaturePoint  " ";
CM_ SG_ 273 FR_CRCCheck_111  " ";
CM_ SG_ 273 FR_RollingCounter_111  " ";
CM_ SG_ 273 FR_OBJ2_HeightGround  "反射点最强点距离地面的高度 ";
CM_ SG_ 273 FR_OBJ2_MotionStatusConf  " ";
CM_ SG_ 273 FR_OBJ2_ClassConf  " ";
CM_ SG_ 273 FR_OBJ2_MotionStatus  " ";
CM_ SG_ 273 FR_OBJ2_Location  " ";
CM_ SG_ 273 FR_OBJ2_Measured  " ";
CM_ SG_ 273 FR_OBJ2_valid  " ";
CM_ SG_ 273 FR_OBJ2_Track_Age  " ";
CM_ SG_ 273 FR_OBJ2_Track_ID  " ";
CM_ SG_ 273 FR_OBJ2_ObstacleProb  " ";
CM_ SG_ 273 FR_OBJ2_ExistProb  " ";
CM_ SG_ 273 FR_OBJ2_RelAx  " ";
CM_ SG_ 273 FR_OBJ2_RelAy  " ";
CM_ SG_ 273 FR_OBJ2_RelVx_std  " ";
CM_ SG_ 273 FR_OBJ2_RelVx  " ";
CM_ SG_ 273 FR_OBJ2_RelVy_std  " ";
CM_ SG_ 273 FR_OBJ2_RelVy  " ";
CM_ SG_ 273 FR_OBJ2_Dx_Vnce  " ";
CM_ SG_ 273 FR_OBJ2_Dx  " ";
CM_ SG_ 273 FR_OBJ2_Dy_Vnce  " ";
CM_ SG_ 273 FR_OBJ2_Dy  " ";
CM_ SG_ 273 FR_OBJ2_HeadingAngle  " ";
CM_ SG_ 273 FR_OBJ2_Length  " ";
CM_ SG_ 273 FR_OBJ2_Height  " ";
CM_ SG_ 273 FR_OBJ2_Width  " ";
CM_ SG_ 273 FR_OBJ2_Class  " ";
CM_ SG_ 273 FR_OBJ1_HeightGround  "反射点最强点距离地面的高度 ";
CM_ SG_ 273 FR_OBJ1_MotionStatusConf  " ";
CM_ SG_ 273 FR_OBJ1_ClassConf  " ";
CM_ SG_ 273 FR_OBJ1_MotionStatus  " ";
CM_ SG_ 273 FR_OBJ1_Location  " ";
CM_ SG_ 273 FR_OBJ1_Measured  " ";
CM_ SG_ 273 FR_OBJ1_valid  " ";
CM_ SG_ 273 FR_OBJ1_Track_Age  " ";
CM_ SG_ 273 FR_OBJ1_Track_ID  " ";
CM_ SG_ 273 FR_OBJ1_ObstacleProb  " ";
CM_ SG_ 273 FR_OBJ1_ExistProb  " ";
CM_ SG_ 273 FR_OBJ1_RelAx  " ";
CM_ SG_ 273 FR_OBJ1_RelAy  " ";
CM_ SG_ 273 FR_OBJ1_RelVx_std  " ";
CM_ SG_ 273 FR_OBJ1_RelVx  " ";
CM_ SG_ 273 FR_OBJ1_RelVy_std  " ";
CM_ SG_ 273 FR_OBJ1_RelVy  " ";
CM_ SG_ 273 FR_OBJ1_Dx_Vnce  " ";
CM_ SG_ 273 FR_OBJ1_Dx  " ";
CM_ SG_ 273 FR_OBJ1_Dy_Vnce  " ";
CM_ SG_ 273 FR_OBJ1_Dy  " ";
CM_ SG_ 273 FR_OBJ1_HeadingAngle  " ";
CM_ SG_ 273 FR_OBJ1_Length  " ";
CM_ SG_ 273 FR_OBJ1_Height  " ";
CM_ SG_ 273 FR_OBJ1_Width  " ";
CM_ SG_ 273 FR_OBJ1_Class  " ";

CM_ BO_ 274  " ";
CM_ SG_ 274 FR_OBJ4_Ax  " ";
CM_ SG_ 274 FR_OBJ4_Ay  " ";
CM_ SG_ 274 FR_OBJ4_Vx  " ";
CM_ SG_ 274 FR_OBJ4_Vy  " ";
CM_ SG_ 274 FR_OBJ3_Ax  " ";
CM_ SG_ 274 FR_OBJ3_Ay  " ";
CM_ SG_ 274 FR_OBJ3_Vx  " ";
CM_ SG_ 274 FR_OBJ3_Vy  " ";
CM_ SG_ 274 FR_OBJ4_FeaturePoint  " ";
CM_ SG_ 274 FR_OBJ3_FeaturePoint  " ";
CM_ SG_ 274 FR_CRCCheck_112  " ";
CM_ SG_ 274 FR_RollingCounter_112  " ";
CM_ SG_ 274 FR_OBJ4_HeightGround  "反射点最强点距离地面的高度 ";
CM_ SG_ 274 FR_OBJ4_MotionStatusConf  " ";
CM_ SG_ 274 FR_OBJ4_ClassConf  " ";
CM_ SG_ 274 FR_OBJ4_MotionStatus  " ";
CM_ SG_ 274 FR_OBJ4_Location  " ";
CM_ SG_ 274 FR_OBJ4_Measured  " ";
CM_ SG_ 274 FR_OBJ4_valid  " ";
CM_ SG_ 274 FR_OBJ4_Track_Age  " ";
CM_ SG_ 274 FR_OBJ4_Track_ID  " ";
CM_ SG_ 274 FR_OBJ4_ObstacleProb  " ";
CM_ SG_ 274 FR_OBJ4_ExistProb  " ";
CM_ SG_ 274 FR_OBJ4_RelAx  " ";
CM_ SG_ 274 FR_OBJ4_RelAy  " ";
CM_ SG_ 274 FR_OBJ4_RelVx_std  " ";
CM_ SG_ 274 FR_OBJ4_RelVx  " ";
CM_ SG_ 274 FR_OBJ4_RelVy_std  " ";
CM_ SG_ 274 FR_OBJ4_RelVy  " ";
CM_ SG_ 274 FR_OBJ4_Dx_Vnce  " ";
CM_ SG_ 274 FR_OBJ4_Dx  " ";
CM_ SG_ 274 FR_OBJ4_Dy_Vnce  " ";
CM_ SG_ 274 FR_OBJ4_Dy  " ";
CM_ SG_ 274 FR_OBJ4_HeadingAngle  " ";
CM_ SG_ 274 FR_OBJ4_Length  " ";
CM_ SG_ 274 FR_OBJ4_Height  " ";
CM_ SG_ 274 FR_OBJ4_Width  " ";
CM_ SG_ 274 FR_OBJ4_Class  " ";
CM_ SG_ 274 FR_OBJ3_HeightGround  "反射点最强点距离地面的高度 ";
CM_ SG_ 274 FR_OBJ3_MotionStatusConf  " ";
CM_ SG_ 274 FR_OBJ3_ClassConf  " ";
CM_ SG_ 274 FR_OBJ3_MotionStatus  " ";
CM_ SG_ 274 FR_OBJ3_Location  " ";
CM_ SG_ 274 FR_OBJ3_Measured  " ";
CM_ SG_ 274 FR_OBJ3_valid  " ";
CM_ SG_ 274 FR_OBJ3_Track_Age  " ";
CM_ SG_ 274 FR_OBJ3_Track_ID  " ";
CM_ SG_ 274 FR_OBJ3_ObstacleProb  " ";
CM_ SG_ 274 FR_OBJ3_ExistProb  " ";
CM_ SG_ 274 FR_OBJ3_RelAx  " ";
CM_ SG_ 274 FR_OBJ3_RelAy  " ";
CM_ SG_ 274 FR_OBJ3_RelVx_std  " ";
CM_ SG_ 274 FR_OBJ3_RelVx  " ";
CM_ SG_ 274 FR_OBJ3_RelVy_std  " ";
CM_ SG_ 274 FR_OBJ3_RelVy  " ";
CM_ SG_ 274 FR_OBJ3_Dx_Vnce  " ";
CM_ SG_ 274 FR_OBJ3_Dx  " ";
CM_ SG_ 274 FR_OBJ3_Dy_Vnce  " ";
CM_ SG_ 274 FR_OBJ3_Dy  " ";
CM_ SG_ 274 FR_OBJ3_HeadingAngle  " ";
CM_ SG_ 274 FR_OBJ3_Length  " ";
CM_ SG_ 274 FR_OBJ3_Height  " ";
CM_ SG_ 274 FR_OBJ3_Width  " ";
CM_ SG_ 274 FR_OBJ3_Class  " ";

CM_ BO_ 275  " ";
CM_ SG_ 275 FR_OBJ6_Ax  " ";
CM_ SG_ 275 FR_OBJ6_Ay  " ";
CM_ SG_ 275 FR_OBJ6_Vx  " ";
CM_ SG_ 275 FR_OBJ6_Vy  " ";
CM_ SG_ 275 FR_OBJ5_Ax  " ";
CM_ SG_ 275 FR_OBJ5_Ay  " ";
CM_ SG_ 275 FR_OBJ5_Vx  " ";
CM_ SG_ 275 FR_OBJ5_Vy  " ";
CM_ SG_ 275 FR_OBJ6_FeaturePoint  " ";
CM_ SG_ 275 FR_OBJ5_FeaturePoint  " ";
CM_ SG_ 275 FR_CRCCheck_113  " ";
CM_ SG_ 275 FR_RollingCounter_113  " ";
CM_ SG_ 275 FR_OBJ6_HeightGround  "反射点最强点距离地面的高度 ";
CM_ SG_ 275 FR_OBJ6_MotionStatusConf  " ";
CM_ SG_ 275 FR_OBJ6_ClassConf  " ";
CM_ SG_ 275 FR_OBJ6_MotionStatus  " ";
CM_ SG_ 275 FR_OBJ6_Location  " ";
CM_ SG_ 275 FR_OBJ6_Measured  " ";
CM_ SG_ 275 FR_OBJ6_valid  " ";
CM_ SG_ 275 FR_OBJ6_Track_Age  " ";
CM_ SG_ 275 FR_OBJ6_Track_ID  " ";
CM_ SG_ 275 FR_OBJ6_ObstacleProb  " ";
CM_ SG_ 275 FR_OBJ6_ExistProb  " ";
CM_ SG_ 275 FR_OBJ6_RelAx  " ";
CM_ SG_ 275 FR_OBJ6_RelAy  " ";
CM_ SG_ 275 FR_OBJ6_RelVx_std  " ";
CM_ SG_ 275 FR_OBJ6_RelVx  " ";
CM_ SG_ 275 FR_OBJ6_RelVy_std  " ";
CM_ SG_ 275 FR_OBJ6_RelVy  " ";
CM_ SG_ 275 FR_OBJ6_Dx_Vnce  " ";
CM_ SG_ 275 FR_OBJ6_Dx  " ";
CM_ SG_ 275 FR_OBJ6_Dy_Vnce  " ";
CM_ SG_ 275 FR_OBJ6_Dy  " ";
CM_ SG_ 275 FR_OBJ6_HeadingAngle  " ";
CM_ SG_ 275 FR_OBJ6_Length  " ";
CM_ SG_ 275 FR_OBJ6_Height  " ";
CM_ SG_ 275 FR_OBJ6_Width  " ";
CM_ SG_ 275 FR_OBJ6_Class  " ";
CM_ SG_ 275 FR_OBJ5_HeightGround  "反射点最强点距离地面的高度 ";
CM_ SG_ 275 FR_OBJ5_MotionStatusConf  " ";
CM_ SG_ 275 FR_OBJ5_ClassConf  " ";
CM_ SG_ 275 FR_OBJ5_MotionStatus  " ";
CM_ SG_ 275 FR_OBJ5_Location  " ";
CM_ SG_ 275 FR_OBJ5_Measured  " ";
CM_ SG_ 275 FR_OBJ5_valid  " ";
CM_ SG_ 275 FR_OBJ5_Track_Age  " ";
CM_ SG_ 275 FR_OBJ5_Track_ID  " ";
CM_ SG_ 275 FR_OBJ5_ObstacleProb  " ";
CM_ SG_ 275 FR_OBJ5_ExistProb  " ";
CM_ SG_ 275 FR_OBJ5_RelAx  " ";
CM_ SG_ 275 FR_OBJ5_RelAy  " ";
CM_ SG_ 275 FR_OBJ5_RelVx_std  " ";
CM_ SG_ 275 FR_OBJ5_RelVx  " ";
CM_ SG_ 275 FR_OBJ5_RelVy_std  " ";
CM_ SG_ 275 FR_OBJ5_RelVy  " ";
CM_ SG_ 275 FR_OBJ5_Dx_Vnce  " ";
CM_ SG_ 275 FR_OBJ5_Dx  " ";
CM_ SG_ 275 FR_OBJ5_Dy_Vnce  " ";
CM_ SG_ 275 FR_OBJ5_Dy  " ";
CM_ SG_ 275 FR_OBJ5_HeadingAngle  " ";
CM_ SG_ 275 FR_OBJ5_Length  " ";
CM_ SG_ 275 FR_OBJ5_Height  " ";
CM_ SG_ 275 FR_OBJ5_Width  " ";
CM_ SG_ 275 FR_OBJ5_Class  " ";

CM_ BO_ 276  " ";
CM_ SG_ 276 FR_OBJ8_Ax  " ";
CM_ SG_ 276 FR_OBJ8_Ay  " ";
CM_ SG_ 276 FR_OBJ8_Vx  " ";
CM_ SG_ 276 FR_OBJ8_Vy  " ";
CM_ SG_ 276 FR_OBJ7_Ax  " ";
CM_ SG_ 276 FR_OBJ7_Ay  " ";
CM_ SG_ 276 FR_OBJ7_Vx  " ";
CM_ SG_ 276 FR_OBJ7_Vy  " ";
CM_ SG_ 276 FR_OBJ8_FeaturePoint  " ";
CM_ SG_ 276 FR_OBJ7_FeaturePoint  " ";
CM_ SG_ 276 FR_CRCCheck_114  " ";
CM_ SG_ 276 FR_RollingCounter_114  " ";
CM_ SG_ 276 FR_OBJ8_HeightGround  "反射点最强点距离地面的高度 ";
CM_ SG_ 276 FR_OBJ8_MotionStatusConf  " ";
CM_ SG_ 276 FR_OBJ8_ClassConf  " ";
CM_ SG_ 276 FR_OBJ8_MotionStatus  " ";
CM_ SG_ 276 FR_OBJ8_Location  " ";
CM_ SG_ 276 FR_OBJ8_Measured  " ";
CM_ SG_ 276 FR_OBJ8_valid  " ";
CM_ SG_ 276 FR_OBJ8_Track_Age  " ";
CM_ SG_ 276 FR_OBJ8_Track_ID  " ";
CM_ SG_ 276 FR_OBJ8_ObstacleProb  " ";
CM_ SG_ 276 FR_OBJ8_ExistProb  " ";
CM_ SG_ 276 FR_OBJ8_RelAx  " ";
CM_ SG_ 276 FR_OBJ8_RelAy  " ";
CM_ SG_ 276 FR_OBJ8_RelVx_std  " ";
CM_ SG_ 276 FR_OBJ8_RelVx  " ";
CM_ SG_ 276 FR_OBJ8_RelVy_std  " ";
CM_ SG_ 276 FR_OBJ8_RelVy  " ";
CM_ SG_ 276 FR_OBJ8_Dx_Vnce  " ";
CM_ SG_ 276 FR_OBJ8_Dx  " ";
CM_ SG_ 276 FR_OBJ8_Dy_Vnce  " ";
CM_ SG_ 276 FR_OBJ8_Dy  " ";
CM_ SG_ 276 FR_OBJ8_HeadingAngle  " ";
CM_ SG_ 276 FR_OBJ8_Length  " ";
CM_ SG_ 276 FR_OBJ8_Height  " ";
CM_ SG_ 276 FR_OBJ8_Width  " ";
CM_ SG_ 276 FR_OBJ8_Class  " ";
CM_ SG_ 276 FR_OBJ7_HeightGround  "反射点最强点距离地面的高度 ";
CM_ SG_ 276 FR_OBJ7_MotionStatusConf  " ";
CM_ SG_ 276 FR_OBJ7_ClassConf  " ";
CM_ SG_ 276 FR_OBJ7_MotionStatus  " ";
CM_ SG_ 276 FR_OBJ7_Location  " ";
CM_ SG_ 276 FR_OBJ7_Measured  " ";
CM_ SG_ 276 FR_OBJ7_valid  " ";
CM_ SG_ 276 FR_OBJ7_Track_Age  " ";
CM_ SG_ 276 FR_OBJ7_Track_ID  " ";
CM_ SG_ 276 FR_OBJ7_ObstacleProb  " ";
CM_ SG_ 276 FR_OBJ7_ExistProb  " ";
CM_ SG_ 276 FR_OBJ7_RelAx  " ";
CM_ SG_ 276 FR_OBJ7_RelAy  " ";
CM_ SG_ 276 FR_OBJ7_RelVx_std  " ";
CM_ SG_ 276 FR_OBJ7_RelVx  " ";
CM_ SG_ 276 FR_OBJ7_RelVy_std  " ";
CM_ SG_ 276 FR_OBJ7_RelVy  " ";
CM_ SG_ 276 FR_OBJ7_Dx_Vnce  " ";
CM_ SG_ 276 FR_OBJ7_Dx  " ";
CM_ SG_ 276 FR_OBJ7_Dy_Vnce  " ";
CM_ SG_ 276 FR_OBJ7_Dy  " ";
CM_ SG_ 276 FR_OBJ7_HeadingAngle  " ";
CM_ SG_ 276 FR_OBJ7_Length  " ";
CM_ SG_ 276 FR_OBJ7_Height  " ";
CM_ SG_ 276 FR_OBJ7_Width  " ";
CM_ SG_ 276 FR_OBJ7_Class  " ";

CM_ BO_ 277  " ";
CM_ SG_ 277 FR_OBJ10_Ax  " ";
CM_ SG_ 277 FR_OBJ10_Ay  " ";
CM_ SG_ 277 FR_OBJ10_Vx  " ";
CM_ SG_ 277 FR_OBJ10_Vy  " ";
CM_ SG_ 277 FR_OBJ9_Ax  " ";
CM_ SG_ 277 FR_OBJ9_Ay  " ";
CM_ SG_ 277 FR_OBJ9_Vx  " ";
CM_ SG_ 277 FR_OBJ9_Vy  " ";
CM_ SG_ 277 FR_OBJ10_FeaturePoint  " ";
CM_ SG_ 277 FR_OBJ9_FeaturePoint  " ";
CM_ SG_ 277 FR_CRCCheck_115  " ";
CM_ SG_ 277 FR_RollingCounter_115  " ";
CM_ SG_ 277 FR_OBJ10_HeightGround  "反射点最强点距离地面的高度 ";
CM_ SG_ 277 FR_OBJ10_MotionStatusConf  " ";
CM_ SG_ 277 FR_OBJ10_ClassConf  " ";
CM_ SG_ 277 FR_OBJ10_MotionStatus  " ";
CM_ SG_ 277 FR_OBJ10_Location  " ";
CM_ SG_ 277 FR_OBJ10_Measured  " ";
CM_ SG_ 277 FR_OBJ10_valid  " ";
CM_ SG_ 277 FR_OBJ10_Track_Age  " ";
CM_ SG_ 277 FR_OBJ10_Track_ID  " ";
CM_ SG_ 277 FR_OBJ10_ObstacleProb  " ";
CM_ SG_ 277 FR_OBJ10_ExistProb  " ";
CM_ SG_ 277 FR_OBJ10_RelAx  " ";
CM_ SG_ 277 FR_OBJ10_RelAy  " ";
CM_ SG_ 277 FR_OBJ10_RelVx_std  " ";
CM_ SG_ 277 FR_OBJ10_RelVx  " ";
CM_ SG_ 277 FR_OBJ10_RelVy_std  " ";
CM_ SG_ 277 FR_OBJ10_RelVy  " ";
CM_ SG_ 277 FR_OBJ10_Dx_Vnce  " ";
CM_ SG_ 277 FR_OBJ10_Dx  " ";
CM_ SG_ 277 FR_OBJ10_Dy_Vnce  " ";
CM_ SG_ 277 FR_OBJ10_Dy  " ";
CM_ SG_ 277 FR_OBJ10_HeadingAngle  " ";
CM_ SG_ 277 FR_OBJ10_Length  " ";
CM_ SG_ 277 FR_OBJ10_Height  " ";
CM_ SG_ 277 FR_OBJ10_Width  " ";
CM_ SG_ 277 FR_OBJ10_Class  " ";
CM_ SG_ 277 FR_OBJ9_HeightGround  "反射点最强点距离地面的高度 ";
CM_ SG_ 277 FR_OBJ9_MotionStatusConf  " ";
CM_ SG_ 277 FR_OBJ9_ClassConf  " ";
CM_ SG_ 277 FR_OBJ9_MotionStatus  " ";
CM_ SG_ 277 FR_OBJ9_Location  " ";
CM_ SG_ 277 FR_OBJ9_Measured  " ";
CM_ SG_ 277 FR_OBJ9_valid  " ";
CM_ SG_ 277 FR_OBJ9_Track_Age  " ";
CM_ SG_ 277 FR_OBJ9_Track_ID  " ";
CM_ SG_ 277 FR_OBJ9_ObstacleProb  " ";
CM_ SG_ 277 FR_OBJ9_ExistProb  " ";
CM_ SG_ 277 FR_OBJ9_RelAx  " ";
CM_ SG_ 277 FR_OBJ9_RelAy  " ";
CM_ SG_ 277 FR_OBJ9_RelVx_std  " ";
CM_ SG_ 277 FR_OBJ9_RelVx  " ";
CM_ SG_ 277 FR_OBJ9_RelVy_std  " ";
CM_ SG_ 277 FR_OBJ9_RelVy  " ";
CM_ SG_ 277 FR_OBJ9_Dx_Vnce  " ";
CM_ SG_ 277 FR_OBJ9_Dx  " ";
CM_ SG_ 277 FR_OBJ9_Dy_Vnce  " ";
CM_ SG_ 277 FR_OBJ9_Dy  " ";
CM_ SG_ 277 FR_OBJ9_HeadingAngle  " ";
CM_ SG_ 277 FR_OBJ9_Length  " ";
CM_ SG_ 277 FR_OBJ9_Height  " ";
CM_ SG_ 277 FR_OBJ9_Width  " ";
CM_ SG_ 277 FR_OBJ9_Class  " ";

CM_ BO_ 278  " ";
CM_ SG_ 278 FR_OBJ12_Ax  " ";
CM_ SG_ 278 FR_OBJ12_Ay  " ";
CM_ SG_ 278 FR_OBJ12_Vx  " ";
CM_ SG_ 278 FR_OBJ12_Vy  " ";
CM_ SG_ 278 FR_OBJ11_Ax  " ";
CM_ SG_ 278 FR_OBJ11_Ay  " ";
CM_ SG_ 278 FR_OBJ11_Vx  " ";
CM_ SG_ 278 FR_OBJ11_Vy  " ";
CM_ SG_ 278 FR_OBJ12_FeaturePoint  " ";
CM_ SG_ 278 FR_OBJ11_FeaturePoint  " ";
CM_ SG_ 278 FR_CRCCheck_116  " ";
CM_ SG_ 278 FR_RollingCounter_116  " ";
CM_ SG_ 278 FR_OBJ12_HeightGround  "反射点最强点距离地面的高度 ";
CM_ SG_ 278 FR_OBJ12_MotionStatusConf  " ";
CM_ SG_ 278 FR_OBJ12_ClassConf  " ";
CM_ SG_ 278 FR_OBJ12_MotionStatus  " ";
CM_ SG_ 278 FR_OBJ12_Location  " ";
CM_ SG_ 278 FR_OBJ12_Measured  " ";
CM_ SG_ 278 FR_OBJ12_valid  " ";
CM_ SG_ 278 FR_OBJ12_Track_Age  " ";
CM_ SG_ 278 FR_OBJ12_Track_ID  " ";
CM_ SG_ 278 FR_OBJ12_ObstacleProb  " ";
CM_ SG_ 278 FR_OBJ12_ExistProb  " ";
CM_ SG_ 278 FR_OBJ12_RelAx  " ";
CM_ SG_ 278 FR_OBJ12_RelAy  " ";
CM_ SG_ 278 FR_OBJ12_RelVx_std  " ";
CM_ SG_ 278 FR_OBJ12_RelVx  " ";
CM_ SG_ 278 FR_OBJ12_RelVy_std  " ";
CM_ SG_ 278 FR_OBJ12_RelVy  " ";
CM_ SG_ 278 FR_OBJ12_Dx_Vnce  " ";
CM_ SG_ 278 FR_OBJ12_Dx  " ";
CM_ SG_ 278 FR_OBJ12_Dy_Vnce  " ";
CM_ SG_ 278 FR_OBJ12_Dy  " ";
CM_ SG_ 278 FR_OBJ12_HeadingAngle  " ";
CM_ SG_ 278 FR_OBJ12_Length  " ";
CM_ SG_ 278 FR_OBJ12_Height  " ";
CM_ SG_ 278 FR_OBJ12_Width  " ";
CM_ SG_ 278 FR_OBJ12_Class  " ";
CM_ SG_ 278 FR_OBJ11_HeightGround  "反射点最强点距离地面的高度 ";
CM_ SG_ 278 FR_OBJ11_MotionStatusConf  " ";
CM_ SG_ 278 FR_OBJ11_ClassConf  " ";
CM_ SG_ 278 FR_OBJ11_MotionStatus  " ";
CM_ SG_ 278 FR_OBJ11_Location  " ";
CM_ SG_ 278 FR_OBJ11_Measured  " ";
CM_ SG_ 278 FR_OBJ11_valid  " ";
CM_ SG_ 278 FR_OBJ11_Track_Age  " ";
CM_ SG_ 278 FR_OBJ11_Track_ID  " ";
CM_ SG_ 278 FR_OBJ11_ObstacleProb  " ";
CM_ SG_ 278 FR_OBJ11_ExistProb  " ";
CM_ SG_ 278 FR_OBJ11_RelAx  " ";
CM_ SG_ 278 FR_OBJ11_RelAy  " ";
CM_ SG_ 278 FR_OBJ11_RelVx_std  " ";
CM_ SG_ 278 FR_OBJ11_RelVx  " ";
CM_ SG_ 278 FR_OBJ11_RelVy_std  " ";
CM_ SG_ 278 FR_OBJ11_RelVy  " ";
CM_ SG_ 278 FR_OBJ11_Dx_Vnce  " ";
CM_ SG_ 278 FR_OBJ11_Dx  " ";
CM_ SG_ 278 FR_OBJ11_Dy_Vnce  " ";
CM_ SG_ 278 FR_OBJ11_Dy  " ";
CM_ SG_ 278 FR_OBJ11_HeadingAngle  " ";
CM_ SG_ 278 FR_OBJ11_Length  " ";
CM_ SG_ 278 FR_OBJ11_Height  " ";
CM_ SG_ 278 FR_OBJ11_Width  " ";
CM_ SG_ 278 FR_OBJ11_Class  " ";

CM_ BO_ 279  " ";
CM_ SG_ 279 FR_OBJ14_Ax  " ";
CM_ SG_ 279 FR_OBJ14_Ay  " ";
CM_ SG_ 279 FR_OBJ14_Vx  " ";
CM_ SG_ 279 FR_OBJ14_Vy  " ";
CM_ SG_ 279 FR_OBJ13_Ax  " ";
CM_ SG_ 279 FR_OBJ13_Ay  " ";
CM_ SG_ 279 FR_OBJ13_Vx  " ";
CM_ SG_ 279 FR_OBJ13_Vy  " ";
CM_ SG_ 279 FR_OBJ14_FeaturePoint  " ";
CM_ SG_ 279 FR_OBJ13_FeaturePoint  " ";
CM_ SG_ 279 FR_CRCCheck_117  " ";
CM_ SG_ 279 FR_RollingCounter_117  " ";
CM_ SG_ 279 FR_OBJ14_HeightGround  "反射点最强点距离地面的高度 ";
CM_ SG_ 279 FR_OBJ14_MotionStatusConf  " ";
CM_ SG_ 279 FR_OBJ14_ClassConf  " ";
CM_ SG_ 279 FR_OBJ14_MotionStatus  " ";
CM_ SG_ 279 FR_OBJ14_Location  " ";
CM_ SG_ 279 FR_OBJ14_Measured  " ";
CM_ SG_ 279 FR_OBJ14_valid  " ";
CM_ SG_ 279 FR_OBJ14_Track_Age  " ";
CM_ SG_ 279 FR_OBJ14_Track_ID  " ";
CM_ SG_ 279 FR_OBJ14_ObstacleProb  " ";
CM_ SG_ 279 FR_OBJ14_ExistProb  " ";
CM_ SG_ 279 FR_OBJ14_RelAx  " ";
CM_ SG_ 279 FR_OBJ14_RelAy  " ";
CM_ SG_ 279 FR_OBJ14_RelVx_std  " ";
CM_ SG_ 279 FR_OBJ14_RelVx  " ";
CM_ SG_ 279 FR_OBJ14_RelVy_std  " ";
CM_ SG_ 279 FR_OBJ14_RelVy  " ";
CM_ SG_ 279 FR_OBJ14_Dx_Vnce  " ";
CM_ SG_ 279 FR_OBJ14_Dx  " ";
CM_ SG_ 279 FR_OBJ14_Dy_Vnce  " ";
CM_ SG_ 279 FR_OBJ14_Dy  " ";
CM_ SG_ 279 FR_OBJ14_HeadingAngle  " ";
CM_ SG_ 279 FR_OBJ14_Length  " ";
CM_ SG_ 279 FR_OBJ14_Height  " ";
CM_ SG_ 279 FR_OBJ14_Width  " ";
CM_ SG_ 279 FR_OBJ14_Class  " ";
CM_ SG_ 279 FR_OBJ13_HeightGround  "反射点最强点距离地面的高度 ";
CM_ SG_ 279 FR_OBJ13_MotionStatusConf  " ";
CM_ SG_ 279 FR_OBJ13_ClassConf  " ";
CM_ SG_ 279 FR_OBJ13_MotionStatus  " ";
CM_ SG_ 279 FR_OBJ13_Location  " ";
CM_ SG_ 279 FR_OBJ13_Measured  " ";
CM_ SG_ 279 FR_OBJ13_valid  " ";
CM_ SG_ 279 FR_OBJ13_Track_Age  " ";
CM_ SG_ 279 FR_OBJ13_Track_ID  " ";
CM_ SG_ 279 FR_OBJ13_ObstacleProb  " ";
CM_ SG_ 279 FR_OBJ13_ExistProb  " ";
CM_ SG_ 279 FR_OBJ13_RelAx  " ";
CM_ SG_ 279 FR_OBJ13_RelAy  " ";
CM_ SG_ 279 FR_OBJ13_RelVx_std  " ";
CM_ SG_ 279 FR_OBJ13_RelVx  " ";
CM_ SG_ 279 FR_OBJ13_RelVy_std  " ";
CM_ SG_ 279 FR_OBJ13_RelVy  " ";
CM_ SG_ 279 FR_OBJ13_Dx_Vnce  " ";
CM_ SG_ 279 FR_OBJ13_Dx  " ";
CM_ SG_ 279 FR_OBJ13_Dy_Vnce  " ";
CM_ SG_ 279 FR_OBJ13_Dy  " ";
CM_ SG_ 279 FR_OBJ13_HeadingAngle  " ";
CM_ SG_ 279 FR_OBJ13_Length  " ";
CM_ SG_ 279 FR_OBJ13_Height  " ";
CM_ SG_ 279 FR_OBJ13_Width  " ";
CM_ SG_ 279 FR_OBJ13_Class  " ";

CM_ BO_ 280  " ";
CM_ SG_ 280 FR_OBJ16_Ax  " ";
CM_ SG_ 280 FR_OBJ16_Ay  " ";
CM_ SG_ 280 FR_OBJ16_Vx  " ";
CM_ SG_ 280 FR_OBJ16_Vy  " ";
CM_ SG_ 280 FR_OBJ15_Ax  " ";
CM_ SG_ 280 FR_OBJ15_Ay  " ";
CM_ SG_ 280 FR_OBJ15_Vx  " ";
CM_ SG_ 280 FR_OBJ15_Vy  " ";
CM_ SG_ 280 FR_OBJ16_FeaturePoint  " ";
CM_ SG_ 280 FR_OBJ15_FeaturePoint  " ";
CM_ SG_ 280 FR_CRCCheck_118  " ";
CM_ SG_ 280 FR_RollingCounter_118  " ";
CM_ SG_ 280 FR_OBJ16_HeightGround  "反射点最强点距离地面的高度 ";
CM_ SG_ 280 FR_OBJ16_MotionStatusConf  " ";
CM_ SG_ 280 FR_OBJ16_ClassConf  " ";
CM_ SG_ 280 FR_OBJ16_MotionStatus  " ";
CM_ SG_ 280 FR_OBJ16_Location  " ";
CM_ SG_ 280 FR_OBJ16_Measured  " ";
CM_ SG_ 280 FR_OBJ16_valid  " ";
CM_ SG_ 280 FR_OBJ16_Track_Age  " ";
CM_ SG_ 280 FR_OBJ16_Track_ID  " ";
CM_ SG_ 280 FR_OBJ16_ObstacleProb  " ";
CM_ SG_ 280 FR_OBJ16_ExistProb  " ";
CM_ SG_ 280 FR_OBJ16_RelAx  " ";
CM_ SG_ 280 FR_OBJ16_RelAy  " ";
CM_ SG_ 280 FR_OBJ16_RelVx_std  " ";
CM_ SG_ 280 FR_OBJ16_RelVx  " ";
CM_ SG_ 280 FR_OBJ16_RelVy_std  " ";
CM_ SG_ 280 FR_OBJ16_RelVy  " ";
CM_ SG_ 280 FR_OBJ16_Dx_Vnce  " ";
CM_ SG_ 280 FR_OBJ16_Dx  " ";
CM_ SG_ 280 FR_OBJ16_Dy_Vnce  " ";
CM_ SG_ 280 FR_OBJ16_Dy  " ";
CM_ SG_ 280 FR_OBJ16_HeadingAngle  " ";
CM_ SG_ 280 FR_OBJ16_Length  " ";
CM_ SG_ 280 FR_OBJ16_Height  " ";
CM_ SG_ 280 FR_OBJ16_Width  " ";
CM_ SG_ 280 FR_OBJ16_Class  " ";
CM_ SG_ 280 FR_OBJ15_HeightGround  "反射点最强点距离地面的高度 ";
CM_ SG_ 280 FR_OBJ15_MotionStatusConf  " ";
CM_ SG_ 280 FR_OBJ15_ClassConf  " ";
CM_ SG_ 280 FR_OBJ15_MotionStatus  " ";
CM_ SG_ 280 FR_OBJ15_Location  " ";
CM_ SG_ 280 FR_OBJ15_Measured  " ";
CM_ SG_ 280 FR_OBJ15_valid  " ";
CM_ SG_ 280 FR_OBJ15_Track_Age  " ";
CM_ SG_ 280 FR_OBJ15_Track_ID  " ";
CM_ SG_ 280 FR_OBJ15_ObstacleProb  " ";
CM_ SG_ 280 FR_OBJ15_ExistProb  " ";
CM_ SG_ 280 FR_OBJ15_RelAx  " ";
CM_ SG_ 280 FR_OBJ15_RelAy  " ";
CM_ SG_ 280 FR_OBJ15_RelVx_std  " ";
CM_ SG_ 280 FR_OBJ15_RelVx  " ";
CM_ SG_ 280 FR_OBJ15_RelVy_std  " ";
CM_ SG_ 280 FR_OBJ15_RelVy  " ";
CM_ SG_ 280 FR_OBJ15_Dx_Vnce  " ";
CM_ SG_ 280 FR_OBJ15_Dx  " ";
CM_ SG_ 280 FR_OBJ15_Dy_Vnce  " ";
CM_ SG_ 280 FR_OBJ15_Dy  " ";
CM_ SG_ 280 FR_OBJ15_HeadingAngle  " ";
CM_ SG_ 280 FR_OBJ15_Length  " ";
CM_ SG_ 280 FR_OBJ15_Height  " ";
CM_ SG_ 280 FR_OBJ15_Width  " ";
CM_ SG_ 280 FR_OBJ15_Class  " ";

CM_ BO_ 281  " ";
CM_ SG_ 281 FR_OBJ18_Ax  " ";
CM_ SG_ 281 FR_OBJ18_Ay  " ";
CM_ SG_ 281 FR_OBJ18_Vx  " ";
CM_ SG_ 281 FR_OBJ18_Vy  " ";
CM_ SG_ 281 FR_OBJ17_Ax  " ";
CM_ SG_ 281 FR_OBJ17_Ay  " ";
CM_ SG_ 281 FR_OBJ17_Vx  " ";
CM_ SG_ 281 FR_OBJ17_Vy  " ";
CM_ SG_ 281 FR_OBJ18_FeaturePoint  " ";
CM_ SG_ 281 FR_OBJ17_FeaturePoint  " ";
CM_ SG_ 281 FR_CRCCheck_119  " ";
CM_ SG_ 281 FR_RollingCounter_119  " ";
CM_ SG_ 281 FR_OBJ18_HeightGround  "反射点最强点距离地面的高度 ";
CM_ SG_ 281 FR_OBJ18_MotionStatusConf  " ";
CM_ SG_ 281 FR_OBJ18_ClassConf  " ";
CM_ SG_ 281 FR_OBJ18_MotionStatus  " ";
CM_ SG_ 281 FR_OBJ18_Location  " ";
CM_ SG_ 281 FR_OBJ18_Measured  " ";
CM_ SG_ 281 FR_OBJ18_valid  " ";
CM_ SG_ 281 FR_OBJ18_Track_Age  " ";
CM_ SG_ 281 FR_OBJ18_Track_ID  " ";
CM_ SG_ 281 FR_OBJ18_ObstacleProb  " ";
CM_ SG_ 281 FR_OBJ18_ExistProb  " ";
CM_ SG_ 281 FR_OBJ18_RelAx  " ";
CM_ SG_ 281 FR_OBJ18_RelAy  " ";
CM_ SG_ 281 FR_OBJ18_RelVx_std  " ";
CM_ SG_ 281 FR_OBJ18_RelVx  " ";
CM_ SG_ 281 FR_OBJ18_RelVy_std  " ";
CM_ SG_ 281 FR_OBJ18_RelVy  " ";
CM_ SG_ 281 FR_OBJ18_Dx_Vnce  " ";
CM_ SG_ 281 FR_OBJ18_Dx  " ";
CM_ SG_ 281 FR_OBJ18_Dy_Vnce  " ";
CM_ SG_ 281 FR_OBJ18_Dy  " ";
CM_ SG_ 281 FR_OBJ18_HeadingAngle  " ";
CM_ SG_ 281 FR_OBJ18_Length  " ";
CM_ SG_ 281 FR_OBJ18_Height  " ";
CM_ SG_ 281 FR_OBJ18_Width  " ";
CM_ SG_ 281 FR_OBJ18_Class  " ";
CM_ SG_ 281 FR_OBJ17_HeightGround  "反射点最强点距离地面的高度 ";
CM_ SG_ 281 FR_OBJ17_MotionStatusConf  " ";
CM_ SG_ 281 FR_OBJ17_ClassConf  " ";
CM_ SG_ 281 FR_OBJ17_MotionStatus  " ";
CM_ SG_ 281 FR_OBJ17_Location  " ";
CM_ SG_ 281 FR_OBJ17_Measured  " ";
CM_ SG_ 281 FR_OBJ17_valid  " ";
CM_ SG_ 281 FR_OBJ17_Track_Age  " ";
CM_ SG_ 281 FR_OBJ17_Track_ID  " ";
CM_ SG_ 281 FR_OBJ17_ObstacleProb  " ";
CM_ SG_ 281 FR_OBJ17_ExistProb  " ";
CM_ SG_ 281 FR_OBJ17_RelAx  " ";
CM_ SG_ 281 FR_OBJ17_RelAy  " ";
CM_ SG_ 281 FR_OBJ17_RelVx_std  " ";
CM_ SG_ 281 FR_OBJ17_RelVx  " ";
CM_ SG_ 281 FR_OBJ17_RelVy_std  " ";
CM_ SG_ 281 FR_OBJ17_RelVy  " ";
CM_ SG_ 281 FR_OBJ17_Dx_Vnce  " ";
CM_ SG_ 281 FR_OBJ17_Dx  " ";
CM_ SG_ 281 FR_OBJ17_Dy_Vnce  " ";
CM_ SG_ 281 FR_OBJ17_Dy  " ";
CM_ SG_ 281 FR_OBJ17_HeadingAngle  " ";
CM_ SG_ 281 FR_OBJ17_Length  " ";
CM_ SG_ 281 FR_OBJ17_Height  " ";
CM_ SG_ 281 FR_OBJ17_Width  " ";
CM_ SG_ 281 FR_OBJ17_Class  " ";

CM_ BO_ 282  " ";
CM_ SG_ 282 FR_OBJ20_Ax  " ";
CM_ SG_ 282 FR_OBJ20_Ay  " ";
CM_ SG_ 282 FR_OBJ20_Vx  " ";
CM_ SG_ 282 FR_OBJ20_Vy  " ";
CM_ SG_ 282 FR_OBJ19_Ax  " ";
CM_ SG_ 282 FR_OBJ19_Ay  " ";
CM_ SG_ 282 FR_OBJ19_Vx  " ";
CM_ SG_ 282 FR_OBJ19_Vy  " ";
CM_ SG_ 282 FR_OBJ20_FeaturePoint  " ";
CM_ SG_ 282 FR_OBJ19_FeaturePoint  " ";
CM_ SG_ 282 FR_CRCCheck_11A  " ";
CM_ SG_ 282 FR_RollingCounter_11A  " ";
CM_ SG_ 282 FR_OBJ20_HeightGround  "反射点最强点距离地面的高度 ";
CM_ SG_ 282 FR_OBJ20_MotionStatusConf  " ";
CM_ SG_ 282 FR_OBJ20_ClassConf  " ";
CM_ SG_ 282 FR_OBJ20_MotionStatus  " ";
CM_ SG_ 282 FR_OBJ20_Location  " ";
CM_ SG_ 282 FR_OBJ20_Measured  " ";
CM_ SG_ 282 FR_OBJ20_valid  " ";
CM_ SG_ 282 FR_OBJ20_Track_Age  " ";
CM_ SG_ 282 FR_OBJ20_Track_ID  " ";
CM_ SG_ 282 FR_OBJ20_ObstacleProb  " ";
CM_ SG_ 282 FR_OBJ20_ExistProb  " ";
CM_ SG_ 282 FR_OBJ20_RelAx  " ";
CM_ SG_ 282 FR_OBJ20_RelAy  " ";
CM_ SG_ 282 FR_OBJ20_RelVx_std  " ";
CM_ SG_ 282 FR_OBJ20_RelVx  " ";
CM_ SG_ 282 FR_OBJ20_RelVy_std  " ";
CM_ SG_ 282 FR_OBJ20_RelVy  " ";
CM_ SG_ 282 FR_OBJ20_Dx_Vnce  " ";
CM_ SG_ 282 FR_OBJ20_Dx  " ";
CM_ SG_ 282 FR_OBJ20_Dy_Vnce  " ";
CM_ SG_ 282 FR_OBJ20_Dy  " ";
CM_ SG_ 282 FR_OBJ20_HeadingAngle  " ";
CM_ SG_ 282 FR_OBJ20_Length  " ";
CM_ SG_ 282 FR_OBJ20_Height  " ";
CM_ SG_ 282 FR_OBJ20_Width  " ";
CM_ SG_ 282 FR_OBJ20_Class  " ";
CM_ SG_ 282 FR_OBJ19_HeightGround  "反射点最强点距离地面的高度 ";
CM_ SG_ 282 FR_OBJ19_MotionStatusConf  " ";
CM_ SG_ 282 FR_OBJ19_ClassConf  " ";
CM_ SG_ 282 FR_OBJ19_MotionStatus  " ";
CM_ SG_ 282 FR_OBJ19_Location  " ";
CM_ SG_ 282 FR_OBJ19_Measured  " ";
CM_ SG_ 282 FR_OBJ19_valid  " ";
CM_ SG_ 282 FR_OBJ19_Track_Age  " ";
CM_ SG_ 282 FR_OBJ19_Track_ID  " ";
CM_ SG_ 282 FR_OBJ19_ObstacleProb  " ";
CM_ SG_ 282 FR_OBJ19_ExistProb  " ";
CM_ SG_ 282 FR_OBJ19_RelAx  " ";
CM_ SG_ 282 FR_OBJ19_RelAy  " ";
CM_ SG_ 282 FR_OBJ19_RelVx_std  " ";
CM_ SG_ 282 FR_OBJ19_RelVx  " ";
CM_ SG_ 282 FR_OBJ19_RelVy_std  " ";
CM_ SG_ 282 FR_OBJ19_RelVy  " ";
CM_ SG_ 282 FR_OBJ19_Dx_Vnce  " ";
CM_ SG_ 282 FR_OBJ19_Dx  " ";
CM_ SG_ 282 FR_OBJ19_Dy_Vnce  " ";
CM_ SG_ 282 FR_OBJ19_Dy  " ";
CM_ SG_ 282 FR_OBJ19_HeadingAngle  " ";
CM_ SG_ 282 FR_OBJ19_Length  " ";
CM_ SG_ 282 FR_OBJ19_Height  " ";
CM_ SG_ 282 FR_OBJ19_Width  " ";
CM_ SG_ 282 FR_OBJ19_Class  " ";

BA_DEF_ SG_  "GenSigStartValue" INT 0 0;
BA_DEF_ SG_  "GenSigInvalidValue" STRING  ;
BA_DEF_ SG_  "GenSigCycleTime" INT 0 0;
BA_DEF_ SG_  "GenSigSendType" ENUM  "Cyclic","OnWrite","OnWriteWithRepetition","OnChange","OnChangeWithRepetition","IfActive","IfActiveWithRepetition","NoSigSendType","NotUsed","NotUsed","NotUsed","NotUsed","NotUsed";
BA_DEF_  "Baudrate" INT 0 1000000;
BA_DEF_  "NmType" STRING ;
BA_DEF_  "Manufacturer" STRING ;
BA_DEF_  "VersionYear" INT 2009 2210;
BA_DEF_  "VersionNumber" INT 0 65535;
BA_DEF_  "VersionMonth" INT 0 18;
BA_DEF_  "VersionDay" INT 0 49;
BA_DEF_ BU_  "NodeLayerModules" STRING ;
BA_DEF_ BU_  "ILUsed" ENUM  "No","Yes";
BA_DEF_  "GenNWMTalkNM" STRING ;
BA_DEF_  "GenNWMGotoMode_BusSleep" STRING ;
BA_DEF_  "GenNWMGotoMode_Awake" STRING ;
BA_DEF_  "GenNWMApCanWakeUp" STRING ;
BA_DEF_  "GenNWMApCanSleep" STRING ;
BA_DEF_  "GenNWMApCanOn" STRING ;
BA_DEF_  "GenNWMApCanOff" STRING ;
BA_DEF_  "GenNWMApCanNormal" STRING ;
BA_DEF_  "GenNWMApBusSleep" STRING ;
BA_DEF_ BO_  "GenMsgSendType" ENUM  "Cyclic","Event","NotUsed","NotUsed","NotUsed","Cyclic","NotUsed","IfActive","NoMsgSendType","NotUsed";
BA_DEF_ BO_  "GenMsgILSupport" ENUM  "No","Yes";
BA_DEF_ BO_  "GenMsgCycleTime" INT 0 65535;
BA_DEF_ BO_  "CANFD_BRS" ENUM  "0","1";
BA_DEF_ BO_  "VFrameFormat" ENUM  "StandardCAN","ExtendedCAN","reserved","reserved","reserved","reserved","reserved","reserved","reserved","reserved","reserved","reserved","reserved","reserved","StandardCAN_FD","ExtendedCAN_FD";
BA_DEF_DEF_  "GenSigStartValue" 0;
BA_DEF_DEF_  "GenSigInvalidValue" "/";
BA_DEF_DEF_  "GenSigCycleTime" 0;
BA_DEF_DEF_  "GenSigSendType" "Cyclic";
BA_DEF_DEF_  "Baudrate" 500000;
BA_DEF_DEF_  "NmType" "";
BA_DEF_DEF_  "Manufacturer" "CHANA";
BA_DEF_DEF_  "VersionYear" 2010;
BA_DEF_DEF_  "VersionNumber" 0;
BA_DEF_DEF_  "VersionMonth" 11;
BA_DEF_DEF_  "VersionDay" 0;
BA_DEF_DEF_  "NodeLayerModules" "OSEKNM01.dll,CANoeILNLVector.dll";
BA_DEF_DEF_  "ILUsed" "Yes";
BA_DEF_DEF_  "GenNWMTalkNM" "TalkNM()";
BA_DEF_DEF_  "GenNWMGotoMode_BusSleep" "GotoMode_BusSleep()";
BA_DEF_DEF_  "GenNWMGotoMode_Awake" "GotoMode_Awake()";
BA_DEF_DEF_  "GenNWMApCanWakeUp" "apCanWakeUp()";
BA_DEF_DEF_  "GenNWMApCanSleep" "apCanSleep()";
BA_DEF_DEF_  "GenNWMApCanOn" "apCanOn()";
BA_DEF_DEF_  "GenNWMApCanOff" "apCanOff()";
BA_DEF_DEF_  "GenNWMApCanNormal" "apCanNormal()";
BA_DEF_DEF_  "GenNWMApBusSleep" "apBusSleep()";
BA_DEF_DEF_  "GenMsgSendType" "NoMsgSendType";
BA_DEF_DEF_  "GenMsgILSupport" "Yes";
BA_DEF_DEF_  "GenMsgCycleTime" 0;
BA_DEF_DEF_  "CANFD_BRS" "1";
BA_DEF_DEF_  "VFrameFormat" "StandardCAN";

BA_ "VersionYear" 2023;
BA_ "VersionNumber" 11;
BA_ "VersionMonth" 04;
BA_ "VersionDay" 28;
BA_ "Baudrate" 2000000;
BA_ "NmType" "OSEK";
BA_ "GenMsgCycleTime" BO_ 273 70;
BA_ "GenMsgSendType" BO_ 273 0;
BA_ "VFrameFormat" BO_ 273 14;
BA_ "GenMsgCycleTime" BO_ 274 70;
BA_ "GenMsgSendType" BO_ 274 0;
BA_ "VFrameFormat" BO_ 274 14;
BA_ "GenMsgCycleTime" BO_ 275 70;
BA_ "GenMsgSendType" BO_ 275 0;
BA_ "VFrameFormat" BO_ 275 14;
BA_ "GenMsgCycleTime" BO_ 276 70;
BA_ "GenMsgSendType" BO_ 276 0;
BA_ "VFrameFormat" BO_ 276 14;
BA_ "GenMsgCycleTime" BO_ 277 70;
BA_ "GenMsgSendType" BO_ 277 0;
BA_ "VFrameFormat" BO_ 277 14;
BA_ "GenMsgCycleTime" BO_ 278 70;
BA_ "GenMsgSendType" BO_ 278 0;
BA_ "VFrameFormat" BO_ 278 14;
BA_ "GenMsgCycleTime" BO_ 279 70;
BA_ "GenMsgSendType" BO_ 279 0;
BA_ "VFrameFormat" BO_ 279 14;
BA_ "GenMsgCycleTime" BO_ 280 70;
BA_ "GenMsgSendType" BO_ 280 0;
BA_ "VFrameFormat" BO_ 280 14;
BA_ "GenMsgCycleTime" BO_ 281 70;
BA_ "GenMsgSendType" BO_ 281 0;
BA_ "VFrameFormat" BO_ 281 14;
BA_ "GenMsgCycleTime" BO_ 282 70;
BA_ "GenMsgSendType" BO_ 282 0;
BA_ "VFrameFormat" BO_ 282 14;
BA_ "GenSigCycleTime" SG_ 273 FR_OBJ2_Ax 70;
BA_ "GenSigCycleTime" SG_ 273 FR_OBJ2_Ay 70;
BA_ "GenSigCycleTime" SG_ 273 FR_OBJ2_Vx 70;
BA_ "GenSigCycleTime" SG_ 273 FR_OBJ2_Vy 70;
BA_ "GenSigCycleTime" SG_ 273 FR_OBJ1_Ax 70;
BA_ "GenSigCycleTime" SG_ 273 FR_OBJ1_Ay 70;
BA_ "GenSigCycleTime" SG_ 273 FR_OBJ1_Vx 70;
BA_ "GenSigCycleTime" SG_ 273 FR_OBJ1_Vy 70;
BA_ "GenSigCycleTime" SG_ 273 FR_OBJ2_FeaturePoint 70;
BA_ "GenSigCycleTime" SG_ 273 FR_OBJ1_FeaturePoint 70;
BA_ "GenSigCycleTime" SG_ 273 FR_CRCCheck_111 70;
BA_ "GenSigCycleTime" SG_ 273 FR_RollingCounter_111 70;
BA_ "GenSigCycleTime" SG_ 273 FR_OBJ2_HeightGround 70;
BA_ "GenSigCycleTime" SG_ 273 FR_OBJ2_MotionStatusConf 70;
BA_ "GenSigCycleTime" SG_ 273 FR_OBJ2_ClassConf 70;
BA_ "GenSigCycleTime" SG_ 273 FR_OBJ2_MotionStatus 70;
BA_ "GenSigCycleTime" SG_ 273 FR_OBJ2_Location 70;
BA_ "GenSigCycleTime" SG_ 273 FR_OBJ2_Measured 70;
BA_ "GenSigCycleTime" SG_ 273 FR_OBJ2_valid 70;
BA_ "GenSigCycleTime" SG_ 273 FR_OBJ2_Track_Age 70;
BA_ "GenSigCycleTime" SG_ 273 FR_OBJ2_Track_ID 70;
BA_ "GenSigInvalidValue" SG_ 273 FR_OBJ2_Track_ID "0";
BA_ "GenSigCycleTime" SG_ 273 FR_OBJ2_ObstacleProb 70;
BA_ "GenSigCycleTime" SG_ 273 FR_OBJ2_ExistProb 70;
BA_ "GenSigCycleTime" SG_ 273 FR_OBJ2_RelAx 70;
BA_ "GenSigCycleTime" SG_ 273 FR_OBJ2_RelAy 70;
BA_ "GenSigCycleTime" SG_ 273 FR_OBJ2_RelVx_std 70;
BA_ "GenSigInvalidValue" SG_ 273 FR_OBJ2_RelVx_std "4095";
BA_ "GenSigCycleTime" SG_ 273 FR_OBJ2_RelVx 70;
BA_ "GenSigCycleTime" SG_ 273 FR_OBJ2_RelVy_std 70;
BA_ "GenSigInvalidValue" SG_ 273 FR_OBJ2_RelVy_std "1023";
BA_ "GenSigCycleTime" SG_ 273 FR_OBJ2_RelVy 70;
BA_ "GenSigCycleTime" SG_ 273 FR_OBJ2_Dx_Vnce 70;
BA_ "GenSigInvalidValue" SG_ 273 FR_OBJ2_Dx_Vnce "16383";
BA_ "GenSigCycleTime" SG_ 273 FR_OBJ2_Dx 70;
BA_ "GenSigCycleTime" SG_ 273 FR_OBJ2_Dy_Vnce 70;
BA_ "GenSigInvalidValue" SG_ 273 FR_OBJ2_Dy_Vnce "1023";
BA_ "GenSigCycleTime" SG_ 273 FR_OBJ2_Dy 70;
BA_ "GenSigCycleTime" SG_ 273 FR_OBJ2_HeadingAngle 70;
BA_ "GenSigCycleTime" SG_ 273 FR_OBJ2_Length 70;
BA_ "GenSigCycleTime" SG_ 273 FR_OBJ2_Height 70;
BA_ "GenSigCycleTime" SG_ 273 FR_OBJ2_Width 70;
BA_ "GenSigCycleTime" SG_ 273 FR_OBJ2_Class 70;
BA_ "GenSigCycleTime" SG_ 273 FR_OBJ1_HeightGround 70;
BA_ "GenSigCycleTime" SG_ 273 FR_OBJ1_MotionStatusConf 70;
BA_ "GenSigCycleTime" SG_ 273 FR_OBJ1_ClassConf 70;
BA_ "GenSigCycleTime" SG_ 273 FR_OBJ1_MotionStatus 70;
BA_ "GenSigCycleTime" SG_ 273 FR_OBJ1_Location 70;
BA_ "GenSigCycleTime" SG_ 273 FR_OBJ1_Measured 70;
BA_ "GenSigCycleTime" SG_ 273 FR_OBJ1_valid 70;
BA_ "GenSigCycleTime" SG_ 273 FR_OBJ1_Track_Age 70;
BA_ "GenSigCycleTime" SG_ 273 FR_OBJ1_Track_ID 70;
BA_ "GenSigInvalidValue" SG_ 273 FR_OBJ1_Track_ID "0";
BA_ "GenSigCycleTime" SG_ 273 FR_OBJ1_ObstacleProb 70;
BA_ "GenSigCycleTime" SG_ 273 FR_OBJ1_ExistProb 70;
BA_ "GenSigCycleTime" SG_ 273 FR_OBJ1_RelAx 70;
BA_ "GenSigCycleTime" SG_ 273 FR_OBJ1_RelAy 70;
BA_ "GenSigCycleTime" SG_ 273 FR_OBJ1_RelVx_std 70;
BA_ "GenSigInvalidValue" SG_ 273 FR_OBJ1_RelVx_std "4095";
BA_ "GenSigCycleTime" SG_ 273 FR_OBJ1_RelVx 70;
BA_ "GenSigCycleTime" SG_ 273 FR_OBJ1_RelVy_std 70;
BA_ "GenSigInvalidValue" SG_ 273 FR_OBJ1_RelVy_std "1023";
BA_ "GenSigCycleTime" SG_ 273 FR_OBJ1_RelVy 70;
BA_ "GenSigCycleTime" SG_ 273 FR_OBJ1_Dx_Vnce 70;
BA_ "GenSigInvalidValue" SG_ 273 FR_OBJ1_Dx_Vnce "16383";
BA_ "GenSigCycleTime" SG_ 273 FR_OBJ1_Dx 70;
BA_ "GenSigCycleTime" SG_ 273 FR_OBJ1_Dy_Vnce 70;
BA_ "GenSigInvalidValue" SG_ 273 FR_OBJ1_Dy_Vnce "1023";
BA_ "GenSigCycleTime" SG_ 273 FR_OBJ1_Dy 70;
BA_ "GenSigCycleTime" SG_ 273 FR_OBJ1_HeadingAngle 70;
BA_ "GenSigCycleTime" SG_ 273 FR_OBJ1_Length 70;
BA_ "GenSigCycleTime" SG_ 273 FR_OBJ1_Height 70;
BA_ "GenSigCycleTime" SG_ 273 FR_OBJ1_Width 70;
BA_ "GenSigCycleTime" SG_ 273 FR_OBJ1_Class 70;

BA_ "GenSigCycleTime" SG_ 274 FR_OBJ4_Ax 70;
BA_ "GenSigCycleTime" SG_ 274 FR_OBJ4_Ay 70;
BA_ "GenSigCycleTime" SG_ 274 FR_OBJ4_Vx 70;
BA_ "GenSigCycleTime" SG_ 274 FR_OBJ4_Vy 70;
BA_ "GenSigCycleTime" SG_ 274 FR_OBJ3_Ax 70;
BA_ "GenSigCycleTime" SG_ 274 FR_OBJ3_Ay 70;
BA_ "GenSigCycleTime" SG_ 274 FR_OBJ3_Vx 70;
BA_ "GenSigCycleTime" SG_ 274 FR_OBJ3_Vy 70;
BA_ "GenSigCycleTime" SG_ 274 FR_OBJ4_FeaturePoint 70;
BA_ "GenSigCycleTime" SG_ 274 FR_OBJ3_FeaturePoint 70;
BA_ "GenSigCycleTime" SG_ 274 FR_CRCCheck_112 70;
BA_ "GenSigCycleTime" SG_ 274 FR_RollingCounter_112 70;
BA_ "GenSigCycleTime" SG_ 274 FR_OBJ4_HeightGround 70;
BA_ "GenSigCycleTime" SG_ 274 FR_OBJ4_MotionStatusConf 70;
BA_ "GenSigCycleTime" SG_ 274 FR_OBJ4_ClassConf 70;
BA_ "GenSigCycleTime" SG_ 274 FR_OBJ4_MotionStatus 70;
BA_ "GenSigCycleTime" SG_ 274 FR_OBJ4_Location 70;
BA_ "GenSigCycleTime" SG_ 274 FR_OBJ4_Measured 70;
BA_ "GenSigCycleTime" SG_ 274 FR_OBJ4_valid 70;
BA_ "GenSigCycleTime" SG_ 274 FR_OBJ4_Track_Age 70;
BA_ "GenSigCycleTime" SG_ 274 FR_OBJ4_Track_ID 70;
BA_ "GenSigInvalidValue" SG_ 274 FR_OBJ4_Track_ID "0";
BA_ "GenSigCycleTime" SG_ 274 FR_OBJ4_ObstacleProb 70;
BA_ "GenSigCycleTime" SG_ 274 FR_OBJ4_ExistProb 70;
BA_ "GenSigCycleTime" SG_ 274 FR_OBJ4_RelAx 70;
BA_ "GenSigCycleTime" SG_ 274 FR_OBJ4_RelAy 70;
BA_ "GenSigCycleTime" SG_ 274 FR_OBJ4_RelVx_std 70;
BA_ "GenSigInvalidValue" SG_ 274 FR_OBJ4_RelVx_std "4095";
BA_ "GenSigCycleTime" SG_ 274 FR_OBJ4_RelVx 70;
BA_ "GenSigCycleTime" SG_ 274 FR_OBJ4_RelVy_std 70;
BA_ "GenSigInvalidValue" SG_ 274 FR_OBJ4_RelVy_std "1023";
BA_ "GenSigCycleTime" SG_ 274 FR_OBJ4_RelVy 70;
BA_ "GenSigCycleTime" SG_ 274 FR_OBJ4_Dx_Vnce 70;
BA_ "GenSigInvalidValue" SG_ 274 FR_OBJ4_Dx_Vnce "16383";
BA_ "GenSigCycleTime" SG_ 274 FR_OBJ4_Dx 70;
BA_ "GenSigCycleTime" SG_ 274 FR_OBJ4_Dy_Vnce 70;
BA_ "GenSigInvalidValue" SG_ 274 FR_OBJ4_Dy_Vnce "1023";
BA_ "GenSigCycleTime" SG_ 274 FR_OBJ4_Dy 70;
BA_ "GenSigCycleTime" SG_ 274 FR_OBJ4_HeadingAngle 70;
BA_ "GenSigCycleTime" SG_ 274 FR_OBJ4_Length 70;
BA_ "GenSigCycleTime" SG_ 274 FR_OBJ4_Height 70;
BA_ "GenSigCycleTime" SG_ 274 FR_OBJ4_Width 70;
BA_ "GenSigCycleTime" SG_ 274 FR_OBJ4_Class 70;
BA_ "GenSigCycleTime" SG_ 274 FR_OBJ3_HeightGround 70;
BA_ "GenSigCycleTime" SG_ 274 FR_OBJ3_MotionStatusConf 70;
BA_ "GenSigCycleTime" SG_ 274 FR_OBJ3_ClassConf 70;
BA_ "GenSigCycleTime" SG_ 274 FR_OBJ3_MotionStatus 70;
BA_ "GenSigCycleTime" SG_ 274 FR_OBJ3_Location 70;
BA_ "GenSigCycleTime" SG_ 274 FR_OBJ3_Measured 70;
BA_ "GenSigCycleTime" SG_ 274 FR_OBJ3_valid 70;
BA_ "GenSigCycleTime" SG_ 274 FR_OBJ3_Track_Age 70;
BA_ "GenSigCycleTime" SG_ 274 FR_OBJ3_Track_ID 70;
BA_ "GenSigInvalidValue" SG_ 274 FR_OBJ3_Track_ID "0";
BA_ "GenSigCycleTime" SG_ 274 FR_OBJ3_ObstacleProb 70;
BA_ "GenSigCycleTime" SG_ 274 FR_OBJ3_ExistProb 70;
BA_ "GenSigCycleTime" SG_ 274 FR_OBJ3_RelAx 70;
BA_ "GenSigCycleTime" SG_ 274 FR_OBJ3_RelAy 70;
BA_ "GenSigCycleTime" SG_ 274 FR_OBJ3_RelVx_std 70;
BA_ "GenSigInvalidValue" SG_ 274 FR_OBJ3_RelVx_std "4095";
BA_ "GenSigCycleTime" SG_ 274 FR_OBJ3_RelVx 70;
BA_ "GenSigCycleTime" SG_ 274 FR_OBJ3_RelVy_std 70;
BA_ "GenSigInvalidValue" SG_ 274 FR_OBJ3_RelVy_std "1023";
BA_ "GenSigCycleTime" SG_ 274 FR_OBJ3_RelVy 70;
BA_ "GenSigCycleTime" SG_ 274 FR_OBJ3_Dx_Vnce 70;
BA_ "GenSigInvalidValue" SG_ 274 FR_OBJ3_Dx_Vnce "16383";
BA_ "GenSigCycleTime" SG_ 274 FR_OBJ3_Dx 70;
BA_ "GenSigCycleTime" SG_ 274 FR_OBJ3_Dy_Vnce 70;
BA_ "GenSigInvalidValue" SG_ 274 FR_OBJ3_Dy_Vnce "1023";
BA_ "GenSigCycleTime" SG_ 274 FR_OBJ3_Dy 70;
BA_ "GenSigCycleTime" SG_ 274 FR_OBJ3_HeadingAngle 70;
BA_ "GenSigCycleTime" SG_ 274 FR_OBJ3_Length 70;
BA_ "GenSigCycleTime" SG_ 274 FR_OBJ3_Height 70;
BA_ "GenSigCycleTime" SG_ 274 FR_OBJ3_Width 70;
BA_ "GenSigCycleTime" SG_ 274 FR_OBJ3_Class 70;

BA_ "GenSigCycleTime" SG_ 275 FR_OBJ6_Ax 70;
BA_ "GenSigCycleTime" SG_ 275 FR_OBJ6_Ay 70;
BA_ "GenSigCycleTime" SG_ 275 FR_OBJ6_Vx 70;
BA_ "GenSigCycleTime" SG_ 275 FR_OBJ6_Vy 70;
BA_ "GenSigCycleTime" SG_ 275 FR_OBJ5_Ax 70;
BA_ "GenSigCycleTime" SG_ 275 FR_OBJ5_Ay 70;
BA_ "GenSigCycleTime" SG_ 275 FR_OBJ5_Vx 70;
BA_ "GenSigCycleTime" SG_ 275 FR_OBJ5_Vy 70;
BA_ "GenSigCycleTime" SG_ 275 FR_OBJ6_FeaturePoint 70;
BA_ "GenSigCycleTime" SG_ 275 FR_OBJ5_FeaturePoint 70;
BA_ "GenSigCycleTime" SG_ 275 FR_CRCCheck_113 70;
BA_ "GenSigCycleTime" SG_ 275 FR_RollingCounter_113 70;
BA_ "GenSigCycleTime" SG_ 275 FR_OBJ6_HeightGround 70;
BA_ "GenSigCycleTime" SG_ 275 FR_OBJ6_MotionStatusConf 70;
BA_ "GenSigCycleTime" SG_ 275 FR_OBJ6_ClassConf 70;
BA_ "GenSigCycleTime" SG_ 275 FR_OBJ6_MotionStatus 70;
BA_ "GenSigCycleTime" SG_ 275 FR_OBJ6_Location 70;
BA_ "GenSigCycleTime" SG_ 275 FR_OBJ6_Measured 70;
BA_ "GenSigCycleTime" SG_ 275 FR_OBJ6_valid 70;
BA_ "GenSigCycleTime" SG_ 275 FR_OBJ6_Track_Age 70;
BA_ "GenSigCycleTime" SG_ 275 FR_OBJ6_Track_ID 70;
BA_ "GenSigInvalidValue" SG_ 275 FR_OBJ6_Track_ID "0";
BA_ "GenSigCycleTime" SG_ 275 FR_OBJ6_ObstacleProb 70;
BA_ "GenSigCycleTime" SG_ 275 FR_OBJ6_ExistProb 70;
BA_ "GenSigCycleTime" SG_ 275 FR_OBJ6_RelAx 70;
BA_ "GenSigCycleTime" SG_ 275 FR_OBJ6_RelAy 70;
BA_ "GenSigCycleTime" SG_ 275 FR_OBJ6_RelVx_std 70;
BA_ "GenSigInvalidValue" SG_ 275 FR_OBJ6_RelVx_std "4095";
BA_ "GenSigCycleTime" SG_ 275 FR_OBJ6_RelVx 70;
BA_ "GenSigCycleTime" SG_ 275 FR_OBJ6_RelVy_std 70;
BA_ "GenSigInvalidValue" SG_ 275 FR_OBJ6_RelVy_std "1023";
BA_ "GenSigCycleTime" SG_ 275 FR_OBJ6_RelVy 70;
BA_ "GenSigCycleTime" SG_ 275 FR_OBJ6_Dx_Vnce 70;
BA_ "GenSigInvalidValue" SG_ 275 FR_OBJ6_Dx_Vnce "16383";
BA_ "GenSigCycleTime" SG_ 275 FR_OBJ6_Dx 70;
BA_ "GenSigCycleTime" SG_ 275 FR_OBJ6_Dy_Vnce 70;
BA_ "GenSigInvalidValue" SG_ 275 FR_OBJ6_Dy_Vnce "1023";
BA_ "GenSigCycleTime" SG_ 275 FR_OBJ6_Dy 70;
BA_ "GenSigCycleTime" SG_ 275 FR_OBJ6_HeadingAngle 70;
BA_ "GenSigCycleTime" SG_ 275 FR_OBJ6_Length 70;
BA_ "GenSigCycleTime" SG_ 275 FR_OBJ6_Height 70;
BA_ "GenSigCycleTime" SG_ 275 FR_OBJ6_Width 70;
BA_ "GenSigCycleTime" SG_ 275 FR_OBJ6_Class 70;
BA_ "GenSigCycleTime" SG_ 275 FR_OBJ5_HeightGround 70;
BA_ "GenSigCycleTime" SG_ 275 FR_OBJ5_MotionStatusConf 70;
BA_ "GenSigCycleTime" SG_ 275 FR_OBJ5_ClassConf 70;
BA_ "GenSigCycleTime" SG_ 275 FR_OBJ5_MotionStatus 70;
BA_ "GenSigCycleTime" SG_ 275 FR_OBJ5_Location 70;
BA_ "GenSigCycleTime" SG_ 275 FR_OBJ5_Measured 70;
BA_ "GenSigCycleTime" SG_ 275 FR_OBJ5_valid 70;
BA_ "GenSigCycleTime" SG_ 275 FR_OBJ5_Track_Age 70;
BA_ "GenSigCycleTime" SG_ 275 FR_OBJ5_Track_ID 70;
BA_ "GenSigInvalidValue" SG_ 275 FR_OBJ5_Track_ID "0";
BA_ "GenSigCycleTime" SG_ 275 FR_OBJ5_ObstacleProb 70;
BA_ "GenSigCycleTime" SG_ 275 FR_OBJ5_ExistProb 70;
BA_ "GenSigCycleTime" SG_ 275 FR_OBJ5_RelAx 70;
BA_ "GenSigCycleTime" SG_ 275 FR_OBJ5_RelAy 70;
BA_ "GenSigCycleTime" SG_ 275 FR_OBJ5_RelVx_std 70;
BA_ "GenSigInvalidValue" SG_ 275 FR_OBJ5_RelVx_std "4095";
BA_ "GenSigCycleTime" SG_ 275 FR_OBJ5_RelVx 70;
BA_ "GenSigCycleTime" SG_ 275 FR_OBJ5_RelVy_std 70;
BA_ "GenSigInvalidValue" SG_ 275 FR_OBJ5_RelVy_std "1023";
BA_ "GenSigCycleTime" SG_ 275 FR_OBJ5_RelVy 70;
BA_ "GenSigCycleTime" SG_ 275 FR_OBJ5_Dx_Vnce 70;
BA_ "GenSigInvalidValue" SG_ 275 FR_OBJ5_Dx_Vnce "16383";
BA_ "GenSigCycleTime" SG_ 275 FR_OBJ5_Dx 70;
BA_ "GenSigCycleTime" SG_ 275 FR_OBJ5_Dy_Vnce 70;
BA_ "GenSigInvalidValue" SG_ 275 FR_OBJ5_Dy_Vnce "1023";
BA_ "GenSigCycleTime" SG_ 275 FR_OBJ5_Dy 70;
BA_ "GenSigCycleTime" SG_ 275 FR_OBJ5_HeadingAngle 70;
BA_ "GenSigCycleTime" SG_ 275 FR_OBJ5_Length 70;
BA_ "GenSigCycleTime" SG_ 275 FR_OBJ5_Height 70;
BA_ "GenSigCycleTime" SG_ 275 FR_OBJ5_Width 70;
BA_ "GenSigCycleTime" SG_ 275 FR_OBJ5_Class 70;

BA_ "GenSigCycleTime" SG_ 276 FR_OBJ8_Ax 70;
BA_ "GenSigCycleTime" SG_ 276 FR_OBJ8_Ay 70;
BA_ "GenSigCycleTime" SG_ 276 FR_OBJ8_Vx 70;
BA_ "GenSigCycleTime" SG_ 276 FR_OBJ8_Vy 70;
BA_ "GenSigCycleTime" SG_ 276 FR_OBJ7_Ax 70;
BA_ "GenSigCycleTime" SG_ 276 FR_OBJ7_Ay 70;
BA_ "GenSigCycleTime" SG_ 276 FR_OBJ7_Vx 70;
BA_ "GenSigCycleTime" SG_ 276 FR_OBJ7_Vy 70;
BA_ "GenSigCycleTime" SG_ 276 FR_OBJ8_FeaturePoint 70;
BA_ "GenSigCycleTime" SG_ 276 FR_OBJ7_FeaturePoint 70;
BA_ "GenSigCycleTime" SG_ 276 FR_CRCCheck_114 70;
BA_ "GenSigCycleTime" SG_ 276 FR_RollingCounter_114 70;
BA_ "GenSigCycleTime" SG_ 276 FR_OBJ8_HeightGround 70;
BA_ "GenSigCycleTime" SG_ 276 FR_OBJ8_MotionStatusConf 70;
BA_ "GenSigCycleTime" SG_ 276 FR_OBJ8_ClassConf 70;
BA_ "GenSigCycleTime" SG_ 276 FR_OBJ8_MotionStatus 70;
BA_ "GenSigCycleTime" SG_ 276 FR_OBJ8_Location 70;
BA_ "GenSigCycleTime" SG_ 276 FR_OBJ8_Measured 70;
BA_ "GenSigCycleTime" SG_ 276 FR_OBJ8_valid 70;
BA_ "GenSigCycleTime" SG_ 276 FR_OBJ8_Track_Age 70;
BA_ "GenSigCycleTime" SG_ 276 FR_OBJ8_Track_ID 70;
BA_ "GenSigInvalidValue" SG_ 276 FR_OBJ8_Track_ID "0";
BA_ "GenSigCycleTime" SG_ 276 FR_OBJ8_ObstacleProb 70;
BA_ "GenSigCycleTime" SG_ 276 FR_OBJ8_ExistProb 70;
BA_ "GenSigCycleTime" SG_ 276 FR_OBJ8_RelAx 70;
BA_ "GenSigCycleTime" SG_ 276 FR_OBJ8_RelAy 70;
BA_ "GenSigCycleTime" SG_ 276 FR_OBJ8_RelVx_std 70;
BA_ "GenSigInvalidValue" SG_ 276 FR_OBJ8_RelVx_std "4095";
BA_ "GenSigCycleTime" SG_ 276 FR_OBJ8_RelVx 70;
BA_ "GenSigCycleTime" SG_ 276 FR_OBJ8_RelVy_std 70;
BA_ "GenSigInvalidValue" SG_ 276 FR_OBJ8_RelVy_std "1023";
BA_ "GenSigCycleTime" SG_ 276 FR_OBJ8_RelVy 70;
BA_ "GenSigCycleTime" SG_ 276 FR_OBJ8_Dx_Vnce 70;
BA_ "GenSigInvalidValue" SG_ 276 FR_OBJ8_Dx_Vnce "16383";
BA_ "GenSigCycleTime" SG_ 276 FR_OBJ8_Dx 70;
BA_ "GenSigCycleTime" SG_ 276 FR_OBJ8_Dy_Vnce 70;
BA_ "GenSigInvalidValue" SG_ 276 FR_OBJ8_Dy_Vnce "1023";
BA_ "GenSigCycleTime" SG_ 276 FR_OBJ8_Dy 70;
BA_ "GenSigCycleTime" SG_ 276 FR_OBJ8_HeadingAngle 70;
BA_ "GenSigCycleTime" SG_ 276 FR_OBJ8_Length 70;
BA_ "GenSigCycleTime" SG_ 276 FR_OBJ8_Height 70;
BA_ "GenSigCycleTime" SG_ 276 FR_OBJ8_Width 70;
BA_ "GenSigCycleTime" SG_ 276 FR_OBJ8_Class 70;
BA_ "GenSigCycleTime" SG_ 276 FR_OBJ7_HeightGround 70;
BA_ "GenSigCycleTime" SG_ 276 FR_OBJ7_MotionStatusConf 70;
BA_ "GenSigCycleTime" SG_ 276 FR_OBJ7_ClassConf 70;
BA_ "GenSigCycleTime" SG_ 276 FR_OBJ7_MotionStatus 70;
BA_ "GenSigCycleTime" SG_ 276 FR_OBJ7_Location 70;
BA_ "GenSigCycleTime" SG_ 276 FR_OBJ7_Measured 70;
BA_ "GenSigCycleTime" SG_ 276 FR_OBJ7_valid 70;
BA_ "GenSigCycleTime" SG_ 276 FR_OBJ7_Track_Age 70;
BA_ "GenSigCycleTime" SG_ 276 FR_OBJ7_Track_ID 70;
BA_ "GenSigInvalidValue" SG_ 276 FR_OBJ7_Track_ID "0";
BA_ "GenSigCycleTime" SG_ 276 FR_OBJ7_ObstacleProb 70;
BA_ "GenSigCycleTime" SG_ 276 FR_OBJ7_ExistProb 70;
BA_ "GenSigCycleTime" SG_ 276 FR_OBJ7_RelAx 70;
BA_ "GenSigCycleTime" SG_ 276 FR_OBJ7_RelAy 70;
BA_ "GenSigCycleTime" SG_ 276 FR_OBJ7_RelVx_std 70;
BA_ "GenSigInvalidValue" SG_ 276 FR_OBJ7_RelVx_std "4095";
BA_ "GenSigCycleTime" SG_ 276 FR_OBJ7_RelVx 70;
BA_ "GenSigCycleTime" SG_ 276 FR_OBJ7_RelVy_std 70;
BA_ "GenSigInvalidValue" SG_ 276 FR_OBJ7_RelVy_std "1023";
BA_ "GenSigCycleTime" SG_ 276 FR_OBJ7_RelVy 70;
BA_ "GenSigCycleTime" SG_ 276 FR_OBJ7_Dx_Vnce 70;
BA_ "GenSigInvalidValue" SG_ 276 FR_OBJ7_Dx_Vnce "16383";
BA_ "GenSigCycleTime" SG_ 276 FR_OBJ7_Dx 70;
BA_ "GenSigCycleTime" SG_ 276 FR_OBJ7_Dy_Vnce 70;
BA_ "GenSigInvalidValue" SG_ 276 FR_OBJ7_Dy_Vnce "1023";
BA_ "GenSigCycleTime" SG_ 276 FR_OBJ7_Dy 70;
BA_ "GenSigCycleTime" SG_ 276 FR_OBJ7_HeadingAngle 70;
BA_ "GenSigCycleTime" SG_ 276 FR_OBJ7_Length 70;
BA_ "GenSigCycleTime" SG_ 276 FR_OBJ7_Height 70;
BA_ "GenSigCycleTime" SG_ 276 FR_OBJ7_Width 70;
BA_ "GenSigCycleTime" SG_ 276 FR_OBJ7_Class 70;

BA_ "GenSigCycleTime" SG_ 277 FR_OBJ10_Ax 70;
BA_ "GenSigCycleTime" SG_ 277 FR_OBJ10_Ay 70;
BA_ "GenSigCycleTime" SG_ 277 FR_OBJ10_Vx 70;
BA_ "GenSigCycleTime" SG_ 277 FR_OBJ10_Vy 70;
BA_ "GenSigCycleTime" SG_ 277 FR_OBJ9_Ax 70;
BA_ "GenSigCycleTime" SG_ 277 FR_OBJ9_Ay 70;
BA_ "GenSigCycleTime" SG_ 277 FR_OBJ9_Vx 70;
BA_ "GenSigCycleTime" SG_ 277 FR_OBJ9_Vy 70;
BA_ "GenSigCycleTime" SG_ 277 FR_OBJ10_FeaturePoint 70;
BA_ "GenSigCycleTime" SG_ 277 FR_OBJ9_FeaturePoint 70;
BA_ "GenSigCycleTime" SG_ 277 FR_CRCCheck_115 70;
BA_ "GenSigCycleTime" SG_ 277 FR_RollingCounter_115 70;
BA_ "GenSigCycleTime" SG_ 277 FR_OBJ10_HeightGround 70;
BA_ "GenSigCycleTime" SG_ 277 FR_OBJ10_MotionStatusConf 70;
BA_ "GenSigCycleTime" SG_ 277 FR_OBJ10_ClassConf 70;
BA_ "GenSigCycleTime" SG_ 277 FR_OBJ10_MotionStatus 70;
BA_ "GenSigCycleTime" SG_ 277 FR_OBJ10_Location 70;
BA_ "GenSigCycleTime" SG_ 277 FR_OBJ10_Measured 70;
BA_ "GenSigCycleTime" SG_ 277 FR_OBJ10_valid 70;
BA_ "GenSigCycleTime" SG_ 277 FR_OBJ10_Track_Age 70;
BA_ "GenSigCycleTime" SG_ 277 FR_OBJ10_Track_ID 70;
BA_ "GenSigInvalidValue" SG_ 277 FR_OBJ10_Track_ID "0";
BA_ "GenSigCycleTime" SG_ 277 FR_OBJ10_ObstacleProb 70;
BA_ "GenSigCycleTime" SG_ 277 FR_OBJ10_ExistProb 70;
BA_ "GenSigCycleTime" SG_ 277 FR_OBJ10_RelAx 70;
BA_ "GenSigCycleTime" SG_ 277 FR_OBJ10_RelAy 70;
BA_ "GenSigCycleTime" SG_ 277 FR_OBJ10_RelVx_std 70;
BA_ "GenSigInvalidValue" SG_ 277 FR_OBJ10_RelVx_std "4095";
BA_ "GenSigCycleTime" SG_ 277 FR_OBJ10_RelVx 70;
BA_ "GenSigCycleTime" SG_ 277 FR_OBJ10_RelVy_std 70;
BA_ "GenSigInvalidValue" SG_ 277 FR_OBJ10_RelVy_std "1023";
BA_ "GenSigCycleTime" SG_ 277 FR_OBJ10_RelVy 70;
BA_ "GenSigCycleTime" SG_ 277 FR_OBJ10_Dx_Vnce 70;
BA_ "GenSigInvalidValue" SG_ 277 FR_OBJ10_Dx_Vnce "16383";
BA_ "GenSigCycleTime" SG_ 277 FR_OBJ10_Dx 70;
BA_ "GenSigCycleTime" SG_ 277 FR_OBJ10_Dy_Vnce 70;
BA_ "GenSigInvalidValue" SG_ 277 FR_OBJ10_Dy_Vnce "1023";
BA_ "GenSigCycleTime" SG_ 277 FR_OBJ10_Dy 70;
BA_ "GenSigCycleTime" SG_ 277 FR_OBJ10_HeadingAngle 70;
BA_ "GenSigCycleTime" SG_ 277 FR_OBJ10_Length 70;
BA_ "GenSigCycleTime" SG_ 277 FR_OBJ10_Height 70;
BA_ "GenSigCycleTime" SG_ 277 FR_OBJ10_Width 70;
BA_ "GenSigCycleTime" SG_ 277 FR_OBJ10_Class 70;
BA_ "GenSigCycleTime" SG_ 277 FR_OBJ9_HeightGround 70;
BA_ "GenSigCycleTime" SG_ 277 FR_OBJ9_MotionStatusConf 70;
BA_ "GenSigCycleTime" SG_ 277 FR_OBJ9_ClassConf 70;
BA_ "GenSigCycleTime" SG_ 277 FR_OBJ9_MotionStatus 70;
BA_ "GenSigCycleTime" SG_ 277 FR_OBJ9_Location 70;
BA_ "GenSigCycleTime" SG_ 277 FR_OBJ9_Measured 70;
BA_ "GenSigCycleTime" SG_ 277 FR_OBJ9_valid 70;
BA_ "GenSigCycleTime" SG_ 277 FR_OBJ9_Track_Age 70;
BA_ "GenSigCycleTime" SG_ 277 FR_OBJ9_Track_ID 70;
BA_ "GenSigInvalidValue" SG_ 277 FR_OBJ9_Track_ID "0";
BA_ "GenSigCycleTime" SG_ 277 FR_OBJ9_ObstacleProb 70;
BA_ "GenSigCycleTime" SG_ 277 FR_OBJ9_ExistProb 70;
BA_ "GenSigCycleTime" SG_ 277 FR_OBJ9_RelAx 70;
BA_ "GenSigCycleTime" SG_ 277 FR_OBJ9_RelAy 70;
BA_ "GenSigCycleTime" SG_ 277 FR_OBJ9_RelVx_std 70;
BA_ "GenSigInvalidValue" SG_ 277 FR_OBJ9_RelVx_std "4095";
BA_ "GenSigCycleTime" SG_ 277 FR_OBJ9_RelVx 70;
BA_ "GenSigCycleTime" SG_ 277 FR_OBJ9_RelVy_std 70;
BA_ "GenSigInvalidValue" SG_ 277 FR_OBJ9_RelVy_std "1023";
BA_ "GenSigCycleTime" SG_ 277 FR_OBJ9_RelVy 70;
BA_ "GenSigCycleTime" SG_ 277 FR_OBJ9_Dx_Vnce 70;
BA_ "GenSigInvalidValue" SG_ 277 FR_OBJ9_Dx_Vnce "16383";
BA_ "GenSigCycleTime" SG_ 277 FR_OBJ9_Dx 70;
BA_ "GenSigCycleTime" SG_ 277 FR_OBJ9_Dy_Vnce 70;
BA_ "GenSigInvalidValue" SG_ 277 FR_OBJ9_Dy_Vnce "1023";
BA_ "GenSigCycleTime" SG_ 277 FR_OBJ9_Dy 70;
BA_ "GenSigCycleTime" SG_ 277 FR_OBJ9_HeadingAngle 70;
BA_ "GenSigCycleTime" SG_ 277 FR_OBJ9_Length 70;
BA_ "GenSigCycleTime" SG_ 277 FR_OBJ9_Height 70;
BA_ "GenSigCycleTime" SG_ 277 FR_OBJ9_Width 70;
BA_ "GenSigCycleTime" SG_ 277 FR_OBJ9_Class 70;

BA_ "GenSigCycleTime" SG_ 278 FR_OBJ12_Ax 70;
BA_ "GenSigCycleTime" SG_ 278 FR_OBJ12_Ay 70;
BA_ "GenSigCycleTime" SG_ 278 FR_OBJ12_Vx 70;
BA_ "GenSigCycleTime" SG_ 278 FR_OBJ12_Vy 70;
BA_ "GenSigCycleTime" SG_ 278 FR_OBJ11_Ax 70;
BA_ "GenSigCycleTime" SG_ 278 FR_OBJ11_Ay 70;
BA_ "GenSigCycleTime" SG_ 278 FR_OBJ11_Vx 70;
BA_ "GenSigCycleTime" SG_ 278 FR_OBJ11_Vy 70;
BA_ "GenSigCycleTime" SG_ 278 FR_OBJ12_FeaturePoint 70;
BA_ "GenSigCycleTime" SG_ 278 FR_OBJ11_FeaturePoint 70;
BA_ "GenSigCycleTime" SG_ 278 FR_CRCCheck_116 70;
BA_ "GenSigCycleTime" SG_ 278 FR_RollingCounter_116 70;
BA_ "GenSigCycleTime" SG_ 278 FR_OBJ12_HeightGround 70;
BA_ "GenSigCycleTime" SG_ 278 FR_OBJ12_MotionStatusConf 70;
BA_ "GenSigCycleTime" SG_ 278 FR_OBJ12_ClassConf 70;
BA_ "GenSigCycleTime" SG_ 278 FR_OBJ12_MotionStatus 70;
BA_ "GenSigCycleTime" SG_ 278 FR_OBJ12_Location 70;
BA_ "GenSigCycleTime" SG_ 278 FR_OBJ12_Measured 70;
BA_ "GenSigCycleTime" SG_ 278 FR_OBJ12_valid 70;
BA_ "GenSigCycleTime" SG_ 278 FR_OBJ12_Track_Age 70;
BA_ "GenSigCycleTime" SG_ 278 FR_OBJ12_Track_ID 70;
BA_ "GenSigInvalidValue" SG_ 278 FR_OBJ12_Track_ID "0";
BA_ "GenSigCycleTime" SG_ 278 FR_OBJ12_ObstacleProb 70;
BA_ "GenSigCycleTime" SG_ 278 FR_OBJ12_ExistProb 70;
BA_ "GenSigCycleTime" SG_ 278 FR_OBJ12_RelAx 70;
BA_ "GenSigCycleTime" SG_ 278 FR_OBJ12_RelAy 70;
BA_ "GenSigCycleTime" SG_ 278 FR_OBJ12_RelVx_std 70;
BA_ "GenSigInvalidValue" SG_ 278 FR_OBJ12_RelVx_std "4095";
BA_ "GenSigCycleTime" SG_ 278 FR_OBJ12_RelVx 70;
BA_ "GenSigCycleTime" SG_ 278 FR_OBJ12_RelVy_std 70;
BA_ "GenSigInvalidValue" SG_ 278 FR_OBJ12_RelVy_std "1023";
BA_ "GenSigCycleTime" SG_ 278 FR_OBJ12_RelVy 70;
BA_ "GenSigCycleTime" SG_ 278 FR_OBJ12_Dx_Vnce 70;
BA_ "GenSigInvalidValue" SG_ 278 FR_OBJ12_Dx_Vnce "16383";
BA_ "GenSigCycleTime" SG_ 278 FR_OBJ12_Dx 70;
BA_ "GenSigCycleTime" SG_ 278 FR_OBJ12_Dy_Vnce 70;
BA_ "GenSigInvalidValue" SG_ 278 FR_OBJ12_Dy_Vnce "1023";
BA_ "GenSigCycleTime" SG_ 278 FR_OBJ12_Dy 70;
BA_ "GenSigCycleTime" SG_ 278 FR_OBJ12_HeadingAngle 70;
BA_ "GenSigCycleTime" SG_ 278 FR_OBJ12_Length 70;
BA_ "GenSigCycleTime" SG_ 278 FR_OBJ12_Height 70;
BA_ "GenSigCycleTime" SG_ 278 FR_OBJ12_Width 70;
BA_ "GenSigCycleTime" SG_ 278 FR_OBJ12_Class 70;
BA_ "GenSigCycleTime" SG_ 278 FR_OBJ11_HeightGround 70;
BA_ "GenSigCycleTime" SG_ 278 FR_OBJ11_MotionStatusConf 70;
BA_ "GenSigCycleTime" SG_ 278 FR_OBJ11_ClassConf 70;
BA_ "GenSigCycleTime" SG_ 278 FR_OBJ11_MotionStatus 70;
BA_ "GenSigCycleTime" SG_ 278 FR_OBJ11_Location 70;
BA_ "GenSigCycleTime" SG_ 278 FR_OBJ11_Measured 70;
BA_ "GenSigCycleTime" SG_ 278 FR_OBJ11_valid 70;
BA_ "GenSigCycleTime" SG_ 278 FR_OBJ11_Track_Age 70;
BA_ "GenSigCycleTime" SG_ 278 FR_OBJ11_Track_ID 70;
BA_ "GenSigInvalidValue" SG_ 278 FR_OBJ11_Track_ID "0";
BA_ "GenSigCycleTime" SG_ 278 FR_OBJ11_ObstacleProb 70;
BA_ "GenSigCycleTime" SG_ 278 FR_OBJ11_ExistProb 70;
BA_ "GenSigCycleTime" SG_ 278 FR_OBJ11_RelAx 70;
BA_ "GenSigCycleTime" SG_ 278 FR_OBJ11_RelAy 70;
BA_ "GenSigCycleTime" SG_ 278 FR_OBJ11_RelVx_std 70;
BA_ "GenSigInvalidValue" SG_ 278 FR_OBJ11_RelVx_std "4095";
BA_ "GenSigCycleTime" SG_ 278 FR_OBJ11_RelVx 70;
BA_ "GenSigCycleTime" SG_ 278 FR_OBJ11_RelVy_std 70;
BA_ "GenSigInvalidValue" SG_ 278 FR_OBJ11_RelVy_std "1023";
BA_ "GenSigCycleTime" SG_ 278 FR_OBJ11_RelVy 70;
BA_ "GenSigCycleTime" SG_ 278 FR_OBJ11_Dx_Vnce 70;
BA_ "GenSigInvalidValue" SG_ 278 FR_OBJ11_Dx_Vnce "16383";
BA_ "GenSigCycleTime" SG_ 278 FR_OBJ11_Dx 70;
BA_ "GenSigCycleTime" SG_ 278 FR_OBJ11_Dy_Vnce 70;
BA_ "GenSigInvalidValue" SG_ 278 FR_OBJ11_Dy_Vnce "1023";
BA_ "GenSigCycleTime" SG_ 278 FR_OBJ11_Dy 70;
BA_ "GenSigCycleTime" SG_ 278 FR_OBJ11_HeadingAngle 70;
BA_ "GenSigCycleTime" SG_ 278 FR_OBJ11_Length 70;
BA_ "GenSigCycleTime" SG_ 278 FR_OBJ11_Height 70;
BA_ "GenSigCycleTime" SG_ 278 FR_OBJ11_Width 70;
BA_ "GenSigCycleTime" SG_ 278 FR_OBJ11_Class 70;

BA_ "GenSigCycleTime" SG_ 279 FR_OBJ14_Ax 70;
BA_ "GenSigCycleTime" SG_ 279 FR_OBJ14_Ay 70;
BA_ "GenSigCycleTime" SG_ 279 FR_OBJ14_Vx 70;
BA_ "GenSigCycleTime" SG_ 279 FR_OBJ14_Vy 70;
BA_ "GenSigCycleTime" SG_ 279 FR_OBJ13_Ax 70;
BA_ "GenSigCycleTime" SG_ 279 FR_OBJ13_Ay 70;
BA_ "GenSigCycleTime" SG_ 279 FR_OBJ13_Vx 70;
BA_ "GenSigCycleTime" SG_ 279 FR_OBJ13_Vy 70;
BA_ "GenSigCycleTime" SG_ 279 FR_OBJ14_FeaturePoint 70;
BA_ "GenSigCycleTime" SG_ 279 FR_OBJ13_FeaturePoint 70;
BA_ "GenSigCycleTime" SG_ 279 FR_CRCCheck_117 70;
BA_ "GenSigCycleTime" SG_ 279 FR_RollingCounter_117 70;
BA_ "GenSigCycleTime" SG_ 279 FR_OBJ14_HeightGround 70;
BA_ "GenSigCycleTime" SG_ 279 FR_OBJ14_MotionStatusConf 70;
BA_ "GenSigCycleTime" SG_ 279 FR_OBJ14_ClassConf 70;
BA_ "GenSigCycleTime" SG_ 279 FR_OBJ14_MotionStatus 70;
BA_ "GenSigCycleTime" SG_ 279 FR_OBJ14_Location 70;
BA_ "GenSigCycleTime" SG_ 279 FR_OBJ14_Measured 70;
BA_ "GenSigCycleTime" SG_ 279 FR_OBJ14_valid 70;
BA_ "GenSigCycleTime" SG_ 279 FR_OBJ14_Track_Age 70;
BA_ "GenSigCycleTime" SG_ 279 FR_OBJ14_Track_ID 70;
BA_ "GenSigInvalidValue" SG_ 279 FR_OBJ14_Track_ID "0";
BA_ "GenSigCycleTime" SG_ 279 FR_OBJ14_ObstacleProb 70;
BA_ "GenSigCycleTime" SG_ 279 FR_OBJ14_ExistProb 70;
BA_ "GenSigCycleTime" SG_ 279 FR_OBJ14_RelAx 70;
BA_ "GenSigCycleTime" SG_ 279 FR_OBJ14_RelAy 70;
BA_ "GenSigCycleTime" SG_ 279 FR_OBJ14_RelVx_std 70;
BA_ "GenSigInvalidValue" SG_ 279 FR_OBJ14_RelVx_std "4095";
BA_ "GenSigCycleTime" SG_ 279 FR_OBJ14_RelVx 70;
BA_ "GenSigCycleTime" SG_ 279 FR_OBJ14_RelVy_std 70;
BA_ "GenSigInvalidValue" SG_ 279 FR_OBJ14_RelVy_std "1023";
BA_ "GenSigCycleTime" SG_ 279 FR_OBJ14_RelVy 70;
BA_ "GenSigCycleTime" SG_ 279 FR_OBJ14_Dx_Vnce 70;
BA_ "GenSigInvalidValue" SG_ 279 FR_OBJ14_Dx_Vnce "16383";
BA_ "GenSigCycleTime" SG_ 279 FR_OBJ14_Dx 70;
BA_ "GenSigCycleTime" SG_ 279 FR_OBJ14_Dy_Vnce 70;
BA_ "GenSigInvalidValue" SG_ 279 FR_OBJ14_Dy_Vnce "1023";
BA_ "GenSigCycleTime" SG_ 279 FR_OBJ14_Dy 70;
BA_ "GenSigCycleTime" SG_ 279 FR_OBJ14_HeadingAngle 70;
BA_ "GenSigCycleTime" SG_ 279 FR_OBJ14_Length 70;
BA_ "GenSigCycleTime" SG_ 279 FR_OBJ14_Height 70;
BA_ "GenSigCycleTime" SG_ 279 FR_OBJ14_Width 70;
BA_ "GenSigCycleTime" SG_ 279 FR_OBJ14_Class 70;
BA_ "GenSigCycleTime" SG_ 279 FR_OBJ13_HeightGround 70;
BA_ "GenSigCycleTime" SG_ 279 FR_OBJ13_MotionStatusConf 70;
BA_ "GenSigCycleTime" SG_ 279 FR_OBJ13_ClassConf 70;
BA_ "GenSigCycleTime" SG_ 279 FR_OBJ13_MotionStatus 70;
BA_ "GenSigCycleTime" SG_ 279 FR_OBJ13_Location 70;
BA_ "GenSigCycleTime" SG_ 279 FR_OBJ13_Measured 70;
BA_ "GenSigCycleTime" SG_ 279 FR_OBJ13_valid 70;
BA_ "GenSigCycleTime" SG_ 279 FR_OBJ13_Track_Age 70;
BA_ "GenSigCycleTime" SG_ 279 FR_OBJ13_Track_ID 70;
BA_ "GenSigInvalidValue" SG_ 279 FR_OBJ13_Track_ID "0";
BA_ "GenSigCycleTime" SG_ 279 FR_OBJ13_ObstacleProb 70;
BA_ "GenSigCycleTime" SG_ 279 FR_OBJ13_ExistProb 70;
BA_ "GenSigCycleTime" SG_ 279 FR_OBJ13_RelAx 70;
BA_ "GenSigCycleTime" SG_ 279 FR_OBJ13_RelAy 70;
BA_ "GenSigCycleTime" SG_ 279 FR_OBJ13_RelVx_std 70;
BA_ "GenSigInvalidValue" SG_ 279 FR_OBJ13_RelVx_std "4095";
BA_ "GenSigCycleTime" SG_ 279 FR_OBJ13_RelVx 70;
BA_ "GenSigCycleTime" SG_ 279 FR_OBJ13_RelVy_std 70;
BA_ "GenSigInvalidValue" SG_ 279 FR_OBJ13_RelVy_std "1023";
BA_ "GenSigCycleTime" SG_ 279 FR_OBJ13_RelVy 70;
BA_ "GenSigCycleTime" SG_ 279 FR_OBJ13_Dx_Vnce 70;
BA_ "GenSigInvalidValue" SG_ 279 FR_OBJ13_Dx_Vnce "16383";
BA_ "GenSigCycleTime" SG_ 279 FR_OBJ13_Dx 70;
BA_ "GenSigCycleTime" SG_ 279 FR_OBJ13_Dy_Vnce 70;
BA_ "GenSigInvalidValue" SG_ 279 FR_OBJ13_Dy_Vnce "1023";
BA_ "GenSigCycleTime" SG_ 279 FR_OBJ13_Dy 70;
BA_ "GenSigCycleTime" SG_ 279 FR_OBJ13_HeadingAngle 70;
BA_ "GenSigCycleTime" SG_ 279 FR_OBJ13_Length 70;
BA_ "GenSigCycleTime" SG_ 279 FR_OBJ13_Height 70;
BA_ "GenSigCycleTime" SG_ 279 FR_OBJ13_Width 70;
BA_ "GenSigCycleTime" SG_ 279 FR_OBJ13_Class 70;

BA_ "GenSigCycleTime" SG_ 280 FR_OBJ16_Ax 70;
BA_ "GenSigCycleTime" SG_ 280 FR_OBJ16_Ay 70;
BA_ "GenSigCycleTime" SG_ 280 FR_OBJ16_Vx 70;
BA_ "GenSigCycleTime" SG_ 280 FR_OBJ16_Vy 70;
BA_ "GenSigCycleTime" SG_ 280 FR_OBJ15_Ax 70;
BA_ "GenSigCycleTime" SG_ 280 FR_OBJ15_Ay 70;
BA_ "GenSigCycleTime" SG_ 280 FR_OBJ15_Vx 70;
BA_ "GenSigCycleTime" SG_ 280 FR_OBJ15_Vy 70;
BA_ "GenSigCycleTime" SG_ 280 FR_OBJ16_FeaturePoint 70;
BA_ "GenSigCycleTime" SG_ 280 FR_OBJ15_FeaturePoint 70;
BA_ "GenSigCycleTime" SG_ 280 FR_CRCCheck_118 70;
BA_ "GenSigCycleTime" SG_ 280 FR_RollingCounter_118 70;
BA_ "GenSigCycleTime" SG_ 280 FR_OBJ16_HeightGround 70;
BA_ "GenSigCycleTime" SG_ 280 FR_OBJ16_MotionStatusConf 70;
BA_ "GenSigCycleTime" SG_ 280 FR_OBJ16_ClassConf 70;
BA_ "GenSigCycleTime" SG_ 280 FR_OBJ16_MotionStatus 70;
BA_ "GenSigCycleTime" SG_ 280 FR_OBJ16_Location 70;
BA_ "GenSigCycleTime" SG_ 280 FR_OBJ16_Measured 70;
BA_ "GenSigCycleTime" SG_ 280 FR_OBJ16_valid 70;
BA_ "GenSigCycleTime" SG_ 280 FR_OBJ16_Track_Age 70;
BA_ "GenSigCycleTime" SG_ 280 FR_OBJ16_Track_ID 70;
BA_ "GenSigInvalidValue" SG_ 280 FR_OBJ16_Track_ID "0";
BA_ "GenSigCycleTime" SG_ 280 FR_OBJ16_ObstacleProb 70;
BA_ "GenSigCycleTime" SG_ 280 FR_OBJ16_ExistProb 70;
BA_ "GenSigCycleTime" SG_ 280 FR_OBJ16_RelAx 70;
BA_ "GenSigCycleTime" SG_ 280 FR_OBJ16_RelAy 70;
BA_ "GenSigCycleTime" SG_ 280 FR_OBJ16_RelVx_std 70;
BA_ "GenSigInvalidValue" SG_ 280 FR_OBJ16_RelVx_std "4095";
BA_ "GenSigCycleTime" SG_ 280 FR_OBJ16_RelVx 70;
BA_ "GenSigCycleTime" SG_ 280 FR_OBJ16_RelVy_std 70;
BA_ "GenSigInvalidValue" SG_ 280 FR_OBJ16_RelVy_std "1023";
BA_ "GenSigCycleTime" SG_ 280 FR_OBJ16_RelVy 70;
BA_ "GenSigCycleTime" SG_ 280 FR_OBJ16_Dx_Vnce 70;
BA_ "GenSigInvalidValue" SG_ 280 FR_OBJ16_Dx_Vnce "16383";
BA_ "GenSigCycleTime" SG_ 280 FR_OBJ16_Dx 70;
BA_ "GenSigCycleTime" SG_ 280 FR_OBJ16_Dy_Vnce 70;
BA_ "GenSigInvalidValue" SG_ 280 FR_OBJ16_Dy_Vnce "1023";
BA_ "GenSigCycleTime" SG_ 280 FR_OBJ16_Dy 70;
BA_ "GenSigCycleTime" SG_ 280 FR_OBJ16_HeadingAngle 70;
BA_ "GenSigCycleTime" SG_ 280 FR_OBJ16_Length 70;
BA_ "GenSigCycleTime" SG_ 280 FR_OBJ16_Height 70;
BA_ "GenSigCycleTime" SG_ 280 FR_OBJ16_Width 70;
BA_ "GenSigCycleTime" SG_ 280 FR_OBJ16_Class 70;
BA_ "GenSigCycleTime" SG_ 280 FR_OBJ15_HeightGround 70;
BA_ "GenSigCycleTime" SG_ 280 FR_OBJ15_MotionStatusConf 70;
BA_ "GenSigCycleTime" SG_ 280 FR_OBJ15_ClassConf 70;
BA_ "GenSigCycleTime" SG_ 280 FR_OBJ15_MotionStatus 70;
BA_ "GenSigCycleTime" SG_ 280 FR_OBJ15_Location 70;
BA_ "GenSigCycleTime" SG_ 280 FR_OBJ15_Measured 70;
BA_ "GenSigCycleTime" SG_ 280 FR_OBJ15_valid 70;
BA_ "GenSigCycleTime" SG_ 280 FR_OBJ15_Track_Age 70;
BA_ "GenSigCycleTime" SG_ 280 FR_OBJ15_Track_ID 70;
BA_ "GenSigInvalidValue" SG_ 280 FR_OBJ15_Track_ID "0";
BA_ "GenSigCycleTime" SG_ 280 FR_OBJ15_ObstacleProb 70;
BA_ "GenSigCycleTime" SG_ 280 FR_OBJ15_ExistProb 70;
BA_ "GenSigCycleTime" SG_ 280 FR_OBJ15_RelAx 70;
BA_ "GenSigCycleTime" SG_ 280 FR_OBJ15_RelAy 70;
BA_ "GenSigCycleTime" SG_ 280 FR_OBJ15_RelVx_std 70;
BA_ "GenSigInvalidValue" SG_ 280 FR_OBJ15_RelVx_std "4095";
BA_ "GenSigCycleTime" SG_ 280 FR_OBJ15_RelVx 70;
BA_ "GenSigCycleTime" SG_ 280 FR_OBJ15_RelVy_std 70;
BA_ "GenSigInvalidValue" SG_ 280 FR_OBJ15_RelVy_std "1023";
BA_ "GenSigCycleTime" SG_ 280 FR_OBJ15_RelVy 70;
BA_ "GenSigCycleTime" SG_ 280 FR_OBJ15_Dx_Vnce 70;
BA_ "GenSigInvalidValue" SG_ 280 FR_OBJ15_Dx_Vnce "16383";
BA_ "GenSigCycleTime" SG_ 280 FR_OBJ15_Dx 70;
BA_ "GenSigCycleTime" SG_ 280 FR_OBJ15_Dy_Vnce 70;
BA_ "GenSigInvalidValue" SG_ 280 FR_OBJ15_Dy_Vnce "1023";
BA_ "GenSigCycleTime" SG_ 280 FR_OBJ15_Dy 70;
BA_ "GenSigCycleTime" SG_ 280 FR_OBJ15_HeadingAngle 70;
BA_ "GenSigCycleTime" SG_ 280 FR_OBJ15_Length 70;
BA_ "GenSigCycleTime" SG_ 280 FR_OBJ15_Height 70;
BA_ "GenSigCycleTime" SG_ 280 FR_OBJ15_Width 70;
BA_ "GenSigCycleTime" SG_ 280 FR_OBJ15_Class 70;

BA_ "GenSigCycleTime" SG_ 281 FR_OBJ18_Ax 70;
BA_ "GenSigCycleTime" SG_ 281 FR_OBJ18_Ay 70;
BA_ "GenSigCycleTime" SG_ 281 FR_OBJ18_Vx 70;
BA_ "GenSigCycleTime" SG_ 281 FR_OBJ18_Vy 70;
BA_ "GenSigCycleTime" SG_ 281 FR_OBJ17_Ax 70;
BA_ "GenSigCycleTime" SG_ 281 FR_OBJ17_Ay 70;
BA_ "GenSigCycleTime" SG_ 281 FR_OBJ17_Vx 70;
BA_ "GenSigCycleTime" SG_ 281 FR_OBJ17_Vy 70;
BA_ "GenSigCycleTime" SG_ 281 FR_OBJ18_FeaturePoint 70;
BA_ "GenSigCycleTime" SG_ 281 FR_OBJ17_FeaturePoint 70;
BA_ "GenSigCycleTime" SG_ 281 FR_CRCCheck_119 70;
BA_ "GenSigCycleTime" SG_ 281 FR_RollingCounter_119 70;
BA_ "GenSigCycleTime" SG_ 281 FR_OBJ18_HeightGround 70;
BA_ "GenSigCycleTime" SG_ 281 FR_OBJ18_MotionStatusConf 70;
BA_ "GenSigCycleTime" SG_ 281 FR_OBJ18_ClassConf 70;
BA_ "GenSigCycleTime" SG_ 281 FR_OBJ18_MotionStatus 70;
BA_ "GenSigCycleTime" SG_ 281 FR_OBJ18_Location 70;
BA_ "GenSigCycleTime" SG_ 281 FR_OBJ18_Measured 70;
BA_ "GenSigCycleTime" SG_ 281 FR_OBJ18_valid 70;
BA_ "GenSigCycleTime" SG_ 281 FR_OBJ18_Track_Age 70;
BA_ "GenSigCycleTime" SG_ 281 FR_OBJ18_Track_ID 70;
BA_ "GenSigInvalidValue" SG_ 281 FR_OBJ18_Track_ID "0";
BA_ "GenSigCycleTime" SG_ 281 FR_OBJ18_ObstacleProb 70;
BA_ "GenSigCycleTime" SG_ 281 FR_OBJ18_ExistProb 70;
BA_ "GenSigCycleTime" SG_ 281 FR_OBJ18_RelAx 70;
BA_ "GenSigCycleTime" SG_ 281 FR_OBJ18_RelAy 70;
BA_ "GenSigCycleTime" SG_ 281 FR_OBJ18_RelVx_std 70;
BA_ "GenSigInvalidValue" SG_ 281 FR_OBJ18_RelVx_std "4095";
BA_ "GenSigCycleTime" SG_ 281 FR_OBJ18_RelVx 70;
BA_ "GenSigCycleTime" SG_ 281 FR_OBJ18_RelVy_std 70;
BA_ "GenSigInvalidValue" SG_ 281 FR_OBJ18_RelVy_std "1023";
BA_ "GenSigCycleTime" SG_ 281 FR_OBJ18_RelVy 70;
BA_ "GenSigCycleTime" SG_ 281 FR_OBJ18_Dx_Vnce 70;
BA_ "GenSigInvalidValue" SG_ 281 FR_OBJ18_Dx_Vnce "16383";
BA_ "GenSigCycleTime" SG_ 281 FR_OBJ18_Dx 70;
BA_ "GenSigCycleTime" SG_ 281 FR_OBJ18_Dy_Vnce 70;
BA_ "GenSigInvalidValue" SG_ 281 FR_OBJ18_Dy_Vnce "1023";
BA_ "GenSigCycleTime" SG_ 281 FR_OBJ18_Dy 70;
BA_ "GenSigCycleTime" SG_ 281 FR_OBJ18_HeadingAngle 70;
BA_ "GenSigCycleTime" SG_ 281 FR_OBJ18_Length 70;
BA_ "GenSigCycleTime" SG_ 281 FR_OBJ18_Height 70;
BA_ "GenSigCycleTime" SG_ 281 FR_OBJ18_Width 70;
BA_ "GenSigCycleTime" SG_ 281 FR_OBJ18_Class 70;
BA_ "GenSigCycleTime" SG_ 281 FR_OBJ17_HeightGround 70;
BA_ "GenSigCycleTime" SG_ 281 FR_OBJ17_MotionStatusConf 70;
BA_ "GenSigCycleTime" SG_ 281 FR_OBJ17_ClassConf 70;
BA_ "GenSigCycleTime" SG_ 281 FR_OBJ17_MotionStatus 70;
BA_ "GenSigCycleTime" SG_ 281 FR_OBJ17_Location 70;
BA_ "GenSigCycleTime" SG_ 281 FR_OBJ17_Measured 70;
BA_ "GenSigCycleTime" SG_ 281 FR_OBJ17_valid 70;
BA_ "GenSigCycleTime" SG_ 281 FR_OBJ17_Track_Age 70;
BA_ "GenSigCycleTime" SG_ 281 FR_OBJ17_Track_ID 70;
BA_ "GenSigInvalidValue" SG_ 281 FR_OBJ17_Track_ID "0";
BA_ "GenSigCycleTime" SG_ 281 FR_OBJ17_ObstacleProb 70;
BA_ "GenSigCycleTime" SG_ 281 FR_OBJ17_ExistProb 70;
BA_ "GenSigCycleTime" SG_ 281 FR_OBJ17_RelAx 70;
BA_ "GenSigCycleTime" SG_ 281 FR_OBJ17_RelAy 70;
BA_ "GenSigCycleTime" SG_ 281 FR_OBJ17_RelVx_std 70;
BA_ "GenSigInvalidValue" SG_ 281 FR_OBJ17_RelVx_std "4095";
BA_ "GenSigCycleTime" SG_ 281 FR_OBJ17_RelVx 70;
BA_ "GenSigCycleTime" SG_ 281 FR_OBJ17_RelVy_std 70;
BA_ "GenSigInvalidValue" SG_ 281 FR_OBJ17_RelVy_std "1023";
BA_ "GenSigCycleTime" SG_ 281 FR_OBJ17_RelVy 70;
BA_ "GenSigCycleTime" SG_ 281 FR_OBJ17_Dx_Vnce 70;
BA_ "GenSigInvalidValue" SG_ 281 FR_OBJ17_Dx_Vnce "16383";
BA_ "GenSigCycleTime" SG_ 281 FR_OBJ17_Dx 70;
BA_ "GenSigCycleTime" SG_ 281 FR_OBJ17_Dy_Vnce 70;
BA_ "GenSigInvalidValue" SG_ 281 FR_OBJ17_Dy_Vnce "1023";
BA_ "GenSigCycleTime" SG_ 281 FR_OBJ17_Dy 70;
BA_ "GenSigCycleTime" SG_ 281 FR_OBJ17_HeadingAngle 70;
BA_ "GenSigCycleTime" SG_ 281 FR_OBJ17_Length 70;
BA_ "GenSigCycleTime" SG_ 281 FR_OBJ17_Height 70;
BA_ "GenSigCycleTime" SG_ 281 FR_OBJ17_Width 70;
BA_ "GenSigCycleTime" SG_ 281 FR_OBJ17_Class 70;

BA_ "GenSigCycleTime" SG_ 282 FR_OBJ20_Ax 70;
BA_ "GenSigCycleTime" SG_ 282 FR_OBJ20_Ay 70;
BA_ "GenSigCycleTime" SG_ 282 FR_OBJ20_Vx 70;
BA_ "GenSigCycleTime" SG_ 282 FR_OBJ20_Vy 70;
BA_ "GenSigCycleTime" SG_ 282 FR_OBJ19_Ax 70;
BA_ "GenSigCycleTime" SG_ 282 FR_OBJ19_Ay 70;
BA_ "GenSigCycleTime" SG_ 282 FR_OBJ19_Vx 70;
BA_ "GenSigCycleTime" SG_ 282 FR_OBJ19_Vy 70;
BA_ "GenSigCycleTime" SG_ 282 FR_OBJ20_FeaturePoint 70;
BA_ "GenSigCycleTime" SG_ 282 FR_OBJ19_FeaturePoint 70;
BA_ "GenSigCycleTime" SG_ 282 FR_CRCCheck_11A 70;
BA_ "GenSigCycleTime" SG_ 282 FR_RollingCounter_11A 70;
BA_ "GenSigCycleTime" SG_ 282 FR_OBJ20_HeightGround 70;
BA_ "GenSigCycleTime" SG_ 282 FR_OBJ20_MotionStatusConf 70;
BA_ "GenSigCycleTime" SG_ 282 FR_OBJ20_ClassConf 70;
BA_ "GenSigCycleTime" SG_ 282 FR_OBJ20_MotionStatus 70;
BA_ "GenSigCycleTime" SG_ 282 FR_OBJ20_Location 70;
BA_ "GenSigCycleTime" SG_ 282 FR_OBJ20_Measured 70;
BA_ "GenSigCycleTime" SG_ 282 FR_OBJ20_valid 70;
BA_ "GenSigCycleTime" SG_ 282 FR_OBJ20_Track_Age 70;
BA_ "GenSigCycleTime" SG_ 282 FR_OBJ20_Track_ID 70;
BA_ "GenSigInvalidValue" SG_ 282 FR_OBJ20_Track_ID "0";
BA_ "GenSigCycleTime" SG_ 282 FR_OBJ20_ObstacleProb 70;
BA_ "GenSigCycleTime" SG_ 282 FR_OBJ20_ExistProb 70;
BA_ "GenSigCycleTime" SG_ 282 FR_OBJ20_RelAx 70;
BA_ "GenSigCycleTime" SG_ 282 FR_OBJ20_RelAy 70;
BA_ "GenSigCycleTime" SG_ 282 FR_OBJ20_RelVx_std 70;
BA_ "GenSigInvalidValue" SG_ 282 FR_OBJ20_RelVx_std "4095";
BA_ "GenSigCycleTime" SG_ 282 FR_OBJ20_RelVx 70;
BA_ "GenSigCycleTime" SG_ 282 FR_OBJ20_RelVy_std 70;
BA_ "GenSigInvalidValue" SG_ 282 FR_OBJ20_RelVy_std "1023";
BA_ "GenSigCycleTime" SG_ 282 FR_OBJ20_RelVy 70;
BA_ "GenSigCycleTime" SG_ 282 FR_OBJ20_Dx_Vnce 70;
BA_ "GenSigInvalidValue" SG_ 282 FR_OBJ20_Dx_Vnce "16383";
BA_ "GenSigCycleTime" SG_ 282 FR_OBJ20_Dx 70;
BA_ "GenSigCycleTime" SG_ 282 FR_OBJ20_Dy_Vnce 70;
BA_ "GenSigInvalidValue" SG_ 282 FR_OBJ20_Dy_Vnce "1023";
BA_ "GenSigCycleTime" SG_ 282 FR_OBJ20_Dy 70;
BA_ "GenSigCycleTime" SG_ 282 FR_OBJ20_HeadingAngle 70;
BA_ "GenSigCycleTime" SG_ 282 FR_OBJ20_Length 70;
BA_ "GenSigCycleTime" SG_ 282 FR_OBJ20_Height 70;
BA_ "GenSigCycleTime" SG_ 282 FR_OBJ20_Width 70;
BA_ "GenSigCycleTime" SG_ 282 FR_OBJ20_Class 70;
BA_ "GenSigCycleTime" SG_ 282 FR_OBJ19_HeightGround 70;
BA_ "GenSigCycleTime" SG_ 282 FR_OBJ19_MotionStatusConf 70;
BA_ "GenSigCycleTime" SG_ 282 FR_OBJ19_ClassConf 70;
BA_ "GenSigCycleTime" SG_ 282 FR_OBJ19_MotionStatus 70;
BA_ "GenSigCycleTime" SG_ 282 FR_OBJ19_Location 70;
BA_ "GenSigCycleTime" SG_ 282 FR_OBJ19_Measured 70;
BA_ "GenSigCycleTime" SG_ 282 FR_OBJ19_valid 70;
BA_ "GenSigCycleTime" SG_ 282 FR_OBJ19_Track_Age 70;
BA_ "GenSigCycleTime" SG_ 282 FR_OBJ19_Track_ID 70;
BA_ "GenSigInvalidValue" SG_ 282 FR_OBJ19_Track_ID "0";
BA_ "GenSigCycleTime" SG_ 282 FR_OBJ19_ObstacleProb 70;
BA_ "GenSigCycleTime" SG_ 282 FR_OBJ19_ExistProb 70;
BA_ "GenSigCycleTime" SG_ 282 FR_OBJ19_RelAx 70;
BA_ "GenSigCycleTime" SG_ 282 FR_OBJ19_RelAy 70;
BA_ "GenSigCycleTime" SG_ 282 FR_OBJ19_RelVx_std 70;
BA_ "GenSigInvalidValue" SG_ 282 FR_OBJ19_RelVx_std "4095";
BA_ "GenSigCycleTime" SG_ 282 FR_OBJ19_RelVx 70;
BA_ "GenSigCycleTime" SG_ 282 FR_OBJ19_RelVy_std 70;
BA_ "GenSigInvalidValue" SG_ 282 FR_OBJ19_RelVy_std "1023";
BA_ "GenSigCycleTime" SG_ 282 FR_OBJ19_RelVy 70;
BA_ "GenSigCycleTime" SG_ 282 FR_OBJ19_Dx_Vnce 70;
BA_ "GenSigInvalidValue" SG_ 282 FR_OBJ19_Dx_Vnce "16383";
BA_ "GenSigCycleTime" SG_ 282 FR_OBJ19_Dx 70;
BA_ "GenSigCycleTime" SG_ 282 FR_OBJ19_Dy_Vnce 70;
BA_ "GenSigInvalidValue" SG_ 282 FR_OBJ19_Dy_Vnce "1023";
BA_ "GenSigCycleTime" SG_ 282 FR_OBJ19_Dy 70;
BA_ "GenSigCycleTime" SG_ 282 FR_OBJ19_HeadingAngle 70;
BA_ "GenSigCycleTime" SG_ 282 FR_OBJ19_Length 70;
BA_ "GenSigCycleTime" SG_ 282 FR_OBJ19_Height 70;
BA_ "GenSigCycleTime" SG_ 282 FR_OBJ19_Width 70;
BA_ "GenSigCycleTime" SG_ 282 FR_OBJ19_Class 70;

VAL_ 273 FR_OBJ2_FeaturePoint 0 " UNDETERMINED
0x1 = POINT_REAR_LEFT 
0x2 = POINT_REAR_CENTER 
0x3 = POINT_REAR_RIGHT 
0x4 = POINT_CENTER_LEFT 
0x5 = POINT_CENTER_CENTER 
0x6 = POINT_CENTER_RIGHT
0x7 = POINT_FRONT_LEFT
0x8 = POINT_FRONT_CENTER 
0x9 = POINT_FRONT_RIGHT ";
VAL_ 273 FR_OBJ1_FeaturePoint 0 " UNDETERMINED
0x1 = POINT_REAR_LEFT 
0x2 = POINT_REAR_CENTER 
0x3 = POINT_REAR_RIGHT 
0x4 = POINT_CENTER_LEFT 
0x5 = POINT_CENTER_CENTER 
0x6 = POINT_CENTER_RIGHT
0x7 = POINT_FRONT_LEFT
0x8 = POINT_FRONT_CENTER 
0x9 = POINT_FRONT_RIGHT ";
VAL_ 273 FR_OBJ2_MotionStatus 0 "unknown" 1 "moving " 2 "stopped" 3 "stationary" 4 "crossing" 5 "reserve;";
VAL_ 273 FR_OBJ2_Location 0 "unknown" 1 "Left Lane" 2 "Right  Lane" 3 "Ego Lane";
VAL_ 273 FR_OBJ2_Measured 0 "unknown" 1 "Measured" 2 "Predicted" 3 "Reserved";
VAL_ 273 FR_OBJ2_valid 0 "";
VAL_ 273 FR_OBJ2_Class 0 "Not Detected" 1 "car" 2 "truck" 3 "bicycle/motorbike" 4 "pedestrian" 5 "general" 6 "animal" 7 "uncertain";
VAL_ 273 FR_OBJ1_MotionStatus 0 "unknown" 1 "moving " 2 "stopped" 3 "stationary" 4 "crossing" 5 "reserve;";
VAL_ 273 FR_OBJ1_Location 0 "unknown" 1 "Left Lane" 2 "Right  Lane" 3 "Ego Lane";
VAL_ 273 FR_OBJ1_Measured 0 "unknown" 1 "Measured" 2 "Predicted" 3 "Reserved";
VAL_ 273 FR_OBJ1_valid 0 "";
VAL_ 273 FR_OBJ1_Class 0 "Not Detected" 1 "car" 2 "truck" 3 "bicycle/motorbike" 4 "pedestrian" 5 "general" 6 "animal" 7 "uncertain";

VAL_ 274 FR_OBJ4_FeaturePoint 0 " UNDETERMINED
0x1 = POINT_REAR_LEFT 
0x2 = POINT_REAR_CENTER 
0x3 = POINT_REAR_RIGHT 
0x4 = POINT_CENTER_LEFT 
0x5 = POINT_CENTER_CENTER 
0x6 = POINT_CENTER_RIGHT
0x7 = POINT_FRONT_LEFT
0x8 = POINT_FRONT_CENTER 
0x9 = POINT_FRONT_RIGHT ";
VAL_ 274 FR_OBJ3_FeaturePoint 0 " UNDETERMINED
0x1 = POINT_REAR_LEFT 
0x2 = POINT_REAR_CENTER 
0x3 = POINT_REAR_RIGHT 
0x4 = POINT_CENTER_LEFT 
0x5 = POINT_CENTER_CENTER 
0x6 = POINT_CENTER_RIGHT
0x7 = POINT_FRONT_LEFT
0x8 = POINT_FRONT_CENTER 
0x9 = POINT_FRONT_RIGHT ";
VAL_ 274 FR_OBJ4_MotionStatus 0 "unknown" 1 "moving " 2 "stopped" 3 "stationary" 4 "crossing" 5 "reserve;";
VAL_ 274 FR_OBJ4_Location 0 "unknown" 1 "Left Lane" 2 "Right  Lane" 3 "Ego Lane";
VAL_ 274 FR_OBJ4_Measured 0 "unknown" 1 "Measured" 2 "Predicted" 3 "Reserved";
VAL_ 274 FR_OBJ4_valid 0 "";
VAL_ 274 FR_OBJ4_Class 0 "Not Detected" 1 "car" 2 "truck" 3 "bicycle/motorbike" 4 "pedestrian" 5 "general" 6 "animal" 7 "uncertain";
VAL_ 274 FR_OBJ3_MotionStatus 0 "unknown" 1 "moving " 2 "stopped" 3 "stationary" 4 "crossing" 5 "reserve;";
VAL_ 274 FR_OBJ3_Location 0 "unknown" 1 "Left Lane" 2 "Right  Lane" 3 "Ego Lane";
VAL_ 274 FR_OBJ3_Measured 0 "unknown" 1 "Measured" 2 "Predicted" 3 "Reserved";
VAL_ 274 FR_OBJ3_valid 0 "";
VAL_ 274 FR_OBJ3_Class 0 "Not Detected" 1 "car" 2 "truck" 3 "bicycle/motorbike" 4 "pedestrian" 5 "general" 6 "animal" 7 "uncertain";

VAL_ 275 FR_OBJ6_FeaturePoint 0 " UNDETERMINED
0x1 = POINT_REAR_LEFT 
0x2 = POINT_REAR_CENTER 
0x3 = POINT_REAR_RIGHT 
0x4 = POINT_CENTER_LEFT 
0x5 = POINT_CENTER_CENTER 
0x6 = POINT_CENTER_RIGHT
0x7 = POINT_FRONT_LEFT
0x8 = POINT_FRONT_CENTER 
0x9 = POINT_FRONT_RIGHT ";
VAL_ 275 FR_OBJ5_FeaturePoint 0 " UNDETERMINED
0x1 = POINT_REAR_LEFT 
0x2 = POINT_REAR_CENTER 
0x3 = POINT_REAR_RIGHT 
0x4 = POINT_CENTER_LEFT 
0x5 = POINT_CENTER_CENTER 
0x6 = POINT_CENTER_RIGHT
0x7 = POINT_FRONT_LEFT
0x8 = POINT_FRONT_CENTER 
0x9 = POINT_FRONT_RIGHT ";
VAL_ 275 FR_OBJ6_MotionStatus 0 "unknown" 1 "moving " 2 "stopped" 3 "stationary" 4 "crossing" 5 "reserve;";
VAL_ 275 FR_OBJ6_Location 0 "unknown" 1 "Left Lane" 2 "Right  Lane" 3 "Ego Lane";
VAL_ 275 FR_OBJ6_Measured 0 "unknown" 1 "Measured" 2 "Predicted" 3 "Reserved";
VAL_ 275 FR_OBJ6_valid 0 "";
VAL_ 275 FR_OBJ6_Class 0 "Not Detected" 1 "car" 2 "truck" 3 "bicycle/motorbike" 4 "pedestrian" 5 "general" 6 "animal" 7 "uncertain";
VAL_ 275 FR_OBJ5_MotionStatus 0 "unknown" 1 "moving " 2 "stopped" 3 "stationary" 4 "crossing" 5 "reserve;";
VAL_ 275 FR_OBJ5_Location 0 "unknown" 1 "Left Lane" 2 "Right  Lane" 3 "Ego Lane";
VAL_ 275 FR_OBJ5_Measured 0 "unknown" 1 "Measured" 2 "Predicted" 3 "Reserved";
VAL_ 275 FR_OBJ5_valid 0 "";
VAL_ 275 FR_OBJ5_Class 0 "Not Detected" 1 "car" 2 "truck" 3 "bicycle/motorbike" 4 "pedestrian" 5 "general" 6 "animal" 7 "uncertain";

VAL_ 276 FR_OBJ8_FeaturePoint 0 " UNDETERMINED
0x1 = POINT_REAR_LEFT 
0x2 = POINT_REAR_CENTER 
0x3 = POINT_REAR_RIGHT 
0x4 = POINT_CENTER_LEFT 
0x5 = POINT_CENTER_CENTER 
0x6 = POINT_CENTER_RIGHT
0x7 = POINT_FRONT_LEFT
0x8 = POINT_FRONT_CENTER 
0x9 = POINT_FRONT_RIGHT ";
VAL_ 276 FR_OBJ7_FeaturePoint 0 " UNDETERMINED
0x1 = POINT_REAR_LEFT 
0x2 = POINT_REAR_CENTER 
0x3 = POINT_REAR_RIGHT 
0x4 = POINT_CENTER_LEFT 
0x5 = POINT_CENTER_CENTER 
0x6 = POINT_CENTER_RIGHT
0x7 = POINT_FRONT_LEFT
0x8 = POINT_FRONT_CENTER 
0x9 = POINT_FRONT_RIGHT ";
VAL_ 276 FR_OBJ8_MotionStatus 0 "unknown" 1 "moving " 2 "stopped" 3 "stationary" 4 "crossing" 5 "reserve;";
VAL_ 276 FR_OBJ8_Location 0 "unknown" 1 "Left Lane" 2 "Right  Lane" 3 "Ego Lane";
VAL_ 276 FR_OBJ8_Measured 0 "unknown" 1 "Measured" 2 "Predicted" 3 "Reserved";
VAL_ 276 FR_OBJ8_valid 0 "";
VAL_ 276 FR_OBJ8_Class 0 "Not Detected" 1 "car" 2 "truck" 3 "bicycle/motorbike" 4 "pedestrian" 5 "general" 6 "animal" 7 "uncertain";
VAL_ 276 FR_OBJ7_MotionStatus 0 "unknown" 1 "moving " 2 "stopped" 3 "stationary" 4 "crossing" 5 "reserve;";
VAL_ 276 FR_OBJ7_Location 0 "unknown" 1 "Left Lane" 2 "Right  Lane" 3 "Ego Lane";
VAL_ 276 FR_OBJ7_Measured 0 "unknown" 1 "Measured" 2 "Predicted" 3 "Reserved";
VAL_ 276 FR_OBJ7_valid 0 "";
VAL_ 276 FR_OBJ7_Class 0 "Not Detected" 1 "car" 2 "truck" 3 "bicycle/motorbike" 4 "pedestrian" 5 "general" 6 "animal" 7 "uncertain";

VAL_ 277 FR_OBJ10_FeaturePoint 0 " UNDETERMINED
0x1 = POINT_REAR_LEFT 
0x2 = POINT_REAR_CENTER 
0x3 = POINT_REAR_RIGHT 
0x4 = POINT_CENTER_LEFT 
0x5 = POINT_CENTER_CENTER 
0x6 = POINT_CENTER_RIGHT
0x7 = POINT_FRONT_LEFT
0x8 = POINT_FRONT_CENTER 
0x9 = POINT_FRONT_RIGHT ";
VAL_ 277 FR_OBJ9_FeaturePoint 0 " UNDETERMINED
0x1 = POINT_REAR_LEFT 
0x2 = POINT_REAR_CENTER 
0x3 = POINT_REAR_RIGHT 
0x4 = POINT_CENTER_LEFT 
0x5 = POINT_CENTER_CENTER 
0x6 = POINT_CENTER_RIGHT
0x7 = POINT_FRONT_LEFT
0x8 = POINT_FRONT_CENTER 
0x9 = POINT_FRONT_RIGHT ";
VAL_ 277 FR_OBJ10_MotionStatus 0 "unknown" 1 "moving " 2 "stopped" 3 "stationary" 4 "crossing" 5 "reserve;";
VAL_ 277 FR_OBJ10_Location 0 "unknown" 1 "Left Lane" 2 "Right  Lane" 3 "Ego Lane";
VAL_ 277 FR_OBJ10_Measured 0 "unknown" 1 "Measured" 2 "Predicted" 3 "Reserved";
VAL_ 277 FR_OBJ10_valid 0 "";
VAL_ 277 FR_OBJ10_Class 0 "Not Detected" 1 "car" 2 "truck" 3 "bicycle/motorbike" 4 "pedestrian" 5 "general" 6 "animal" 7 "uncertain";
VAL_ 277 FR_OBJ9_MotionStatus 0 "unknown" 1 "moving " 2 "stopped" 3 "stationary" 4 "crossing" 5 "reserve;";
VAL_ 277 FR_OBJ9_Location 0 "unknown" 1 "Left Lane" 2 "Right  Lane" 3 "Ego Lane";
VAL_ 277 FR_OBJ9_Measured 0 "unknown" 1 "Measured" 2 "Predicted" 3 "Reserved";
VAL_ 277 FR_OBJ9_valid 0 "";
VAL_ 277 FR_OBJ9_Class 0 "Not Detected" 1 "car" 2 "truck" 3 "bicycle/motorbike" 4 "pedestrian" 5 "general" 6 "animal" 7 "uncertain";

VAL_ 278 FR_OBJ12_FeaturePoint 0 " UNDETERMINED
0x1 = POINT_REAR_LEFT 
0x2 = POINT_REAR_CENTER 
0x3 = POINT_REAR_RIGHT 
0x4 = POINT_CENTER_LEFT 
0x5 = POINT_CENTER_CENTER 
0x6 = POINT_CENTER_RIGHT
0x7 = POINT_FRONT_LEFT
0x8 = POINT_FRONT_CENTER 
0x9 = POINT_FRONT_RIGHT ";
VAL_ 278 FR_OBJ11_FeaturePoint 0 " UNDETERMINED
0x1 = POINT_REAR_LEFT 
0x2 = POINT_REAR_CENTER 
0x3 = POINT_REAR_RIGHT 
0x4 = POINT_CENTER_LEFT 
0x5 = POINT_CENTER_CENTER 
0x6 = POINT_CENTER_RIGHT
0x7 = POINT_FRONT_LEFT
0x8 = POINT_FRONT_CENTER 
0x9 = POINT_FRONT_RIGHT ";
VAL_ 278 FR_OBJ12_MotionStatus 0 "unknown" 1 "moving " 2 "stopped" 3 "stationary" 4 "crossing" 5 "reserve;";
VAL_ 278 FR_OBJ12_Location 0 "unknown" 1 "Left Lane" 2 "Right  Lane" 3 "Ego Lane";
VAL_ 278 FR_OBJ12_Measured 0 "unknown" 1 "Measured" 2 "Predicted" 3 "Reserved";
VAL_ 278 FR_OBJ12_valid 0 "";
VAL_ 278 FR_OBJ12_Class 0 "Not Detected" 1 "car" 2 "truck" 3 "bicycle/motorbike" 4 "pedestrian" 5 "general" 6 "animal" 7 "uncertain";
VAL_ 278 FR_OBJ11_MotionStatus 0 "unknown" 1 "moving " 2 "stopped" 3 "stationary" 4 "crossing" 5 "reserve;";
VAL_ 278 FR_OBJ11_Location 0 "unknown" 1 "Left Lane" 2 "Right  Lane" 3 "Ego Lane";
VAL_ 278 FR_OBJ11_Measured 0 "unknown" 1 "Measured" 2 "Predicted" 3 "Reserved";
VAL_ 278 FR_OBJ11_valid 0 "";
VAL_ 278 FR_OBJ11_Class 0 "Not Detected" 1 "car" 2 "truck" 3 "bicycle/motorbike" 4 "pedestrian" 5 "general" 6 "animal" 7 "uncertain";

VAL_ 279 FR_OBJ14_FeaturePoint 0 " UNDETERMINED
0x1 = POINT_REAR_LEFT 
0x2 = POINT_REAR_CENTER 
0x3 = POINT_REAR_RIGHT 
0x4 = POINT_CENTER_LEFT 
0x5 = POINT_CENTER_CENTER 
0x6 = POINT_CENTER_RIGHT
0x7 = POINT_FRONT_LEFT
0x8 = POINT_FRONT_CENTER 
0x9 = POINT_FRONT_RIGHT ";
VAL_ 279 FR_OBJ13_FeaturePoint 0 " UNDETERMINED
0x1 = POINT_REAR_LEFT 
0x2 = POINT_REAR_CENTER 
0x3 = POINT_REAR_RIGHT 
0x4 = POINT_CENTER_LEFT 
0x5 = POINT_CENTER_CENTER 
0x6 = POINT_CENTER_RIGHT
0x7 = POINT_FRONT_LEFT
0x8 = POINT_FRONT_CENTER 
0x9 = POINT_FRONT_RIGHT ";
VAL_ 279 FR_OBJ14_MotionStatus 0 "unknown" 1 "moving " 2 "stopped" 3 "stationary" 4 "crossing" 5 "reserve;";
VAL_ 279 FR_OBJ14_Location 0 "unknown" 1 "Left Lane" 2 "Right  Lane" 3 "Ego Lane";
VAL_ 279 FR_OBJ14_Measured 0 "unknown" 1 "Measured" 2 "Predicted" 3 "Reserved";
VAL_ 279 FR_OBJ14_valid 0 "";
VAL_ 279 FR_OBJ14_Class 0 "Not Detected" 1 "car" 2 "truck" 3 "bicycle/motorbike" 4 "pedestrian" 5 "general" 6 "animal" 7 "uncertain";
VAL_ 279 FR_OBJ13_MotionStatus 0 "unknown" 1 "moving " 2 "stopped" 3 "stationary" 4 "crossing" 5 "reserve;";
VAL_ 279 FR_OBJ13_Location 0 "unknown" 1 "Left Lane" 2 "Right  Lane" 3 "Ego Lane";
VAL_ 279 FR_OBJ13_Measured 0 "unknown" 1 "Measured" 2 "Predicted" 3 "Reserved";
VAL_ 279 FR_OBJ13_valid 0 "";
VAL_ 279 FR_OBJ13_Class 0 "Not Detected" 1 "car" 2 "truck" 3 "bicycle/motorbike" 4 "pedestrian" 5 "general" 6 "animal" 7 "uncertain";

VAL_ 280 FR_OBJ16_FeaturePoint 0 " UNDETERMINED
0x1 = POINT_REAR_LEFT 
0x2 = POINT_REAR_CENTER 
0x3 = POINT_REAR_RIGHT 
0x4 = POINT_CENTER_LEFT 
0x5 = POINT_CENTER_CENTER 
0x6 = POINT_CENTER_RIGHT
0x7 = POINT_FRONT_LEFT
0x8 = POINT_FRONT_CENTER 
0x9 = POINT_FRONT_RIGHT ";
VAL_ 280 FR_OBJ15_FeaturePoint 0 " UNDETERMINED
0x1 = POINT_REAR_LEFT 
0x2 = POINT_REAR_CENTER 
0x3 = POINT_REAR_RIGHT 
0x4 = POINT_CENTER_LEFT 
0x5 = POINT_CENTER_CENTER 
0x6 = POINT_CENTER_RIGHT
0x7 = POINT_FRONT_LEFT
0x8 = POINT_FRONT_CENTER 
0x9 = POINT_FRONT_RIGHT ";
VAL_ 280 FR_OBJ16_MotionStatus 0 "unknown" 1 "moving " 2 "stopped" 3 "stationary" 4 "crossing" 5 "reserve;";
VAL_ 280 FR_OBJ16_Location 0 "unknown" 1 "Left Lane" 2 "Right  Lane" 3 "Ego Lane";
VAL_ 280 FR_OBJ16_Measured 0 "unknown" 1 "Measured" 2 "Predicted" 3 "Reserved";
VAL_ 280 FR_OBJ16_valid 0 "";
VAL_ 280 FR_OBJ16_Class 0 "Not Detected" 1 "car" 2 "truck" 3 "bicycle/motorbike" 4 "pedestrian" 5 "general" 6 "animal" 7 "uncertain";
VAL_ 280 FR_OBJ15_MotionStatus 0 "unknown" 1 "moving " 2 "stopped" 3 "stationary" 4 "crossing" 5 "reserve;";
VAL_ 280 FR_OBJ15_Location 0 "unknown" 1 "Left Lane" 2 "Right  Lane" 3 "Ego Lane";
VAL_ 280 FR_OBJ15_Measured 0 "unknown" 1 "Measured" 2 "Predicted" 3 "Reserved";
VAL_ 280 FR_OBJ15_valid 0 "";
VAL_ 280 FR_OBJ15_Class 0 "Not Detected" 1 "car" 2 "truck" 3 "bicycle/motorbike" 4 "pedestrian" 5 "general" 6 "animal" 7 "uncertain";

VAL_ 281 FR_OBJ18_FeaturePoint 0 " UNDETERMINED
0x1 = POINT_REAR_LEFT 
0x2 = POINT_REAR_CENTER 
0x3 = POINT_REAR_RIGHT 
0x4 = POINT_CENTER_LEFT 
0x5 = POINT_CENTER_CENTER 
0x6 = POINT_CENTER_RIGHT
0x7 = POINT_FRONT_LEFT
0x8 = POINT_FRONT_CENTER 
0x9 = POINT_FRONT_RIGHT ";
VAL_ 281 FR_OBJ17_FeaturePoint 0 " UNDETERMINED
0x1 = POINT_REAR_LEFT 
0x2 = POINT_REAR_CENTER 
0x3 = POINT_REAR_RIGHT 
0x4 = POINT_CENTER_LEFT 
0x5 = POINT_CENTER_CENTER 
0x6 = POINT_CENTER_RIGHT
0x7 = POINT_FRONT_LEFT
0x8 = POINT_FRONT_CENTER 
0x9 = POINT_FRONT_RIGHT ";
VAL_ 281 FR_OBJ18_MotionStatus 0 "unknown" 1 "moving " 2 "stopped" 3 "stationary" 4 "crossing" 5 "reserve;";
VAL_ 281 FR_OBJ18_Location 0 "unknown" 1 "Left Lane" 2 "Right  Lane" 3 "Ego Lane";
VAL_ 281 FR_OBJ18_Measured 0 "unknown" 1 "Measured" 2 "Predicted" 3 "Reserved";
VAL_ 281 FR_OBJ18_valid 0 "";
VAL_ 281 FR_OBJ18_Class 0 "Not Detected" 1 "car" 2 "truck" 3 "bicycle/motorbike" 4 "pedestrian" 5 "general" 6 "animal" 7 "uncertain";
VAL_ 281 FR_OBJ17_MotionStatus 0 "unknown" 1 "moving " 2 "stopped" 3 "stationary" 4 "crossing" 5 "reserve;";
VAL_ 281 FR_OBJ17_Location 0 "unknown" 1 "Left Lane" 2 "Right  Lane" 3 "Ego Lane";
VAL_ 281 FR_OBJ17_Measured 0 "unknown" 1 "Measured" 2 "Predicted" 3 "Reserved";
VAL_ 281 FR_OBJ17_valid 0 "";
VAL_ 281 FR_OBJ17_Class 0 "Not Detected" 1 "car" 2 "truck" 3 "bicycle/motorbike" 4 "pedestrian" 5 "general" 6 "animal" 7 "uncertain";

VAL_ 282 FR_OBJ20_FeaturePoint 0 " UNDETERMINED
0x1 = POINT_REAR_LEFT 
0x2 = POINT_REAR_CENTER 
0x3 = POINT_REAR_RIGHT 
0x4 = POINT_CENTER_LEFT 
0x5 = POINT_CENTER_CENTER 
0x6 = POINT_CENTER_RIGHT
0x7 = POINT_FRONT_LEFT
0x8 = POINT_FRONT_CENTER 
0x9 = POINT_FRONT_RIGHT ";
VAL_ 282 FR_OBJ19_FeaturePoint 0 " UNDETERMINED
0x1 = POINT_REAR_LEFT 
0x2 = POINT_REAR_CENTER 
0x3 = POINT_REAR_RIGHT 
0x4 = POINT_CENTER_LEFT 
0x5 = POINT_CENTER_CENTER 
0x6 = POINT_CENTER_RIGHT
0x7 = POINT_FRONT_LEFT
0x8 = POINT_FRONT_CENTER 
0x9 = POINT_FRONT_RIGHT ";
VAL_ 282 FR_OBJ20_MotionStatus 0 "unknown" 1 "moving " 2 "stopped" 3 "stationary" 4 "crossing" 5 "reserve;";
VAL_ 282 FR_OBJ20_Location 0 "unknown" 1 "Left Lane" 2 "Right  Lane" 3 "Ego Lane";
VAL_ 282 FR_OBJ20_Measured 0 "unknown" 1 "Measured" 2 "Predicted" 3 "Reserved";
VAL_ 282 FR_OBJ20_valid 0 "";
VAL_ 282 FR_OBJ20_Class 0 "Not Detected" 1 "car" 2 "truck" 3 "bicycle/motorbike" 4 "pedestrian" 5 "general" 6 "animal" 7 "uncertain";
VAL_ 282 FR_OBJ19_MotionStatus 0 "unknown" 1 "moving " 2 "stopped" 3 "stationary" 3 "crossing" 4 "reserve;";
VAL_ 282 FR_OBJ19_Location 0 "unknown" 1 "Left Lane" 2 "Right  Lane" 3 "Ego Lane";
VAL_ 282 FR_OBJ19_Measured 0 "unknown" 1 "Measured" 2 "Predicted" 3 "Reserved";
VAL_ 282 FR_OBJ19_valid 0 "";
VAL_ 282 FR_OBJ19_Class 0 "Not Detected" 1 "car" 2 "truck" 3 "bicycle/motorbike" 4 "pedestrian" 5 "general" 6 "animal" 7 "uncertain";
