AUTOSAR XML (schema 4-0-3)
package /AUTOSAR_StbM/SwComponentTypes
  service sw component type StbM
    provide port GlobalTime_Slave_StbMSynchronizedTimeBase_0: provided-interface=StbM_GlobalTime_Slave_StbMSynchronizedTimeBase_0
      provided-com-specs:
        operation=GetCurrentTime, queue-length=1
        operation=GetRateDeviation, queue-length=1
        operation=GetTimeBaseStatus, queue-length=1
        operation=GetTimeLeap, queue-length=1
    behavior StbMIntBeh: handle-termination-and-restart=NO-SUPPORT, port-api-option{enable-take-address=false, indirect-api=false, port-defined-argument-value{value=0, value-type=StbM_SynchronizedTimeBaseType}, port=GlobalTime_Slave_StbMSynchronizedTimeBase_0}
      4 x operation invoked event:
        EV_GetCurrentTime_StbMSynchronizedTimeBase_0: start-on-event=RE_GetCurrentTime, operation=GlobalTime_Slave_StbMSynchronizedTimeBase_0.GetCurrentTime
        EV_GetRateDeviation_StbMSynchronizedTimeBase_0: start-on-event=RE_GetRateDeviation, operation=GlobalTime_Slave_StbMSynchronizedTimeBase_0.GetRateDeviation
        EV_GetTimeBaseStatus_StbMSynchronizedTimeBase_0: start-on-event=RE_GetTimeBaseStatus, operation=GlobalTime_Slave_StbMSynchronizedTimeBase_0.GetTimeBaseStatus
        EV_GetTimeLeap_StbMSynchronizedTimeBase_0: start-on-event=RE_GetTimeLeap, operation=GlobalTime_Slave_StbMSynchronizedTimeBase_0.GetTimeLeap
      5 x runnable:
        RE_MainFunction: symbol=StbM_MainFunction
        RE_GetCurrentTime: can-be-invoked-concurrently=true, symbol=StbM_GetCurrentTime
        RE_GetRateDeviation: can-be-invoked-concurrently=true, symbol=StbM_GetRateDeviation
        RE_GetTimeBaseStatus: can-be-invoked-concurrently=true, symbol=StbM_GetTimeBaseStatus
        RE_GetTimeLeap: can-be-invoked-concurrently=true, symbol=StbM_GetTimeLeap
package /EB_StbM/SwcImplementations
  swc implementation StbMImpl: programming-language=C, sw-version=4.0.0, vendor-id=1, behavior=StbMIntBeh
    code-descriptors:
      code Code: artifact-descriptors=autosar-engineering-object={short-label=EngObject, category=SWSRC}
    resource consumption Resources
      memory section CODE: sw-addrmethod=CODE
