VERSION ""

NS_ :

BS_:
BU_: FR FC ADC

BO_ 354 FC_162: 64 FC
 SG_ FC_Obj3_VehicleDir : 9|3@0+ (1.0000000000,0.0000000000) [0.0000000000|7.0000000000] ""  FC,ADC
 SG_ FC_Obj3ReDoorSts : 11|2@0+ (1.0000000000,0.0000000000) [0.0000000000|3.0000000000] ""  FC,ADC
 SG_ FC_Obj3RiDoorSts : 5|2@0+ (1.0000000000,0.0000000000) [0.0000000000|3.0000000000] ""  FC,ADC
 SG_ FC_Obj3LeDoorSts : 7|2@0+ (1.0000000000,0.0000000000) [0.0000000000|3.0000000000] ""  FC,ADC
 SG_ FC_Obj3WSInfoPosType : 133|4@0+ (1.0000000000,0.0000000000) [0.0000000000|15.0000000000] ""  FC,ADC
 SG_ FC_CRCCheck_162 : 503|16@0+ (1.0000000000,0.0000000000) [0.0000000000|65535.0000000000] ""  FC,ADC
 SG_ FC_RollingCounter_162 : 491|4@0+ (1.0000000000,0.0000000000) [0.0000000000|15.0000000000] ""  FC,ADC
 SG_ FC_Obj3_Img2dBox_RightDown_V : 288|12@0+ (1.0000000000,0.0000000000) [0.0000000000|3000.0000000000] "pix"  FC,ADC
 SG_ FC_Obj3_Img2dBox_LeftTop_V : 284|12@0+ (1.0000000000,0.0000000000) [0.0000000000|3000.0000000000] "pix"  FC,ADC
 SG_ FC_Obj3_Img2dBox_RightDown_U : 264|12@0+ (1.0000000000,0.0000000000) [0.0000000000|4095.0000000000] "pix"  FC,ADC
 SG_ FC_Obj3_Img2dBox_LeftTop_U : 260|12@0+ (1.0000000000,0.0000000000) [0.0000000000|4095.0000000000] "pix"  FC,ADC
 SG_ FC_Obj3_TurnLight : 262|2@0+ (1.0000000000,0.0000000000) [0.0000000000|3.0000000000] ""  FC,ADC
 SG_ FC_Obj3_valid : 263|1@0+ (1.0000000000,0.0000000000) [0.0000000000|1.0000000000] ""  FC,ADC
 SG_ FC_Obj3_Vy_Vnce : 241|10@0+ (0.1250000000,-64.0000000000) [-64.0000000000|63.8750000000] "m/s"  FC,ADC
 SG_ FC_Obj3_Vx_Vnce : 237|12@0+ (0.0625000000,-128.0000000000) [-128.0000000000|127.9375000000] "m/s"  FC,ADC
 SG_ FC_Obj3_CenterAngle : 230|9@0+ (0.0100000000,-1.5700000000) [-1.5700000000|1.5700000000] ""  FC,ADC
 SG_ FC_Obj3_DistInLane : 209|11@0+ (0.0100000000,-10.0000000000) [-10.0000000000|10.0000000000] ""  FC,ADC
 SG_ FC_Obj3_objCutInLane : 211|2@0+ (1.0000000000,0.0000000000) [0.0000000000|2.0000000000] ""  FC,ADC
 SG_ FC_Obj3_objCutInFlag : 201|2@0+ (1.0000000000,0.0000000000) [0.0000000000|2.0000000000] ""  FC,ADC
 SG_ FC_Obj3_CornerPoint_y : 199|14@0+ (0.0100000000,-80.0000000000) [-80.0000000000|80.0000000000] ""  FC,ADC
 SG_ FC_Obj3_CornerPoint_x : 182|15@0+ (0.0100000000,0.0000000000) [0.0000000000|200.0000000000] ""  FC,ADC
 SG_ FC_Obj3_LaneAssignment : 169|3@0+ (1.0000000000,0.0000000000) [0.0000000000|7.0000000000] ""  FC,ADC
 SG_ FC_Obj3_MotionType : 172|3@0+ (1.0000000000,0.0000000000) [0.0000000000|4.0000000000] ""  FC,ADC
 SG_ FC_obj3_Brakelight_Info : 173|1@0+ (1.0000000000,0.0000000000) [0.0000000000|1.0000000000] ""  FC,ADC
 SG_ FC_Obj3_Width : 155|11@0+ (0.0100000000,0.0000000000) [0.0000000000|12.0000000000] "m"  FC,ADC
 SG_ FC_Obj3_Length : 148|9@0+ (0.0500000000,0.0000000000) [0.0000000000|25.5000000000] "m"  FC,ADC
 SG_ FC_Obj3_Height : 141|9@0+ (0.0100000000,0.0000000000) [0.0000000000|5.1100000000] "m"  FC,ADC
 SG_ FC_Obj3_HeadOrientation : 129|4@0+ (1.0000000000,0.0000000000) [0.0000000000|15.0000000000] ""  FC,ADC
 SG_ FC_Obj3_HeadingAngle : 308|10@0+ (0.0100000000,-3.1400000000) [-3.1400000000|3.1400000000] "rad"  FC,ADC
 SG_ FC_Obj3_ExistProb : 112|6@0+ (2.0000000000,0.0000000000) [0.0000000000|100.0000000000] "%"  FC,ADC
 SG_ FC_Obj3_Dy_Vnce : 106|10@0+ (0.0200000000,0.0000000000) [0.0000000000|20.0000000000] "m2"  FC,ADC
 SG_ FC_Obj3_Dy : 88|14@0+ (0.0100000000,-80.0000000000) [-80.0000000000|80.0000000000] "m"  FC,ADC
 SG_ FC_Obj3_Dx_Vnce : 86|14@0+ (0.0500000000,0.0000000000) [0.0000000000|50.0000000000] "m2"  FC,ADC
 SG_ FC_Obj3_Dx : 66|12@0+ (0.0500000000,0.0000000000) [0.0000000000|204.7000000000] "m"  FC,ADC
 SG_ FC_Obj3_RelVy : 60|10@0+ (0.1000000000,-50.0000000000) [-50.0000000000|50.0000000000] "m/s"  FC,ADC
 SG_ FC_Obj3_RelVx : 40|12@0+ (0.1000000000,-154.0000000000) [-154.0000000000|50.0000000000] "m/s"  FC,ADC
 SG_ FC_Obj3_RelAy : 32|8@0+ (0.1000000000,-12.0000000000) [-12.0000000000|12.0000000000] "m/s2"  FC,ADC
 SG_ FC_Obj3_RelAx : 25|9@0+ (0.1000000000,-16.0000000000) [-16.0000000000|16.0000000000] "m/s2"  FC,ADC
 SG_ FC_Obj3_TypeProb : 31|6@0+ (2.0000000000,0.0000000000) [0.0000000000|100.0000000000] "%"  FC,ADC
 SG_ FC_Obj3_Type : 19|4@0+ (1.0000000000,0.0000000000) [0.0000000000|15.0000000000] ""  FC,ADC
 SG_ FC_Obj3_Track_Age : 314|16@0+ (1.0000000000,0.0000000000) [0.0000000000|65535.0000000000] ""  FC,ADC
 SG_ FC_Obj3_Track_ID : 3|8@0+ (1.0000000000,0.0000000000) [0.0000000000|255.0000000000] ""  FC,ADC

BO_ 355 FC_163: 64 FC
 SG_ FC_Obj4_VehicleDir : 9|3@0+ (1.0000000000,0.0000000000) [0.0000000000|7.0000000000] ""  FC,ADC
 SG_ FC_Obj4ReDoorSts : 11|2@0+ (1.0000000000,0.0000000000) [0.0000000000|3.0000000000] ""  FC,ADC
 SG_ FC_Obj4RiDoorSts : 5|2@0+ (1.0000000000,0.0000000000) [0.0000000000|3.0000000000] ""  FC,ADC
 SG_ FC_Obj4LeDoorSts : 7|2@0+ (1.0000000000,0.0000000000) [0.0000000000|3.0000000000] ""  FC,ADC
 SG_ FC_Obj4WSInfoPosType : 133|4@0+ (1.0000000000,0.0000000000) [0.0000000000|15.0000000000] ""  FC,ADC
 SG_ FC_CRCCheck_163 : 503|16@0+ (1.0000000000,0.0000000000) [0.0000000000|65535.0000000000] ""  FC,ADC
 SG_ FC_RollingCounter_163 : 491|4@0+ (1.0000000000,0.0000000000) [0.0000000000|15.0000000000] ""  FC,ADC
 SG_ FC_Obj4_Img2dBox_RightDown_V : 288|12@0+ (1.0000000000,0.0000000000) [0.0000000000|3000.0000000000] "pix"  FC,ADC
 SG_ FC_Obj4_Img2dBox_LeftTop_V : 284|12@0+ (1.0000000000,0.0000000000) [0.0000000000|3000.0000000000] "pix"  FC,ADC
 SG_ FC_Obj4_Img2dBox_RightDown_U : 264|12@0+ (1.0000000000,0.0000000000) [0.0000000000|4095.0000000000] "pix"  FC,ADC
 SG_ FC_Obj4_Img2dBox_LeftTop_U : 260|12@0+ (1.0000000000,0.0000000000) [0.0000000000|4095.0000000000] "pix"  FC,ADC
 SG_ FC_Obj4_TurnLight : 262|2@0+ (1.0000000000,0.0000000000) [0.0000000000|3.0000000000] ""  FC,ADC
 SG_ FC_Obj4_valid : 263|1@0+ (1.0000000000,0.0000000000) [0.0000000000|1.0000000000] ""  FC,ADC
 SG_ FC_Obj4_Vy_Vnce : 241|10@0+ (0.1250000000,-64.0000000000) [-64.0000000000|63.8750000000] "m/s"  FC,ADC
 SG_ FC_Obj4_Vx_Vnce : 237|12@0+ (0.0625000000,-128.0000000000) [-128.0000000000|127.9375000000] "m/s"  FC,ADC
 SG_ FC_Obj4_CenterAngle : 230|9@0+ (0.0100000000,-1.5700000000) [-1.5700000000|1.5700000000] ""  FC,ADC
 SG_ FC_Obj4_DistInLane : 209|11@0+ (0.0100000000,-10.0000000000) [-10.0000000000|10.0000000000] ""  FC,ADC
 SG_ FC_Obj4_objCutInLane : 211|2@0+ (1.0000000000,0.0000000000) [0.0000000000|2.0000000000] ""  FC,ADC
 SG_ FC_Obj4_objCutInFlag : 201|2@0+ (1.0000000000,0.0000000000) [0.0000000000|2.0000000000] ""  FC,ADC
 SG_ FC_Obj4_CornerPoint_y : 199|14@0+ (0.0100000000,-80.0000000000) [-80.0000000000|80.0000000000] ""  FC,ADC
 SG_ FC_Obj4_CornerPoint_x : 182|15@0+ (0.0100000000,0.0000000000) [0.0000000000|200.0000000000] ""  FC,ADC
 SG_ FC_Obj4_LaneAssignment : 169|3@0+ (1.0000000000,0.0000000000) [0.0000000000|7.0000000000] ""  FC,ADC
 SG_ FC_Obj4_MotionType : 172|3@0+ (1.0000000000,0.0000000000) [0.0000000000|4.0000000000] ""  FC,ADC
 SG_ FC_obj4_Brakelight_Info : 173|1@0+ (1.0000000000,0.0000000000) [0.0000000000|1.0000000000] ""  FC,ADC
 SG_ FC_Obj4_Width : 155|11@0+ (0.0100000000,0.0000000000) [0.0000000000|12.0000000000] "m"  FC,ADC
 SG_ FC_Obj4_Length : 148|9@0+ (0.0500000000,0.0000000000) [0.0000000000|25.5000000000] "m"  FC,ADC
 SG_ FC_Obj4_Height : 141|9@0+ (0.0100000000,0.0000000000) [0.0000000000|5.1100000000] "m"  FC,ADC
 SG_ FC_Obj4_HeadOrientation : 129|4@0+ (1.0000000000,0.0000000000) [0.0000000000|15.0000000000] ""  FC,ADC
 SG_ FC_Obj4_HeadingAngle : 308|10@0+ (0.0100000000,-3.1400000000) [-3.1400000000|3.1400000000] "rad"  FC,ADC
 SG_ FC_Obj4_ExistProb : 112|6@0+ (2.0000000000,0.0000000000) [0.0000000000|100.0000000000] "%"  FC,ADC
 SG_ FC_Obj4_Dy_Vnce : 106|10@0+ (0.0200000000,0.0000000000) [0.0000000000|20.0000000000] "m2"  FC,ADC
 SG_ FC_Obj4_Dy : 88|14@0+ (0.0100000000,-80.0000000000) [-80.0000000000|80.0000000000] "m"  FC,ADC
 SG_ FC_Obj4_Dx_Vnce : 86|14@0+ (0.0500000000,0.0000000000) [0.0000000000|50.0000000000] "m2"  FC,ADC
 SG_ FC_Obj4_Dx : 66|12@0+ (0.0500000000,0.0000000000) [0.0000000000|204.7000000000] "m"  FC,ADC
 SG_ FC_Obj4_RelVy : 60|10@0+ (0.1000000000,-50.0000000000) [-50.0000000000|50.0000000000] "m/s"  FC,ADC
 SG_ FC_Obj4_RelVx : 40|12@0+ (0.1000000000,-154.0000000000) [-154.0000000000|50.0000000000] "m/s"  FC,ADC
 SG_ FC_Obj4_RelAy : 32|8@0+ (0.1000000000,-12.0000000000) [-12.0000000000|12.0000000000] "m/s2"  FC,ADC
 SG_ FC_Obj4_RelAx : 25|9@0+ (0.1000000000,-16.0000000000) [-16.0000000000|16.0000000000] "m/s2"  FC,ADC
 SG_ FC_Obj4_TypeProb : 31|6@0+ (2.0000000000,0.0000000000) [0.0000000000|100.0000000000] "%"  FC,ADC
 SG_ FC_Obj4_Type : 19|4@0+ (1.0000000000,0.0000000000) [0.0000000000|15.0000000000] ""  FC,ADC
 SG_ FC_Obj4_Track_Age : 314|16@0+ (1.0000000000,0.0000000000) [0.0000000000|65535.0000000000] ""  FC,ADC
 SG_ FC_Obj4_Track_ID : 3|8@0+ (1.0000000000,0.0000000000) [0.0000000000|255.0000000000] ""  FC,ADC

BO_ 356 FC_164: 64 FC
 SG_ FC_Obj5_VehicleDir : 9|3@0+ (1.0000000000,0.0000000000) [0.0000000000|7.0000000000] ""  FC,ADC
 SG_ FC_Obj5ReDoorSts : 11|2@0+ (1.0000000000,0.0000000000) [0.0000000000|3.0000000000] ""  FC,ADC
 SG_ FC_Obj5RiDoorSts : 5|2@0+ (1.0000000000,0.0000000000) [0.0000000000|3.0000000000] ""  FC,ADC
 SG_ FC_Obj5LeDoorSts : 7|2@0+ (1.0000000000,0.0000000000) [0.0000000000|3.0000000000] ""  FC,ADC
 SG_ FC_Obj5WSInfoPosType : 133|4@0+ (1.0000000000,0.0000000000) [0.0000000000|15.0000000000] ""  FC,ADC
 SG_ FC_CRCCheck_164 : 503|16@0+ (1.0000000000,0.0000000000) [0.0000000000|65535.0000000000] ""  FC,ADC
 SG_ FC_RollingCounter_164 : 491|4@0+ (1.0000000000,0.0000000000) [0.0000000000|15.0000000000] ""  FC,ADC
 SG_ FC_Obj5_Img2dBox_RightDown_V : 288|12@0+ (1.0000000000,0.0000000000) [0.0000000000|3000.0000000000] "pix"  FC,ADC
 SG_ FC_Obj5_Img2dBox_LeftTop_V : 284|12@0+ (1.0000000000,0.0000000000) [0.0000000000|3000.0000000000] "pix"  FC,ADC
 SG_ FC_Obj5_Img2dBox_RightDown_U : 264|12@0+ (1.0000000000,0.0000000000) [0.0000000000|4095.0000000000] "pix"  FC,ADC
 SG_ FC_Obj5_Img2dBox_LeftTop_U : 260|12@0+ (1.0000000000,0.0000000000) [0.0000000000|4095.0000000000] "pix"  FC,ADC
 SG_ FC_Obj5_TurnLight : 262|2@0+ (1.0000000000,0.0000000000) [0.0000000000|3.0000000000] ""  FC,ADC
 SG_ FC_Obj5_valid : 263|1@0+ (1.0000000000,0.0000000000) [0.0000000000|1.0000000000] ""  FC,ADC
 SG_ FC_Obj5_Vy_Vnce : 241|10@0+ (0.1250000000,-64.0000000000) [-64.0000000000|63.8750000000] "m/s"  FC,ADC
 SG_ FC_Obj5_Vx_Vnce : 237|12@0+ (0.0625000000,-128.0000000000) [-128.0000000000|127.9375000000] "m/s"  FC,ADC
 SG_ FC_Obj5_CenterAngle : 230|9@0+ (0.0100000000,-1.5700000000) [-1.5700000000|1.5700000000] ""  FC,ADC
 SG_ FC_Obj5_DistInLane : 209|11@0+ (0.0100000000,-10.0000000000) [-10.0000000000|10.0000000000] ""  FC,ADC
 SG_ FC_Obj5_objCutInLane : 211|2@0+ (1.0000000000,0.0000000000) [0.0000000000|2.0000000000] ""  FC,ADC
 SG_ FC_Obj5_objCutInFlag : 201|2@0+ (1.0000000000,0.0000000000) [0.0000000000|2.0000000000] ""  FC,ADC
 SG_ FC_Obj5_CornerPoint_y : 199|14@0+ (0.0100000000,-80.0000000000) [-80.0000000000|80.0000000000] ""  FC,ADC
 SG_ FC_Obj5_CornerPoint_x : 182|15@0+ (0.0100000000,0.0000000000) [0.0000000000|200.0000000000] ""  FC,ADC
 SG_ FC_Obj5_LaneAssignment : 169|3@0+ (1.0000000000,0.0000000000) [0.0000000000|7.0000000000] ""  FC,ADC
 SG_ FC_Obj5_MotionType : 172|3@0+ (1.0000000000,0.0000000000) [0.0000000000|4.0000000000] ""  FC,ADC
 SG_ FC_obj5_Brakelight_Info : 173|1@0+ (1.0000000000,0.0000000000) [0.0000000000|1.0000000000] ""  FC,ADC
 SG_ FC_Obj5_Width : 155|11@0+ (0.0100000000,0.0000000000) [0.0000000000|12.0000000000] "m"  FC,ADC
 SG_ FC_Obj5_Length : 148|9@0+ (0.0500000000,0.0000000000) [0.0000000000|25.5000000000] "m"  FC,ADC
 SG_ FC_Obj5_Height : 141|9@0+ (0.0100000000,0.0000000000) [0.0000000000|5.1100000000] "m"  FC,ADC
 SG_ FC_Obj5_HeadOrientation : 129|4@0+ (1.0000000000,0.0000000000) [0.0000000000|15.0000000000] ""  FC,ADC
 SG_ FC_Obj5_HeadingAngle : 308|10@0+ (0.0100000000,-3.1400000000) [-3.1400000000|3.1400000000] "rad"  FC,ADC
 SG_ FC_Obj5_ExistProb : 112|6@0+ (2.0000000000,0.0000000000) [0.0000000000|100.0000000000] "%"  FC,ADC
 SG_ FC_Obj5_Dy_Vnce : 106|10@0+ (0.0200000000,0.0000000000) [0.0000000000|20.0000000000] "m2"  FC,ADC
 SG_ FC_Obj5_Dy : 88|14@0+ (0.0100000000,-80.0000000000) [-80.0000000000|80.0000000000] "m"  FC,ADC
 SG_ FC_Obj5_Dx_Vnce : 86|14@0+ (0.0500000000,0.0000000000) [0.0000000000|50.0000000000] "m2"  FC,ADC
 SG_ FC_Obj5_Dx : 66|12@0+ (0.0500000000,0.0000000000) [0.0000000000|204.7000000000] "m"  FC,ADC
 SG_ FC_Obj5_RelVy : 60|10@0+ (0.1000000000,-50.0000000000) [-50.0000000000|50.0000000000] "m/s"  FC,ADC
 SG_ FC_Obj5_RelVx : 40|12@0+ (0.1000000000,-154.0000000000) [-154.0000000000|50.0000000000] "m/s"  FC,ADC
 SG_ FC_Obj5_RelAy : 32|8@0+ (0.1000000000,-12.0000000000) [-12.0000000000|12.0000000000] "m/s2"  FC,ADC
 SG_ FC_Obj5_RelAx : 25|9@0+ (0.1000000000,-16.0000000000) [-16.0000000000|16.0000000000] "m/s2"  FC,ADC
 SG_ FC_Obj5_TypeProb : 31|6@0+ (2.0000000000,0.0000000000) [0.0000000000|100.0000000000] "%"  FC,ADC
 SG_ FC_Obj5_Type : 19|4@0+ (1.0000000000,0.0000000000) [0.0000000000|15.0000000000] ""  FC,ADC
 SG_ FC_Obj5_Track_Age : 314|16@0+ (1.0000000000,0.0000000000) [0.0000000000|65535.0000000000] ""  FC,ADC
 SG_ FC_Obj5_Track_ID : 3|8@0+ (1.0000000000,0.0000000000) [0.0000000000|255.0000000000] ""  FC,ADC

BO_ 357 FC_165: 64 FC
 SG_ FC_Obj6_VehicleDir : 9|3@0+ (1.0000000000,0.0000000000) [0.0000000000|7.0000000000] ""  FC,ADC
 SG_ FC_Obj6ReDoorSts : 11|2@0+ (1.0000000000,0.0000000000) [0.0000000000|3.0000000000] ""  FC,ADC
 SG_ FC_Obj6RiDoorSts : 5|2@0+ (1.0000000000,0.0000000000) [0.0000000000|3.0000000000] ""  FC,ADC
 SG_ FC_Obj6LeDoorSts : 7|2@0+ (1.0000000000,0.0000000000) [0.0000000000|3.0000000000] ""  FC,ADC
 SG_ FC_Obj6WSInfoPosType : 133|4@0+ (1.0000000000,0.0000000000) [0.0000000000|15.0000000000] ""  FC,ADC
 SG_ FC_CRCCheck_165 : 503|16@0+ (1.0000000000,0.0000000000) [0.0000000000|65535.0000000000] ""  FC,ADC
 SG_ FC_RollingCounter_165 : 491|4@0+ (1.0000000000,0.0000000000) [0.0000000000|15.0000000000] ""  FC,ADC
 SG_ FC_Obj6_Img2dBox_RightDown_V : 288|12@0+ (1.0000000000,0.0000000000) [0.0000000000|3000.0000000000] "pix"  FC,ADC
 SG_ FC_Obj6_Img2dBox_LeftTop_V : 284|12@0+ (1.0000000000,0.0000000000) [0.0000000000|3000.0000000000] "pix"  FC,ADC
 SG_ FC_Obj6_Img2dBox_RightDown_U : 264|12@0+ (1.0000000000,0.0000000000) [0.0000000000|4095.0000000000] "pix"  FC,ADC
 SG_ FC_Obj6_Img2dBox_LeftTop_U : 260|12@0+ (1.0000000000,0.0000000000) [0.0000000000|4095.0000000000] "pix"  FC,ADC
 SG_ FC_Obj6_TurnLight : 262|2@0+ (1.0000000000,0.0000000000) [0.0000000000|3.0000000000] ""  FC,ADC
 SG_ FC_Obj6_valid : 263|1@0+ (1.0000000000,0.0000000000) [0.0000000000|1.0000000000] ""  FC,ADC
 SG_ FC_Obj6_Vy_Vnce : 241|10@0+ (0.1250000000,-64.0000000000) [-64.0000000000|63.8750000000] "m/s"  FC,ADC
 SG_ FC_Obj6_Vx_Vnce : 237|12@0+ (0.0625000000,-128.0000000000) [-128.0000000000|127.9375000000] "m/s"  FC,ADC
 SG_ FC_Obj6_CenterAngle : 230|9@0+ (0.0100000000,-1.5700000000) [-1.5700000000|1.5700000000] ""  FC,ADC
 SG_ FC_Obj6_DistInLane : 209|11@0+ (0.0100000000,-10.0000000000) [-10.0000000000|10.0000000000] ""  FC,ADC
 SG_ FC_Obj6_objCutInLane : 211|2@0+ (1.0000000000,0.0000000000) [0.0000000000|2.0000000000] ""  FC,ADC
 SG_ FC_Obj6_objCutInFlag : 201|2@0+ (1.0000000000,0.0000000000) [0.0000000000|2.0000000000] ""  FC,ADC
 SG_ FC_Obj6_CornerPoint_y : 199|14@0+ (0.0100000000,-80.0000000000) [-80.0000000000|80.0000000000] ""  FC,ADC
 SG_ FC_Obj6_CornerPoint_x : 182|15@0+ (0.0100000000,0.0000000000) [0.0000000000|200.0000000000] ""  FC,ADC
 SG_ FC_Obj6_LaneAssignment : 169|3@0+ (1.0000000000,0.0000000000) [0.0000000000|7.0000000000] ""  FC,ADC
 SG_ FC_Obj6_MotionType : 172|3@0+ (1.0000000000,0.0000000000) [0.0000000000|4.0000000000] ""  FC,ADC
 SG_ FC_obj6_Brakelight_Info : 173|1@0+ (1.0000000000,0.0000000000) [0.0000000000|1.0000000000] ""  FC,ADC
 SG_ FC_Obj6_Width : 155|11@0+ (0.0100000000,0.0000000000) [0.0000000000|12.0000000000] "m"  FC,ADC
 SG_ FC_Obj6_Length : 148|9@0+ (0.0500000000,0.0000000000) [0.0000000000|25.5000000000] "m"  FC,ADC
 SG_ FC_Obj6_Height : 141|9@0+ (0.0100000000,0.0000000000) [0.0000000000|5.1100000000] "m"  FC,ADC
 SG_ FC_Obj6_HeadOrientation : 129|4@0+ (1.0000000000,0.0000000000) [0.0000000000|15.0000000000] ""  FC,ADC
 SG_ FC_Obj6_HeadingAngle : 308|10@0+ (0.0100000000,-3.1400000000) [-3.1400000000|3.1400000000] "rad"  FC,ADC
 SG_ FC_Obj6_ExistProb : 112|6@0+ (2.0000000000,0.0000000000) [0.0000000000|100.0000000000] "%"  FC,ADC
 SG_ FC_Obj6_Dy_Vnce : 106|10@0+ (0.0200000000,0.0000000000) [0.0000000000|20.0000000000] "m2"  FC,ADC
 SG_ FC_Obj6_Dy : 88|14@0+ (0.0100000000,-80.0000000000) [-80.0000000000|80.0000000000] "m"  FC,ADC
 SG_ FC_Obj6_Dx_Vnce : 86|14@0+ (0.0500000000,0.0000000000) [0.0000000000|50.0000000000] "m2"  FC,ADC
 SG_ FC_Obj6_Dx : 66|12@0+ (0.0500000000,0.0000000000) [0.0000000000|204.7000000000] "m"  FC,ADC
 SG_ FC_Obj6_RelVy : 60|10@0+ (0.1000000000,-50.0000000000) [-50.0000000000|50.0000000000] "m/s"  FC,ADC
 SG_ FC_Obj6_RelVx : 40|12@0+ (0.1000000000,-154.0000000000) [-154.0000000000|50.0000000000] "m/s"  FC,ADC
 SG_ FC_Obj6_RelAy : 32|8@0+ (0.1000000000,-12.0000000000) [-12.0000000000|12.0000000000] "m/s2"  FC,ADC
 SG_ FC_Obj6_RelAx : 25|9@0+ (0.1000000000,-16.0000000000) [-16.0000000000|16.0000000000] "m/s2"  FC,ADC
 SG_ FC_Obj6_TypeProb : 31|6@0+ (2.0000000000,0.0000000000) [0.0000000000|100.0000000000] "%"  FC,ADC
 SG_ FC_Obj6_Type : 19|4@0+ (1.0000000000,0.0000000000) [0.0000000000|15.0000000000] ""  FC,ADC
 SG_ FC_Obj6_Track_Age : 314|16@0+ (1.0000000000,0.0000000000) [0.0000000000|65535.0000000000] ""  FC,ADC
 SG_ FC_Obj6_Track_ID : 3|8@0+ (1.0000000000,0.0000000000) [0.0000000000|255.0000000000] ""  FC,ADC

BO_ 358 FC_166: 64 FC
 SG_ FC_Obj7_VehicleDir : 9|3@0+ (1.0000000000,0.0000000000) [0.0000000000|7.0000000000] ""  FC,ADC
 SG_ FC_Obj7ReDoorSts : 11|2@0+ (1.0000000000,0.0000000000) [0.0000000000|3.0000000000] ""  FC,ADC
 SG_ FC_Obj7RiDoorSts : 5|2@0+ (1.0000000000,0.0000000000) [0.0000000000|3.0000000000] ""  FC,ADC
 SG_ FC_Obj7LeDoorSts : 7|2@0+ (1.0000000000,0.0000000000) [0.0000000000|3.0000000000] ""  FC,ADC
 SG_ FC_Obj7WSInfoPosType : 133|4@0+ (1.0000000000,0.0000000000) [0.0000000000|15.0000000000] ""  FC,ADC
 SG_ FC_CRCCheck_166 : 503|16@0+ (1.0000000000,0.0000000000) [0.0000000000|65535.0000000000] ""  FC,ADC
 SG_ FC_RollingCounter_166 : 491|4@0+ (1.0000000000,0.0000000000) [0.0000000000|15.0000000000] ""  FC,ADC
 SG_ FC_Obj7_Img2dBox_RightDown_V : 288|12@0+ (1.0000000000,0.0000000000) [0.0000000000|3000.0000000000] "pix"  FC,ADC
 SG_ FC_Obj7_Img2dBox_LeftTop_V : 284|12@0+ (1.0000000000,0.0000000000) [0.0000000000|3000.0000000000] "pix"  FC,ADC
 SG_ FC_Obj7_Img2dBox_RightDown_U : 264|12@0+ (1.0000000000,0.0000000000) [0.0000000000|4095.0000000000] "pix"  FC,ADC
 SG_ FC_Obj7_Img2dBox_LeftTop_U : 260|12@0+ (1.0000000000,0.0000000000) [0.0000000000|4095.0000000000] "pix"  FC,ADC
 SG_ FC_Obj7_TurnLight : 262|2@0+ (1.0000000000,0.0000000000) [0.0000000000|3.0000000000] ""  FC,ADC
 SG_ FC_Obj7_valid : 263|1@0+ (1.0000000000,0.0000000000) [0.0000000000|1.0000000000] ""  FC,ADC
 SG_ FC_Obj7_Vy_Vnce : 241|10@0+ (0.1250000000,-64.0000000000) [-64.0000000000|63.8750000000] "m/s"  FC,ADC
 SG_ FC_Obj7_Vx_Vnce : 237|12@0+ (0.0625000000,-128.0000000000) [-128.0000000000|127.9375000000] "m/s"  FC,ADC
 SG_ FC_Obj7_CenterAngle : 230|9@0+ (0.0100000000,-1.5700000000) [-1.5700000000|1.5700000000] ""  FC,ADC
 SG_ FC_Obj7_DistInLane : 209|11@0+ (0.0100000000,-10.0000000000) [-10.0000000000|10.0000000000] ""  FC,ADC
 SG_ FC_Obj7_objCutInLane : 211|2@0+ (1.0000000000,0.0000000000) [0.0000000000|2.0000000000] ""  FC,ADC
 SG_ FC_Obj7_objCutInFlag : 201|2@0+ (1.0000000000,0.0000000000) [0.0000000000|2.0000000000] ""  FC,ADC
 SG_ FC_Obj7_CornerPoint_y : 199|14@0+ (0.0100000000,-80.0000000000) [-80.0000000000|80.0000000000] ""  FC,ADC
 SG_ FC_Obj7_CornerPoint_x : 182|15@0+ (0.0100000000,0.0000000000) [0.0000000000|200.0000000000] ""  FC,ADC
 SG_ FC_Obj7_LaneAssignment : 169|3@0+ (1.0000000000,0.0000000000) [0.0000000000|7.0000000000] ""  FC,ADC
 SG_ FC_Obj7_MotionType : 172|3@0+ (1.0000000000,0.0000000000) [0.0000000000|4.0000000000] ""  FC,ADC
 SG_ FC_obj7_Brakelight_Info : 173|1@0+ (1.0000000000,0.0000000000) [0.0000000000|1.0000000000] ""  FC,ADC
 SG_ FC_Obj7_Width : 155|11@0+ (0.0100000000,0.0000000000) [0.0000000000|12.0000000000] "m"  FC,ADC
 SG_ FC_Obj7_Length : 148|9@0+ (0.0500000000,0.0000000000) [0.0000000000|25.5000000000] "m"  FC,ADC
 SG_ FC_Obj7_Height : 141|9@0+ (0.0100000000,0.0000000000) [0.0000000000|5.1100000000] "m"  FC,ADC
 SG_ FC_Obj7_HeadOrientation : 129|4@0+ (1.0000000000,0.0000000000) [0.0000000000|15.0000000000] ""  FC,ADC
 SG_ FC_Obj7_HeadingAngle : 308|10@0+ (0.0100000000,-3.1400000000) [-3.1400000000|3.1400000000] "rad"  FC,ADC
 SG_ FC_Obj7_ExistProb : 112|6@0+ (2.0000000000,0.0000000000) [0.0000000000|100.0000000000] "%"  FC,ADC
 SG_ FC_Obj7_Dy_Vnce : 106|10@0+ (0.0200000000,0.0000000000) [0.0000000000|20.0000000000] "m2"  FC,ADC
 SG_ FC_Obj7_Dy : 88|14@0+ (0.0100000000,-80.0000000000) [-80.0000000000|80.0000000000] "m"  FC,ADC
 SG_ FC_Obj7_Dx_Vnce : 86|14@0+ (0.0500000000,0.0000000000) [0.0000000000|50.0000000000] "m2"  FC,ADC
 SG_ FC_Obj7_Dx : 66|12@0+ (0.0500000000,0.0000000000) [0.0000000000|204.7000000000] "m"  FC,ADC
 SG_ FC_Obj7_RelVy : 60|10@0+ (0.1000000000,-50.0000000000) [-50.0000000000|50.0000000000] "m/s"  FC,ADC
 SG_ FC_Obj7_RelVx : 40|12@0+ (0.1000000000,-154.0000000000) [-154.0000000000|50.0000000000] "m/s"  FC,ADC
 SG_ FC_Obj7_RelAy : 32|8@0+ (0.1000000000,-12.0000000000) [-12.0000000000|12.0000000000] "m/s2"  FC,ADC
 SG_ FC_Obj7_RelAx : 25|9@0+ (0.1000000000,-16.0000000000) [-16.0000000000|16.0000000000] "m/s2"  FC,ADC
 SG_ FC_Obj7_TypeProb : 31|6@0+ (2.0000000000,0.0000000000) [0.0000000000|100.0000000000] "%"  FC,ADC
 SG_ FC_Obj7_Type : 19|4@0+ (1.0000000000,0.0000000000) [0.0000000000|15.0000000000] ""  FC,ADC
 SG_ FC_Obj7_Track_Age : 314|16@0+ (1.0000000000,0.0000000000) [0.0000000000|65535.0000000000] ""  FC,ADC
 SG_ FC_Obj7_Track_ID : 3|8@0+ (1.0000000000,0.0000000000) [0.0000000000|255.0000000000] ""  FC,ADC

BO_ 359 FC_167: 64 FC
 SG_ FC_Obj8_VehicleDir : 9|3@0+ (1.0000000000,0.0000000000) [0.0000000000|7.0000000000] ""  FC,ADC
 SG_ FC_Obj8ReDoorSts : 11|2@0+ (1.0000000000,0.0000000000) [0.0000000000|3.0000000000] ""  FC,ADC
 SG_ FC_Obj8RiDoorSts : 5|2@0+ (1.0000000000,0.0000000000) [0.0000000000|3.0000000000] ""  FC,ADC
 SG_ FC_Obj8LeDoorSts : 7|2@0+ (1.0000000000,0.0000000000) [0.0000000000|3.0000000000] ""  FC,ADC
 SG_ FC_Obj8WSInfoPosType : 133|4@0+ (1.0000000000,0.0000000000) [0.0000000000|15.0000000000] ""  FC,ADC
 SG_ FC_CRCCheck_167 : 503|16@0+ (1.0000000000,0.0000000000) [0.0000000000|65535.0000000000] ""  FC,ADC
 SG_ FC_RollingCounter_167 : 491|4@0+ (1.0000000000,0.0000000000) [0.0000000000|15.0000000000] ""  FC,ADC
 SG_ FC_Obj8_Img2dBox_RightDown_V : 288|12@0+ (1.0000000000,0.0000000000) [0.0000000000|3000.0000000000] "pix"  FC,ADC
 SG_ FC_Obj8_Img2dBox_LeftTop_V : 284|12@0+ (1.0000000000,0.0000000000) [0.0000000000|3000.0000000000] "pix"  FC,ADC
 SG_ FC_Obj8_Img2dBox_RightDown_U : 264|12@0+ (1.0000000000,0.0000000000) [0.0000000000|4095.0000000000] "pix"  FC,ADC
 SG_ FC_Obj8_Img2dBox_LeftTop_U : 260|12@0+ (1.0000000000,0.0000000000) [0.0000000000|4095.0000000000] "pix"  FC,ADC
 SG_ FC_Obj8_TurnLight : 262|2@0+ (1.0000000000,0.0000000000) [0.0000000000|3.0000000000] ""  FC,ADC
 SG_ FC_Obj8_valid : 263|1@0+ (1.0000000000,0.0000000000) [0.0000000000|1.0000000000] ""  FC,ADC
 SG_ FC_Obj8_Vy_Vnce : 241|10@0+ (0.1250000000,-64.0000000000) [-64.0000000000|63.8750000000] "m/s"  FC,ADC
 SG_ FC_Obj8_Vx_Vnce : 237|12@0+ (0.0625000000,-128.0000000000) [-128.0000000000|127.9375000000] "m/s"  FC,ADC
 SG_ FC_Obj8_CenterAngle : 230|9@0+ (0.0100000000,-1.5700000000) [-1.5700000000|1.5700000000] ""  FC,ADC
 SG_ FC_Obj8_DistInLane : 209|11@0+ (0.0100000000,-10.0000000000) [-10.0000000000|10.0000000000] ""  FC,ADC
 SG_ FC_Obj8_objCutInLane : 211|2@0+ (1.0000000000,0.0000000000) [0.0000000000|2.0000000000] ""  FC,ADC
 SG_ FC_Obj8_objCutInFlag : 201|2@0+ (1.0000000000,0.0000000000) [0.0000000000|2.0000000000] ""  FC,ADC
 SG_ FC_Obj8_CornerPoint_y : 199|14@0+ (0.0100000000,-80.0000000000) [-80.0000000000|80.0000000000] ""  FC,ADC
 SG_ FC_Obj8_CornerPoint_x : 182|15@0+ (0.0100000000,0.0000000000) [0.0000000000|200.0000000000] ""  FC,ADC
 SG_ FC_Obj8_LaneAssignment : 169|3@0+ (1.0000000000,0.0000000000) [0.0000000000|7.0000000000] ""  FC,ADC
 SG_ FC_Obj8_MotionType : 172|3@0+ (1.0000000000,0.0000000000) [0.0000000000|4.0000000000] ""  FC,ADC
 SG_ FC_obj8_Brakelight_Info : 173|1@0+ (1.0000000000,0.0000000000) [0.0000000000|1.0000000000] ""  FC,ADC
 SG_ FC_Obj8_Width : 155|11@0+ (0.0100000000,0.0000000000) [0.0000000000|12.0000000000] "m"  FC,ADC
 SG_ FC_Obj8_Length : 148|9@0+ (0.0500000000,0.0000000000) [0.0000000000|25.5000000000] "m"  FC,ADC
 SG_ FC_Obj8_Height : 141|9@0+ (0.0100000000,0.0000000000) [0.0000000000|5.1100000000] "m"  FC,ADC
 SG_ FC_Obj8_HeadOrientation : 129|4@0+ (1.0000000000,0.0000000000) [0.0000000000|15.0000000000] ""  FC,ADC
 SG_ FC_Obj8_HeadingAngle : 308|10@0+ (0.0100000000,-3.1400000000) [-3.1400000000|3.1400000000] "rad"  FC,ADC
 SG_ FC_Obj8_ExistProb : 112|6@0+ (2.0000000000,0.0000000000) [0.0000000000|100.0000000000] "%"  FC,ADC
 SG_ FC_Obj8_Dy_Vnce : 106|10@0+ (0.0200000000,0.0000000000) [0.0000000000|20.0000000000] "m2"  FC,ADC
 SG_ FC_Obj8_Dy : 88|14@0+ (0.0100000000,-80.0000000000) [-80.0000000000|80.0000000000] "m"  FC,ADC
 SG_ FC_Obj8_Dx_Vnce : 86|14@0+ (0.0500000000,0.0000000000) [0.0000000000|50.0000000000] "m2"  FC,ADC
 SG_ FC_Obj8_Dx : 66|12@0+ (0.0500000000,0.0000000000) [0.0000000000|204.7000000000] "m"  FC,ADC
 SG_ FC_Obj8_RelVy : 60|10@0+ (0.1000000000,-50.0000000000) [-50.0000000000|50.0000000000] "m/s"  FC,ADC
 SG_ FC_Obj8_RelVx : 40|12@0+ (0.1000000000,-154.0000000000) [-154.0000000000|50.0000000000] "m/s"  FC,ADC
 SG_ FC_Obj8_RelAy : 32|8@0+ (0.1000000000,-12.0000000000) [-12.0000000000|12.0000000000] "m/s2"  FC,ADC
 SG_ FC_Obj8_RelAx : 25|9@0+ (0.1000000000,-16.0000000000) [-16.0000000000|16.0000000000] "m/s2"  FC,ADC
 SG_ FC_Obj8_TypeProb : 31|6@0+ (2.0000000000,0.0000000000) [0.0000000000|100.0000000000] "%"  FC,ADC
 SG_ FC_Obj8_Type : 19|4@0+ (1.0000000000,0.0000000000) [0.0000000000|15.0000000000] ""  FC,ADC
 SG_ FC_Obj8_Track_Age : 314|16@0+ (1.0000000000,0.0000000000) [0.0000000000|65535.0000000000] ""  FC,ADC
 SG_ FC_Obj8_Track_ID : 3|8@0+ (1.0000000000,0.0000000000) [0.0000000000|255.0000000000] ""  FC,ADC

BO_ 360 FC_168: 64 FC
 SG_ FC_Obj9_VehicleDir : 9|3@0+ (1.0000000000,0.0000000000) [0.0000000000|7.0000000000] ""  FC,ADC
 SG_ FC_Obj9ReDoorSts : 11|2@0+ (1.0000000000,0.0000000000) [0.0000000000|3.0000000000] ""  FC,ADC
 SG_ FC_Obj9RiDoorSts : 5|2@0+ (1.0000000000,0.0000000000) [0.0000000000|3.0000000000] ""  FC,ADC
 SG_ FC_Obj9LeDoorSts : 7|2@0+ (1.0000000000,0.0000000000) [0.0000000000|3.0000000000] ""  FC,ADC
 SG_ FC_Obj9WSInfoPosType : 133|4@0+ (1.0000000000,0.0000000000) [0.0000000000|15.0000000000] ""  FC,ADC
 SG_ FC_CRCCheck_168 : 503|16@0+ (1.0000000000,0.0000000000) [0.0000000000|65535.0000000000] ""  FC,ADC
 SG_ FC_RollingCounter_168 : 491|4@0+ (1.0000000000,0.0000000000) [0.0000000000|15.0000000000] ""  FC,ADC
 SG_ FC_Obj9_Img2dBox_RightDown_V : 288|12@0+ (1.0000000000,0.0000000000) [0.0000000000|3000.0000000000] "pix"  FC,ADC
 SG_ FC_Obj9_Img2dBox_LeftTop_V : 284|12@0+ (1.0000000000,0.0000000000) [0.0000000000|3000.0000000000] "pix"  FC,ADC
 SG_ FC_Obj9_Img2dBox_RightDown_U : 264|12@0+ (1.0000000000,0.0000000000) [0.0000000000|4095.0000000000] "pix"  FC,ADC
 SG_ FC_Obj9_Img2dBox_LeftTop_U : 260|12@0+ (1.0000000000,0.0000000000) [0.0000000000|4095.0000000000] "pix"  FC,ADC
 SG_ FC_Obj9_TurnLight : 262|2@0+ (1.0000000000,0.0000000000) [0.0000000000|3.0000000000] ""  FC,ADC
 SG_ FC_Obj9_valid : 263|1@0+ (1.0000000000,0.0000000000) [0.0000000000|1.0000000000] ""  FC,ADC
 SG_ FC_Obj9_Vy_Vnce : 241|10@0+ (0.1250000000,-64.0000000000) [-64.0000000000|63.8750000000] "m/s"  FC,ADC
 SG_ FC_Obj9_Vx_Vnce : 237|12@0+ (0.0625000000,-128.0000000000) [-128.0000000000|127.9375000000] "m/s"  FC,ADC
 SG_ FC_Obj9_CenterAngle : 230|9@0+ (0.0100000000,-1.5700000000) [-1.5700000000|1.5700000000] ""  FC,ADC
 SG_ FC_Obj9_DistInLane : 209|11@0+ (0.0100000000,-10.0000000000) [-10.0000000000|10.0000000000] ""  FC,ADC
 SG_ FC_Obj9_objCutInLane : 211|2@0+ (1.0000000000,0.0000000000) [0.0000000000|2.0000000000] ""  FC,ADC
 SG_ FC_Obj9_objCutInFlag : 201|2@0+ (1.0000000000,0.0000000000) [0.0000000000|2.0000000000] ""  FC,ADC
 SG_ FC_Obj9_CornerPoint_y : 199|14@0+ (0.0100000000,-80.0000000000) [-80.0000000000|80.0000000000] ""  FC,ADC
 SG_ FC_Obj9_CornerPoint_x : 182|15@0+ (0.0100000000,0.0000000000) [0.0000000000|200.0000000000] ""  FC,ADC
 SG_ FC_Obj9_LaneAssignment : 169|3@0+ (1.0000000000,0.0000000000) [0.0000000000|7.0000000000] ""  FC,ADC
 SG_ FC_Obj9_MotionType : 172|3@0+ (1.0000000000,0.0000000000) [0.0000000000|4.0000000000] ""  FC,ADC
 SG_ FC_obj9_Brakelight_Info : 173|1@0+ (1.0000000000,0.0000000000) [0.0000000000|1.0000000000] ""  FC,ADC
 SG_ FC_Obj9_Width : 155|11@0+ (0.0100000000,0.0000000000) [0.0000000000|12.0000000000] "m"  FC,ADC
 SG_ FC_Obj9_Length : 148|9@0+ (0.0500000000,0.0000000000) [0.0000000000|25.5000000000] "m"  FC,ADC
 SG_ FC_Obj9_Height : 141|9@0+ (0.0100000000,0.0000000000) [0.0000000000|5.1100000000] "m"  FC,ADC
 SG_ FC_Obj9_HeadOrientation : 129|4@0+ (1.0000000000,0.0000000000) [0.0000000000|15.0000000000] ""  FC,ADC
 SG_ FC_Obj9_HeadingAngle : 308|10@0+ (0.0100000000,-3.1400000000) [-3.1400000000|3.1400000000] "rad"  FC,ADC
 SG_ FC_Obj9_ExistProb : 112|6@0+ (2.0000000000,0.0000000000) [0.0000000000|100.0000000000] "%"  FC,ADC
 SG_ FC_Obj9_Dy_Vnce : 106|10@0+ (0.0200000000,0.0000000000) [0.0000000000|20.0000000000] "m2"  FC,ADC
 SG_ FC_Obj9_Dy : 88|14@0+ (0.0100000000,-80.0000000000) [-80.0000000000|80.0000000000] "m"  FC,ADC
 SG_ FC_Obj9_Dx_Vnce : 86|14@0+ (0.0500000000,0.0000000000) [0.0000000000|50.0000000000] "m2"  FC,ADC
 SG_ FC_Obj9_Dx : 66|12@0+ (0.0500000000,0.0000000000) [0.0000000000|204.7000000000] "m"  FC,ADC
 SG_ FC_Obj9_RelVy : 60|10@0+ (0.1000000000,-50.0000000000) [-50.0000000000|50.0000000000] "m/s"  FC,ADC
 SG_ FC_Obj9_RelVx : 40|12@0+ (0.1000000000,-154.0000000000) [-154.0000000000|50.0000000000] "m/s"  FC,ADC
 SG_ FC_Obj9_RelAy : 32|8@0+ (0.1000000000,-12.0000000000) [-12.0000000000|12.0000000000] "m/s2"  FC,ADC
 SG_ FC_Obj9_RelAx : 25|9@0+ (0.1000000000,-16.0000000000) [-16.0000000000|16.0000000000] "m/s2"  FC,ADC
 SG_ FC_Obj9_TypeProb : 31|6@0+ (2.0000000000,0.0000000000) [0.0000000000|100.0000000000] "%"  FC,ADC
 SG_ FC_Obj9_Type : 19|4@0+ (1.0000000000,0.0000000000) [0.0000000000|15.0000000000] ""  FC,ADC
 SG_ FC_Obj9_Track_Age : 314|16@0+ (1.0000000000,0.0000000000) [0.0000000000|65535.0000000000] ""  FC,ADC
 SG_ FC_Obj9_Track_ID : 3|8@0+ (1.0000000000,0.0000000000) [0.0000000000|255.0000000000] ""  FC,ADC

BO_ 361 FC_169: 64 FC
 SG_ FC_Obj10_VehicleDir : 9|3@0+ (1.0000000000,0.0000000000) [0.0000000000|7.0000000000] ""  FC,ADC
 SG_ FC_Obj10ReDoorSts : 11|2@0+ (1.0000000000,0.0000000000) [0.0000000000|3.0000000000] ""  FC,ADC
 SG_ FC_Obj10RiDoorSts : 5|2@0+ (1.0000000000,0.0000000000) [0.0000000000|3.0000000000] ""  FC,ADC
 SG_ FC_Obj10LeDoorSts : 7|2@0+ (1.0000000000,0.0000000000) [0.0000000000|3.0000000000] ""  FC,ADC
 SG_ FC_Obj10WSInfoPosType : 133|4@0+ (1.0000000000,0.0000000000) [0.0000000000|15.0000000000] ""  FC,ADC
 SG_ FC_CRCCheck_169 : 503|16@0+ (1.0000000000,0.0000000000) [0.0000000000|65535.0000000000] ""  FC,ADC
 SG_ FC_RollingCounter_169 : 491|4@0+ (1.0000000000,0.0000000000) [0.0000000000|15.0000000000] ""  FC,ADC
 SG_ FC_Obj10_Img2dBox_RightDown_V : 288|12@0+ (1.0000000000,0.0000000000) [0.0000000000|3000.0000000000] "pix"  FC,ADC
 SG_ FC_Obj10_Img2dBox_LeftTop_V : 284|12@0+ (1.0000000000,0.0000000000) [0.0000000000|3000.0000000000] "pix"  FC,ADC
 SG_ FC_Obj10_Img2dBox_RightDown_U : 264|12@0+ (1.0000000000,0.0000000000) [0.0000000000|4095.0000000000] "pix"  FC,ADC
 SG_ FC_Obj10_Img2dBox_LeftTop_U : 260|12@0+ (1.0000000000,0.0000000000) [0.0000000000|4095.0000000000] "pix"  FC,ADC
 SG_ FC_Obj10_TurnLight : 262|2@0+ (1.0000000000,0.0000000000) [0.0000000000|3.0000000000] ""  FC,ADC
 SG_ FC_Obj10_valid : 263|1@0+ (1.0000000000,0.0000000000) [0.0000000000|1.0000000000] ""  FC,ADC
 SG_ FC_Obj10_Vy_Vnce : 241|10@0+ (0.1250000000,-64.0000000000) [-64.0000000000|63.8750000000] "m/s"  FC,ADC
 SG_ FC_Obj10_Vx_Vnce : 237|12@0+ (0.0625000000,-128.0000000000) [-128.0000000000|127.9375000000] "m/s"  FC,ADC
 SG_ FC_Obj10_CenterAngle : 230|9@0+ (0.0100000000,-1.5700000000) [-1.5700000000|1.5700000000] ""  FC,ADC
 SG_ FC_Obj10_DistInLane : 209|11@0+ (0.0100000000,-10.0000000000) [-10.0000000000|10.0000000000] ""  FC,ADC
 SG_ FC_Obj10_objCutInLane : 211|2@0+ (1.0000000000,0.0000000000) [0.0000000000|2.0000000000] ""  FC,ADC
 SG_ FC_Obj10_objCutInFlag : 201|2@0+ (1.0000000000,0.0000000000) [0.0000000000|2.0000000000] ""  FC,ADC
 SG_ FC_Obj10_CornerPoint_y : 199|14@0+ (0.0100000000,-80.0000000000) [-80.0000000000|80.0000000000] ""  FC,ADC
 SG_ FC_Obj10_CornerPoint_x : 182|15@0+ (0.0100000000,0.0000000000) [0.0000000000|200.0000000000] ""  FC,ADC
 SG_ FC_Obj10_LaneAssignment : 169|3@0+ (1.0000000000,0.0000000000) [0.0000000000|7.0000000000] ""  FC,ADC
 SG_ FC_Obj10_MotionType : 172|3@0+ (1.0000000000,0.0000000000) [0.0000000000|4.0000000000] ""  FC,ADC
 SG_ FC_obj10_Brakelight_Info : 173|1@0+ (1.0000000000,0.0000000000) [0.0000000000|1.0000000000] ""  FC,ADC
 SG_ FC_Obj10_Width : 155|11@0+ (0.0100000000,0.0000000000) [0.0000000000|12.0000000000] "m"  FC,ADC
 SG_ FC_Obj10_Length : 148|9@0+ (0.0500000000,0.0000000000) [0.0000000000|25.5000000000] "m"  FC,ADC
 SG_ FC_Obj10_Height : 141|9@0+ (0.0100000000,0.0000000000) [0.0000000000|5.1100000000] "m"  FC,ADC
 SG_ FC_Obj10_HeadOrientation : 129|4@0+ (1.0000000000,0.0000000000) [0.0000000000|15.0000000000] ""  FC,ADC
 SG_ FC_Obj10_HeadingAngle : 308|10@0+ (0.0100000000,-3.1400000000) [-3.1400000000|3.1400000000] "rad"  FC,ADC
 SG_ FC_Obj10_ExistProb : 112|6@0+ (2.0000000000,0.0000000000) [0.0000000000|100.0000000000] "%"  FC,ADC
 SG_ FC_Obj10_Dy_Vnce : 106|10@0+ (0.0200000000,0.0000000000) [0.0000000000|20.0000000000] "m2"  FC,ADC
 SG_ FC_Obj10_Dy : 88|14@0+ (0.0100000000,-80.0000000000) [-80.0000000000|80.0000000000] "m"  FC,ADC
 SG_ FC_Obj10_Dx_Vnce : 86|14@0+ (0.0500000000,0.0000000000) [0.0000000000|50.0000000000] "m2"  FC,ADC
 SG_ FC_Obj10_Dx : 66|12@0+ (0.0500000000,0.0000000000) [0.0000000000|204.7000000000] "m"  FC,ADC
 SG_ FC_Obj10_RelVy : 60|10@0+ (0.1000000000,-50.0000000000) [-50.0000000000|50.0000000000] "m/s"  FC,ADC
 SG_ FC_Obj10_RelVx : 40|12@0+ (0.1000000000,-154.0000000000) [-154.0000000000|50.0000000000] "m/s"  FC,ADC
 SG_ FC_Obj10_RelAy : 32|8@0+ (0.1000000000,-12.0000000000) [-12.0000000000|12.0000000000] "m/s2"  FC,ADC
 SG_ FC_Obj10_RelAx : 25|9@0+ (0.1000000000,-16.0000000000) [-16.0000000000|16.0000000000] "m/s2"  FC,ADC
 SG_ FC_Obj10_TypeProb : 31|6@0+ (2.0000000000,0.0000000000) [0.0000000000|100.0000000000] "%"  FC,ADC
 SG_ FC_Obj10_Type : 19|4@0+ (1.0000000000,0.0000000000) [0.0000000000|15.0000000000] ""  FC,ADC
 SG_ FC_Obj10_Track_Age : 314|16@0+ (1.0000000000,0.0000000000) [0.0000000000|65535.0000000000] ""  FC,ADC
 SG_ FC_Obj10_Track_ID : 3|8@0+ (1.0000000000,0.0000000000) [0.0000000000|255.0000000000] ""  FC,ADC

BO_ 368 FC_170: 64 FC
 SG_ FC_Obj11_VehicleDir : 9|3@0+ (1.0000000000,0.0000000000) [0.0000000000|7.0000000000] ""  FC,ADC
 SG_ FC_Obj11ReDoorSts : 11|2@0+ (1.0000000000,0.0000000000) [0.0000000000|3.0000000000] ""  FC,ADC
 SG_ FC_Obj11RiDoorSts : 5|2@0+ (1.0000000000,0.0000000000) [0.0000000000|3.0000000000] ""  FC,ADC
 SG_ FC_Obj11LeDoorSts : 7|2@0+ (1.0000000000,0.0000000000) [0.0000000000|3.0000000000] ""  FC,ADC
 SG_ FC_Obj11WSInfoPosType : 133|4@0+ (1.0000000000,0.0000000000) [0.0000000000|15.0000000000] ""  FC,ADC
 SG_ FC_CRCCheck_170 : 503|16@0+ (1.0000000000,0.0000000000) [0.0000000000|65535.0000000000] ""  FC,ADC
 SG_ FC_RollingCounter_170 : 491|4@0+ (1.0000000000,0.0000000000) [0.0000000000|15.0000000000] ""  FC,ADC
 SG_ FC_Obj11_Img2dBox_RightDown_V : 288|12@0+ (1.0000000000,0.0000000000) [0.0000000000|3000.0000000000] "pix"  FC,ADC
 SG_ FC_Obj11_Img2dBox_LeftTop_V : 284|12@0+ (1.0000000000,0.0000000000) [0.0000000000|3000.0000000000] "pix"  FC,ADC
 SG_ FC_Obj11_Img2dBox_RightDown_U : 264|12@0+ (1.0000000000,0.0000000000) [0.0000000000|4095.0000000000] "pix"  FC,ADC
 SG_ FC_Obj11_Img2dBox_LeftTop_U : 260|12@0+ (1.0000000000,0.0000000000) [0.0000000000|4095.0000000000] "pix"  FC,ADC
 SG_ FC_Obj11_TurnLight : 262|2@0+ (1.0000000000,0.0000000000) [0.0000000000|3.0000000000] ""  FC,ADC
 SG_ FC_Obj11_valid : 263|1@0+ (1.0000000000,0.0000000000) [0.0000000000|1.0000000000] ""  FC,ADC
 SG_ FC_Obj11_Vy_Vnce : 241|10@0+ (0.1250000000,-64.0000000000) [-64.0000000000|63.8750000000] "m/s"  FC,ADC
 SG_ FC_Obj11_Vx_Vnce : 237|12@0+ (0.0625000000,-128.0000000000) [-128.0000000000|127.9375000000] "m/s"  FC,ADC
 SG_ FC_Obj11_CenterAngle : 230|9@0+ (0.0100000000,-1.5700000000) [-1.5700000000|1.5700000000] ""  FC,ADC
 SG_ FC_Obj11_DistInLane : 209|11@0+ (0.0100000000,-10.0000000000) [-10.0000000000|10.0000000000] ""  FC,ADC
 SG_ FC_Obj11_objCutInLane : 211|2@0+ (1.0000000000,0.0000000000) [0.0000000000|2.0000000000] ""  FC,ADC
 SG_ FC_Obj11_objCutInFlag : 201|2@0+ (1.0000000000,0.0000000000) [0.0000000000|2.0000000000] ""  FC,ADC
 SG_ FC_Obj11_CornerPoint_y : 199|14@0+ (0.0100000000,-80.0000000000) [-80.0000000000|80.0000000000] ""  FC,ADC
 SG_ FC_Obj11_CornerPoint_x : 182|15@0+ (0.0100000000,0.0000000000) [0.0000000000|200.0000000000] ""  FC,ADC
 SG_ FC_Obj11_LaneAssignment : 169|3@0+ (1.0000000000,0.0000000000) [0.0000000000|7.0000000000] ""  FC,ADC
 SG_ FC_Obj11_MotionType : 172|3@0+ (1.0000000000,0.0000000000) [0.0000000000|4.0000000000] ""  FC,ADC
 SG_ FC_obj11_Brakelight_Info : 173|1@0+ (1.0000000000,0.0000000000) [0.0000000000|1.0000000000] ""  FC,ADC
 SG_ FC_Obj11_Width : 155|11@0+ (0.0100000000,0.0000000000) [0.0000000000|12.0000000000] "m"  FC,ADC
 SG_ FC_Obj11_Length : 148|9@0+ (0.0500000000,0.0000000000) [0.0000000000|25.5000000000] "m"  FC,ADC
 SG_ FC_Obj11_Height : 141|9@0+ (0.0100000000,0.0000000000) [0.0000000000|5.1100000000] "m"  FC,ADC
 SG_ FC_Obj11_HeadOrientation : 129|4@0+ (1.0000000000,0.0000000000) [0.0000000000|15.0000000000] ""  FC,ADC
 SG_ FC_Obj11_HeadingAngle : 308|10@0+ (0.0100000000,-3.1400000000) [-3.1400000000|3.1400000000] "rad"  FC,ADC
 SG_ FC_Obj11_ExistProb : 112|6@0+ (2.0000000000,0.0000000000) [0.0000000000|100.0000000000] "%"  FC,ADC
 SG_ FC_Obj11_Dy_Vnce : 106|10@0+ (0.0200000000,0.0000000000) [0.0000000000|20.0000000000] "m2"  FC,ADC
 SG_ FC_Obj11_Dy : 88|14@0+ (0.0100000000,-80.0000000000) [-80.0000000000|80.0000000000] "m"  FC,ADC
 SG_ FC_Obj11_Dx_Vnce : 86|14@0+ (0.0500000000,0.0000000000) [0.0000000000|50.0000000000] "m2"  FC,ADC
 SG_ FC_Obj11_Dx : 66|12@0+ (0.0500000000,0.0000000000) [0.0000000000|204.7000000000] "m"  FC,ADC
 SG_ FC_Obj11_RelVy : 60|10@0+ (0.1000000000,-50.0000000000) [-50.0000000000|50.0000000000] "m/s"  FC,ADC
 SG_ FC_Obj11_RelVx : 40|12@0+ (0.1000000000,-154.0000000000) [-154.0000000000|50.0000000000] "m/s"  FC,ADC
 SG_ FC_Obj11_RelAy : 32|8@0+ (0.1000000000,-12.0000000000) [-12.0000000000|12.0000000000] "m/s2"  FC,ADC
 SG_ FC_Obj11_RelAx : 25|9@0+ (0.1000000000,-16.0000000000) [-16.0000000000|16.0000000000] "m/s2"  FC,ADC
 SG_ FC_Obj11_TypeProb : 31|6@0+ (2.0000000000,0.0000000000) [0.0000000000|100.0000000000] "%"  FC,ADC
 SG_ FC_Obj11_Type : 19|4@0+ (1.0000000000,0.0000000000) [0.0000000000|15.0000000000] ""  FC,ADC
 SG_ FC_Obj11_Track_Age : 314|16@0+ (1.0000000000,0.0000000000) [0.0000000000|65535.0000000000] ""  FC,ADC
 SG_ FC_Obj11_Track_ID : 3|8@0+ (1.0000000000,0.0000000000) [0.0000000000|255.0000000000] ""  FC,ADC

BO_ 369 FC_171: 64 FC
 SG_ FC_Obj12_VehicleDir : 9|3@0+ (1.0000000000,0.0000000000) [0.0000000000|7.0000000000] ""  FC,ADC
 SG_ FC_Obj12ReDoorSts : 11|2@0+ (1.0000000000,0.0000000000) [0.0000000000|3.0000000000] ""  FC,ADC
 SG_ FC_Obj12RiDoorSts : 5|2@0+ (1.0000000000,0.0000000000) [0.0000000000|3.0000000000] ""  FC,ADC
 SG_ FC_Obj12LeDoorSts : 7|2@0+ (1.0000000000,0.0000000000) [0.0000000000|3.0000000000] ""  FC,ADC
 SG_ FC_Obj12WSInfoPosType : 133|4@0+ (1.0000000000,0.0000000000) [0.0000000000|15.0000000000] ""  FC,ADC
 SG_ FC_CRCCheck_171 : 503|16@0+ (1.0000000000,0.0000000000) [0.0000000000|65535.0000000000] ""  FC,ADC
 SG_ FC_RollingCounter_171 : 491|4@0+ (1.0000000000,0.0000000000) [0.0000000000|15.0000000000] ""  FC,ADC
 SG_ FC_Obj12_Img2dBox_RightDown_V : 288|12@0+ (1.0000000000,0.0000000000) [0.0000000000|3000.0000000000] "pix"  FC,ADC
 SG_ FC_Obj12_Img2dBox_LeftTop_V : 284|12@0+ (1.0000000000,0.0000000000) [0.0000000000|3000.0000000000] "pix"  FC,ADC
 SG_ FC_Obj12_Img2dBox_RightDown_U : 264|12@0+ (1.0000000000,0.0000000000) [0.0000000000|4095.0000000000] "pix"  FC,ADC
 SG_ FC_Obj12_Img2dBox_LeftTop_U : 260|12@0+ (1.0000000000,0.0000000000) [0.0000000000|4095.0000000000] "pix"  FC,ADC
 SG_ FC_Obj12_TurnLight : 262|2@0+ (1.0000000000,0.0000000000) [0.0000000000|3.0000000000] ""  FC,ADC
 SG_ FC_Obj12_valid : 263|1@0+ (1.0000000000,0.0000000000) [0.0000000000|1.0000000000] ""  FC,ADC
 SG_ FC_Obj12_Vy_Vnce : 241|10@0+ (0.1250000000,-64.0000000000) [-64.0000000000|63.8750000000] "m/s"  FC,ADC
 SG_ FC_Obj12_Vx_Vnce : 237|12@0+ (0.0625000000,-128.0000000000) [-128.0000000000|127.9375000000] "m/s"  FC,ADC
 SG_ FC_Obj12_CenterAngle : 230|9@0+ (0.0100000000,-1.5700000000) [-1.5700000000|1.5700000000] ""  FC,ADC
 SG_ FC_Obj12_DistInLane : 209|11@0+ (0.0100000000,-10.0000000000) [-10.0000000000|10.0000000000] ""  FC,ADC
 SG_ FC_Obj12_objCutInLane : 211|2@0+ (1.0000000000,0.0000000000) [0.0000000000|2.0000000000] ""  FC,ADC
 SG_ FC_Obj12_objCutInFlag : 201|2@0+ (1.0000000000,0.0000000000) [0.0000000000|2.0000000000] ""  FC,ADC
 SG_ FC_Obj12_CornerPoint_y : 199|14@0+ (0.0100000000,-80.0000000000) [-80.0000000000|80.0000000000] ""  FC,ADC
 SG_ FC_Obj12_CornerPoint_x : 182|15@0+ (0.0100000000,0.0000000000) [0.0000000000|200.0000000000] ""  FC,ADC
 SG_ FC_Obj12_LaneAssignment : 169|3@0+ (1.0000000000,0.0000000000) [0.0000000000|7.0000000000] ""  FC,ADC
 SG_ FC_Obj12_MotionType : 172|3@0+ (1.0000000000,0.0000000000) [0.0000000000|4.0000000000] ""  FC,ADC
 SG_ FC_obj12_Brakelight_Info : 173|1@0+ (1.0000000000,0.0000000000) [0.0000000000|1.0000000000] ""  FC,ADC
 SG_ FC_Obj12_Width : 155|11@0+ (0.0100000000,0.0000000000) [0.0000000000|12.0000000000] "m"  FC,ADC
 SG_ FC_Obj12_Length : 148|9@0+ (0.0500000000,0.0000000000) [0.0000000000|25.5000000000] "m"  FC,ADC
 SG_ FC_Obj12_Height : 141|9@0+ (0.0100000000,0.0000000000) [0.0000000000|5.1100000000] "m"  FC,ADC
 SG_ FC_Obj12_HeadOrientation : 129|4@0+ (1.0000000000,0.0000000000) [0.0000000000|15.0000000000] ""  FC,ADC
 SG_ FC_Obj12_HeadingAngle : 308|10@0+ (0.0100000000,-3.1400000000) [-3.1400000000|3.1400000000] "rad"  FC,ADC
 SG_ FC_Obj12_ExistProb : 112|6@0+ (2.0000000000,0.0000000000) [0.0000000000|100.0000000000] "%"  FC,ADC
 SG_ FC_Obj12_Dy_Vnce : 106|10@0+ (0.0200000000,0.0000000000) [0.0000000000|20.0000000000] "m2"  FC,ADC
 SG_ FC_Obj12_Dy : 88|14@0+ (0.0100000000,-80.0000000000) [-80.0000000000|80.0000000000] "m"  FC,ADC
 SG_ FC_Obj12_Dx_Vnce : 86|14@0+ (0.0500000000,0.0000000000) [0.0000000000|50.0000000000] "m2"  FC,ADC
 SG_ FC_Obj12_Dx : 66|12@0+ (0.0500000000,0.0000000000) [0.0000000000|204.7000000000] "m"  FC,ADC
 SG_ FC_Obj12_RelVy : 60|10@0+ (0.1000000000,-50.0000000000) [-50.0000000000|50.0000000000] "m/s"  FC,ADC
 SG_ FC_Obj12_RelVx : 40|12@0+ (0.1000000000,-154.0000000000) [-154.0000000000|50.0000000000] "m/s"  FC,ADC
 SG_ FC_Obj12_RelAy : 32|8@0+ (0.1000000000,-12.0000000000) [-12.0000000000|12.0000000000] "m/s2"  FC,ADC
 SG_ FC_Obj12_RelAx : 25|9@0+ (0.1000000000,-16.0000000000) [-16.0000000000|16.0000000000] "m/s2"  FC,ADC
 SG_ FC_Obj12_TypeProb : 31|6@0+ (2.0000000000,0.0000000000) [0.0000000000|100.0000000000] "%"  FC,ADC
 SG_ FC_Obj12_Type : 19|4@0+ (1.0000000000,0.0000000000) [0.0000000000|15.0000000000] ""  FC,ADC
 SG_ FC_Obj12_Track_Age : 314|16@0+ (1.0000000000,0.0000000000) [0.0000000000|65535.0000000000] ""  FC,ADC
 SG_ FC_Obj12_Track_ID : 3|8@0+ (1.0000000000,0.0000000000) [0.0000000000|255.0000000000] ""  FC,ADC

BO_ 370 FC_172: 64 FC
 SG_ FC_Obj13_VehicleDir : 9|3@0+ (1.0000000000,0.0000000000) [0.0000000000|7.0000000000] ""  FC,ADC
 SG_ FC_Obj13ReDoorSts : 11|2@0+ (1.0000000000,0.0000000000) [0.0000000000|3.0000000000] ""  FC,ADC
 SG_ FC_Obj13RiDoorSts : 5|2@0+ (1.0000000000,0.0000000000) [0.0000000000|3.0000000000] ""  FC,ADC
 SG_ FC_Obj13LeDoorSts : 7|2@0+ (1.0000000000,0.0000000000) [0.0000000000|3.0000000000] ""  FC,ADC
 SG_ FC_Obj13WSInfoPosType : 133|4@0+ (1.0000000000,0.0000000000) [0.0000000000|15.0000000000] ""  FC,ADC
 SG_ FC_CRCCheck_172 : 503|16@0+ (1.0000000000,0.0000000000) [0.0000000000|65535.0000000000] ""  FC,ADC
 SG_ FC_RollingCounter_172 : 491|4@0+ (1.0000000000,0.0000000000) [0.0000000000|15.0000000000] ""  FC,ADC
 SG_ FC_Obj13_Img2dBox_RightDown_V : 288|12@0+ (1.0000000000,0.0000000000) [0.0000000000|3000.0000000000] "pix"  FC,ADC
 SG_ FC_Obj13_Img2dBox_LeftTop_V : 284|12@0+ (1.0000000000,0.0000000000) [0.0000000000|3000.0000000000] "pix"  FC,ADC
 SG_ FC_Obj13_Img2dBox_RightDown_U : 264|12@0+ (1.0000000000,0.0000000000) [0.0000000000|4095.0000000000] "pix"  FC,ADC
 SG_ FC_Obj13_Img2dBox_LeftTop_U : 260|12@0+ (1.0000000000,0.0000000000) [0.0000000000|4095.0000000000] "pix"  FC,ADC
 SG_ FC_Obj13_TurnLight : 262|2@0+ (1.0000000000,0.0000000000) [0.0000000000|3.0000000000] ""  FC,ADC
 SG_ FC_Obj13_valid : 263|1@0+ (1.0000000000,0.0000000000) [0.0000000000|1.0000000000] ""  FC,ADC
 SG_ FC_Obj13_Vy_Vnce : 241|10@0+ (0.1250000000,-64.0000000000) [-64.0000000000|63.8750000000] "m/s"  FC,ADC
 SG_ FC_Obj13_Vx_Vnce : 237|12@0+ (0.0625000000,-128.0000000000) [-128.0000000000|127.9375000000] "m/s"  FC,ADC
 SG_ FC_Obj13_CenterAngle : 230|9@0+ (0.0100000000,-1.5700000000) [-1.5700000000|1.5700000000] ""  FC,ADC
 SG_ FC_Obj13_DistInLane : 209|11@0+ (0.0100000000,-10.0000000000) [-10.0000000000|10.0000000000] ""  FC,ADC
 SG_ FC_Obj13_objCutInLane : 211|2@0+ (1.0000000000,0.0000000000) [0.0000000000|2.0000000000] ""  FC,ADC
 SG_ FC_Obj13_objCutInFlag : 201|2@0+ (1.0000000000,0.0000000000) [0.0000000000|2.0000000000] ""  FC,ADC
 SG_ FC_Obj13_CornerPoint_y : 199|14@0+ (0.0100000000,-80.0000000000) [-80.0000000000|80.0000000000] ""  FC,ADC
 SG_ FC_Obj13_CornerPoint_x : 182|15@0+ (0.0100000000,0.0000000000) [0.0000000000|200.0000000000] ""  FC,ADC
 SG_ FC_Obj13_LaneAssignment : 169|3@0+ (1.0000000000,0.0000000000) [0.0000000000|7.0000000000] ""  FC,ADC
 SG_ FC_Obj13_MotionType : 172|3@0+ (1.0000000000,0.0000000000) [0.0000000000|4.0000000000] ""  FC,ADC
 SG_ FC_obj13_Brakelight_Info : 173|1@0+ (1.0000000000,0.0000000000) [0.0000000000|1.0000000000] ""  FC,ADC
 SG_ FC_Obj13_Width : 155|11@0+ (0.0100000000,0.0000000000) [0.0000000000|12.0000000000] "m"  FC,ADC
 SG_ FC_Obj13_Length : 148|9@0+ (0.0500000000,0.0000000000) [0.0000000000|25.5000000000] "m"  FC,ADC
 SG_ FC_Obj13_Height : 141|9@0+ (0.0100000000,0.0000000000) [0.0000000000|5.1100000000] "m"  FC,ADC
 SG_ FC_Obj13_HeadOrientation : 129|4@0+ (1.0000000000,0.0000000000) [0.0000000000|15.0000000000] ""  FC,ADC
 SG_ FC_Obj13_HeadingAngle : 308|10@0+ (0.0100000000,-3.1400000000) [-3.1400000000|3.1400000000] "rad"  FC,ADC
 SG_ FC_Obj13_ExistProb : 112|6@0+ (2.0000000000,0.0000000000) [0.0000000000|100.0000000000] "%"  FC,ADC
 SG_ FC_Obj13_Dy_Vnce : 106|10@0+ (0.0200000000,0.0000000000) [0.0000000000|20.0000000000] "m2"  FC,ADC
 SG_ FC_Obj13_Dy : 88|14@0+ (0.0100000000,-80.0000000000) [-80.0000000000|80.0000000000] "m"  FC,ADC
 SG_ FC_Obj13_Dx_Vnce : 86|14@0+ (0.0500000000,0.0000000000) [0.0000000000|50.0000000000] "m2"  FC,ADC
 SG_ FC_Obj13_Dx : 66|12@0+ (0.0500000000,0.0000000000) [0.0000000000|204.7000000000] "m"  FC,ADC
 SG_ FC_Obj13_RelVy : 60|10@0+ (0.1000000000,-50.0000000000) [-50.0000000000|50.0000000000] "m/s"  FC,ADC
 SG_ FC_Obj13_RelVx : 40|12@0+ (0.1000000000,-154.0000000000) [-154.0000000000|50.0000000000] "m/s"  FC,ADC
 SG_ FC_Obj13_RelAy : 32|8@0+ (0.1000000000,-12.0000000000) [-12.0000000000|12.0000000000] "m/s2"  FC,ADC
 SG_ FC_Obj13_RelAx : 25|9@0+ (0.1000000000,-16.0000000000) [-16.0000000000|16.0000000000] "m/s2"  FC,ADC
 SG_ FC_Obj13_TypeProb : 31|6@0+ (2.0000000000,0.0000000000) [0.0000000000|100.0000000000] "%"  FC,ADC
 SG_ FC_Obj13_Type : 19|4@0+ (1.0000000000,0.0000000000) [0.0000000000|15.0000000000] ""  FC,ADC
 SG_ FC_Obj13_Track_Age : 314|16@0+ (1.0000000000,0.0000000000) [0.0000000000|65535.0000000000] ""  FC,ADC
 SG_ FC_Obj13_Track_ID : 3|8@0+ (1.0000000000,0.0000000000) [0.0000000000|255.0000000000] ""  FC,ADC

BO_ 371 FC_173: 64 FC
 SG_ FC_Obj14_VehicleDir : 9|3@0+ (1.0000000000,0.0000000000) [0.0000000000|7.0000000000] ""  FC,ADC
 SG_ FC_Obj14ReDoorSts : 11|2@0+ (1.0000000000,0.0000000000) [0.0000000000|3.0000000000] ""  FC,ADC
 SG_ FC_Obj14RiDoorSts : 5|2@0+ (1.0000000000,0.0000000000) [0.0000000000|3.0000000000] ""  FC,ADC
 SG_ FC_Obj14LeDoorSts : 7|2@0+ (1.0000000000,0.0000000000) [0.0000000000|3.0000000000] ""  FC,ADC
 SG_ FC_Obj14WSInfoPosType : 133|4@0+ (1.0000000000,0.0000000000) [0.0000000000|15.0000000000] ""  FC,ADC
 SG_ FC_CRCCheck_173 : 503|16@0+ (1.0000000000,0.0000000000) [0.0000000000|65535.0000000000] ""  FC,ADC
 SG_ FC_RollingCounter_173 : 491|4@0+ (1.0000000000,0.0000000000) [0.0000000000|15.0000000000] ""  FC,ADC
 SG_ FC_Obj14_Img2dBox_RightDown_V : 288|12@0+ (1.0000000000,0.0000000000) [0.0000000000|3000.0000000000] "pix"  FC,ADC
 SG_ FC_Obj14_Img2dBox_LeftTop_V : 284|12@0+ (1.0000000000,0.0000000000) [0.0000000000|3000.0000000000] "pix"  FC,ADC
 SG_ FC_Obj14_Img2dBox_RightDown_U : 264|12@0+ (1.0000000000,0.0000000000) [0.0000000000|4095.0000000000] "pix"  FC,ADC
 SG_ FC_Obj14_Img2dBox_LeftTop_U : 260|12@0+ (1.0000000000,0.0000000000) [0.0000000000|4095.0000000000] "pix"  FC,ADC
 SG_ FC_Obj14_TurnLight : 262|2@0+ (1.0000000000,0.0000000000) [0.0000000000|3.0000000000] ""  FC,ADC
 SG_ FC_Obj14_valid : 263|1@0+ (1.0000000000,0.0000000000) [0.0000000000|1.0000000000] ""  FC,ADC
 SG_ FC_Obj14_Vy_Vnce : 241|10@0+ (0.1250000000,-64.0000000000) [-64.0000000000|63.8750000000] "m/s"  FC,ADC
 SG_ FC_Obj14_Vx_Vnce : 237|12@0+ (0.0625000000,-128.0000000000) [-128.0000000000|127.9375000000] "m/s"  FC,ADC
 SG_ FC_Obj14_CenterAngle : 230|9@0+ (0.0100000000,-1.5700000000) [-1.5700000000|1.5700000000] ""  FC,ADC
 SG_ FC_Obj14_DistInLane : 209|11@0+ (0.0100000000,-10.0000000000) [-10.0000000000|10.0000000000] ""  FC,ADC
 SG_ FC_Obj14_objCutInLane : 211|2@0+ (1.0000000000,0.0000000000) [0.0000000000|2.0000000000] ""  FC,ADC
 SG_ FC_Obj14_objCutInFlag : 201|2@0+ (1.0000000000,0.0000000000) [0.0000000000|2.0000000000] ""  FC,ADC
 SG_ FC_Obj14_CornerPoint_y : 199|14@0+ (0.0100000000,-80.0000000000) [-80.0000000000|80.0000000000] ""  FC,ADC
 SG_ FC_Obj14_CornerPoint_x : 182|15@0+ (0.0100000000,0.0000000000) [0.0000000000|200.0000000000] ""  FC,ADC
 SG_ FC_Obj14_LaneAssignment : 169|3@0+ (1.0000000000,0.0000000000) [0.0000000000|7.0000000000] ""  FC,ADC
 SG_ FC_Obj14_MotionType : 172|3@0+ (1.0000000000,0.0000000000) [0.0000000000|4.0000000000] ""  FC,ADC
 SG_ FC_obj14_Brakelight_Info : 173|1@0+ (1.0000000000,0.0000000000) [0.0000000000|1.0000000000] ""  FC,ADC
 SG_ FC_Obj14_Width : 155|11@0+ (0.0100000000,0.0000000000) [0.0000000000|12.0000000000] "m"  FC,ADC
 SG_ FC_Obj14_Length : 148|9@0+ (0.0500000000,0.0000000000) [0.0000000000|25.5000000000] "m"  FC,ADC
 SG_ FC_Obj14_Height : 141|9@0+ (0.0100000000,0.0000000000) [0.0000000000|5.1100000000] "m"  FC,ADC
 SG_ FC_Obj14_HeadOrientation : 129|4@0+ (1.0000000000,0.0000000000) [0.0000000000|15.0000000000] ""  FC,ADC
 SG_ FC_Obj14_HeadingAngle : 308|10@0+ (0.0100000000,-3.1400000000) [-3.1400000000|3.1400000000] "rad"  FC,ADC
 SG_ FC_Obj14_ExistProb : 112|6@0+ (2.0000000000,0.0000000000) [0.0000000000|100.0000000000] "%"  FC,ADC
 SG_ FC_Obj14_Dy_Vnce : 106|10@0+ (0.0200000000,0.0000000000) [0.0000000000|20.0000000000] "m2"  FC,ADC
 SG_ FC_Obj14_Dy : 88|14@0+ (0.0100000000,-80.0000000000) [-80.0000000000|80.0000000000] "m"  FC,ADC
 SG_ FC_Obj14_Dx_Vnce : 86|14@0+ (0.0500000000,0.0000000000) [0.0000000000|50.0000000000] "m2"  FC,ADC
 SG_ FC_Obj14_Dx : 66|12@0+ (0.0500000000,0.0000000000) [0.0000000000|204.7000000000] "m"  FC,ADC
 SG_ FC_Obj14_RelVy : 60|10@0+ (0.1000000000,-50.0000000000) [-50.0000000000|50.0000000000] "m/s"  FC,ADC
 SG_ FC_Obj14_RelVx : 40|12@0+ (0.1000000000,-154.0000000000) [-154.0000000000|50.0000000000] "m/s"  FC,ADC
 SG_ FC_Obj14_RelAy : 32|8@0+ (0.1000000000,-12.0000000000) [-12.0000000000|12.0000000000] "m/s2"  FC,ADC
 SG_ FC_Obj14_RelAx : 25|9@0+ (0.1000000000,-16.0000000000) [-16.0000000000|16.0000000000] "m/s2"  FC,ADC
 SG_ FC_Obj14_TypeProb : 31|6@0+ (2.0000000000,0.0000000000) [0.0000000000|100.0000000000] "%"  FC,ADC
 SG_ FC_Obj14_Type : 19|4@0+ (1.0000000000,0.0000000000) [0.0000000000|15.0000000000] ""  FC,ADC
 SG_ FC_Obj14_Track_Age : 314|16@0+ (1.0000000000,0.0000000000) [0.0000000000|65535.0000000000] ""  FC,ADC
 SG_ FC_Obj14_Track_ID : 3|8@0+ (1.0000000000,0.0000000000) [0.0000000000|255.0000000000] ""  FC,ADC

BO_ 372 FC_174: 64 FC
 SG_ FC_Obj15_VehicleDir : 9|3@0+ (1.0000000000,0.0000000000) [0.0000000000|7.0000000000] ""  FC,ADC
 SG_ FC_Obj15ReDoorSts : 11|2@0+ (1.0000000000,0.0000000000) [0.0000000000|3.0000000000] ""  FC,ADC
 SG_ FC_Obj15RiDoorSts : 5|2@0+ (1.0000000000,0.0000000000) [0.0000000000|3.0000000000] ""  FC,ADC
 SG_ FC_Obj15LeDoorSts : 7|2@0+ (1.0000000000,0.0000000000) [0.0000000000|3.0000000000] ""  FC,ADC
 SG_ FC_Obj15WSInfoPosType : 133|4@0+ (1.0000000000,0.0000000000) [0.0000000000|15.0000000000] ""  FC,ADC
 SG_ FC_CRCCheck_174 : 503|16@0+ (1.0000000000,0.0000000000) [0.0000000000|65535.0000000000] ""  FC,ADC
 SG_ FC_RollingCounter_174 : 491|4@0+ (1.0000000000,0.0000000000) [0.0000000000|15.0000000000] ""  FC,ADC
 SG_ FC_Obj15_Img2dBox_RightDown_V : 288|12@0+ (1.0000000000,0.0000000000) [0.0000000000|3000.0000000000] "pix"  FC,ADC
 SG_ FC_Obj15_Img2dBox_LeftTop_V : 284|12@0+ (1.0000000000,0.0000000000) [0.0000000000|3000.0000000000] "pix"  FC,ADC
 SG_ FC_Obj15_Img2dBox_RightDown_U : 264|12@0+ (1.0000000000,0.0000000000) [0.0000000000|4095.0000000000] "pix"  FC,ADC
 SG_ FC_Obj15_Img2dBox_LeftTop_U : 260|12@0+ (1.0000000000,0.0000000000) [0.0000000000|4095.0000000000] "pix"  FC,ADC
 SG_ FC_Obj15_TurnLight : 262|2@0+ (1.0000000000,0.0000000000) [0.0000000000|3.0000000000] ""  FC,ADC
 SG_ FC_Obj15_valid : 263|1@0+ (1.0000000000,0.0000000000) [0.0000000000|1.0000000000] ""  FC,ADC
 SG_ FC_Obj15_Vy_Vnce : 241|10@0+ (0.1250000000,-64.0000000000) [-64.0000000000|63.8750000000] "m/s"  FC,ADC
 SG_ FC_Obj15_Vx_Vnce : 237|12@0+ (0.0625000000,-128.0000000000) [-128.0000000000|127.9375000000] "m/s"  FC,ADC
 SG_ FC_Obj15_CenterAngle : 230|9@0+ (0.0100000000,-1.5700000000) [-1.5700000000|1.5700000000] ""  FC,ADC
 SG_ FC_Obj15_DistInLane : 209|11@0+ (0.0100000000,-10.0000000000) [-10.0000000000|10.0000000000] ""  FC,ADC
 SG_ FC_Obj15_objCutInLane : 211|2@0+ (1.0000000000,0.0000000000) [0.0000000000|2.0000000000] ""  FC,ADC
 SG_ FC_Obj15_objCutInFlag : 201|2@0+ (1.0000000000,0.0000000000) [0.0000000000|2.0000000000] ""  FC,ADC
 SG_ FC_Obj15_CornerPoint_y : 199|14@0+ (0.0100000000,-80.0000000000) [-80.0000000000|80.0000000000] ""  FC,ADC
 SG_ FC_Obj15_CornerPoint_x : 182|15@0+ (0.0100000000,0.0000000000) [0.0000000000|200.0000000000] ""  FC,ADC
 SG_ FC_Obj15_LaneAssignment : 169|3@0+ (1.0000000000,0.0000000000) [0.0000000000|7.0000000000] ""  FC,ADC
 SG_ FC_Obj15_MotionType : 172|3@0+ (1.0000000000,0.0000000000) [0.0000000000|4.0000000000] ""  FC,ADC
 SG_ FC_obj15_Brakelight_Info : 173|1@0+ (1.0000000000,0.0000000000) [0.0000000000|1.0000000000] ""  FC,ADC
 SG_ FC_Obj15_Width : 155|11@0+ (0.0100000000,0.0000000000) [0.0000000000|12.0000000000] "m"  FC,ADC
 SG_ FC_Obj15_Length : 148|9@0+ (0.0500000000,0.0000000000) [0.0000000000|25.5000000000] "m"  FC,ADC
 SG_ FC_Obj15_Height : 141|9@0+ (0.0100000000,0.0000000000) [0.0000000000|5.1100000000] "m"  FC,ADC
 SG_ FC_Obj15_HeadOrientation : 129|4@0+ (1.0000000000,0.0000000000) [0.0000000000|15.0000000000] ""  FC,ADC
 SG_ FC_Obj15_HeadingAngle : 308|10@0+ (0.0100000000,-3.1400000000) [-3.1400000000|3.1400000000] "rad"  FC,ADC
 SG_ FC_Obj15_ExistProb : 112|6@0+ (2.0000000000,0.0000000000) [0.0000000000|100.0000000000] "%"  FC,ADC
 SG_ FC_Obj15_Dy_Vnce : 106|10@0+ (0.0200000000,0.0000000000) [0.0000000000|20.0000000000] "m2"  FC,ADC
 SG_ FC_Obj15_Dy : 88|14@0+ (0.0100000000,-80.0000000000) [-80.0000000000|80.0000000000] "m"  FC,ADC
 SG_ FC_Obj15_Dx_Vnce : 86|14@0+ (0.0500000000,0.0000000000) [0.0000000000|50.0000000000] "m2"  FC,ADC
 SG_ FC_Obj15_Dx : 66|12@0+ (0.0500000000,0.0000000000) [0.0000000000|204.7000000000] "m"  FC,ADC
 SG_ FC_Obj15_RelVy : 60|10@0+ (0.1000000000,-50.0000000000) [-50.0000000000|50.0000000000] "m/s"  FC,ADC
 SG_ FC_Obj15_RelVx : 40|12@0+ (0.1000000000,-154.0000000000) [-154.0000000000|50.0000000000] "m/s"  FC,ADC
 SG_ FC_Obj15_RelAy : 32|8@0+ (0.1000000000,-12.0000000000) [-12.0000000000|12.0000000000] "m/s2"  FC,ADC
 SG_ FC_Obj15_RelAx : 25|9@0+ (0.1000000000,-16.0000000000) [-16.0000000000|16.0000000000] "m/s2"  FC,ADC
 SG_ FC_Obj15_TypeProb : 31|6@0+ (2.0000000000,0.0000000000) [0.0000000000|100.0000000000] "%"  FC,ADC
 SG_ FC_Obj15_Type : 19|4@0+ (1.0000000000,0.0000000000) [0.0000000000|15.0000000000] ""  FC,ADC
 SG_ FC_Obj15_Track_Age : 314|16@0+ (1.0000000000,0.0000000000) [0.0000000000|65535.0000000000] ""  FC,ADC
 SG_ FC_Obj15_Track_ID : 3|8@0+ (1.0000000000,0.0000000000) [0.0000000000|255.0000000000] ""  FC,ADC

BO_ 373 FC_175: 64 FC
 SG_ FC_Obj16_VehicleDir : 9|3@0+ (1.0000000000,0.0000000000) [0.0000000000|7.0000000000] ""  FC,ADC
 SG_ FC_Obj16ReDoorSts : 11|2@0+ (1.0000000000,0.0000000000) [0.0000000000|3.0000000000] ""  FC,ADC
 SG_ FC_Obj16RiDoorSts : 5|2@0+ (1.0000000000,0.0000000000) [0.0000000000|3.0000000000] ""  FC,ADC
 SG_ FC_Obj16LeDoorSts : 7|2@0+ (1.0000000000,0.0000000000) [0.0000000000|3.0000000000] ""  FC,ADC
 SG_ FC_Obj16WSInfoPosType : 133|4@0+ (1.0000000000,0.0000000000) [0.0000000000|15.0000000000] ""  FC,ADC
 SG_ FC_CRCCheck_175 : 503|16@0+ (1.0000000000,0.0000000000) [0.0000000000|65535.0000000000] ""  FC,ADC
 SG_ FC_RollingCounter_175 : 491|4@0+ (1.0000000000,0.0000000000) [0.0000000000|15.0000000000] ""  FC,ADC
 SG_ FC_Obj16_Img2dBox_RightDown_V : 288|12@0+ (1.0000000000,0.0000000000) [0.0000000000|3000.0000000000] "pix"  FC,ADC
 SG_ FC_Obj16_Img2dBox_LeftTop_V : 284|12@0+ (1.0000000000,0.0000000000) [0.0000000000|3000.0000000000] "pix"  FC,ADC
 SG_ FC_Obj16_Img2dBox_RightDown_U : 264|12@0+ (1.0000000000,0.0000000000) [0.0000000000|4095.0000000000] "pix"  FC,ADC
 SG_ FC_Obj16_Img2dBox_LeftTop_U : 260|12@0+ (1.0000000000,0.0000000000) [0.0000000000|4095.0000000000] "pix"  FC,ADC
 SG_ FC_Obj16_TurnLight : 262|2@0+ (1.0000000000,0.0000000000) [0.0000000000|3.0000000000] ""  FC,ADC
 SG_ FC_Obj16_valid : 263|1@0+ (1.0000000000,0.0000000000) [0.0000000000|1.0000000000] ""  FC,ADC
 SG_ FC_Obj16_Vy_Vnce : 241|10@0+ (0.1250000000,-64.0000000000) [-64.0000000000|63.8750000000] "m/s"  FC,ADC
 SG_ FC_Obj16_Vx_Vnce : 237|12@0+ (0.0625000000,-128.0000000000) [-128.0000000000|127.9375000000] "m/s"  FC,ADC
 SG_ FC_Obj16_CenterAngle : 230|9@0+ (0.0100000000,-1.5700000000) [-1.5700000000|1.5700000000] ""  FC,ADC
 SG_ FC_Obj16_DistInLane : 209|11@0+ (0.0100000000,-10.0000000000) [-10.0000000000|10.0000000000] ""  FC,ADC
 SG_ FC_Obj16_objCutInLane : 211|2@0+ (1.0000000000,0.0000000000) [0.0000000000|2.0000000000] ""  FC,ADC
 SG_ FC_Obj16_objCutInFlag : 201|2@0+ (1.0000000000,0.0000000000) [0.0000000000|2.0000000000] ""  FC,ADC
 SG_ FC_Obj16_CornerPoint_y : 199|14@0+ (0.0100000000,-80.0000000000) [-80.0000000000|80.0000000000] ""  FC,ADC
 SG_ FC_Obj16_CornerPoint_x : 182|15@0+ (0.0100000000,0.0000000000) [0.0000000000|200.0000000000] ""  FC,ADC
 SG_ FC_Obj16_LaneAssignment : 169|3@0+ (1.0000000000,0.0000000000) [0.0000000000|7.0000000000] ""  FC,ADC
 SG_ FC_Obj16_MotionType : 172|3@0+ (1.0000000000,0.0000000000) [0.0000000000|4.0000000000] ""  FC,ADC
 SG_ FC_obj16_Brakelight_Info : 173|1@0+ (1.0000000000,0.0000000000) [0.0000000000|1.0000000000] ""  FC,ADC
 SG_ FC_Obj16_Width : 155|11@0+ (0.0100000000,0.0000000000) [0.0000000000|12.0000000000] "m"  FC,ADC
 SG_ FC_Obj16_Length : 148|9@0+ (0.0500000000,0.0000000000) [0.0000000000|25.5000000000] "m"  FC,ADC
 SG_ FC_Obj16_Height : 141|9@0+ (0.0100000000,0.0000000000) [0.0000000000|5.1100000000] "m"  FC,ADC
 SG_ FC_Obj16_HeadOrientation : 129|4@0+ (1.0000000000,0.0000000000) [0.0000000000|15.0000000000] ""  FC,ADC
 SG_ FC_Obj16_HeadingAngle : 308|10@0+ (0.0100000000,-3.1400000000) [-3.1400000000|3.1400000000] "rad"  FC,ADC
 SG_ FC_Obj16_ExistProb : 112|6@0+ (2.0000000000,0.0000000000) [0.0000000000|100.0000000000] "%"  FC,ADC
 SG_ FC_Obj16_Dy_Vnce : 106|10@0+ (0.0200000000,0.0000000000) [0.0000000000|20.0000000000] "m2"  FC,ADC
 SG_ FC_Obj16_Dy : 88|14@0+ (0.0100000000,-80.0000000000) [-80.0000000000|80.0000000000] "m"  FC,ADC
 SG_ FC_Obj16_Dx_Vnce : 86|14@0+ (0.0500000000,0.0000000000) [0.0000000000|50.0000000000] "m2"  FC,ADC
 SG_ FC_Obj16_Dx : 66|12@0+ (0.0500000000,0.0000000000) [0.0000000000|204.7000000000] "m"  FC,ADC
 SG_ FC_Obj16_RelVy : 60|10@0+ (0.1000000000,-50.0000000000) [-50.0000000000|50.0000000000] "m/s"  FC,ADC
 SG_ FC_Obj16_RelVx : 40|12@0+ (0.1000000000,-154.0000000000) [-154.0000000000|50.0000000000] "m/s"  FC,ADC
 SG_ FC_Obj16_RelAy : 32|8@0+ (0.1000000000,-12.0000000000) [-12.0000000000|12.0000000000] "m/s2"  FC,ADC
 SG_ FC_Obj16_RelAx : 25|9@0+ (0.1000000000,-16.0000000000) [-16.0000000000|16.0000000000] "m/s2"  FC,ADC
 SG_ FC_Obj16_TypeProb : 31|6@0+ (2.0000000000,0.0000000000) [0.0000000000|100.0000000000] "%"  FC,ADC
 SG_ FC_Obj16_Type : 19|4@0+ (1.0000000000,0.0000000000) [0.0000000000|15.0000000000] ""  FC,ADC
 SG_ FC_Obj16_Track_Age : 314|16@0+ (1.0000000000,0.0000000000) [0.0000000000|65535.0000000000] ""  FC,ADC
 SG_ FC_Obj16_Track_ID : 3|8@0+ (1.0000000000,0.0000000000) [0.0000000000|255.0000000000] ""  FC,ADC

BO_ 374 FC_176: 64 FC
 SG_ FC_Obj17_VehicleDir : 9|3@0+ (1.0000000000,0.0000000000) [0.0000000000|7.0000000000] ""  FC,ADC
 SG_ FC_Obj17ReDoorSts : 11|2@0+ (1.0000000000,0.0000000000) [0.0000000000|3.0000000000] ""  FC,ADC
 SG_ FC_Obj17RiDoorSts : 5|2@0+ (1.0000000000,0.0000000000) [0.0000000000|3.0000000000] ""  FC,ADC
 SG_ FC_Obj17LeDoorSts : 7|2@0+ (1.0000000000,0.0000000000) [0.0000000000|3.0000000000] ""  FC,ADC
 SG_ FC_Obj17WSInfoPosType : 133|4@0+ (1.0000000000,0.0000000000) [0.0000000000|15.0000000000] ""  FC,ADC
 SG_ FC_CRCCheck_176 : 503|16@0+ (1.0000000000,0.0000000000) [0.0000000000|65535.0000000000] ""  FC,ADC
 SG_ FC_RollingCounter_176 : 491|4@0+ (1.0000000000,0.0000000000) [0.0000000000|15.0000000000] ""  FC,ADC
 SG_ FC_Obj17_Img2dBox_RightDown_V : 288|12@0+ (1.0000000000,0.0000000000) [0.0000000000|3000.0000000000] "pix"  FC,ADC
 SG_ FC_Obj17_Img2dBox_LeftTop_V : 284|12@0+ (1.0000000000,0.0000000000) [0.0000000000|3000.0000000000] "pix"  FC,ADC
 SG_ FC_Obj17_Img2dBox_RightDown_U : 264|12@0+ (1.0000000000,0.0000000000) [0.0000000000|4095.0000000000] "pix"  FC,ADC
 SG_ FC_Obj17_Img2dBox_LeftTop_U : 260|12@0+ (1.0000000000,0.0000000000) [0.0000000000|4095.0000000000] "pix"  FC,ADC
 SG_ FC_Obj17_TurnLight : 262|2@0+ (1.0000000000,0.0000000000) [0.0000000000|3.0000000000] ""  FC,ADC
 SG_ FC_Obj17_valid : 263|1@0+ (1.0000000000,0.0000000000) [0.0000000000|1.0000000000] ""  FC,ADC
 SG_ FC_Obj17_Vy_Vnce : 241|10@0+ (0.1250000000,-64.0000000000) [-64.0000000000|63.8750000000] "m/s"  FC,ADC
 SG_ FC_Obj17_Vx_Vnce : 237|12@0+ (0.0625000000,-128.0000000000) [-128.0000000000|127.9375000000] "m/s"  FC,ADC
 SG_ FC_Obj17_CenterAngle : 230|9@0+ (0.0100000000,-1.5700000000) [-1.5700000000|1.5700000000] ""  FC,ADC
 SG_ FC_Obj17_DistInLane : 209|11@0+ (0.0100000000,-10.0000000000) [-10.0000000000|10.0000000000] ""  FC,ADC
 SG_ FC_Obj17_objCutInLane : 211|2@0+ (1.0000000000,0.0000000000) [0.0000000000|2.0000000000] ""  FC,ADC
 SG_ FC_Obj17_objCutInFlag : 201|2@0+ (1.0000000000,0.0000000000) [0.0000000000|2.0000000000] ""  FC,ADC
 SG_ FC_Obj17_CornerPoint_y : 199|14@0+ (0.0100000000,-80.0000000000) [-80.0000000000|80.0000000000] ""  FC,ADC
 SG_ FC_Obj17_CornerPoint_x : 182|15@0+ (0.0100000000,0.0000000000) [0.0000000000|200.0000000000] ""  FC,ADC
 SG_ FC_Obj17_LaneAssignment : 169|3@0+ (1.0000000000,0.0000000000) [0.0000000000|7.0000000000] ""  FC,ADC
 SG_ FC_Obj17_MotionType : 172|3@0+ (1.0000000000,0.0000000000) [0.0000000000|4.0000000000] ""  FC,ADC
 SG_ FC_obj17_Brakelight_Info : 173|1@0+ (1.0000000000,0.0000000000) [0.0000000000|1.0000000000] ""  FC,ADC
 SG_ FC_Obj17_Width : 155|11@0+ (0.0100000000,0.0000000000) [0.0000000000|12.0000000000] "m"  FC,ADC
 SG_ FC_Obj17_Length : 148|9@0+ (0.0500000000,0.0000000000) [0.0000000000|25.5000000000] "m"  FC,ADC
 SG_ FC_Obj17_Height : 141|9@0+ (0.0100000000,0.0000000000) [0.0000000000|5.1100000000] "m"  FC,ADC
 SG_ FC_Obj17_HeadOrientation : 129|4@0+ (1.0000000000,0.0000000000) [0.0000000000|15.0000000000] ""  FC,ADC
 SG_ FC_Obj17_HeadingAngle : 308|10@0+ (0.0100000000,-3.1400000000) [-3.1400000000|3.1400000000] "rad"  FC,ADC
 SG_ FC_Obj17_ExistProb : 112|6@0+ (2.0000000000,0.0000000000) [0.0000000000|100.0000000000] "%"  FC,ADC
 SG_ FC_Obj17_Dy_Vnce : 106|10@0+ (0.0200000000,0.0000000000) [0.0000000000|20.0000000000] "m2"  FC,ADC
 SG_ FC_Obj17_Dy : 88|14@0+ (0.0100000000,-80.0000000000) [-80.0000000000|80.0000000000] "m"  FC,ADC
 SG_ FC_Obj17_Dx_Vnce : 86|14@0+ (0.0500000000,0.0000000000) [0.0000000000|50.0000000000] "m2"  FC,ADC
 SG_ FC_Obj17_Dx : 66|12@0+ (0.0500000000,0.0000000000) [0.0000000000|204.7000000000] "m"  FC,ADC
 SG_ FC_Obj17_RelVy : 60|10@0+ (0.1000000000,-50.0000000000) [-50.0000000000|50.0000000000] "m/s"  FC,ADC
 SG_ FC_Obj17_RelVx : 40|12@0+ (0.1000000000,-154.0000000000) [-154.0000000000|50.0000000000] "m/s"  FC,ADC
 SG_ FC_Obj17_RelAy : 32|8@0+ (0.1000000000,-12.0000000000) [-12.0000000000|12.0000000000] "m/s2"  FC,ADC
 SG_ FC_Obj17_RelAx : 25|9@0+ (0.1000000000,-16.0000000000) [-16.0000000000|16.0000000000] "m/s2"  FC,ADC
 SG_ FC_Obj17_TypeProb : 31|6@0+ (2.0000000000,0.0000000000) [0.0000000000|100.0000000000] "%"  FC,ADC
 SG_ FC_Obj17_Type : 19|4@0+ (1.0000000000,0.0000000000) [0.0000000000|15.0000000000] ""  FC,ADC
 SG_ FC_Obj17_Track_Age : 314|16@0+ (1.0000000000,0.0000000000) [0.0000000000|65535.0000000000] ""  FC,ADC
 SG_ FC_Obj17_Track_ID : 3|8@0+ (1.0000000000,0.0000000000) [0.0000000000|255.0000000000] ""  FC,ADC

BO_ 375 FC_177: 64 FC
 SG_ FC_Obj18_VehicleDir : 9|3@0+ (1.0000000000,0.0000000000) [0.0000000000|7.0000000000] ""  FC,ADC
 SG_ FC_Obj18ReDoorSts : 11|2@0+ (1.0000000000,0.0000000000) [0.0000000000|3.0000000000] ""  FC,ADC
 SG_ FC_Obj18RiDoorSts : 5|2@0+ (1.0000000000,0.0000000000) [0.0000000000|3.0000000000] ""  FC,ADC
 SG_ FC_Obj18LeDoorSts : 7|2@0+ (1.0000000000,0.0000000000) [0.0000000000|3.0000000000] ""  FC,ADC
 SG_ FC_Obj18WSInfoPosType : 133|4@0+ (1.0000000000,0.0000000000) [0.0000000000|15.0000000000] ""  FC,ADC
 SG_ FC_CRCCheck_177 : 503|16@0+ (1.0000000000,0.0000000000) [0.0000000000|65535.0000000000] ""  FC,ADC
 SG_ FC_RollingCounter_177 : 491|4@0+ (1.0000000000,0.0000000000) [0.0000000000|15.0000000000] ""  FC,ADC
 SG_ FC_Obj18_Img2dBox_RightDown_V : 288|12@0+ (1.0000000000,0.0000000000) [0.0000000000|3000.0000000000] "pix"  FC,ADC
 SG_ FC_Obj18_Img2dBox_LeftTop_V : 284|12@0+ (1.0000000000,0.0000000000) [0.0000000000|3000.0000000000] "pix"  FC,ADC
 SG_ FC_Obj18_Img2dBox_RightDown_U : 264|12@0+ (1.0000000000,0.0000000000) [0.0000000000|4095.0000000000] "pix"  FC,ADC
 SG_ FC_Obj18_Img2dBox_LeftTop_U : 260|12@0+ (1.0000000000,0.0000000000) [0.0000000000|4095.0000000000] "pix"  FC,ADC
 SG_ FC_Obj18_TurnLight : 262|2@0+ (1.0000000000,0.0000000000) [0.0000000000|3.0000000000] ""  FC,ADC
 SG_ FC_Obj18_valid : 263|1@0+ (1.0000000000,0.0000000000) [0.0000000000|1.0000000000] ""  FC,ADC
 SG_ FC_Obj18_Vy_Vnce : 241|10@0+ (0.1250000000,-64.0000000000) [-64.0000000000|63.8750000000] "m/s"  FC,ADC
 SG_ FC_Obj18_Vx_Vnce : 237|12@0+ (0.0625000000,-128.0000000000) [-128.0000000000|127.9375000000] "m/s"  FC,ADC
 SG_ FC_Obj18_CenterAngle : 230|9@0+ (0.0100000000,-1.5700000000) [-1.5700000000|1.5700000000] ""  FC,ADC
 SG_ FC_Obj18_DistInLane : 209|11@0+ (0.0100000000,-10.0000000000) [-10.0000000000|10.0000000000] ""  FC,ADC
 SG_ FC_Obj18_objCutInLane : 211|2@0+ (1.0000000000,0.0000000000) [0.0000000000|2.0000000000] ""  FC,ADC
 SG_ FC_Obj18_objCutInFlag : 201|2@0+ (1.0000000000,0.0000000000) [0.0000000000|2.0000000000] ""  FC,ADC
 SG_ FC_Obj18_CornerPoint_y : 199|14@0+ (0.0100000000,-80.0000000000) [-80.0000000000|80.0000000000] ""  FC,ADC
 SG_ FC_Obj18_CornerPoint_x : 182|15@0+ (0.0100000000,0.0000000000) [0.0000000000|200.0000000000] ""  FC,ADC
 SG_ FC_Obj18_LaneAssignment : 169|3@0+ (1.0000000000,0.0000000000) [0.0000000000|7.0000000000] ""  FC,ADC
 SG_ FC_Obj18_MotionType : 172|3@0+ (1.0000000000,0.0000000000) [0.0000000000|4.0000000000] ""  FC,ADC
 SG_ FC_obj18_Brakelight_Info : 173|1@0+ (1.0000000000,0.0000000000) [0.0000000000|1.0000000000] ""  FC,ADC
 SG_ FC_Obj18_Width : 155|11@0+ (0.0100000000,0.0000000000) [0.0000000000|12.0000000000] "m"  FC,ADC
 SG_ FC_Obj18_Length : 148|9@0+ (0.0500000000,0.0000000000) [0.0000000000|25.5000000000] "m"  FC,ADC
 SG_ FC_Obj18_Height : 141|9@0+ (0.0100000000,0.0000000000) [0.0000000000|5.1100000000] "m"  FC,ADC
 SG_ FC_Obj18_HeadOrientation : 129|4@0+ (1.0000000000,0.0000000000) [0.0000000000|15.0000000000] ""  FC,ADC
 SG_ FC_Obj18_HeadingAngle : 308|10@0+ (0.0100000000,-3.1400000000) [-3.1400000000|3.1400000000] "rad"  FC,ADC
 SG_ FC_Obj18_ExistProb : 112|6@0+ (2.0000000000,0.0000000000) [0.0000000000|100.0000000000] "%"  FC,ADC
 SG_ FC_Obj18_Dy_Vnce : 106|10@0+ (0.0200000000,0.0000000000) [0.0000000000|20.0000000000] "m2"  FC,ADC
 SG_ FC_Obj18_Dy : 88|14@0+ (0.0100000000,-80.0000000000) [-80.0000000000|80.0000000000] "m"  FC,ADC
 SG_ FC_Obj18_Dx_Vnce : 86|14@0+ (0.0500000000,0.0000000000) [0.0000000000|50.0000000000] "m2"  FC,ADC
 SG_ FC_Obj18_Dx : 66|12@0+ (0.0500000000,0.0000000000) [0.0000000000|204.7000000000] "m"  FC,ADC
 SG_ FC_Obj18_RelVy : 60|10@0+ (0.1000000000,-50.0000000000) [-50.0000000000|50.0000000000] "m/s"  FC,ADC
 SG_ FC_Obj18_RelVx : 40|12@0+ (0.1000000000,-154.0000000000) [-154.0000000000|50.0000000000] "m/s"  FC,ADC
 SG_ FC_Obj18_RelAy : 32|8@0+ (0.1000000000,-12.0000000000) [-12.0000000000|12.0000000000] "m/s2"  FC,ADC
 SG_ FC_Obj18_RelAx : 25|9@0+ (0.1000000000,-16.0000000000) [-16.0000000000|16.0000000000] "m/s2"  FC,ADC
 SG_ FC_Obj18_TypeProb : 31|6@0+ (2.0000000000,0.0000000000) [0.0000000000|100.0000000000] "%"  FC,ADC
 SG_ FC_Obj18_Type : 19|4@0+ (1.0000000000,0.0000000000) [0.0000000000|15.0000000000] ""  FC,ADC
 SG_ FC_Obj18_Track_Age : 314|16@0+ (1.0000000000,0.0000000000) [0.0000000000|65535.0000000000] ""  FC,ADC
 SG_ FC_Obj18_Track_ID : 3|8@0+ (1.0000000000,0.0000000000) [0.0000000000|255.0000000000] ""  FC,ADC

CM_ BO_ 354  " ";
CM_ SG_ 354 FC_Obj3_VehicleDir  " ";
CM_ SG_ 354 FC_Obj3ReDoorSts  " ";
CM_ SG_ 354 FC_Obj3RiDoorSts  " ";
CM_ SG_ 354 FC_Obj3LeDoorSts  " ";
CM_ SG_ 354 FC_Obj3WSInfoPosType  " ";
CM_ SG_ 354 FC_CRCCheck_162  " ";
CM_ SG_ 354 FC_RollingCounter_162  " ";
CM_ SG_ 354 FC_Obj3_Img2dBox_RightDown_V  " ";
CM_ SG_ 354 FC_Obj3_Img2dBox_LeftTop_V  " ";
CM_ SG_ 354 FC_Obj3_Img2dBox_RightDown_U  " ";
CM_ SG_ 354 FC_Obj3_Img2dBox_LeftTop_U  " ";
CM_ SG_ 354 FC_Obj3_TurnLight  " ";
CM_ SG_ 354 FC_Obj3_valid  "未收敛目标，输出invalid状态，输出valid状态，信号必须是可性的 ";
CM_ SG_ 354 FC_Obj3_Vy_Vnce  " ";
CM_ SG_ 354 FC_Obj3_Vx_Vnce  " ";
CM_ SG_ 354 FC_Obj3_CenterAngle  " ";
CM_ SG_ 354 FC_Obj3_DistInLane  " ";
CM_ SG_ 354 FC_Obj3_objCutInLane  " ";
CM_ SG_ 354 FC_Obj3_objCutInFlag  " ";
CM_ SG_ 354 FC_Obj3_CornerPoint_y  " ";
CM_ SG_ 354 FC_Obj3_CornerPoint_x  " ";
CM_ SG_ 354 FC_Obj3_LaneAssignment  " ";
CM_ SG_ 354 FC_Obj3_MotionType  " ";
CM_ SG_ 354 FC_obj3_Brakelight_Info  " ";
CM_ SG_ 354 FC_Obj3_Width  " ";
CM_ SG_ 354 FC_Obj3_Length  " ";
CM_ SG_ 354 FC_Obj3_Height  " ";
CM_ SG_ 354 FC_Obj3_HeadOrientation  " ";
CM_ SG_ 354 FC_Obj3_HeadingAngle  " ";
CM_ SG_ 354 FC_Obj3_ExistProb  " ";
CM_ SG_ 354 FC_Obj3_Dy_Vnce  " ";
CM_ SG_ 354 FC_Obj3_Dy  " ";
CM_ SG_ 354 FC_Obj3_Dx_Vnce  " ";
CM_ SG_ 354 FC_Obj3_Dx  " ";
CM_ SG_ 354 FC_Obj3_RelVy  " ";
CM_ SG_ 354 FC_Obj3_RelVx  " ";
CM_ SG_ 354 FC_Obj3_RelAy  " ";
CM_ SG_ 354 FC_Obj3_RelAx  " ";
CM_ SG_ 354 FC_Obj3_TypeProb  " ";
CM_ SG_ 354 FC_Obj3_Type  " ";
CM_ SG_ 354 FC_Obj3_Track_Age  " ";
CM_ SG_ 354 FC_Obj3_Track_ID  " ";

CM_ BO_ 355  " ";
CM_ SG_ 355 FC_Obj4_VehicleDir  " ";
CM_ SG_ 355 FC_Obj4ReDoorSts  " ";
CM_ SG_ 355 FC_Obj4RiDoorSts  " ";
CM_ SG_ 355 FC_Obj4LeDoorSts  " ";
CM_ SG_ 355 FC_Obj4WSInfoPosType  " ";
CM_ SG_ 355 FC_CRCCheck_163  " ";
CM_ SG_ 355 FC_RollingCounter_163  " ";
CM_ SG_ 355 FC_Obj4_Img2dBox_RightDown_V  " ";
CM_ SG_ 355 FC_Obj4_Img2dBox_LeftTop_V  " ";
CM_ SG_ 355 FC_Obj4_Img2dBox_RightDown_U  " ";
CM_ SG_ 355 FC_Obj4_Img2dBox_LeftTop_U  " ";
CM_ SG_ 355 FC_Obj4_TurnLight  " ";
CM_ SG_ 355 FC_Obj4_valid  "未收敛目标，输出invalid状态，输出valid状态，信号必须是可性的 ";
CM_ SG_ 355 FC_Obj4_Vy_Vnce  " ";
CM_ SG_ 355 FC_Obj4_Vx_Vnce  " ";
CM_ SG_ 355 FC_Obj4_CenterAngle  " ";
CM_ SG_ 355 FC_Obj4_DistInLane  " ";
CM_ SG_ 355 FC_Obj4_objCutInLane  " ";
CM_ SG_ 355 FC_Obj4_objCutInFlag  " ";
CM_ SG_ 355 FC_Obj4_CornerPoint_y  " ";
CM_ SG_ 355 FC_Obj4_CornerPoint_x  " ";
CM_ SG_ 355 FC_Obj4_LaneAssignment  " ";
CM_ SG_ 355 FC_Obj4_MotionType  " ";
CM_ SG_ 355 FC_obj4_Brakelight_Info  " ";
CM_ SG_ 355 FC_Obj4_Width  " ";
CM_ SG_ 355 FC_Obj4_Length  " ";
CM_ SG_ 355 FC_Obj4_Height  " ";
CM_ SG_ 355 FC_Obj4_HeadOrientation  " ";
CM_ SG_ 355 FC_Obj4_HeadingAngle  " ";
CM_ SG_ 355 FC_Obj4_ExistProb  " ";
CM_ SG_ 355 FC_Obj4_Dy_Vnce  " ";
CM_ SG_ 355 FC_Obj4_Dy  " ";
CM_ SG_ 355 FC_Obj4_Dx_Vnce  " ";
CM_ SG_ 355 FC_Obj4_Dx  " ";
CM_ SG_ 355 FC_Obj4_RelVy  " ";
CM_ SG_ 355 FC_Obj4_RelVx  " ";
CM_ SG_ 355 FC_Obj4_RelAy  " ";
CM_ SG_ 355 FC_Obj4_RelAx  " ";
CM_ SG_ 355 FC_Obj4_TypeProb  " ";
CM_ SG_ 355 FC_Obj4_Type  " ";
CM_ SG_ 355 FC_Obj4_Track_Age  " ";
CM_ SG_ 355 FC_Obj4_Track_ID  " ";

CM_ BO_ 356  " ";
CM_ SG_ 356 FC_Obj5_VehicleDir  " ";
CM_ SG_ 356 FC_Obj5ReDoorSts  " ";
CM_ SG_ 356 FC_Obj5RiDoorSts  " ";
CM_ SG_ 356 FC_Obj5LeDoorSts  " ";
CM_ SG_ 356 FC_Obj5WSInfoPosType  " ";
CM_ SG_ 356 FC_CRCCheck_164  " ";
CM_ SG_ 356 FC_RollingCounter_164  " ";
CM_ SG_ 356 FC_Obj5_Img2dBox_RightDown_V  " ";
CM_ SG_ 356 FC_Obj5_Img2dBox_LeftTop_V  " ";
CM_ SG_ 356 FC_Obj5_Img2dBox_RightDown_U  " ";
CM_ SG_ 356 FC_Obj5_Img2dBox_LeftTop_U  " ";
CM_ SG_ 356 FC_Obj5_TurnLight  " ";
CM_ SG_ 356 FC_Obj5_valid  "未收敛目标，输出invalid状态，输出valid状态，信号必须是可性的 ";
CM_ SG_ 356 FC_Obj5_Vy_Vnce  " ";
CM_ SG_ 356 FC_Obj5_Vx_Vnce  " ";
CM_ SG_ 356 FC_Obj5_CenterAngle  " ";
CM_ SG_ 356 FC_Obj5_DistInLane  " ";
CM_ SG_ 356 FC_Obj5_objCutInLane  " ";
CM_ SG_ 356 FC_Obj5_objCutInFlag  " ";
CM_ SG_ 356 FC_Obj5_CornerPoint_y  " ";
CM_ SG_ 356 FC_Obj5_CornerPoint_x  " ";
CM_ SG_ 356 FC_Obj5_LaneAssignment  " ";
CM_ SG_ 356 FC_Obj5_MotionType  " ";
CM_ SG_ 356 FC_obj5_Brakelight_Info  " ";
CM_ SG_ 356 FC_Obj5_Width  " ";
CM_ SG_ 356 FC_Obj5_Length  " ";
CM_ SG_ 356 FC_Obj5_Height  " ";
CM_ SG_ 356 FC_Obj5_HeadOrientation  " ";
CM_ SG_ 356 FC_Obj5_HeadingAngle  " ";
CM_ SG_ 356 FC_Obj5_ExistProb  " ";
CM_ SG_ 356 FC_Obj5_Dy_Vnce  " ";
CM_ SG_ 356 FC_Obj5_Dy  " ";
CM_ SG_ 356 FC_Obj5_Dx_Vnce  " ";
CM_ SG_ 356 FC_Obj5_Dx  " ";
CM_ SG_ 356 FC_Obj5_RelVy  " ";
CM_ SG_ 356 FC_Obj5_RelVx  " ";
CM_ SG_ 356 FC_Obj5_RelAy  " ";
CM_ SG_ 356 FC_Obj5_RelAx  " ";
CM_ SG_ 356 FC_Obj5_TypeProb  " ";
CM_ SG_ 356 FC_Obj5_Type  " ";
CM_ SG_ 356 FC_Obj5_Track_Age  " ";
CM_ SG_ 356 FC_Obj5_Track_ID  " ";

CM_ BO_ 357  " ";
CM_ SG_ 357 FC_Obj6_VehicleDir  " ";
CM_ SG_ 357 FC_Obj6ReDoorSts  " ";
CM_ SG_ 357 FC_Obj6RiDoorSts  " ";
CM_ SG_ 357 FC_Obj6LeDoorSts  " ";
CM_ SG_ 357 FC_Obj6WSInfoPosType  " ";
CM_ SG_ 357 FC_CRCCheck_165  " ";
CM_ SG_ 357 FC_RollingCounter_165  " ";
CM_ SG_ 357 FC_Obj6_Img2dBox_RightDown_V  " ";
CM_ SG_ 357 FC_Obj6_Img2dBox_LeftTop_V  " ";
CM_ SG_ 357 FC_Obj6_Img2dBox_RightDown_U  " ";
CM_ SG_ 357 FC_Obj6_Img2dBox_LeftTop_U  " ";
CM_ SG_ 357 FC_Obj6_TurnLight  " ";
CM_ SG_ 357 FC_Obj6_valid  "未收敛目标，输出invalid状态，输出valid状态，信号必须是可性的 ";
CM_ SG_ 357 FC_Obj6_Vy_Vnce  " ";
CM_ SG_ 357 FC_Obj6_Vx_Vnce  " ";
CM_ SG_ 357 FC_Obj6_CenterAngle  " ";
CM_ SG_ 357 FC_Obj6_DistInLane  " ";
CM_ SG_ 357 FC_Obj6_objCutInLane  " ";
CM_ SG_ 357 FC_Obj6_objCutInFlag  " ";
CM_ SG_ 357 FC_Obj6_CornerPoint_y  " ";
CM_ SG_ 357 FC_Obj6_CornerPoint_x  " ";
CM_ SG_ 357 FC_Obj6_LaneAssignment  " ";
CM_ SG_ 357 FC_Obj6_MotionType  " ";
CM_ SG_ 357 FC_obj6_Brakelight_Info  " ";
CM_ SG_ 357 FC_Obj6_Width  " ";
CM_ SG_ 357 FC_Obj6_Length  " ";
CM_ SG_ 357 FC_Obj6_Height  " ";
CM_ SG_ 357 FC_Obj6_HeadOrientation  " ";
CM_ SG_ 357 FC_Obj6_HeadingAngle  " ";
CM_ SG_ 357 FC_Obj6_ExistProb  " ";
CM_ SG_ 357 FC_Obj6_Dy_Vnce  " ";
CM_ SG_ 357 FC_Obj6_Dy  " ";
CM_ SG_ 357 FC_Obj6_Dx_Vnce  " ";
CM_ SG_ 357 FC_Obj6_Dx  " ";
CM_ SG_ 357 FC_Obj6_RelVy  " ";
CM_ SG_ 357 FC_Obj6_RelVx  " ";
CM_ SG_ 357 FC_Obj6_RelAy  " ";
CM_ SG_ 357 FC_Obj6_RelAx  " ";
CM_ SG_ 357 FC_Obj6_TypeProb  " ";
CM_ SG_ 357 FC_Obj6_Type  " ";
CM_ SG_ 357 FC_Obj6_Track_Age  " ";
CM_ SG_ 357 FC_Obj6_Track_ID  " ";

CM_ BO_ 358  " ";
CM_ SG_ 358 FC_Obj7_VehicleDir  " ";
CM_ SG_ 358 FC_Obj7ReDoorSts  " ";
CM_ SG_ 358 FC_Obj7RiDoorSts  " ";
CM_ SG_ 358 FC_Obj7LeDoorSts  " ";
CM_ SG_ 358 FC_Obj7WSInfoPosType  " ";
CM_ SG_ 358 FC_CRCCheck_166  " ";
CM_ SG_ 358 FC_RollingCounter_166  " ";
CM_ SG_ 358 FC_Obj7_Img2dBox_RightDown_V  " ";
CM_ SG_ 358 FC_Obj7_Img2dBox_LeftTop_V  " ";
CM_ SG_ 358 FC_Obj7_Img2dBox_RightDown_U  " ";
CM_ SG_ 358 FC_Obj7_Img2dBox_LeftTop_U  " ";
CM_ SG_ 358 FC_Obj7_TurnLight  " ";
CM_ SG_ 358 FC_Obj7_valid  "未收敛目标，输出invalid状态，输出valid状态，信号必须是可性的 ";
CM_ SG_ 358 FC_Obj7_Vy_Vnce  " ";
CM_ SG_ 358 FC_Obj7_Vx_Vnce  " ";
CM_ SG_ 358 FC_Obj7_CenterAngle  " ";
CM_ SG_ 358 FC_Obj7_DistInLane  " ";
CM_ SG_ 358 FC_Obj7_objCutInLane  " ";
CM_ SG_ 358 FC_Obj7_objCutInFlag  " ";
CM_ SG_ 358 FC_Obj7_CornerPoint_y  " ";
CM_ SG_ 358 FC_Obj7_CornerPoint_x  " ";
CM_ SG_ 358 FC_Obj7_LaneAssignment  " ";
CM_ SG_ 358 FC_Obj7_MotionType  " ";
CM_ SG_ 358 FC_obj7_Brakelight_Info  " ";
CM_ SG_ 358 FC_Obj7_Width  " ";
CM_ SG_ 358 FC_Obj7_Length  " ";
CM_ SG_ 358 FC_Obj7_Height  " ";
CM_ SG_ 358 FC_Obj7_HeadOrientation  " ";
CM_ SG_ 358 FC_Obj7_HeadingAngle  " ";
CM_ SG_ 358 FC_Obj7_ExistProb  " ";
CM_ SG_ 358 FC_Obj7_Dy_Vnce  " ";
CM_ SG_ 358 FC_Obj7_Dy  " ";
CM_ SG_ 358 FC_Obj7_Dx_Vnce  " ";
CM_ SG_ 358 FC_Obj7_Dx  " ";
CM_ SG_ 358 FC_Obj7_RelVy  " ";
CM_ SG_ 358 FC_Obj7_RelVx  " ";
CM_ SG_ 358 FC_Obj7_RelAy  " ";
CM_ SG_ 358 FC_Obj7_RelAx  " ";
CM_ SG_ 358 FC_Obj7_TypeProb  " ";
CM_ SG_ 358 FC_Obj7_Type  " ";
CM_ SG_ 358 FC_Obj7_Track_Age  " ";
CM_ SG_ 358 FC_Obj7_Track_ID  " ";

CM_ BO_ 359  " ";
CM_ SG_ 359 FC_Obj8_VehicleDir  " ";
CM_ SG_ 359 FC_Obj8ReDoorSts  " ";
CM_ SG_ 359 FC_Obj8RiDoorSts  " ";
CM_ SG_ 359 FC_Obj8LeDoorSts  " ";
CM_ SG_ 359 FC_Obj8WSInfoPosType  " ";
CM_ SG_ 359 FC_CRCCheck_167  " ";
CM_ SG_ 359 FC_RollingCounter_167  " ";
CM_ SG_ 359 FC_Obj8_Img2dBox_RightDown_V  " ";
CM_ SG_ 359 FC_Obj8_Img2dBox_LeftTop_V  " ";
CM_ SG_ 359 FC_Obj8_Img2dBox_RightDown_U  " ";
CM_ SG_ 359 FC_Obj8_Img2dBox_LeftTop_U  " ";
CM_ SG_ 359 FC_Obj8_TurnLight  " ";
CM_ SG_ 359 FC_Obj8_valid  "未收敛目标，输出invalid状态，输出valid状态，信号必须是可性的 ";
CM_ SG_ 359 FC_Obj8_Vy_Vnce  " ";
CM_ SG_ 359 FC_Obj8_Vx_Vnce  " ";
CM_ SG_ 359 FC_Obj8_CenterAngle  " ";
CM_ SG_ 359 FC_Obj8_DistInLane  " ";
CM_ SG_ 359 FC_Obj8_objCutInLane  " ";
CM_ SG_ 359 FC_Obj8_objCutInFlag  " ";
CM_ SG_ 359 FC_Obj8_CornerPoint_y  " ";
CM_ SG_ 359 FC_Obj8_CornerPoint_x  " ";
CM_ SG_ 359 FC_Obj8_LaneAssignment  " ";
CM_ SG_ 359 FC_Obj8_MotionType  " ";
CM_ SG_ 359 FC_obj8_Brakelight_Info  " ";
CM_ SG_ 359 FC_Obj8_Width  " ";
CM_ SG_ 359 FC_Obj8_Length  " ";
CM_ SG_ 359 FC_Obj8_Height  " ";
CM_ SG_ 359 FC_Obj8_HeadOrientation  " ";
CM_ SG_ 359 FC_Obj8_HeadingAngle  " ";
CM_ SG_ 359 FC_Obj8_ExistProb  " ";
CM_ SG_ 359 FC_Obj8_Dy_Vnce  " ";
CM_ SG_ 359 FC_Obj8_Dy  " ";
CM_ SG_ 359 FC_Obj8_Dx_Vnce  " ";
CM_ SG_ 359 FC_Obj8_Dx  " ";
CM_ SG_ 359 FC_Obj8_RelVy  " ";
CM_ SG_ 359 FC_Obj8_RelVx  " ";
CM_ SG_ 359 FC_Obj8_RelAy  " ";
CM_ SG_ 359 FC_Obj8_RelAx  " ";
CM_ SG_ 359 FC_Obj8_TypeProb  " ";
CM_ SG_ 359 FC_Obj8_Type  " ";
CM_ SG_ 359 FC_Obj8_Track_Age  " ";
CM_ SG_ 359 FC_Obj8_Track_ID  " ";

CM_ BO_ 360  " ";
CM_ SG_ 360 FC_Obj9_VehicleDir  " ";
CM_ SG_ 360 FC_Obj9ReDoorSts  " ";
CM_ SG_ 360 FC_Obj9RiDoorSts  " ";
CM_ SG_ 360 FC_Obj9LeDoorSts  " ";
CM_ SG_ 360 FC_Obj9WSInfoPosType  " ";
CM_ SG_ 360 FC_CRCCheck_168  " ";
CM_ SG_ 360 FC_RollingCounter_168  " ";
CM_ SG_ 360 FC_Obj9_Img2dBox_RightDown_V  " ";
CM_ SG_ 360 FC_Obj9_Img2dBox_LeftTop_V  " ";
CM_ SG_ 360 FC_Obj9_Img2dBox_RightDown_U  " ";
CM_ SG_ 360 FC_Obj9_Img2dBox_LeftTop_U  " ";
CM_ SG_ 360 FC_Obj9_TurnLight  " ";
CM_ SG_ 360 FC_Obj9_valid  "未收敛目标，输出invalid状态，输出valid状态，信号必须是可性的 ";
CM_ SG_ 360 FC_Obj9_Vy_Vnce  " ";
CM_ SG_ 360 FC_Obj9_Vx_Vnce  " ";
CM_ SG_ 360 FC_Obj9_CenterAngle  " ";
CM_ SG_ 360 FC_Obj9_DistInLane  " ";
CM_ SG_ 360 FC_Obj9_objCutInLane  " ";
CM_ SG_ 360 FC_Obj9_objCutInFlag  " ";
CM_ SG_ 360 FC_Obj9_CornerPoint_y  " ";
CM_ SG_ 360 FC_Obj9_CornerPoint_x  " ";
CM_ SG_ 360 FC_Obj9_LaneAssignment  " ";
CM_ SG_ 360 FC_Obj9_MotionType  " ";
CM_ SG_ 360 FC_obj9_Brakelight_Info  " ";
CM_ SG_ 360 FC_Obj9_Width  " ";
CM_ SG_ 360 FC_Obj9_Length  " ";
CM_ SG_ 360 FC_Obj9_Height  " ";
CM_ SG_ 360 FC_Obj9_HeadOrientation  " ";
CM_ SG_ 360 FC_Obj9_HeadingAngle  " ";
CM_ SG_ 360 FC_Obj9_ExistProb  " ";
CM_ SG_ 360 FC_Obj9_Dy_Vnce  " ";
CM_ SG_ 360 FC_Obj9_Dy  " ";
CM_ SG_ 360 FC_Obj9_Dx_Vnce  " ";
CM_ SG_ 360 FC_Obj9_Dx  " ";
CM_ SG_ 360 FC_Obj9_RelVy  " ";
CM_ SG_ 360 FC_Obj9_RelVx  " ";
CM_ SG_ 360 FC_Obj9_RelAy  " ";
CM_ SG_ 360 FC_Obj9_RelAx  " ";
CM_ SG_ 360 FC_Obj9_TypeProb  " ";
CM_ SG_ 360 FC_Obj9_Type  " ";
CM_ SG_ 360 FC_Obj9_Track_Age  " ";
CM_ SG_ 360 FC_Obj9_Track_ID  " ";

CM_ BO_ 361  " ";
CM_ SG_ 361 FC_Obj10_VehicleDir  " ";
CM_ SG_ 361 FC_Obj10ReDoorSts  " ";
CM_ SG_ 361 FC_Obj10RiDoorSts  " ";
CM_ SG_ 361 FC_Obj10LeDoorSts  " ";
CM_ SG_ 361 FC_Obj10WSInfoPosType  " ";
CM_ SG_ 361 FC_CRCCheck_169  " ";
CM_ SG_ 361 FC_RollingCounter_169  " ";
CM_ SG_ 361 FC_Obj10_Img2dBox_RightDown_V  " ";
CM_ SG_ 361 FC_Obj10_Img2dBox_LeftTop_V  " ";
CM_ SG_ 361 FC_Obj10_Img2dBox_RightDown_U  " ";
CM_ SG_ 361 FC_Obj10_Img2dBox_LeftTop_U  " ";
CM_ SG_ 361 FC_Obj10_TurnLight  " ";
CM_ SG_ 361 FC_Obj10_valid  "未收敛目标，输出invalid状态，输出valid状态，信号必须是可性的 ";
CM_ SG_ 361 FC_Obj10_Vy_Vnce  " ";
CM_ SG_ 361 FC_Obj10_Vx_Vnce  " ";
CM_ SG_ 361 FC_Obj10_CenterAngle  " ";
CM_ SG_ 361 FC_Obj10_DistInLane  " ";
CM_ SG_ 361 FC_Obj10_objCutInLane  " ";
CM_ SG_ 361 FC_Obj10_objCutInFlag  " ";
CM_ SG_ 361 FC_Obj10_CornerPoint_y  " ";
CM_ SG_ 361 FC_Obj10_CornerPoint_x  " ";
CM_ SG_ 361 FC_Obj10_LaneAssignment  " ";
CM_ SG_ 361 FC_Obj10_MotionType  " ";
CM_ SG_ 361 FC_obj10_Brakelight_Info  " ";
CM_ SG_ 361 FC_Obj10_Width  " ";
CM_ SG_ 361 FC_Obj10_Length  " ";
CM_ SG_ 361 FC_Obj10_Height  " ";
CM_ SG_ 361 FC_Obj10_HeadOrientation  " ";
CM_ SG_ 361 FC_Obj10_HeadingAngle  " ";
CM_ SG_ 361 FC_Obj10_ExistProb  " ";
CM_ SG_ 361 FC_Obj10_Dy_Vnce  " ";
CM_ SG_ 361 FC_Obj10_Dy  " ";
CM_ SG_ 361 FC_Obj10_Dx_Vnce  " ";
CM_ SG_ 361 FC_Obj10_Dx  " ";
CM_ SG_ 361 FC_Obj10_RelVy  " ";
CM_ SG_ 361 FC_Obj10_RelVx  " ";
CM_ SG_ 361 FC_Obj10_RelAy  " ";
CM_ SG_ 361 FC_Obj10_RelAx  " ";
CM_ SG_ 361 FC_Obj10_TypeProb  " ";
CM_ SG_ 361 FC_Obj10_Type  " ";
CM_ SG_ 361 FC_Obj10_Track_Age  " ";
CM_ SG_ 361 FC_Obj10_Track_ID  " ";

CM_ BO_ 368  " ";
CM_ SG_ 368 FC_Obj11_VehicleDir  " ";
CM_ SG_ 368 FC_Obj11ReDoorSts  " ";
CM_ SG_ 368 FC_Obj11RiDoorSts  " ";
CM_ SG_ 368 FC_Obj11LeDoorSts  " ";
CM_ SG_ 368 FC_Obj11WSInfoPosType  " ";
CM_ SG_ 368 FC_CRCCheck_170  " ";
CM_ SG_ 368 FC_RollingCounter_170  " ";
CM_ SG_ 368 FC_Obj11_Img2dBox_RightDown_V  " ";
CM_ SG_ 368 FC_Obj11_Img2dBox_LeftTop_V  " ";
CM_ SG_ 368 FC_Obj11_Img2dBox_RightDown_U  " ";
CM_ SG_ 368 FC_Obj11_Img2dBox_LeftTop_U  " ";
CM_ SG_ 368 FC_Obj11_TurnLight  " ";
CM_ SG_ 368 FC_Obj11_valid  "未收敛目标，输出invalid状态，输出valid状态，信号必须是可性的 ";
CM_ SG_ 368 FC_Obj11_Vy_Vnce  " ";
CM_ SG_ 368 FC_Obj11_Vx_Vnce  " ";
CM_ SG_ 368 FC_Obj11_CenterAngle  " ";
CM_ SG_ 368 FC_Obj11_DistInLane  " ";
CM_ SG_ 368 FC_Obj11_objCutInLane  " ";
CM_ SG_ 368 FC_Obj11_objCutInFlag  " ";
CM_ SG_ 368 FC_Obj11_CornerPoint_y  " ";
CM_ SG_ 368 FC_Obj11_CornerPoint_x  " ";
CM_ SG_ 368 FC_Obj11_LaneAssignment  " ";
CM_ SG_ 368 FC_Obj11_MotionType  " ";
CM_ SG_ 368 FC_obj11_Brakelight_Info  " ";
CM_ SG_ 368 FC_Obj11_Width  " ";
CM_ SG_ 368 FC_Obj11_Length  " ";
CM_ SG_ 368 FC_Obj11_Height  " ";
CM_ SG_ 368 FC_Obj11_HeadOrientation  " ";
CM_ SG_ 368 FC_Obj11_HeadingAngle  " ";
CM_ SG_ 368 FC_Obj11_ExistProb  " ";
CM_ SG_ 368 FC_Obj11_Dy_Vnce  " ";
CM_ SG_ 368 FC_Obj11_Dy  " ";
CM_ SG_ 368 FC_Obj11_Dx_Vnce  " ";
CM_ SG_ 368 FC_Obj11_Dx  " ";
CM_ SG_ 368 FC_Obj11_RelVy  " ";
CM_ SG_ 368 FC_Obj11_RelVx  " ";
CM_ SG_ 368 FC_Obj11_RelAy  " ";
CM_ SG_ 368 FC_Obj11_RelAx  " ";
CM_ SG_ 368 FC_Obj11_TypeProb  " ";
CM_ SG_ 368 FC_Obj11_Type  " ";
CM_ SG_ 368 FC_Obj11_Track_Age  " ";
CM_ SG_ 368 FC_Obj11_Track_ID  " ";

CM_ BO_ 369  " ";
CM_ SG_ 369 FC_Obj12_VehicleDir  " ";
CM_ SG_ 369 FC_Obj12ReDoorSts  " ";
CM_ SG_ 369 FC_Obj12RiDoorSts  " ";
CM_ SG_ 369 FC_Obj12LeDoorSts  " ";
CM_ SG_ 369 FC_Obj12WSInfoPosType  " ";
CM_ SG_ 369 FC_CRCCheck_171  " ";
CM_ SG_ 369 FC_RollingCounter_171  " ";
CM_ SG_ 369 FC_Obj12_Img2dBox_RightDown_V  " ";
CM_ SG_ 369 FC_Obj12_Img2dBox_LeftTop_V  " ";
CM_ SG_ 369 FC_Obj12_Img2dBox_RightDown_U  " ";
CM_ SG_ 369 FC_Obj12_Img2dBox_LeftTop_U  " ";
CM_ SG_ 369 FC_Obj12_TurnLight  " ";
CM_ SG_ 369 FC_Obj12_valid  "未收敛目标，输出invalid状态，输出valid状态，信号必须是可性的 ";
CM_ SG_ 369 FC_Obj12_Vy_Vnce  " ";
CM_ SG_ 369 FC_Obj12_Vx_Vnce  " ";
CM_ SG_ 369 FC_Obj12_CenterAngle  " ";
CM_ SG_ 369 FC_Obj12_DistInLane  " ";
CM_ SG_ 369 FC_Obj12_objCutInLane  " ";
CM_ SG_ 369 FC_Obj12_objCutInFlag  " ";
CM_ SG_ 369 FC_Obj12_CornerPoint_y  " ";
CM_ SG_ 369 FC_Obj12_CornerPoint_x  " ";
CM_ SG_ 369 FC_Obj12_LaneAssignment  " ";
CM_ SG_ 369 FC_Obj12_MotionType  " ";
CM_ SG_ 369 FC_obj12_Brakelight_Info  " ";
CM_ SG_ 369 FC_Obj12_Width  " ";
CM_ SG_ 369 FC_Obj12_Length  " ";
CM_ SG_ 369 FC_Obj12_Height  " ";
CM_ SG_ 369 FC_Obj12_HeadOrientation  " ";
CM_ SG_ 369 FC_Obj12_HeadingAngle  " ";
CM_ SG_ 369 FC_Obj12_ExistProb  " ";
CM_ SG_ 369 FC_Obj12_Dy_Vnce  " ";
CM_ SG_ 369 FC_Obj12_Dy  " ";
CM_ SG_ 369 FC_Obj12_Dx_Vnce  " ";
CM_ SG_ 369 FC_Obj12_Dx  " ";
CM_ SG_ 369 FC_Obj12_RelVy  " ";
CM_ SG_ 369 FC_Obj12_RelVx  " ";
CM_ SG_ 369 FC_Obj12_RelAy  " ";
CM_ SG_ 369 FC_Obj12_RelAx  " ";
CM_ SG_ 369 FC_Obj12_TypeProb  " ";
CM_ SG_ 369 FC_Obj12_Type  " ";
CM_ SG_ 369 FC_Obj12_Track_Age  " ";
CM_ SG_ 369 FC_Obj12_Track_ID  " ";

CM_ BO_ 370  " ";
CM_ SG_ 370 FC_Obj13_VehicleDir  " ";
CM_ SG_ 370 FC_Obj13ReDoorSts  " ";
CM_ SG_ 370 FC_Obj13RiDoorSts  " ";
CM_ SG_ 370 FC_Obj13LeDoorSts  " ";
CM_ SG_ 370 FC_Obj13WSInfoPosType  " ";
CM_ SG_ 370 FC_CRCCheck_172  " ";
CM_ SG_ 370 FC_RollingCounter_172  " ";
CM_ SG_ 370 FC_Obj13_Img2dBox_RightDown_V  " ";
CM_ SG_ 370 FC_Obj13_Img2dBox_LeftTop_V  " ";
CM_ SG_ 370 FC_Obj13_Img2dBox_RightDown_U  " ";
CM_ SG_ 370 FC_Obj13_Img2dBox_LeftTop_U  " ";
CM_ SG_ 370 FC_Obj13_TurnLight  " ";
CM_ SG_ 370 FC_Obj13_valid  "未收敛目标，输出invalid状态，输出valid状态，信号必须是可性的 ";
CM_ SG_ 370 FC_Obj13_Vy_Vnce  " ";
CM_ SG_ 370 FC_Obj13_Vx_Vnce  " ";
CM_ SG_ 370 FC_Obj13_CenterAngle  " ";
CM_ SG_ 370 FC_Obj13_DistInLane  " ";
CM_ SG_ 370 FC_Obj13_objCutInLane  " ";
CM_ SG_ 370 FC_Obj13_objCutInFlag  " ";
CM_ SG_ 370 FC_Obj13_CornerPoint_y  " ";
CM_ SG_ 370 FC_Obj13_CornerPoint_x  " ";
CM_ SG_ 370 FC_Obj13_LaneAssignment  " ";
CM_ SG_ 370 FC_Obj13_MotionType  " ";
CM_ SG_ 370 FC_obj13_Brakelight_Info  " ";
CM_ SG_ 370 FC_Obj13_Width  " ";
CM_ SG_ 370 FC_Obj13_Length  " ";
CM_ SG_ 370 FC_Obj13_Height  " ";
CM_ SG_ 370 FC_Obj13_HeadOrientation  " ";
CM_ SG_ 370 FC_Obj13_HeadingAngle  " ";
CM_ SG_ 370 FC_Obj13_ExistProb  " ";
CM_ SG_ 370 FC_Obj13_Dy_Vnce  " ";
CM_ SG_ 370 FC_Obj13_Dy  " ";
CM_ SG_ 370 FC_Obj13_Dx_Vnce  " ";
CM_ SG_ 370 FC_Obj13_Dx  " ";
CM_ SG_ 370 FC_Obj13_RelVy  " ";
CM_ SG_ 370 FC_Obj13_RelVx  " ";
CM_ SG_ 370 FC_Obj13_RelAy  " ";
CM_ SG_ 370 FC_Obj13_RelAx  " ";
CM_ SG_ 370 FC_Obj13_TypeProb  " ";
CM_ SG_ 370 FC_Obj13_Type  " ";
CM_ SG_ 370 FC_Obj13_Track_Age  " ";
CM_ SG_ 370 FC_Obj13_Track_ID  " ";

CM_ BO_ 371  " ";
CM_ SG_ 371 FC_Obj14_VehicleDir  " ";
CM_ SG_ 371 FC_Obj14ReDoorSts  " ";
CM_ SG_ 371 FC_Obj14RiDoorSts  " ";
CM_ SG_ 371 FC_Obj14LeDoorSts  " ";
CM_ SG_ 371 FC_Obj14WSInfoPosType  " ";
CM_ SG_ 371 FC_CRCCheck_173  " ";
CM_ SG_ 371 FC_RollingCounter_173  " ";
CM_ SG_ 371 FC_Obj14_Img2dBox_RightDown_V  " ";
CM_ SG_ 371 FC_Obj14_Img2dBox_LeftTop_V  " ";
CM_ SG_ 371 FC_Obj14_Img2dBox_RightDown_U  " ";
CM_ SG_ 371 FC_Obj14_Img2dBox_LeftTop_U  " ";
CM_ SG_ 371 FC_Obj14_TurnLight  " ";
CM_ SG_ 371 FC_Obj14_valid  "未收敛目标，输出invalid状态，输出valid状态，信号必须是可性的 ";
CM_ SG_ 371 FC_Obj14_Vy_Vnce  " ";
CM_ SG_ 371 FC_Obj14_Vx_Vnce  " ";
CM_ SG_ 371 FC_Obj14_CenterAngle  " ";
CM_ SG_ 371 FC_Obj14_DistInLane  " ";
CM_ SG_ 371 FC_Obj14_objCutInLane  " ";
CM_ SG_ 371 FC_Obj14_objCutInFlag  " ";
CM_ SG_ 371 FC_Obj14_CornerPoint_y  " ";
CM_ SG_ 371 FC_Obj14_CornerPoint_x  " ";
CM_ SG_ 371 FC_Obj14_LaneAssignment  " ";
CM_ SG_ 371 FC_Obj14_MotionType  " ";
CM_ SG_ 371 FC_obj14_Brakelight_Info  " ";
CM_ SG_ 371 FC_Obj14_Width  " ";
CM_ SG_ 371 FC_Obj14_Length  " ";
CM_ SG_ 371 FC_Obj14_Height  " ";
CM_ SG_ 371 FC_Obj14_HeadOrientation  " ";
CM_ SG_ 371 FC_Obj14_HeadingAngle  " ";
CM_ SG_ 371 FC_Obj14_ExistProb  " ";
CM_ SG_ 371 FC_Obj14_Dy_Vnce  " ";
CM_ SG_ 371 FC_Obj14_Dy  " ";
CM_ SG_ 371 FC_Obj14_Dx_Vnce  " ";
CM_ SG_ 371 FC_Obj14_Dx  " ";
CM_ SG_ 371 FC_Obj14_RelVy  " ";
CM_ SG_ 371 FC_Obj14_RelVx  " ";
CM_ SG_ 371 FC_Obj14_RelAy  " ";
CM_ SG_ 371 FC_Obj14_RelAx  " ";
CM_ SG_ 371 FC_Obj14_TypeProb  " ";
CM_ SG_ 371 FC_Obj14_Type  " ";
CM_ SG_ 371 FC_Obj14_Track_Age  " ";
CM_ SG_ 371 FC_Obj14_Track_ID  " ";

CM_ BO_ 372  " ";
CM_ SG_ 372 FC_Obj15_VehicleDir  " ";
CM_ SG_ 372 FC_Obj15ReDoorSts  " ";
CM_ SG_ 372 FC_Obj15RiDoorSts  " ";
CM_ SG_ 372 FC_Obj15LeDoorSts  " ";
CM_ SG_ 372 FC_Obj15WSInfoPosType  " ";
CM_ SG_ 372 FC_CRCCheck_174  " ";
CM_ SG_ 372 FC_RollingCounter_174  " ";
CM_ SG_ 372 FC_Obj15_Img2dBox_RightDown_V  " ";
CM_ SG_ 372 FC_Obj15_Img2dBox_LeftTop_V  " ";
CM_ SG_ 372 FC_Obj15_Img2dBox_RightDown_U  " ";
CM_ SG_ 372 FC_Obj15_Img2dBox_LeftTop_U  " ";
CM_ SG_ 372 FC_Obj15_TurnLight  " ";
CM_ SG_ 372 FC_Obj15_valid  "未收敛目标，输出invalid状态，输出valid状态，信号必须是可性的 ";
CM_ SG_ 372 FC_Obj15_Vy_Vnce  " ";
CM_ SG_ 372 FC_Obj15_Vx_Vnce  " ";
CM_ SG_ 372 FC_Obj15_CenterAngle  " ";
CM_ SG_ 372 FC_Obj15_DistInLane  " ";
CM_ SG_ 372 FC_Obj15_objCutInLane  " ";
CM_ SG_ 372 FC_Obj15_objCutInFlag  " ";
CM_ SG_ 372 FC_Obj15_CornerPoint_y  " ";
CM_ SG_ 372 FC_Obj15_CornerPoint_x  " ";
CM_ SG_ 372 FC_Obj15_LaneAssignment  " ";
CM_ SG_ 372 FC_Obj15_MotionType  " ";
CM_ SG_ 372 FC_obj15_Brakelight_Info  " ";
CM_ SG_ 372 FC_Obj15_Width  " ";
CM_ SG_ 372 FC_Obj15_Length  " ";
CM_ SG_ 372 FC_Obj15_Height  " ";
CM_ SG_ 372 FC_Obj15_HeadOrientation  " ";
CM_ SG_ 372 FC_Obj15_HeadingAngle  " ";
CM_ SG_ 372 FC_Obj15_ExistProb  " ";
CM_ SG_ 372 FC_Obj15_Dy_Vnce  " ";
CM_ SG_ 372 FC_Obj15_Dy  " ";
CM_ SG_ 372 FC_Obj15_Dx_Vnce  " ";
CM_ SG_ 372 FC_Obj15_Dx  " ";
CM_ SG_ 372 FC_Obj15_RelVy  " ";
CM_ SG_ 372 FC_Obj15_RelVx  " ";
CM_ SG_ 372 FC_Obj15_RelAy  " ";
CM_ SG_ 372 FC_Obj15_RelAx  " ";
CM_ SG_ 372 FC_Obj15_TypeProb  " ";
CM_ SG_ 372 FC_Obj15_Type  " ";
CM_ SG_ 372 FC_Obj15_Track_Age  " ";
CM_ SG_ 372 FC_Obj15_Track_ID  " ";

CM_ BO_ 373  " ";
CM_ SG_ 373 FC_Obj16_VehicleDir  " ";
CM_ SG_ 373 FC_Obj16ReDoorSts  " ";
CM_ SG_ 373 FC_Obj16RiDoorSts  " ";
CM_ SG_ 373 FC_Obj16LeDoorSts  " ";
CM_ SG_ 373 FC_Obj16WSInfoPosType  " ";
CM_ SG_ 373 FC_CRCCheck_175  " ";
CM_ SG_ 373 FC_RollingCounter_175  " ";
CM_ SG_ 373 FC_Obj16_Img2dBox_RightDown_V  " ";
CM_ SG_ 373 FC_Obj16_Img2dBox_LeftTop_V  " ";
CM_ SG_ 373 FC_Obj16_Img2dBox_RightDown_U  " ";
CM_ SG_ 373 FC_Obj16_Img2dBox_LeftTop_U  " ";
CM_ SG_ 373 FC_Obj16_TurnLight  " ";
CM_ SG_ 373 FC_Obj16_valid  "未收敛目标，输出invalid状态，输出valid状态，信号必须是可性的 ";
CM_ SG_ 373 FC_Obj16_Vy_Vnce  " ";
CM_ SG_ 373 FC_Obj16_Vx_Vnce  " ";
CM_ SG_ 373 FC_Obj16_CenterAngle  " ";
CM_ SG_ 373 FC_Obj16_DistInLane  " ";
CM_ SG_ 373 FC_Obj16_objCutInLane  " ";
CM_ SG_ 373 FC_Obj16_objCutInFlag  " ";
CM_ SG_ 373 FC_Obj16_CornerPoint_y  " ";
CM_ SG_ 373 FC_Obj16_CornerPoint_x  " ";
CM_ SG_ 373 FC_Obj16_LaneAssignment  " ";
CM_ SG_ 373 FC_Obj16_MotionType  " ";
CM_ SG_ 373 FC_obj16_Brakelight_Info  " ";
CM_ SG_ 373 FC_Obj16_Width  " ";
CM_ SG_ 373 FC_Obj16_Length  " ";
CM_ SG_ 373 FC_Obj16_Height  " ";
CM_ SG_ 373 FC_Obj16_HeadOrientation  " ";
CM_ SG_ 373 FC_Obj16_HeadingAngle  " ";
CM_ SG_ 373 FC_Obj16_ExistProb  " ";
CM_ SG_ 373 FC_Obj16_Dy_Vnce  " ";
CM_ SG_ 373 FC_Obj16_Dy  " ";
CM_ SG_ 373 FC_Obj16_Dx_Vnce  " ";
CM_ SG_ 373 FC_Obj16_Dx  " ";
CM_ SG_ 373 FC_Obj16_RelVy  " ";
CM_ SG_ 373 FC_Obj16_RelVx  " ";
CM_ SG_ 373 FC_Obj16_RelAy  " ";
CM_ SG_ 373 FC_Obj16_RelAx  " ";
CM_ SG_ 373 FC_Obj16_TypeProb  " ";
CM_ SG_ 373 FC_Obj16_Type  " ";
CM_ SG_ 373 FC_Obj16_Track_Age  " ";
CM_ SG_ 373 FC_Obj16_Track_ID  " ";

CM_ BO_ 374  " ";
CM_ SG_ 374 FC_Obj17_VehicleDir  " ";
CM_ SG_ 374 FC_Obj17ReDoorSts  " ";
CM_ SG_ 374 FC_Obj17RiDoorSts  " ";
CM_ SG_ 374 FC_Obj17LeDoorSts  " ";
CM_ SG_ 374 FC_Obj17WSInfoPosType  " ";
CM_ SG_ 374 FC_CRCCheck_176  " ";
CM_ SG_ 374 FC_RollingCounter_176  " ";
CM_ SG_ 374 FC_Obj17_Img2dBox_RightDown_V  " ";
CM_ SG_ 374 FC_Obj17_Img2dBox_LeftTop_V  " ";
CM_ SG_ 374 FC_Obj17_Img2dBox_RightDown_U  " ";
CM_ SG_ 374 FC_Obj17_Img2dBox_LeftTop_U  " ";
CM_ SG_ 374 FC_Obj17_TurnLight  " ";
CM_ SG_ 374 FC_Obj17_valid  "未收敛目标，输出invalid状态，输出valid状态，信号必须是可性的 ";
CM_ SG_ 374 FC_Obj17_Vy_Vnce  " ";
CM_ SG_ 374 FC_Obj17_Vx_Vnce  " ";
CM_ SG_ 374 FC_Obj17_CenterAngle  " ";
CM_ SG_ 374 FC_Obj17_DistInLane  " ";
CM_ SG_ 374 FC_Obj17_objCutInLane  " ";
CM_ SG_ 374 FC_Obj17_objCutInFlag  " ";
CM_ SG_ 374 FC_Obj17_CornerPoint_y  " ";
CM_ SG_ 374 FC_Obj17_CornerPoint_x  " ";
CM_ SG_ 374 FC_Obj17_LaneAssignment  " ";
CM_ SG_ 374 FC_Obj17_MotionType  " ";
CM_ SG_ 374 FC_obj17_Brakelight_Info  " ";
CM_ SG_ 374 FC_Obj17_Width  " ";
CM_ SG_ 374 FC_Obj17_Length  " ";
CM_ SG_ 374 FC_Obj17_Height  " ";
CM_ SG_ 374 FC_Obj17_HeadOrientation  " ";
CM_ SG_ 374 FC_Obj17_HeadingAngle  " ";
CM_ SG_ 374 FC_Obj17_ExistProb  " ";
CM_ SG_ 374 FC_Obj17_Dy_Vnce  " ";
CM_ SG_ 374 FC_Obj17_Dy  " ";
CM_ SG_ 374 FC_Obj17_Dx_Vnce  " ";
CM_ SG_ 374 FC_Obj17_Dx  " ";
CM_ SG_ 374 FC_Obj17_RelVy  " ";
CM_ SG_ 374 FC_Obj17_RelVx  " ";
CM_ SG_ 374 FC_Obj17_RelAy  " ";
CM_ SG_ 374 FC_Obj17_RelAx  " ";
CM_ SG_ 374 FC_Obj17_TypeProb  " ";
CM_ SG_ 374 FC_Obj17_Type  " ";
CM_ SG_ 374 FC_Obj17_Track_Age  " ";
CM_ SG_ 374 FC_Obj17_Track_ID  " ";

CM_ BO_ 375  " ";
CM_ SG_ 375 FC_Obj18_VehicleDir  " ";
CM_ SG_ 375 FC_Obj18ReDoorSts  " ";
CM_ SG_ 375 FC_Obj18RiDoorSts  " ";
CM_ SG_ 375 FC_Obj18LeDoorSts  " ";
CM_ SG_ 375 FC_Obj18WSInfoPosType  " ";
CM_ SG_ 375 FC_CRCCheck_177  " ";
CM_ SG_ 375 FC_RollingCounter_177  " ";
CM_ SG_ 375 FC_Obj18_Img2dBox_RightDown_V  " ";
CM_ SG_ 375 FC_Obj18_Img2dBox_LeftTop_V  " ";
CM_ SG_ 375 FC_Obj18_Img2dBox_RightDown_U  " ";
CM_ SG_ 375 FC_Obj18_Img2dBox_LeftTop_U  " ";
CM_ SG_ 375 FC_Obj18_TurnLight  " ";
CM_ SG_ 375 FC_Obj18_valid  "未收敛目标，输出invalid状态，输出valid状态，信号必须是可性的 ";
CM_ SG_ 375 FC_Obj18_Vy_Vnce  " ";
CM_ SG_ 375 FC_Obj18_Vx_Vnce  " ";
CM_ SG_ 375 FC_Obj18_CenterAngle  " ";
CM_ SG_ 375 FC_Obj18_DistInLane  " ";
CM_ SG_ 375 FC_Obj18_objCutInLane  " ";
CM_ SG_ 375 FC_Obj18_objCutInFlag  " ";
CM_ SG_ 375 FC_Obj18_CornerPoint_y  " ";
CM_ SG_ 375 FC_Obj18_CornerPoint_x  " ";
CM_ SG_ 375 FC_Obj18_LaneAssignment  " ";
CM_ SG_ 375 FC_Obj18_MotionType  " ";
CM_ SG_ 375 FC_obj18_Brakelight_Info  " ";
CM_ SG_ 375 FC_Obj18_Width  " ";
CM_ SG_ 375 FC_Obj18_Length  " ";
CM_ SG_ 375 FC_Obj18_Height  " ";
CM_ SG_ 375 FC_Obj18_HeadOrientation  " ";
CM_ SG_ 375 FC_Obj18_HeadingAngle  " ";
CM_ SG_ 375 FC_Obj18_ExistProb  " ";
CM_ SG_ 375 FC_Obj18_Dy_Vnce  " ";
CM_ SG_ 375 FC_Obj18_Dy  " ";
CM_ SG_ 375 FC_Obj18_Dx_Vnce  " ";
CM_ SG_ 375 FC_Obj18_Dx  " ";
CM_ SG_ 375 FC_Obj18_RelVy  " ";
CM_ SG_ 375 FC_Obj18_RelVx  " ";
CM_ SG_ 375 FC_Obj18_RelAy  " ";
CM_ SG_ 375 FC_Obj18_RelAx  " ";
CM_ SG_ 375 FC_Obj18_TypeProb  " ";
CM_ SG_ 375 FC_Obj18_Type  " ";
CM_ SG_ 375 FC_Obj18_Track_Age  " ";
CM_ SG_ 375 FC_Obj18_Track_ID  " ";

BA_DEF_ SG_  "GenSigStartValue" INT 0 0;
BA_DEF_ SG_  "GenSigInvalidValue" STRING  ;
BA_DEF_ SG_  "GenSigCycleTime" INT 0 0;
BA_DEF_ SG_  "GenSigSendType" ENUM  "Cyclic","OnWrite","OnWriteWithRepetition","OnChange","OnChangeWithRepetition","IfActive","IfActiveWithRepetition","NoSigSendType","NotUsed","NotUsed","NotUsed","NotUsed","NotUsed";
BA_DEF_ BO_  "GenMsgSendType" ENUM  "Cyclic","Event","NotUsed","NotUsed","NotUsed","Cyclic","NotUsed","IfActive","NoMsgSendType","NotUsed";
BA_DEF_ BO_  "GenMsgILSupport" ENUM  "No","Yes";
BA_DEF_ BO_  "GenMsgCycleTime" INT 0 65535;
BA_DEF_ BO_  "CANFD_BRS" ENUM  "0","1";
BA_DEF_ BO_  "VFrameFormat" ENUM  "StandardCAN","ExtendedCAN","reserved","reserved","reserved","reserved","reserved","reserved","reserved","reserved","reserved","reserved","reserved","reserved","StandardCAN_FD","ExtendedCAN_FD";
BA_DEF_DEF_  "GenSigStartValue" 0;
BA_DEF_DEF_  "GenSigInvalidValue" "/";
BA_DEF_DEF_  "GenSigCycleTime" 0;
BA_DEF_DEF_  "GenSigSendType" "Cyclic";
BA_DEF_DEF_  "GenMsgSendType" "NoMsgSendType";
BA_DEF_DEF_  "GenMsgILSupport" "Yes";
BA_DEF_DEF_  "GenMsgCycleTime" 0;
BA_DEF_DEF_  "CANFD_BRS" "1";
BA_DEF_DEF_  "VFrameFormat" "StandardCAN";
BA_ "GenMsgCycleTime" BO_ 354 60;
BA_ "GenMsgSendType" BO_ 354 0;
BA_ "VFrameFormat" BO_ 354 14;
BA_ "GenMsgCycleTime" BO_ 355 60;
BA_ "GenMsgSendType" BO_ 355 0;
BA_ "VFrameFormat" BO_ 355 14;
BA_ "GenMsgCycleTime" BO_ 356 60;
BA_ "GenMsgSendType" BO_ 356 0;
BA_ "VFrameFormat" BO_ 356 14;
BA_ "GenMsgCycleTime" BO_ 357 60;
BA_ "GenMsgSendType" BO_ 357 0;
BA_ "VFrameFormat" BO_ 357 14;
BA_ "GenMsgCycleTime" BO_ 358 60;
BA_ "GenMsgSendType" BO_ 358 0;
BA_ "VFrameFormat" BO_ 358 14;
BA_ "GenMsgCycleTime" BO_ 359 60;
BA_ "GenMsgSendType" BO_ 359 0;
BA_ "VFrameFormat" BO_ 359 14;
BA_ "GenMsgCycleTime" BO_ 360 60;
BA_ "GenMsgSendType" BO_ 360 0;
BA_ "VFrameFormat" BO_ 360 14;
BA_ "GenMsgCycleTime" BO_ 361 60;
BA_ "GenMsgSendType" BO_ 361 0;
BA_ "VFrameFormat" BO_ 361 14;
BA_ "GenMsgCycleTime" BO_ 368 60;
BA_ "GenMsgSendType" BO_ 368 0;
BA_ "VFrameFormat" BO_ 368 14;
BA_ "GenMsgCycleTime" BO_ 369 60;
BA_ "GenMsgSendType" BO_ 369 0;
BA_ "VFrameFormat" BO_ 369 14;
BA_ "GenMsgCycleTime" BO_ 370 60;
BA_ "GenMsgSendType" BO_ 370 0;
BA_ "VFrameFormat" BO_ 370 14;
BA_ "GenMsgCycleTime" BO_ 371 60;
BA_ "GenMsgSendType" BO_ 371 0;
BA_ "VFrameFormat" BO_ 371 14;
BA_ "GenMsgCycleTime" BO_ 372 60;
BA_ "GenMsgSendType" BO_ 372 0;
BA_ "VFrameFormat" BO_ 372 14;
BA_ "GenMsgCycleTime" BO_ 373 60;
BA_ "GenMsgSendType" BO_ 373 0;
BA_ "VFrameFormat" BO_ 373 14;
BA_ "GenMsgCycleTime" BO_ 374 60;
BA_ "GenMsgSendType" BO_ 374 0;
BA_ "VFrameFormat" BO_ 374 14;
BA_ "GenMsgCycleTime" BO_ 375 60;
BA_ "GenMsgSendType" BO_ 375 0;
BA_ "VFrameFormat" BO_ 375 14;

BA_ "GenSigCycleTime" SG_ 354 FC_Obj3_VehicleDir 60;
BA_ "GenSigCycleTime" SG_ 354 FC_Obj3ReDoorSts 60;
BA_ "GenSigCycleTime" SG_ 354 FC_Obj3RiDoorSts 60;
BA_ "GenSigCycleTime" SG_ 354 FC_Obj3LeDoorSts 60;
BA_ "GenSigCycleTime" SG_ 354 FC_Obj3WSInfoPosType 60;
BA_ "GenSigCycleTime" SG_ 354 FC_CRCCheck_162 60;
BA_ "GenSigCycleTime" SG_ 354 FC_RollingCounter_162 60;
BA_ "GenSigCycleTime" SG_ 354 FC_Obj3_Img2dBox_RightDown_V 60;
BA_ "GenSigCycleTime" SG_ 354 FC_Obj3_Img2dBox_LeftTop_V 60;
BA_ "GenSigCycleTime" SG_ 354 FC_Obj3_Img2dBox_RightDown_U 60;
BA_ "GenSigCycleTime" SG_ 354 FC_Obj3_Img2dBox_LeftTop_U 60;
BA_ "GenSigCycleTime" SG_ 354 FC_Obj3_TurnLight 60;
BA_ "GenSigCycleTime" SG_ 354 FC_Obj3_valid 60;
BA_ "GenSigCycleTime" SG_ 354 FC_Obj3_Vy_Vnce 60;
BA_ "GenSigCycleTime" SG_ 354 FC_Obj3_Vx_Vnce 60;
BA_ "GenSigCycleTime" SG_ 354 FC_Obj3_CenterAngle 60;
BA_ "GenSigCycleTime" SG_ 354 FC_Obj3_DistInLane 60;
BA_ "GenSigCycleTime" SG_ 354 FC_Obj3_objCutInLane 60;
BA_ "GenSigCycleTime" SG_ 354 FC_Obj3_objCutInFlag 60;
BA_ "GenSigCycleTime" SG_ 354 FC_Obj3_CornerPoint_y 60;
BA_ "GenSigCycleTime" SG_ 354 FC_Obj3_CornerPoint_x 60;
BA_ "GenSigCycleTime" SG_ 354 FC_Obj3_LaneAssignment 60;
BA_ "GenSigCycleTime" SG_ 354 FC_Obj3_MotionType 60;
BA_ "GenSigCycleTime" SG_ 354 FC_obj3_Brakelight_Info 60;
BA_ "GenSigCycleTime" SG_ 354 FC_Obj3_Width 60;
BA_ "GenSigCycleTime" SG_ 354 FC_Obj3_Length 60;
BA_ "GenSigCycleTime" SG_ 354 FC_Obj3_Height 60;
BA_ "GenSigCycleTime" SG_ 354 FC_Obj3_HeadOrientation 60;
BA_ "GenSigCycleTime" SG_ 354 FC_Obj3_HeadingAngle 60;
BA_ "GenSigCycleTime" SG_ 354 FC_Obj3_ExistProb 60;
BA_ "GenSigCycleTime" SG_ 354 FC_Obj3_Dy_Vnce 60;
BA_ "GenSigCycleTime" SG_ 354 FC_Obj3_Dy 60;
BA_ "GenSigCycleTime" SG_ 354 FC_Obj3_Dx_Vnce 60;
BA_ "GenSigCycleTime" SG_ 354 FC_Obj3_Dx 60;
BA_ "GenSigCycleTime" SG_ 354 FC_Obj3_RelVy 60;
BA_ "GenSigCycleTime" SG_ 354 FC_Obj3_RelVx 60;
BA_ "GenSigCycleTime" SG_ 354 FC_Obj3_RelAy 60;
BA_ "GenSigCycleTime" SG_ 354 FC_Obj3_RelAx 60;
BA_ "GenSigCycleTime" SG_ 354 FC_Obj3_TypeProb 60;
BA_ "GenSigCycleTime" SG_ 354 FC_Obj3_Type 60;
BA_ "GenSigCycleTime" SG_ 354 FC_Obj3_Track_Age 60;
BA_ "GenSigCycleTime" SG_ 354 FC_Obj3_Track_ID 60;

BA_ "GenSigCycleTime" SG_ 355 FC_Obj4_VehicleDir 60;
BA_ "GenSigCycleTime" SG_ 355 FC_Obj4ReDoorSts 60;
BA_ "GenSigCycleTime" SG_ 355 FC_Obj4RiDoorSts 60;
BA_ "GenSigCycleTime" SG_ 355 FC_Obj4LeDoorSts 60;
BA_ "GenSigCycleTime" SG_ 355 FC_Obj4WSInfoPosType 60;
BA_ "GenSigCycleTime" SG_ 355 FC_CRCCheck_163 60;
BA_ "GenSigCycleTime" SG_ 355 FC_RollingCounter_163 60;
BA_ "GenSigCycleTime" SG_ 355 FC_Obj4_Img2dBox_RightDown_V 60;
BA_ "GenSigCycleTime" SG_ 355 FC_Obj4_Img2dBox_LeftTop_V 60;
BA_ "GenSigCycleTime" SG_ 355 FC_Obj4_Img2dBox_RightDown_U 60;
BA_ "GenSigCycleTime" SG_ 355 FC_Obj4_Img2dBox_LeftTop_U 60;
BA_ "GenSigCycleTime" SG_ 355 FC_Obj4_TurnLight 60;
BA_ "GenSigCycleTime" SG_ 355 FC_Obj4_valid 60;
BA_ "GenSigCycleTime" SG_ 355 FC_Obj4_Vy_Vnce 60;
BA_ "GenSigCycleTime" SG_ 355 FC_Obj4_Vx_Vnce 60;
BA_ "GenSigCycleTime" SG_ 355 FC_Obj4_CenterAngle 60;
BA_ "GenSigCycleTime" SG_ 355 FC_Obj4_DistInLane 60;
BA_ "GenSigCycleTime" SG_ 355 FC_Obj4_objCutInLane 60;
BA_ "GenSigCycleTime" SG_ 355 FC_Obj4_objCutInFlag 60;
BA_ "GenSigCycleTime" SG_ 355 FC_Obj4_CornerPoint_y 60;
BA_ "GenSigCycleTime" SG_ 355 FC_Obj4_CornerPoint_x 60;
BA_ "GenSigCycleTime" SG_ 355 FC_Obj4_LaneAssignment 60;
BA_ "GenSigCycleTime" SG_ 355 FC_Obj4_MotionType 60;
BA_ "GenSigCycleTime" SG_ 355 FC_obj4_Brakelight_Info 60;
BA_ "GenSigCycleTime" SG_ 355 FC_Obj4_Width 60;
BA_ "GenSigCycleTime" SG_ 355 FC_Obj4_Length 60;
BA_ "GenSigCycleTime" SG_ 355 FC_Obj4_Height 60;
BA_ "GenSigCycleTime" SG_ 355 FC_Obj4_HeadOrientation 60;
BA_ "GenSigCycleTime" SG_ 355 FC_Obj4_HeadingAngle 60;
BA_ "GenSigCycleTime" SG_ 355 FC_Obj4_ExistProb 60;
BA_ "GenSigCycleTime" SG_ 355 FC_Obj4_Dy_Vnce 60;
BA_ "GenSigCycleTime" SG_ 355 FC_Obj4_Dy 60;
BA_ "GenSigCycleTime" SG_ 355 FC_Obj4_Dx_Vnce 60;
BA_ "GenSigCycleTime" SG_ 355 FC_Obj4_Dx 60;
BA_ "GenSigCycleTime" SG_ 355 FC_Obj4_RelVy 60;
BA_ "GenSigCycleTime" SG_ 355 FC_Obj4_RelVx 60;
BA_ "GenSigCycleTime" SG_ 355 FC_Obj4_RelAy 60;
BA_ "GenSigCycleTime" SG_ 355 FC_Obj4_RelAx 60;
BA_ "GenSigCycleTime" SG_ 355 FC_Obj4_TypeProb 60;
BA_ "GenSigCycleTime" SG_ 355 FC_Obj4_Type 60;
BA_ "GenSigCycleTime" SG_ 355 FC_Obj4_Track_Age 60;
BA_ "GenSigCycleTime" SG_ 355 FC_Obj4_Track_ID 60;

BA_ "GenSigCycleTime" SG_ 356 FC_Obj5_VehicleDir 60;
BA_ "GenSigCycleTime" SG_ 356 FC_Obj5ReDoorSts 60;
BA_ "GenSigCycleTime" SG_ 356 FC_Obj5RiDoorSts 60;
BA_ "GenSigCycleTime" SG_ 356 FC_Obj5LeDoorSts 60;
BA_ "GenSigCycleTime" SG_ 356 FC_Obj5WSInfoPosType 60;
BA_ "GenSigCycleTime" SG_ 356 FC_CRCCheck_164 60;
BA_ "GenSigCycleTime" SG_ 356 FC_RollingCounter_164 60;
BA_ "GenSigCycleTime" SG_ 356 FC_Obj5_Img2dBox_RightDown_V 60;
BA_ "GenSigCycleTime" SG_ 356 FC_Obj5_Img2dBox_LeftTop_V 60;
BA_ "GenSigCycleTime" SG_ 356 FC_Obj5_Img2dBox_RightDown_U 60;
BA_ "GenSigCycleTime" SG_ 356 FC_Obj5_Img2dBox_LeftTop_U 60;
BA_ "GenSigCycleTime" SG_ 356 FC_Obj5_TurnLight 60;
BA_ "GenSigCycleTime" SG_ 356 FC_Obj5_valid 60;
BA_ "GenSigCycleTime" SG_ 356 FC_Obj5_Vy_Vnce 60;
BA_ "GenSigCycleTime" SG_ 356 FC_Obj5_Vx_Vnce 60;
BA_ "GenSigCycleTime" SG_ 356 FC_Obj5_CenterAngle 60;
BA_ "GenSigCycleTime" SG_ 356 FC_Obj5_DistInLane 60;
BA_ "GenSigCycleTime" SG_ 356 FC_Obj5_objCutInLane 60;
BA_ "GenSigCycleTime" SG_ 356 FC_Obj5_objCutInFlag 60;
BA_ "GenSigCycleTime" SG_ 356 FC_Obj5_CornerPoint_y 60;
BA_ "GenSigCycleTime" SG_ 356 FC_Obj5_CornerPoint_x 60;
BA_ "GenSigCycleTime" SG_ 356 FC_Obj5_LaneAssignment 60;
BA_ "GenSigCycleTime" SG_ 356 FC_Obj5_MotionType 60;
BA_ "GenSigCycleTime" SG_ 356 FC_obj5_Brakelight_Info 60;
BA_ "GenSigCycleTime" SG_ 356 FC_Obj5_Width 60;
BA_ "GenSigCycleTime" SG_ 356 FC_Obj5_Length 60;
BA_ "GenSigCycleTime" SG_ 356 FC_Obj5_Height 60;
BA_ "GenSigCycleTime" SG_ 356 FC_Obj5_HeadOrientation 60;
BA_ "GenSigCycleTime" SG_ 356 FC_Obj5_HeadingAngle 60;
BA_ "GenSigCycleTime" SG_ 356 FC_Obj5_ExistProb 60;
BA_ "GenSigCycleTime" SG_ 356 FC_Obj5_Dy_Vnce 60;
BA_ "GenSigCycleTime" SG_ 356 FC_Obj5_Dy 60;
BA_ "GenSigCycleTime" SG_ 356 FC_Obj5_Dx_Vnce 60;
BA_ "GenSigCycleTime" SG_ 356 FC_Obj5_Dx 60;
BA_ "GenSigCycleTime" SG_ 356 FC_Obj5_RelVy 60;
BA_ "GenSigCycleTime" SG_ 356 FC_Obj5_RelVx 60;
BA_ "GenSigCycleTime" SG_ 356 FC_Obj5_RelAy 60;
BA_ "GenSigCycleTime" SG_ 356 FC_Obj5_RelAx 60;
BA_ "GenSigCycleTime" SG_ 356 FC_Obj5_TypeProb 60;
BA_ "GenSigCycleTime" SG_ 356 FC_Obj5_Type 60;
BA_ "GenSigCycleTime" SG_ 356 FC_Obj5_Track_Age 60;
BA_ "GenSigCycleTime" SG_ 356 FC_Obj5_Track_ID 60;

BA_ "GenSigCycleTime" SG_ 357 FC_Obj6_VehicleDir 60;
BA_ "GenSigCycleTime" SG_ 357 FC_Obj6ReDoorSts 60;
BA_ "GenSigCycleTime" SG_ 357 FC_Obj6RiDoorSts 60;
BA_ "GenSigCycleTime" SG_ 357 FC_Obj6LeDoorSts 60;
BA_ "GenSigCycleTime" SG_ 357 FC_Obj6WSInfoPosType 60;
BA_ "GenSigCycleTime" SG_ 357 FC_CRCCheck_165 60;
BA_ "GenSigCycleTime" SG_ 357 FC_RollingCounter_165 60;
BA_ "GenSigCycleTime" SG_ 357 FC_Obj6_Img2dBox_RightDown_V 60;
BA_ "GenSigCycleTime" SG_ 357 FC_Obj6_Img2dBox_LeftTop_V 60;
BA_ "GenSigCycleTime" SG_ 357 FC_Obj6_Img2dBox_RightDown_U 60;
BA_ "GenSigCycleTime" SG_ 357 FC_Obj6_Img2dBox_LeftTop_U 60;
BA_ "GenSigCycleTime" SG_ 357 FC_Obj6_TurnLight 60;
BA_ "GenSigCycleTime" SG_ 357 FC_Obj6_valid 60;
BA_ "GenSigCycleTime" SG_ 357 FC_Obj6_Vy_Vnce 60;
BA_ "GenSigCycleTime" SG_ 357 FC_Obj6_Vx_Vnce 60;
BA_ "GenSigCycleTime" SG_ 357 FC_Obj6_CenterAngle 60;
BA_ "GenSigCycleTime" SG_ 357 FC_Obj6_DistInLane 60;
BA_ "GenSigCycleTime" SG_ 357 FC_Obj6_objCutInLane 60;
BA_ "GenSigCycleTime" SG_ 357 FC_Obj6_objCutInFlag 60;
BA_ "GenSigCycleTime" SG_ 357 FC_Obj6_CornerPoint_y 60;
BA_ "GenSigCycleTime" SG_ 357 FC_Obj6_CornerPoint_x 60;
BA_ "GenSigCycleTime" SG_ 357 FC_Obj6_LaneAssignment 60;
BA_ "GenSigCycleTime" SG_ 357 FC_Obj6_MotionType 60;
BA_ "GenSigCycleTime" SG_ 357 FC_obj6_Brakelight_Info 60;
BA_ "GenSigCycleTime" SG_ 357 FC_Obj6_Width 60;
BA_ "GenSigCycleTime" SG_ 357 FC_Obj6_Length 60;
BA_ "GenSigCycleTime" SG_ 357 FC_Obj6_Height 60;
BA_ "GenSigCycleTime" SG_ 357 FC_Obj6_HeadOrientation 60;
BA_ "GenSigCycleTime" SG_ 357 FC_Obj6_HeadingAngle 60;
BA_ "GenSigCycleTime" SG_ 357 FC_Obj6_ExistProb 60;
BA_ "GenSigCycleTime" SG_ 357 FC_Obj6_Dy_Vnce 60;
BA_ "GenSigCycleTime" SG_ 357 FC_Obj6_Dy 60;
BA_ "GenSigCycleTime" SG_ 357 FC_Obj6_Dx_Vnce 60;
BA_ "GenSigCycleTime" SG_ 357 FC_Obj6_Dx 60;
BA_ "GenSigCycleTime" SG_ 357 FC_Obj6_RelVy 60;
BA_ "GenSigCycleTime" SG_ 357 FC_Obj6_RelVx 60;
BA_ "GenSigCycleTime" SG_ 357 FC_Obj6_RelAy 60;
BA_ "GenSigCycleTime" SG_ 357 FC_Obj6_RelAx 60;
BA_ "GenSigCycleTime" SG_ 357 FC_Obj6_TypeProb 60;
BA_ "GenSigCycleTime" SG_ 357 FC_Obj6_Type 60;
BA_ "GenSigCycleTime" SG_ 357 FC_Obj6_Track_Age 60;
BA_ "GenSigCycleTime" SG_ 357 FC_Obj6_Track_ID 60;

BA_ "GenSigCycleTime" SG_ 358 FC_Obj7_VehicleDir 60;
BA_ "GenSigCycleTime" SG_ 358 FC_Obj7ReDoorSts 60;
BA_ "GenSigCycleTime" SG_ 358 FC_Obj7RiDoorSts 60;
BA_ "GenSigCycleTime" SG_ 358 FC_Obj7LeDoorSts 60;
BA_ "GenSigCycleTime" SG_ 358 FC_Obj7WSInfoPosType 60;
BA_ "GenSigCycleTime" SG_ 358 FC_CRCCheck_166 60;
BA_ "GenSigCycleTime" SG_ 358 FC_RollingCounter_166 60;
BA_ "GenSigCycleTime" SG_ 358 FC_Obj7_Img2dBox_RightDown_V 60;
BA_ "GenSigCycleTime" SG_ 358 FC_Obj7_Img2dBox_LeftTop_V 60;
BA_ "GenSigCycleTime" SG_ 358 FC_Obj7_Img2dBox_RightDown_U 60;
BA_ "GenSigCycleTime" SG_ 358 FC_Obj7_Img2dBox_LeftTop_U 60;
BA_ "GenSigCycleTime" SG_ 358 FC_Obj7_TurnLight 60;
BA_ "GenSigCycleTime" SG_ 358 FC_Obj7_valid 60;
BA_ "GenSigCycleTime" SG_ 358 FC_Obj7_Vy_Vnce 60;
BA_ "GenSigCycleTime" SG_ 358 FC_Obj7_Vx_Vnce 60;
BA_ "GenSigCycleTime" SG_ 358 FC_Obj7_CenterAngle 60;
BA_ "GenSigCycleTime" SG_ 358 FC_Obj7_DistInLane 60;
BA_ "GenSigCycleTime" SG_ 358 FC_Obj7_objCutInLane 60;
BA_ "GenSigCycleTime" SG_ 358 FC_Obj7_objCutInFlag 60;
BA_ "GenSigCycleTime" SG_ 358 FC_Obj7_CornerPoint_y 60;
BA_ "GenSigCycleTime" SG_ 358 FC_Obj7_CornerPoint_x 60;
BA_ "GenSigCycleTime" SG_ 358 FC_Obj7_LaneAssignment 60;
BA_ "GenSigCycleTime" SG_ 358 FC_Obj7_MotionType 60;
BA_ "GenSigCycleTime" SG_ 358 FC_obj7_Brakelight_Info 60;
BA_ "GenSigCycleTime" SG_ 358 FC_Obj7_Width 60;
BA_ "GenSigCycleTime" SG_ 358 FC_Obj7_Length 60;
BA_ "GenSigCycleTime" SG_ 358 FC_Obj7_Height 60;
BA_ "GenSigCycleTime" SG_ 358 FC_Obj7_HeadOrientation 60;
BA_ "GenSigCycleTime" SG_ 358 FC_Obj7_HeadingAngle 60;
BA_ "GenSigCycleTime" SG_ 358 FC_Obj7_ExistProb 60;
BA_ "GenSigCycleTime" SG_ 358 FC_Obj7_Dy_Vnce 60;
BA_ "GenSigCycleTime" SG_ 358 FC_Obj7_Dy 60;
BA_ "GenSigCycleTime" SG_ 358 FC_Obj7_Dx_Vnce 60;
BA_ "GenSigCycleTime" SG_ 358 FC_Obj7_Dx 60;
BA_ "GenSigCycleTime" SG_ 358 FC_Obj7_RelVy 60;
BA_ "GenSigCycleTime" SG_ 358 FC_Obj7_RelVx 60;
BA_ "GenSigCycleTime" SG_ 358 FC_Obj7_RelAy 60;
BA_ "GenSigCycleTime" SG_ 358 FC_Obj7_RelAx 60;
BA_ "GenSigCycleTime" SG_ 358 FC_Obj7_TypeProb 60;
BA_ "GenSigCycleTime" SG_ 358 FC_Obj7_Type 60;
BA_ "GenSigCycleTime" SG_ 358 FC_Obj7_Track_Age 60;
BA_ "GenSigCycleTime" SG_ 358 FC_Obj7_Track_ID 60;

BA_ "GenSigCycleTime" SG_ 359 FC_Obj8_VehicleDir 60;
BA_ "GenSigCycleTime" SG_ 359 FC_Obj8ReDoorSts 60;
BA_ "GenSigCycleTime" SG_ 359 FC_Obj8RiDoorSts 60;
BA_ "GenSigCycleTime" SG_ 359 FC_Obj8LeDoorSts 60;
BA_ "GenSigCycleTime" SG_ 359 FC_Obj8WSInfoPosType 60;
BA_ "GenSigCycleTime" SG_ 359 FC_CRCCheck_167 60;
BA_ "GenSigCycleTime" SG_ 359 FC_RollingCounter_167 60;
BA_ "GenSigCycleTime" SG_ 359 FC_Obj8_Img2dBox_RightDown_V 60;
BA_ "GenSigCycleTime" SG_ 359 FC_Obj8_Img2dBox_LeftTop_V 60;
BA_ "GenSigCycleTime" SG_ 359 FC_Obj8_Img2dBox_RightDown_U 60;
BA_ "GenSigCycleTime" SG_ 359 FC_Obj8_Img2dBox_LeftTop_U 60;
BA_ "GenSigCycleTime" SG_ 359 FC_Obj8_TurnLight 60;
BA_ "GenSigCycleTime" SG_ 359 FC_Obj8_valid 60;
BA_ "GenSigCycleTime" SG_ 359 FC_Obj8_Vy_Vnce 60;
BA_ "GenSigCycleTime" SG_ 359 FC_Obj8_Vx_Vnce 60;
BA_ "GenSigCycleTime" SG_ 359 FC_Obj8_CenterAngle 60;
BA_ "GenSigCycleTime" SG_ 359 FC_Obj8_DistInLane 60;
BA_ "GenSigCycleTime" SG_ 359 FC_Obj8_objCutInLane 60;
BA_ "GenSigCycleTime" SG_ 359 FC_Obj8_objCutInFlag 60;
BA_ "GenSigCycleTime" SG_ 359 FC_Obj8_CornerPoint_y 60;
BA_ "GenSigCycleTime" SG_ 359 FC_Obj8_CornerPoint_x 60;
BA_ "GenSigCycleTime" SG_ 359 FC_Obj8_LaneAssignment 60;
BA_ "GenSigCycleTime" SG_ 359 FC_Obj8_MotionType 60;
BA_ "GenSigCycleTime" SG_ 359 FC_obj8_Brakelight_Info 60;
BA_ "GenSigCycleTime" SG_ 359 FC_Obj8_Width 60;
BA_ "GenSigCycleTime" SG_ 359 FC_Obj8_Length 60;
BA_ "GenSigCycleTime" SG_ 359 FC_Obj8_Height 60;
BA_ "GenSigCycleTime" SG_ 359 FC_Obj8_HeadOrientation 60;
BA_ "GenSigCycleTime" SG_ 359 FC_Obj8_HeadingAngle 60;
BA_ "GenSigCycleTime" SG_ 359 FC_Obj8_ExistProb 60;
BA_ "GenSigCycleTime" SG_ 359 FC_Obj8_Dy_Vnce 60;
BA_ "GenSigCycleTime" SG_ 359 FC_Obj8_Dy 60;
BA_ "GenSigCycleTime" SG_ 359 FC_Obj8_Dx_Vnce 60;
BA_ "GenSigCycleTime" SG_ 359 FC_Obj8_Dx 60;
BA_ "GenSigCycleTime" SG_ 359 FC_Obj8_RelVy 60;
BA_ "GenSigCycleTime" SG_ 359 FC_Obj8_RelVx 60;
BA_ "GenSigCycleTime" SG_ 359 FC_Obj8_RelAy 60;
BA_ "GenSigCycleTime" SG_ 359 FC_Obj8_RelAx 60;
BA_ "GenSigCycleTime" SG_ 359 FC_Obj8_TypeProb 60;
BA_ "GenSigCycleTime" SG_ 359 FC_Obj8_Type 60;
BA_ "GenSigCycleTime" SG_ 359 FC_Obj8_Track_Age 60;
BA_ "GenSigCycleTime" SG_ 359 FC_Obj8_Track_ID 60;

BA_ "GenSigCycleTime" SG_ 360 FC_Obj9_VehicleDir 60;
BA_ "GenSigCycleTime" SG_ 360 FC_Obj9ReDoorSts 60;
BA_ "GenSigCycleTime" SG_ 360 FC_Obj9RiDoorSts 60;
BA_ "GenSigCycleTime" SG_ 360 FC_Obj9LeDoorSts 60;
BA_ "GenSigCycleTime" SG_ 360 FC_Obj9WSInfoPosType 60;
BA_ "GenSigCycleTime" SG_ 360 FC_CRCCheck_168 60;
BA_ "GenSigCycleTime" SG_ 360 FC_RollingCounter_168 60;
BA_ "GenSigCycleTime" SG_ 360 FC_Obj9_Img2dBox_RightDown_V 60;
BA_ "GenSigCycleTime" SG_ 360 FC_Obj9_Img2dBox_LeftTop_V 60;
BA_ "GenSigCycleTime" SG_ 360 FC_Obj9_Img2dBox_RightDown_U 60;
BA_ "GenSigCycleTime" SG_ 360 FC_Obj9_Img2dBox_LeftTop_U 60;
BA_ "GenSigCycleTime" SG_ 360 FC_Obj9_TurnLight 60;
BA_ "GenSigCycleTime" SG_ 360 FC_Obj9_valid 60;
BA_ "GenSigCycleTime" SG_ 360 FC_Obj9_Vy_Vnce 60;
BA_ "GenSigCycleTime" SG_ 360 FC_Obj9_Vx_Vnce 60;
BA_ "GenSigCycleTime" SG_ 360 FC_Obj9_CenterAngle 60;
BA_ "GenSigCycleTime" SG_ 360 FC_Obj9_DistInLane 60;
BA_ "GenSigCycleTime" SG_ 360 FC_Obj9_objCutInLane 60;
BA_ "GenSigCycleTime" SG_ 360 FC_Obj9_objCutInFlag 60;
BA_ "GenSigCycleTime" SG_ 360 FC_Obj9_CornerPoint_y 60;
BA_ "GenSigCycleTime" SG_ 360 FC_Obj9_CornerPoint_x 60;
BA_ "GenSigCycleTime" SG_ 360 FC_Obj9_LaneAssignment 60;
BA_ "GenSigCycleTime" SG_ 360 FC_Obj9_MotionType 60;
BA_ "GenSigCycleTime" SG_ 360 FC_obj9_Brakelight_Info 60;
BA_ "GenSigCycleTime" SG_ 360 FC_Obj9_Width 60;
BA_ "GenSigCycleTime" SG_ 360 FC_Obj9_Length 60;
BA_ "GenSigCycleTime" SG_ 360 FC_Obj9_Height 60;
BA_ "GenSigCycleTime" SG_ 360 FC_Obj9_HeadOrientation 60;
BA_ "GenSigCycleTime" SG_ 360 FC_Obj9_HeadingAngle 60;
BA_ "GenSigCycleTime" SG_ 360 FC_Obj9_ExistProb 60;
BA_ "GenSigCycleTime" SG_ 360 FC_Obj9_Dy_Vnce 60;
BA_ "GenSigCycleTime" SG_ 360 FC_Obj9_Dy 60;
BA_ "GenSigCycleTime" SG_ 360 FC_Obj9_Dx_Vnce 60;
BA_ "GenSigCycleTime" SG_ 360 FC_Obj9_Dx 60;
BA_ "GenSigCycleTime" SG_ 360 FC_Obj9_RelVy 60;
BA_ "GenSigCycleTime" SG_ 360 FC_Obj9_RelVx 60;
BA_ "GenSigCycleTime" SG_ 360 FC_Obj9_RelAy 60;
BA_ "GenSigCycleTime" SG_ 360 FC_Obj9_RelAx 60;
BA_ "GenSigCycleTime" SG_ 360 FC_Obj9_TypeProb 60;
BA_ "GenSigCycleTime" SG_ 360 FC_Obj9_Type 60;
BA_ "GenSigCycleTime" SG_ 360 FC_Obj9_Track_Age 60;
BA_ "GenSigCycleTime" SG_ 360 FC_Obj9_Track_ID 60;

BA_ "GenSigCycleTime" SG_ 361 FC_Obj10_VehicleDir 60;
BA_ "GenSigCycleTime" SG_ 361 FC_Obj10ReDoorSts 60;
BA_ "GenSigCycleTime" SG_ 361 FC_Obj10RiDoorSts 60;
BA_ "GenSigCycleTime" SG_ 361 FC_Obj10LeDoorSts 60;
BA_ "GenSigCycleTime" SG_ 361 FC_Obj10WSInfoPosType 60;
BA_ "GenSigCycleTime" SG_ 361 FC_CRCCheck_169 60;
BA_ "GenSigCycleTime" SG_ 361 FC_RollingCounter_169 60;
BA_ "GenSigCycleTime" SG_ 361 FC_Obj10_Img2dBox_RightDown_V 60;
BA_ "GenSigCycleTime" SG_ 361 FC_Obj10_Img2dBox_LeftTop_V 60;
BA_ "GenSigCycleTime" SG_ 361 FC_Obj10_Img2dBox_RightDown_U 60;
BA_ "GenSigCycleTime" SG_ 361 FC_Obj10_Img2dBox_LeftTop_U 60;
BA_ "GenSigCycleTime" SG_ 361 FC_Obj10_TurnLight 60;
BA_ "GenSigCycleTime" SG_ 361 FC_Obj10_valid 60;
BA_ "GenSigCycleTime" SG_ 361 FC_Obj10_Vy_Vnce 60;
BA_ "GenSigCycleTime" SG_ 361 FC_Obj10_Vx_Vnce 60;
BA_ "GenSigCycleTime" SG_ 361 FC_Obj10_CenterAngle 60;
BA_ "GenSigCycleTime" SG_ 361 FC_Obj10_DistInLane 60;
BA_ "GenSigCycleTime" SG_ 361 FC_Obj10_objCutInLane 60;
BA_ "GenSigCycleTime" SG_ 361 FC_Obj10_objCutInFlag 60;
BA_ "GenSigCycleTime" SG_ 361 FC_Obj10_CornerPoint_y 60;
BA_ "GenSigCycleTime" SG_ 361 FC_Obj10_CornerPoint_x 60;
BA_ "GenSigCycleTime" SG_ 361 FC_Obj10_LaneAssignment 60;
BA_ "GenSigCycleTime" SG_ 361 FC_Obj10_MotionType 60;
BA_ "GenSigCycleTime" SG_ 361 FC_obj10_Brakelight_Info 60;
BA_ "GenSigCycleTime" SG_ 361 FC_Obj10_Width 60;
BA_ "GenSigCycleTime" SG_ 361 FC_Obj10_Length 60;
BA_ "GenSigCycleTime" SG_ 361 FC_Obj10_Height 60;
BA_ "GenSigCycleTime" SG_ 361 FC_Obj10_HeadOrientation 60;
BA_ "GenSigCycleTime" SG_ 361 FC_Obj10_HeadingAngle 60;
BA_ "GenSigCycleTime" SG_ 361 FC_Obj10_ExistProb 60;
BA_ "GenSigCycleTime" SG_ 361 FC_Obj10_Dy_Vnce 60;
BA_ "GenSigCycleTime" SG_ 361 FC_Obj10_Dy 60;
BA_ "GenSigCycleTime" SG_ 361 FC_Obj10_Dx_Vnce 60;
BA_ "GenSigCycleTime" SG_ 361 FC_Obj10_Dx 60;
BA_ "GenSigCycleTime" SG_ 361 FC_Obj10_RelVy 60;
BA_ "GenSigCycleTime" SG_ 361 FC_Obj10_RelVx 60;
BA_ "GenSigCycleTime" SG_ 361 FC_Obj10_RelAy 60;
BA_ "GenSigCycleTime" SG_ 361 FC_Obj10_RelAx 60;
BA_ "GenSigCycleTime" SG_ 361 FC_Obj10_TypeProb 60;
BA_ "GenSigCycleTime" SG_ 361 FC_Obj10_Type 60;
BA_ "GenSigCycleTime" SG_ 361 FC_Obj10_Track_Age 60;
BA_ "GenSigCycleTime" SG_ 361 FC_Obj10_Track_ID 60;

BA_ "GenSigCycleTime" SG_ 368 FC_Obj11_VehicleDir 60;
BA_ "GenSigCycleTime" SG_ 368 FC_Obj11ReDoorSts 60;
BA_ "GenSigCycleTime" SG_ 368 FC_Obj11RiDoorSts 60;
BA_ "GenSigCycleTime" SG_ 368 FC_Obj11LeDoorSts 60;
BA_ "GenSigCycleTime" SG_ 368 FC_Obj11WSInfoPosType 60;
BA_ "GenSigCycleTime" SG_ 368 FC_CRCCheck_170 60;
BA_ "GenSigCycleTime" SG_ 368 FC_RollingCounter_170 60;
BA_ "GenSigCycleTime" SG_ 368 FC_Obj11_Img2dBox_RightDown_V 60;
BA_ "GenSigCycleTime" SG_ 368 FC_Obj11_Img2dBox_LeftTop_V 60;
BA_ "GenSigCycleTime" SG_ 368 FC_Obj11_Img2dBox_RightDown_U 60;
BA_ "GenSigCycleTime" SG_ 368 FC_Obj11_Img2dBox_LeftTop_U 60;
BA_ "GenSigCycleTime" SG_ 368 FC_Obj11_TurnLight 60;
BA_ "GenSigCycleTime" SG_ 368 FC_Obj11_valid 60;
BA_ "GenSigCycleTime" SG_ 368 FC_Obj11_Vy_Vnce 60;
BA_ "GenSigCycleTime" SG_ 368 FC_Obj11_Vx_Vnce 60;
BA_ "GenSigCycleTime" SG_ 368 FC_Obj11_CenterAngle 60;
BA_ "GenSigCycleTime" SG_ 368 FC_Obj11_DistInLane 60;
BA_ "GenSigCycleTime" SG_ 368 FC_Obj11_objCutInLane 60;
BA_ "GenSigCycleTime" SG_ 368 FC_Obj11_objCutInFlag 60;
BA_ "GenSigCycleTime" SG_ 368 FC_Obj11_CornerPoint_y 60;
BA_ "GenSigCycleTime" SG_ 368 FC_Obj11_CornerPoint_x 60;
BA_ "GenSigCycleTime" SG_ 368 FC_Obj11_LaneAssignment 60;
BA_ "GenSigCycleTime" SG_ 368 FC_Obj11_MotionType 60;
BA_ "GenSigCycleTime" SG_ 368 FC_obj11_Brakelight_Info 60;
BA_ "GenSigCycleTime" SG_ 368 FC_Obj11_Width 60;
BA_ "GenSigCycleTime" SG_ 368 FC_Obj11_Length 60;
BA_ "GenSigCycleTime" SG_ 368 FC_Obj11_Height 60;
BA_ "GenSigCycleTime" SG_ 368 FC_Obj11_HeadOrientation 60;
BA_ "GenSigCycleTime" SG_ 368 FC_Obj11_HeadingAngle 60;
BA_ "GenSigCycleTime" SG_ 368 FC_Obj11_ExistProb 60;
BA_ "GenSigCycleTime" SG_ 368 FC_Obj11_Dy_Vnce 60;
BA_ "GenSigCycleTime" SG_ 368 FC_Obj11_Dy 60;
BA_ "GenSigCycleTime" SG_ 368 FC_Obj11_Dx_Vnce 60;
BA_ "GenSigCycleTime" SG_ 368 FC_Obj11_Dx 60;
BA_ "GenSigCycleTime" SG_ 368 FC_Obj11_RelVy 60;
BA_ "GenSigCycleTime" SG_ 368 FC_Obj11_RelVx 60;
BA_ "GenSigCycleTime" SG_ 368 FC_Obj11_RelAy 60;
BA_ "GenSigCycleTime" SG_ 368 FC_Obj11_RelAx 60;
BA_ "GenSigCycleTime" SG_ 368 FC_Obj11_TypeProb 60;
BA_ "GenSigCycleTime" SG_ 368 FC_Obj11_Type 60;
BA_ "GenSigCycleTime" SG_ 368 FC_Obj11_Track_Age 60;
BA_ "GenSigCycleTime" SG_ 368 FC_Obj11_Track_ID 60;

BA_ "GenSigCycleTime" SG_ 369 FC_Obj12_VehicleDir 60;
BA_ "GenSigCycleTime" SG_ 369 FC_Obj12ReDoorSts 60;
BA_ "GenSigCycleTime" SG_ 369 FC_Obj12RiDoorSts 60;
BA_ "GenSigCycleTime" SG_ 369 FC_Obj12LeDoorSts 60;
BA_ "GenSigCycleTime" SG_ 369 FC_Obj12WSInfoPosType 60;
BA_ "GenSigCycleTime" SG_ 369 FC_CRCCheck_171 60;
BA_ "GenSigCycleTime" SG_ 369 FC_RollingCounter_171 60;
BA_ "GenSigCycleTime" SG_ 369 FC_Obj12_Img2dBox_RightDown_V 60;
BA_ "GenSigCycleTime" SG_ 369 FC_Obj12_Img2dBox_LeftTop_V 60;
BA_ "GenSigCycleTime" SG_ 369 FC_Obj12_Img2dBox_RightDown_U 60;
BA_ "GenSigCycleTime" SG_ 369 FC_Obj12_Img2dBox_LeftTop_U 60;
BA_ "GenSigCycleTime" SG_ 369 FC_Obj12_TurnLight 60;
BA_ "GenSigCycleTime" SG_ 369 FC_Obj12_valid 60;
BA_ "GenSigCycleTime" SG_ 369 FC_Obj12_Vy_Vnce 60;
BA_ "GenSigCycleTime" SG_ 369 FC_Obj12_Vx_Vnce 60;
BA_ "GenSigCycleTime" SG_ 369 FC_Obj12_CenterAngle 60;
BA_ "GenSigCycleTime" SG_ 369 FC_Obj12_DistInLane 60;
BA_ "GenSigCycleTime" SG_ 369 FC_Obj12_objCutInLane 60;
BA_ "GenSigCycleTime" SG_ 369 FC_Obj12_objCutInFlag 60;
BA_ "GenSigCycleTime" SG_ 369 FC_Obj12_CornerPoint_y 60;
BA_ "GenSigCycleTime" SG_ 369 FC_Obj12_CornerPoint_x 60;
BA_ "GenSigCycleTime" SG_ 369 FC_Obj12_LaneAssignment 60;
BA_ "GenSigCycleTime" SG_ 369 FC_Obj12_MotionType 60;
BA_ "GenSigCycleTime" SG_ 369 FC_obj12_Brakelight_Info 60;
BA_ "GenSigCycleTime" SG_ 369 FC_Obj12_Width 60;
BA_ "GenSigCycleTime" SG_ 369 FC_Obj12_Length 60;
BA_ "GenSigCycleTime" SG_ 369 FC_Obj12_Height 60;
BA_ "GenSigCycleTime" SG_ 369 FC_Obj12_HeadOrientation 60;
BA_ "GenSigCycleTime" SG_ 369 FC_Obj12_HeadingAngle 60;
BA_ "GenSigCycleTime" SG_ 369 FC_Obj12_ExistProb 60;
BA_ "GenSigCycleTime" SG_ 369 FC_Obj12_Dy_Vnce 60;
BA_ "GenSigCycleTime" SG_ 369 FC_Obj12_Dy 60;
BA_ "GenSigCycleTime" SG_ 369 FC_Obj12_Dx_Vnce 60;
BA_ "GenSigCycleTime" SG_ 369 FC_Obj12_Dx 60;
BA_ "GenSigCycleTime" SG_ 369 FC_Obj12_RelVy 60;
BA_ "GenSigCycleTime" SG_ 369 FC_Obj12_RelVx 60;
BA_ "GenSigCycleTime" SG_ 369 FC_Obj12_RelAy 60;
BA_ "GenSigCycleTime" SG_ 369 FC_Obj12_RelAx 60;
BA_ "GenSigCycleTime" SG_ 369 FC_Obj12_TypeProb 60;
BA_ "GenSigCycleTime" SG_ 369 FC_Obj12_Type 60;
BA_ "GenSigCycleTime" SG_ 369 FC_Obj12_Track_Age 60;
BA_ "GenSigCycleTime" SG_ 369 FC_Obj12_Track_ID 60;

BA_ "GenSigCycleTime" SG_ 370 FC_Obj13_VehicleDir 60;
BA_ "GenSigCycleTime" SG_ 370 FC_Obj13ReDoorSts 60;
BA_ "GenSigCycleTime" SG_ 370 FC_Obj13RiDoorSts 60;
BA_ "GenSigCycleTime" SG_ 370 FC_Obj13LeDoorSts 60;
BA_ "GenSigCycleTime" SG_ 370 FC_Obj13WSInfoPosType 60;
BA_ "GenSigCycleTime" SG_ 370 FC_CRCCheck_172 60;
BA_ "GenSigCycleTime" SG_ 370 FC_RollingCounter_172 60;
BA_ "GenSigCycleTime" SG_ 370 FC_Obj13_Img2dBox_RightDown_V 60;
BA_ "GenSigCycleTime" SG_ 370 FC_Obj13_Img2dBox_LeftTop_V 60;
BA_ "GenSigCycleTime" SG_ 370 FC_Obj13_Img2dBox_RightDown_U 60;
BA_ "GenSigCycleTime" SG_ 370 FC_Obj13_Img2dBox_LeftTop_U 60;
BA_ "GenSigCycleTime" SG_ 370 FC_Obj13_TurnLight 60;
BA_ "GenSigCycleTime" SG_ 370 FC_Obj13_valid 60;
BA_ "GenSigCycleTime" SG_ 370 FC_Obj13_Vy_Vnce 60;
BA_ "GenSigCycleTime" SG_ 370 FC_Obj13_Vx_Vnce 60;
BA_ "GenSigCycleTime" SG_ 370 FC_Obj13_CenterAngle 60;
BA_ "GenSigCycleTime" SG_ 370 FC_Obj13_DistInLane 60;
BA_ "GenSigCycleTime" SG_ 370 FC_Obj13_objCutInLane 60;
BA_ "GenSigCycleTime" SG_ 370 FC_Obj13_objCutInFlag 60;
BA_ "GenSigCycleTime" SG_ 370 FC_Obj13_CornerPoint_y 60;
BA_ "GenSigCycleTime" SG_ 370 FC_Obj13_CornerPoint_x 60;
BA_ "GenSigCycleTime" SG_ 370 FC_Obj13_LaneAssignment 60;
BA_ "GenSigCycleTime" SG_ 370 FC_Obj13_MotionType 60;
BA_ "GenSigCycleTime" SG_ 370 FC_obj13_Brakelight_Info 60;
BA_ "GenSigCycleTime" SG_ 370 FC_Obj13_Width 60;
BA_ "GenSigCycleTime" SG_ 370 FC_Obj13_Length 60;
BA_ "GenSigCycleTime" SG_ 370 FC_Obj13_Height 60;
BA_ "GenSigCycleTime" SG_ 370 FC_Obj13_HeadOrientation 60;
BA_ "GenSigCycleTime" SG_ 370 FC_Obj13_HeadingAngle 60;
BA_ "GenSigCycleTime" SG_ 370 FC_Obj13_ExistProb 60;
BA_ "GenSigCycleTime" SG_ 370 FC_Obj13_Dy_Vnce 60;
BA_ "GenSigCycleTime" SG_ 370 FC_Obj13_Dy 60;
BA_ "GenSigCycleTime" SG_ 370 FC_Obj13_Dx_Vnce 60;
BA_ "GenSigCycleTime" SG_ 370 FC_Obj13_Dx 60;
BA_ "GenSigCycleTime" SG_ 370 FC_Obj13_RelVy 60;
BA_ "GenSigCycleTime" SG_ 370 FC_Obj13_RelVx 60;
BA_ "GenSigCycleTime" SG_ 370 FC_Obj13_RelAy 60;
BA_ "GenSigCycleTime" SG_ 370 FC_Obj13_RelAx 60;
BA_ "GenSigCycleTime" SG_ 370 FC_Obj13_TypeProb 60;
BA_ "GenSigCycleTime" SG_ 370 FC_Obj13_Type 60;
BA_ "GenSigCycleTime" SG_ 370 FC_Obj13_Track_Age 60;
BA_ "GenSigCycleTime" SG_ 370 FC_Obj13_Track_ID 60;

BA_ "GenSigCycleTime" SG_ 371 FC_Obj14_VehicleDir 60;
BA_ "GenSigCycleTime" SG_ 371 FC_Obj14ReDoorSts 60;
BA_ "GenSigCycleTime" SG_ 371 FC_Obj14RiDoorSts 60;
BA_ "GenSigCycleTime" SG_ 371 FC_Obj14LeDoorSts 60;
BA_ "GenSigCycleTime" SG_ 371 FC_Obj14WSInfoPosType 60;
BA_ "GenSigCycleTime" SG_ 371 FC_CRCCheck_173 60;
BA_ "GenSigCycleTime" SG_ 371 FC_RollingCounter_173 60;
BA_ "GenSigCycleTime" SG_ 371 FC_Obj14_Img2dBox_RightDown_V 60;
BA_ "GenSigCycleTime" SG_ 371 FC_Obj14_Img2dBox_LeftTop_V 60;
BA_ "GenSigCycleTime" SG_ 371 FC_Obj14_Img2dBox_RightDown_U 60;
BA_ "GenSigCycleTime" SG_ 371 FC_Obj14_Img2dBox_LeftTop_U 60;
BA_ "GenSigCycleTime" SG_ 371 FC_Obj14_TurnLight 60;
BA_ "GenSigCycleTime" SG_ 371 FC_Obj14_valid 60;
BA_ "GenSigCycleTime" SG_ 371 FC_Obj14_Vy_Vnce 60;
BA_ "GenSigCycleTime" SG_ 371 FC_Obj14_Vx_Vnce 60;
BA_ "GenSigCycleTime" SG_ 371 FC_Obj14_CenterAngle 60;
BA_ "GenSigCycleTime" SG_ 371 FC_Obj14_DistInLane 60;
BA_ "GenSigCycleTime" SG_ 371 FC_Obj14_objCutInLane 60;
BA_ "GenSigCycleTime" SG_ 371 FC_Obj14_objCutInFlag 60;
BA_ "GenSigCycleTime" SG_ 371 FC_Obj14_CornerPoint_y 60;
BA_ "GenSigCycleTime" SG_ 371 FC_Obj14_CornerPoint_x 60;
BA_ "GenSigCycleTime" SG_ 371 FC_Obj14_LaneAssignment 60;
BA_ "GenSigCycleTime" SG_ 371 FC_Obj14_MotionType 60;
BA_ "GenSigCycleTime" SG_ 371 FC_obj14_Brakelight_Info 60;
BA_ "GenSigCycleTime" SG_ 371 FC_Obj14_Width 60;
BA_ "GenSigCycleTime" SG_ 371 FC_Obj14_Length 60;
BA_ "GenSigCycleTime" SG_ 371 FC_Obj14_Height 60;
BA_ "GenSigCycleTime" SG_ 371 FC_Obj14_HeadOrientation 60;
BA_ "GenSigCycleTime" SG_ 371 FC_Obj14_HeadingAngle 60;
BA_ "GenSigCycleTime" SG_ 371 FC_Obj14_ExistProb 60;
BA_ "GenSigCycleTime" SG_ 371 FC_Obj14_Dy_Vnce 60;
BA_ "GenSigCycleTime" SG_ 371 FC_Obj14_Dy 60;
BA_ "GenSigCycleTime" SG_ 371 FC_Obj14_Dx_Vnce 60;
BA_ "GenSigCycleTime" SG_ 371 FC_Obj14_Dx 60;
BA_ "GenSigCycleTime" SG_ 371 FC_Obj14_RelVy 60;
BA_ "GenSigCycleTime" SG_ 371 FC_Obj14_RelVx 60;
BA_ "GenSigCycleTime" SG_ 371 FC_Obj14_RelAy 60;
BA_ "GenSigCycleTime" SG_ 371 FC_Obj14_RelAx 60;
BA_ "GenSigCycleTime" SG_ 371 FC_Obj14_TypeProb 60;
BA_ "GenSigCycleTime" SG_ 371 FC_Obj14_Type 60;
BA_ "GenSigCycleTime" SG_ 371 FC_Obj14_Track_Age 60;
BA_ "GenSigCycleTime" SG_ 371 FC_Obj14_Track_ID 60;

BA_ "GenSigCycleTime" SG_ 372 FC_Obj15_VehicleDir 60;
BA_ "GenSigCycleTime" SG_ 372 FC_Obj15ReDoorSts 60;
BA_ "GenSigCycleTime" SG_ 372 FC_Obj15RiDoorSts 60;
BA_ "GenSigCycleTime" SG_ 372 FC_Obj15LeDoorSts 60;
BA_ "GenSigCycleTime" SG_ 372 FC_Obj15WSInfoPosType 60;
BA_ "GenSigCycleTime" SG_ 372 FC_CRCCheck_174 60;
BA_ "GenSigCycleTime" SG_ 372 FC_RollingCounter_174 60;
BA_ "GenSigCycleTime" SG_ 372 FC_Obj15_Img2dBox_RightDown_V 60;
BA_ "GenSigCycleTime" SG_ 372 FC_Obj15_Img2dBox_LeftTop_V 60;
BA_ "GenSigCycleTime" SG_ 372 FC_Obj15_Img2dBox_RightDown_U 60;
BA_ "GenSigCycleTime" SG_ 372 FC_Obj15_Img2dBox_LeftTop_U 60;
BA_ "GenSigCycleTime" SG_ 372 FC_Obj15_TurnLight 60;
BA_ "GenSigCycleTime" SG_ 372 FC_Obj15_valid 60;
BA_ "GenSigCycleTime" SG_ 372 FC_Obj15_Vy_Vnce 60;
BA_ "GenSigCycleTime" SG_ 372 FC_Obj15_Vx_Vnce 60;
BA_ "GenSigCycleTime" SG_ 372 FC_Obj15_CenterAngle 60;
BA_ "GenSigCycleTime" SG_ 372 FC_Obj15_DistInLane 60;
BA_ "GenSigCycleTime" SG_ 372 FC_Obj15_objCutInLane 60;
BA_ "GenSigCycleTime" SG_ 372 FC_Obj15_objCutInFlag 60;
BA_ "GenSigCycleTime" SG_ 372 FC_Obj15_CornerPoint_y 60;
BA_ "GenSigCycleTime" SG_ 372 FC_Obj15_CornerPoint_x 60;
BA_ "GenSigCycleTime" SG_ 372 FC_Obj15_LaneAssignment 60;
BA_ "GenSigCycleTime" SG_ 372 FC_Obj15_MotionType 60;
BA_ "GenSigCycleTime" SG_ 372 FC_obj15_Brakelight_Info 60;
BA_ "GenSigCycleTime" SG_ 372 FC_Obj15_Width 60;
BA_ "GenSigCycleTime" SG_ 372 FC_Obj15_Length 60;
BA_ "GenSigCycleTime" SG_ 372 FC_Obj15_Height 60;
BA_ "GenSigCycleTime" SG_ 372 FC_Obj15_HeadOrientation 60;
BA_ "GenSigCycleTime" SG_ 372 FC_Obj15_HeadingAngle 60;
BA_ "GenSigCycleTime" SG_ 372 FC_Obj15_ExistProb 60;
BA_ "GenSigCycleTime" SG_ 372 FC_Obj15_Dy_Vnce 60;
BA_ "GenSigCycleTime" SG_ 372 FC_Obj15_Dy 60;
BA_ "GenSigCycleTime" SG_ 372 FC_Obj15_Dx_Vnce 60;
BA_ "GenSigCycleTime" SG_ 372 FC_Obj15_Dx 60;
BA_ "GenSigCycleTime" SG_ 372 FC_Obj15_RelVy 60;
BA_ "GenSigCycleTime" SG_ 372 FC_Obj15_RelVx 60;
BA_ "GenSigCycleTime" SG_ 372 FC_Obj15_RelAy 60;
BA_ "GenSigCycleTime" SG_ 372 FC_Obj15_RelAx 60;
BA_ "GenSigCycleTime" SG_ 372 FC_Obj15_TypeProb 60;
BA_ "GenSigCycleTime" SG_ 372 FC_Obj15_Type 60;
BA_ "GenSigCycleTime" SG_ 372 FC_Obj15_Track_Age 60;
BA_ "GenSigCycleTime" SG_ 372 FC_Obj15_Track_ID 60;

BA_ "GenSigCycleTime" SG_ 373 FC_Obj16_VehicleDir 60;
BA_ "GenSigCycleTime" SG_ 373 FC_Obj16ReDoorSts 60;
BA_ "GenSigCycleTime" SG_ 373 FC_Obj16RiDoorSts 60;
BA_ "GenSigCycleTime" SG_ 373 FC_Obj16LeDoorSts 60;
BA_ "GenSigCycleTime" SG_ 373 FC_Obj16WSInfoPosType 60;
BA_ "GenSigCycleTime" SG_ 373 FC_CRCCheck_175 60;
BA_ "GenSigCycleTime" SG_ 373 FC_RollingCounter_175 60;
BA_ "GenSigCycleTime" SG_ 373 FC_Obj16_Img2dBox_RightDown_V 60;
BA_ "GenSigCycleTime" SG_ 373 FC_Obj16_Img2dBox_LeftTop_V 60;
BA_ "GenSigCycleTime" SG_ 373 FC_Obj16_Img2dBox_RightDown_U 60;
BA_ "GenSigCycleTime" SG_ 373 FC_Obj16_Img2dBox_LeftTop_U 60;
BA_ "GenSigCycleTime" SG_ 373 FC_Obj16_TurnLight 60;
BA_ "GenSigCycleTime" SG_ 373 FC_Obj16_valid 60;
BA_ "GenSigCycleTime" SG_ 373 FC_Obj16_Vy_Vnce 60;
BA_ "GenSigCycleTime" SG_ 373 FC_Obj16_Vx_Vnce 60;
BA_ "GenSigCycleTime" SG_ 373 FC_Obj16_CenterAngle 60;
BA_ "GenSigCycleTime" SG_ 373 FC_Obj16_DistInLane 60;
BA_ "GenSigCycleTime" SG_ 373 FC_Obj16_objCutInLane 60;
BA_ "GenSigCycleTime" SG_ 373 FC_Obj16_objCutInFlag 60;
BA_ "GenSigCycleTime" SG_ 373 FC_Obj16_CornerPoint_y 60;
BA_ "GenSigCycleTime" SG_ 373 FC_Obj16_CornerPoint_x 60;
BA_ "GenSigCycleTime" SG_ 373 FC_Obj16_LaneAssignment 60;
BA_ "GenSigCycleTime" SG_ 373 FC_Obj16_MotionType 60;
BA_ "GenSigCycleTime" SG_ 373 FC_obj16_Brakelight_Info 60;
BA_ "GenSigCycleTime" SG_ 373 FC_Obj16_Width 60;
BA_ "GenSigCycleTime" SG_ 373 FC_Obj16_Length 60;
BA_ "GenSigCycleTime" SG_ 373 FC_Obj16_Height 60;
BA_ "GenSigCycleTime" SG_ 373 FC_Obj16_HeadOrientation 60;
BA_ "GenSigCycleTime" SG_ 373 FC_Obj16_HeadingAngle 60;
BA_ "GenSigCycleTime" SG_ 373 FC_Obj16_ExistProb 60;
BA_ "GenSigCycleTime" SG_ 373 FC_Obj16_Dy_Vnce 60;
BA_ "GenSigCycleTime" SG_ 373 FC_Obj16_Dy 60;
BA_ "GenSigCycleTime" SG_ 373 FC_Obj16_Dx_Vnce 60;
BA_ "GenSigCycleTime" SG_ 373 FC_Obj16_Dx 60;
BA_ "GenSigCycleTime" SG_ 373 FC_Obj16_RelVy 60;
BA_ "GenSigCycleTime" SG_ 373 FC_Obj16_RelVx 60;
BA_ "GenSigCycleTime" SG_ 373 FC_Obj16_RelAy 60;
BA_ "GenSigCycleTime" SG_ 373 FC_Obj16_RelAx 60;
BA_ "GenSigCycleTime" SG_ 373 FC_Obj16_TypeProb 60;
BA_ "GenSigCycleTime" SG_ 373 FC_Obj16_Type 60;
BA_ "GenSigCycleTime" SG_ 373 FC_Obj16_Track_Age 60;
BA_ "GenSigCycleTime" SG_ 373 FC_Obj16_Track_ID 60;

BA_ "GenSigCycleTime" SG_ 374 FC_Obj17_VehicleDir 60;
BA_ "GenSigCycleTime" SG_ 374 FC_Obj17ReDoorSts 60;
BA_ "GenSigCycleTime" SG_ 374 FC_Obj17RiDoorSts 60;
BA_ "GenSigCycleTime" SG_ 374 FC_Obj17LeDoorSts 60;
BA_ "GenSigCycleTime" SG_ 374 FC_Obj17WSInfoPosType 60;
BA_ "GenSigCycleTime" SG_ 374 FC_CRCCheck_176 60;
BA_ "GenSigCycleTime" SG_ 374 FC_RollingCounter_176 60;
BA_ "GenSigCycleTime" SG_ 374 FC_Obj17_Img2dBox_RightDown_V 60;
BA_ "GenSigCycleTime" SG_ 374 FC_Obj17_Img2dBox_LeftTop_V 60;
BA_ "GenSigCycleTime" SG_ 374 FC_Obj17_Img2dBox_RightDown_U 60;
BA_ "GenSigCycleTime" SG_ 374 FC_Obj17_Img2dBox_LeftTop_U 60;
BA_ "GenSigCycleTime" SG_ 374 FC_Obj17_TurnLight 60;
BA_ "GenSigCycleTime" SG_ 374 FC_Obj17_valid 60;
BA_ "GenSigCycleTime" SG_ 374 FC_Obj17_Vy_Vnce 60;
BA_ "GenSigCycleTime" SG_ 374 FC_Obj17_Vx_Vnce 60;
BA_ "GenSigCycleTime" SG_ 374 FC_Obj17_CenterAngle 60;
BA_ "GenSigCycleTime" SG_ 374 FC_Obj17_DistInLane 60;
BA_ "GenSigCycleTime" SG_ 374 FC_Obj17_objCutInLane 60;
BA_ "GenSigCycleTime" SG_ 374 FC_Obj17_objCutInFlag 60;
BA_ "GenSigCycleTime" SG_ 374 FC_Obj17_CornerPoint_y 60;
BA_ "GenSigCycleTime" SG_ 374 FC_Obj17_CornerPoint_x 60;
BA_ "GenSigCycleTime" SG_ 374 FC_Obj17_LaneAssignment 60;
BA_ "GenSigCycleTime" SG_ 374 FC_Obj17_MotionType 60;
BA_ "GenSigCycleTime" SG_ 374 FC_obj17_Brakelight_Info 60;
BA_ "GenSigCycleTime" SG_ 374 FC_Obj17_Width 60;
BA_ "GenSigCycleTime" SG_ 374 FC_Obj17_Length 60;
BA_ "GenSigCycleTime" SG_ 374 FC_Obj17_Height 60;
BA_ "GenSigCycleTime" SG_ 374 FC_Obj17_HeadOrientation 60;
BA_ "GenSigCycleTime" SG_ 374 FC_Obj17_HeadingAngle 60;
BA_ "GenSigCycleTime" SG_ 374 FC_Obj17_ExistProb 60;
BA_ "GenSigCycleTime" SG_ 374 FC_Obj17_Dy_Vnce 60;
BA_ "GenSigCycleTime" SG_ 374 FC_Obj17_Dy 60;
BA_ "GenSigCycleTime" SG_ 374 FC_Obj17_Dx_Vnce 60;
BA_ "GenSigCycleTime" SG_ 374 FC_Obj17_Dx 60;
BA_ "GenSigCycleTime" SG_ 374 FC_Obj17_RelVy 60;
BA_ "GenSigCycleTime" SG_ 374 FC_Obj17_RelVx 60;
BA_ "GenSigCycleTime" SG_ 374 FC_Obj17_RelAy 60;
BA_ "GenSigCycleTime" SG_ 374 FC_Obj17_RelAx 60;
BA_ "GenSigCycleTime" SG_ 374 FC_Obj17_TypeProb 60;
BA_ "GenSigCycleTime" SG_ 374 FC_Obj17_Type 60;
BA_ "GenSigCycleTime" SG_ 374 FC_Obj17_Track_Age 60;
BA_ "GenSigCycleTime" SG_ 374 FC_Obj17_Track_ID 60;

BA_ "GenSigCycleTime" SG_ 375 FC_Obj18_VehicleDir 60;
BA_ "GenSigCycleTime" SG_ 375 FC_Obj18ReDoorSts 60;
BA_ "GenSigCycleTime" SG_ 375 FC_Obj18RiDoorSts 60;
BA_ "GenSigCycleTime" SG_ 375 FC_Obj18LeDoorSts 60;
BA_ "GenSigCycleTime" SG_ 375 FC_Obj18WSInfoPosType 60;
BA_ "GenSigCycleTime" SG_ 375 FC_CRCCheck_177 60;
BA_ "GenSigCycleTime" SG_ 375 FC_RollingCounter_177 60;
BA_ "GenSigCycleTime" SG_ 375 FC_Obj18_Img2dBox_RightDown_V 60;
BA_ "GenSigCycleTime" SG_ 375 FC_Obj18_Img2dBox_LeftTop_V 60;
BA_ "GenSigCycleTime" SG_ 375 FC_Obj18_Img2dBox_RightDown_U 60;
BA_ "GenSigCycleTime" SG_ 375 FC_Obj18_Img2dBox_LeftTop_U 60;
BA_ "GenSigCycleTime" SG_ 375 FC_Obj18_TurnLight 60;
BA_ "GenSigCycleTime" SG_ 375 FC_Obj18_valid 60;
BA_ "GenSigCycleTime" SG_ 375 FC_Obj18_Vy_Vnce 60;
BA_ "GenSigCycleTime" SG_ 375 FC_Obj18_Vx_Vnce 60;
BA_ "GenSigCycleTime" SG_ 375 FC_Obj18_CenterAngle 60;
BA_ "GenSigCycleTime" SG_ 375 FC_Obj18_DistInLane 60;
BA_ "GenSigCycleTime" SG_ 375 FC_Obj18_objCutInLane 60;
BA_ "GenSigCycleTime" SG_ 375 FC_Obj18_objCutInFlag 60;
BA_ "GenSigCycleTime" SG_ 375 FC_Obj18_CornerPoint_y 60;
BA_ "GenSigCycleTime" SG_ 375 FC_Obj18_CornerPoint_x 60;
BA_ "GenSigCycleTime" SG_ 375 FC_Obj18_LaneAssignment 60;
BA_ "GenSigCycleTime" SG_ 375 FC_Obj18_MotionType 60;
BA_ "GenSigCycleTime" SG_ 375 FC_obj18_Brakelight_Info 60;
BA_ "GenSigCycleTime" SG_ 375 FC_Obj18_Width 60;
BA_ "GenSigCycleTime" SG_ 375 FC_Obj18_Length 60;
BA_ "GenSigCycleTime" SG_ 375 FC_Obj18_Height 60;
BA_ "GenSigCycleTime" SG_ 375 FC_Obj18_HeadOrientation 60;
BA_ "GenSigCycleTime" SG_ 375 FC_Obj18_HeadingAngle 60;
BA_ "GenSigCycleTime" SG_ 375 FC_Obj18_ExistProb 60;
BA_ "GenSigCycleTime" SG_ 375 FC_Obj18_Dy_Vnce 60;
BA_ "GenSigCycleTime" SG_ 375 FC_Obj18_Dy 60;
BA_ "GenSigCycleTime" SG_ 375 FC_Obj18_Dx_Vnce 60;
BA_ "GenSigCycleTime" SG_ 375 FC_Obj18_Dx 60;
BA_ "GenSigCycleTime" SG_ 375 FC_Obj18_RelVy 60;
BA_ "GenSigCycleTime" SG_ 375 FC_Obj18_RelVx 60;
BA_ "GenSigCycleTime" SG_ 375 FC_Obj18_RelAy 60;
BA_ "GenSigCycleTime" SG_ 375 FC_Obj18_RelAx 60;
BA_ "GenSigCycleTime" SG_ 375 FC_Obj18_TypeProb 60;
BA_ "GenSigCycleTime" SG_ 375 FC_Obj18_Type 60;
BA_ "GenSigCycleTime" SG_ 375 FC_Obj18_Track_Age 60;
BA_ "GenSigCycleTime" SG_ 375 FC_Obj18_Track_ID 60;

VAL_ 354 FC_Obj3_VehicleDir 0 "Unknown" 1 "同向车辆" 2 "对向来车
0x3-0x7=预留";
VAL_ 354 FC_Obj3ReDoorSts 0 "关闭" 1 "全开" 2 "半开（预留）";
VAL_ 354 FC_Obj3RiDoorSts 0 "关闭" 1 "全开" 2 "半开（预留）";
VAL_ 354 FC_Obj3LeDoorSts 0 "关闭" 1 "全开" 2 "半开（预留）";
VAL_ 354 FC_Obj3WSInfoPosType 0 "Unknown" 1 "RearLeft" 2 "RearCenter" 3 "RearRgiht" 4 "FrontLeft" 5 "FrontCenter" 6 "FrontRgiht" 7 "LeftCenter" 8 "RgihtCenter" 9 "Center" 10 "预留;";
VAL_ 354 FC_Obj3_TurnLight 0 "";
VAL_ 354 FC_Obj3_valid 0 "";
VAL_ 354 FC_Obj3_objCutInLane 0 "invalid" 1 "measured;
0x2=predicted;";
VAL_ 354 FC_Obj3_objCutInFlag 0 "invalid" 1 "cutin_hostLane" 2 "cutin_fov";
VAL_ 354 FC_Obj3_LaneAssignment 0 "UNKNOWN    
1=LEFT_LEFT    
2=LEFT    
3=HOST    
4=RIGHT     
5=RIGHT_RIGHT
0x6-0x7=Reserved";
VAL_ 354 FC_Obj3_MotionType 0 "Unknown" 1 "Moving" 2 "Stationary" 3 "Stopped" 4 "Moving Slowly";
VAL_ 354 FC_obj3_Brakelight_Info 0 "off" 1 "on ";
VAL_ 354 FC_Obj3_HeadOrientation 0 "Unknown" 1 "Head Front" 2 "Head Left Front" 3 "Head Left" 4 "Head Left Back" 5 "Head Back" 6 "Head Right Back" 7 "Head Right" 8 "Head right front" 9 "Reserved";
VAL_ 354 FC_Obj3_Type 0 "Not Detected;
0x1=car" 2 "truck" 3 "cyclist/tricycle" 4 "pedestrian" 5 "bicycle/motorbike（无人）" 6 "animal" 7 "uncertain" 8 " bus; 
 0x9~0xF = Reserved;";

VAL_ 355 FC_Obj4_VehicleDir 0 "Unknown" 1 "同向车辆" 2 "对向来车
0x3-0x7=预留";
VAL_ 355 FC_Obj4ReDoorSts 0 "关闭" 1 "全开" 2 "半开（预留）";
VAL_ 355 FC_Obj4RiDoorSts 0 "关闭" 1 "全开" 2 "半开（预留）";
VAL_ 355 FC_Obj4LeDoorSts 0 "关闭" 1 "全开" 2 "半开（预留）";
VAL_ 355 FC_Obj4WSInfoPosType 0 "Unknown" 1 "RearLeft" 2 "RearCenter" 3 "RearRgiht" 4 "FrontLeft" 5 "FrontCenter" 6 "FrontRgiht" 7 "LeftCenter" 8 "RgihtCenter" 9 "Center" 10 "预留;";
VAL_ 355 FC_Obj4_TurnLight 0 "";
VAL_ 355 FC_Obj4_valid 0 "";
VAL_ 355 FC_Obj4_objCutInLane 0 "invalid" 1 "measured;
0x2=predicted;";
VAL_ 355 FC_Obj4_objCutInFlag 0 "invalid" 1 "cutin_hostLane" 2 "cutin_fov";
VAL_ 355 FC_Obj4_LaneAssignment 0 "UNKNOWN    
1=LEFT_LEFT    
2=LEFT    
3=HOST    
4=RIGHT     
5=RIGHT_RIGHT
0x6-0x7=Reserved";
VAL_ 355 FC_Obj4_MotionType 0 "Unknown" 1 "Moving" 2 "Stationary" 3 "Stopped" 4 "Moving Slowly";
VAL_ 355 FC_obj4_Brakelight_Info 0 "off" 1 "on ";
VAL_ 355 FC_Obj4_HeadOrientation 0 "Unknown" 1 "Head Front" 2 "Head Left Front" 3 "Head Left" 4 "Head Left Back" 5 "Head Back" 6 "Head Right Back" 7 "Head Right" 8 "Head right front" 9 "Reserved";
VAL_ 355 FC_Obj4_Type 0 "Not Detected;
0x1=car" 2 "truck" 3 "cyclist/tricycle" 4 "pedestrian" 5 "bicycle/motorbike（无人）" 6 "animal" 7 "uncertain" 8 " bus; 
 0x9~0xF = Reserved;";

VAL_ 356 FC_Obj5_VehicleDir 0 "Unknown" 1 "同向车辆" 2 "对向来车
0x3-0x7=预留";
VAL_ 356 FC_Obj5ReDoorSts 0 "关闭" 1 "全开" 2 "半开（预留）";
VAL_ 356 FC_Obj5RiDoorSts 0 "关闭" 1 "全开" 2 "半开（预留）";
VAL_ 356 FC_Obj5LeDoorSts 0 "关闭" 1 "全开" 2 "半开（预留）";
VAL_ 356 FC_Obj5WSInfoPosType 0 "Unknown" 1 "RearLeft" 2 "RearCenter" 3 "RearRgiht" 4 "FrontLeft" 5 "FrontCenter" 6 "FrontRgiht" 7 "LeftCenter" 8 "RgihtCenter" 9 "Center" 10 "预留;";
VAL_ 356 FC_Obj5_TurnLight 0 "";
VAL_ 356 FC_Obj5_valid 0 "";
VAL_ 356 FC_Obj5_objCutInLane 0 "invalid" 1 "measured;
0x2=predicted;";
VAL_ 356 FC_Obj5_objCutInFlag 0 "invalid" 1 "cutin_hostLane" 2 "cutin_fov";
VAL_ 356 FC_Obj5_LaneAssignment 0 "UNKNOWN    
1=LEFT_LEFT    
2=LEFT    
3=HOST    
4=RIGHT     
5=RIGHT_RIGHT
0x6-0x7=Reserved";
VAL_ 356 FC_Obj5_MotionType 0 "Unknown" 1 "Moving" 2 "Stationary" 3 "Stopped" 4 "Moving Slowly";
VAL_ 356 FC_obj5_Brakelight_Info 0 "off" 1 "on ";
VAL_ 356 FC_Obj5_HeadOrientation 0 "Unknown" 1 "Head Front" 2 "Head Left Front" 3 "Head Left" 4 "Head Left Back" 5 "Head Back" 6 "Head Right Back" 7 "Head Right" 8 "Head right front" 9 "Reserved";
VAL_ 356 FC_Obj5_Type 0 "Not Detected;
0x1=car" 2 "truck" 3 "cyclist/tricycle" 4 "pedestrian" 5 "bicycle/motorbike（无人）" 6 "animal" 7 "uncertain" 8 " bus; 
 0x9~0xF = Reserved;";

VAL_ 357 FC_Obj6_VehicleDir 0 "Unknown" 1 "同向车辆" 2 "对向来车
0x3-0x7=预留";
VAL_ 357 FC_Obj6ReDoorSts 0 "关闭" 1 "全开" 2 "半开（预留）";
VAL_ 357 FC_Obj6RiDoorSts 0 "关闭" 1 "全开" 2 "半开（预留）";
VAL_ 357 FC_Obj6LeDoorSts 0 "关闭" 1 "全开" 2 "半开（预留）";
VAL_ 357 FC_Obj6WSInfoPosType 0 "Unknown" 1 "RearLeft" 2 "RearCenter" 3 "RearRgiht" 4 "FrontLeft" 5 "FrontCenter" 6 "FrontRgiht" 7 "LeftCenter" 8 "RgihtCenter" 9 "Center" 10 "预留;";
VAL_ 357 FC_Obj6_TurnLight 0 "";
VAL_ 357 FC_Obj6_valid 0 "";
VAL_ 357 FC_Obj6_objCutInLane 0 "invalid" 1 "measured;
0x2=predicted;";
VAL_ 357 FC_Obj6_objCutInFlag 0 "invalid" 1 "cutin_hostLane" 2 "cutin_fov";
VAL_ 357 FC_Obj6_LaneAssignment 0 "UNKNOWN    
1=LEFT_LEFT    
2=LEFT    
3=HOST    
4=RIGHT     
5=RIGHT_RIGHT
0x6-0x7=Reserved";
VAL_ 357 FC_Obj6_MotionType 0 "Unknown" 1 "Moving" 2 "Stationary" 3 "Stopped" 4 "Moving Slowly";
VAL_ 357 FC_obj6_Brakelight_Info 0 "off" 1 "on ";
VAL_ 357 FC_Obj6_HeadOrientation 0 "Unknown" 1 "Head Front" 2 "Head Left Front" 3 "Head Left" 4 "Head Left Back" 5 "Head Back" 6 "Head Right Back" 7 "Head Right" 8 "Head right front" 9 "Reserved";
VAL_ 357 FC_Obj6_Type 0 "Not Detected;
0x1=car" 2 "truck" 3 "cyclist/tricycle" 4 "pedestrian" 5 "bicycle/motorbike（无人）" 6 "animal" 7 "uncertain" 8 " bus; 
 0x9~0xF = Reserved;";

VAL_ 358 FC_Obj7_VehicleDir 0 "Unknown" 1 "同向车辆" 2 "对向来车
0x3-0x7=预留";
VAL_ 358 FC_Obj7ReDoorSts 0 "关闭" 1 "全开" 2 "半开（预留）";
VAL_ 358 FC_Obj7RiDoorSts 0 "关闭" 1 "全开" 2 "半开（预留）";
VAL_ 358 FC_Obj7LeDoorSts 0 "关闭" 1 "全开" 2 "半开（预留）";
VAL_ 358 FC_Obj7WSInfoPosType 0 "Unknown" 1 "RearLeft" 2 "RearCenter" 3 "RearRgiht" 4 "FrontLeft" 5 "FrontCenter" 6 "FrontRgiht" 7 "LeftCenter" 8 "RgihtCenter" 9 "Center" 10 "预留;";
VAL_ 358 FC_Obj7_TurnLight 0 "";
VAL_ 358 FC_Obj7_valid 0 "";
VAL_ 358 FC_Obj7_objCutInLane 0 "invalid" 1 "measured;
0x2=predicted;";
VAL_ 358 FC_Obj7_objCutInFlag 0 "invalid" 1 "cutin_hostLane" 2 "cutin_fov";
VAL_ 358 FC_Obj7_LaneAssignment 0 "UNKNOWN    
1=LEFT_LEFT    
2=LEFT    
3=HOST    
4=RIGHT     
5=RIGHT_RIGHT
0x6-0x7=Reserved";
VAL_ 358 FC_Obj7_MotionType 0 "Unknown" 1 "Moving" 2 "Stationary" 3 "Stopped" 4 "Moving Slowly";
VAL_ 358 FC_obj7_Brakelight_Info 0 "off" 1 "on ";
VAL_ 358 FC_Obj7_HeadOrientation 0 "Unknown" 1 "Head Front" 2 "Head Left Front" 3 "Head Left" 4 "Head Left Back" 5 "Head Back" 6 "Head Right Back" 7 "Head Right" 8 "Head right front" 9 "Reserved";
VAL_ 358 FC_Obj7_Type 0 "Not Detected;
0x1=car" 2 "truck" 3 "cyclist/tricycle" 4 "pedestrian" 5 "bicycle/motorbike（无人）" 6 "animal" 7 "uncertain" 8 " bus; 
 0x9~0xF = Reserved;";

VAL_ 359 FC_Obj8_VehicleDir 0 "Unknown" 1 "同向车辆" 2 "对向来车
0x3-0x7=预留";
VAL_ 359 FC_Obj8ReDoorSts 0 "关闭" 1 "全开" 2 "半开（预留）";
VAL_ 359 FC_Obj8RiDoorSts 0 "关闭" 1 "全开" 2 "半开（预留）";
VAL_ 359 FC_Obj8LeDoorSts 0 "关闭" 1 "全开" 2 "半开（预留）";
VAL_ 359 FC_Obj8WSInfoPosType 0 "Unknown" 1 "RearLeft" 2 "RearCenter" 3 "RearRgiht" 4 "FrontLeft" 5 "FrontCenter" 6 "FrontRgiht" 7 "LeftCenter" 8 "RgihtCenter" 9 "Center" 10 "预留;";
VAL_ 359 FC_Obj8_TurnLight 0 "";
VAL_ 359 FC_Obj8_valid 0 "";
VAL_ 359 FC_Obj8_objCutInLane 0 "invalid" 1 "measured;
0x2=predicted;";
VAL_ 359 FC_Obj8_objCutInFlag 0 "invalid" 1 "cutin_hostLane" 2 "cutin_fov";
VAL_ 359 FC_Obj8_LaneAssignment 0 "UNKNOWN    
1=LEFT_LEFT    
2=LEFT    
3=HOST    
4=RIGHT     
5=RIGHT_RIGHT
0x6-0x7=Reserved";
VAL_ 359 FC_Obj8_MotionType 0 "Unknown" 1 "Moving" 2 "Stationary" 3 "Stopped" 4 "Moving Slowly";
VAL_ 359 FC_obj8_Brakelight_Info 0 "off" 1 "on ";
VAL_ 359 FC_Obj8_HeadOrientation 0 "Unknown" 1 "Head Front" 2 "Head Left Front" 3 "Head Left" 4 "Head Left Back" 5 "Head Back" 6 "Head Right Back" 7 "Head Right" 8 "Head right front" 9 "Reserved";
VAL_ 359 FC_Obj8_Type 0 "Not Detected;
0x1=car" 2 "truck" 3 "cyclist/tricycle" 4 "pedestrian" 5 "bicycle/motorbike（无人）" 6 "animal" 7 "uncertain" 8 " bus; 
 0x9~0xF = Reserved;";

VAL_ 360 FC_Obj9_VehicleDir 0 "Unknown" 1 "同向车辆" 2 "对向来车
0x3-0x7=预留";
VAL_ 360 FC_Obj9ReDoorSts 0 "关闭" 1 "全开" 2 "半开（预留）";
VAL_ 360 FC_Obj9RiDoorSts 0 "关闭" 1 "全开" 2 "半开（预留）";
VAL_ 360 FC_Obj9LeDoorSts 0 "关闭" 1 "全开" 2 "半开（预留）";
VAL_ 360 FC_Obj9WSInfoPosType 0 "Unknown" 1 "RearLeft" 2 "RearCenter" 3 "RearRgiht" 4 "FrontLeft" 5 "FrontCenter" 6 "FrontRgiht" 7 "LeftCenter" 8 "RgihtCenter" 9 "Center" 10 "预留;";
VAL_ 360 FC_Obj9_TurnLight 0 "";
VAL_ 360 FC_Obj9_valid 0 "";
VAL_ 360 FC_Obj9_objCutInLane 0 "invalid" 1 "measured;
0x2=predicted;";
VAL_ 360 FC_Obj9_objCutInFlag 0 "invalid" 1 "cutin_hostLane" 2 "cutin_fov";
VAL_ 360 FC_Obj9_LaneAssignment 0 "UNKNOWN    
1=LEFT_LEFT    
2=LEFT    
3=HOST    
4=RIGHT     
5=RIGHT_RIGHT
0x6-0x7=Reserved";
VAL_ 360 FC_Obj9_MotionType 0 "Unknown" 1 "Moving" 2 "Stationary" 3 "Stopped" 4 "Moving Slowly";
VAL_ 360 FC_obj9_Brakelight_Info 0 "off" 1 "on ";
VAL_ 360 FC_Obj9_HeadOrientation 0 "Unknown" 1 "Head Front" 2 "Head Left Front" 3 "Head Left" 4 "Head Left Back" 5 "Head Back" 6 "Head Right Back" 7 "Head Right" 8 "Head right front" 9 "Reserved";
VAL_ 360 FC_Obj9_Type 0 "Not Detected;
0x1=car" 2 "truck" 3 "cyclist/tricycle" 4 "pedestrian" 5 "bicycle/motorbike（无人）" 6 "animal" 7 "uncertain" 8 " bus; 
 0x9~0xF = Reserved;";

VAL_ 361 FC_Obj10_VehicleDir 0 "Unknown" 1 "同向车辆" 2 "对向来车
0x3-0x7=预留";
VAL_ 361 FC_Obj10ReDoorSts 0 "关闭" 1 "全开" 2 "半开（预留）";
VAL_ 361 FC_Obj10RiDoorSts 0 "关闭" 1 "全开" 2 "半开（预留）";
VAL_ 361 FC_Obj10LeDoorSts 0 "关闭" 1 "全开" 2 "半开（预留）";
VAL_ 361 FC_Obj10WSInfoPosType 0 "Unknown" 1 "RearLeft" 2 "RearCenter" 3 "RearRgiht" 4 "FrontLeft" 5 "FrontCenter" 6 "FrontRgiht" 7 "LeftCenter" 8 "RgihtCenter" 9 "Center" 10 "预留;";
VAL_ 361 FC_Obj10_TurnLight 0 "";
VAL_ 361 FC_Obj10_valid 0 "";
VAL_ 361 FC_Obj10_objCutInLane 0 "invalid" 1 "measured;
0x2=predicted;";
VAL_ 361 FC_Obj10_objCutInFlag 0 "invalid" 1 "cutin_hostLane" 2 "cutin_fov";
VAL_ 361 FC_Obj10_LaneAssignment 0 "UNKNOWN    
1=LEFT_LEFT    
2=LEFT    
3=HOST    
4=RIGHT     
5=RIGHT_RIGHT
0x6-0x7=Reserved";
VAL_ 361 FC_Obj10_MotionType 0 "Unknown" 1 "Moving" 2 "Stationary" 3 "Stopped" 4 "Moving Slowly";
VAL_ 361 FC_obj10_Brakelight_Info 0 "off" 1 "on ";
VAL_ 361 FC_Obj10_HeadOrientation 0 "Unknown" 1 "Head Front" 2 "Head Left Front" 3 "Head Left" 4 "Head Left Back" 5 "Head Back" 6 "Head Right Back" 7 "Head Right" 8 "Head right front" 9 "Reserved";
VAL_ 361 FC_Obj10_Type 0 "Not Detected;
0x1=car" 2 "truck" 3 "cyclist/tricycle" 4 "pedestrian" 5 "bicycle/motorbike（无人）" 6 "animal" 7 "uncertain" 8 " bus; 
 0x9~0xF = Reserved;";

VAL_ 368 FC_Obj11_VehicleDir 0 "Unknown" 1 "同向车辆" 2 "对向来车
0x3-0x7=预留";
VAL_ 368 FC_Obj11ReDoorSts 0 "关闭" 1 "全开" 2 "半开（预留）";
VAL_ 368 FC_Obj11RiDoorSts 0 "关闭" 1 "全开" 2 "半开（预留）";
VAL_ 368 FC_Obj11LeDoorSts 0 "关闭" 1 "全开" 2 "半开（预留）";
VAL_ 368 FC_Obj11WSInfoPosType 0 "Unknown" 1 "RearLeft" 2 "RearCenter" 3 "RearRgiht" 4 "FrontLeft" 5 "FrontCenter" 6 "FrontRgiht" 7 "LeftCenter" 8 "RgihtCenter" 9 "Center" 10 "预留;";
VAL_ 368 FC_Obj11_TurnLight 0 "";
VAL_ 368 FC_Obj11_valid 0 "";
VAL_ 368 FC_Obj11_objCutInLane 0 "invalid" 1 "measured;
0x2=predicted;";
VAL_ 368 FC_Obj11_objCutInFlag 0 "invalid" 1 "cutin_hostLane" 2 "cutin_fov";
VAL_ 368 FC_Obj11_LaneAssignment 0 "UNKNOWN    
1=LEFT_LEFT    
2=LEFT    
3=HOST    
4=RIGHT     
5=RIGHT_RIGHT
0x6-0x7=Reserved";
VAL_ 368 FC_Obj11_MotionType 0 "Unknown" 1 "Moving" 2 "Stationary" 3 "Stopped" 4 "Moving Slowly";
VAL_ 368 FC_obj11_Brakelight_Info 0 "off" 1 "on ";
VAL_ 368 FC_Obj11_HeadOrientation 0 "Unknown" 1 "Head Front" 2 "Head Left Front" 3 "Head Left" 4 "Head Left Back" 5 "Head Back" 6 "Head Right Back" 7 "Head Right" 8 "Head right front" 9 "Reserved";
VAL_ 368 FC_Obj11_Type 0 "Not Detected;
0x1=car" 2 "truck" 3 "cyclist/tricycle" 4 "pedestrian" 5 "bicycle/motorbike（无人）" 6 "animal" 7 "uncertain" 8 " bus; 
 0x9~0xF = Reserved;";

VAL_ 369 FC_Obj12_VehicleDir 0 "Unknown" 1 "同向车辆" 2 "对向来车
0x3-0x7=预留";
VAL_ 369 FC_Obj12ReDoorSts 0 "关闭" 1 "全开" 2 "半开（预留）";
VAL_ 369 FC_Obj12RiDoorSts 0 "关闭" 1 "全开" 2 "半开（预留）";
VAL_ 369 FC_Obj12LeDoorSts 0 "关闭" 1 "全开" 2 "半开（预留）";
VAL_ 369 FC_Obj12WSInfoPosType 0 "Unknown" 1 "RearLeft" 2 "RearCenter" 3 "RearRgiht" 4 "FrontLeft" 5 "FrontCenter" 6 "FrontRgiht" 7 "LeftCenter" 8 "RgihtCenter" 9 "Center" 10 "预留;";
VAL_ 369 FC_Obj12_TurnLight 0 "";
VAL_ 369 FC_Obj12_valid 0 "";
VAL_ 369 FC_Obj12_objCutInLane 0 "invalid" 1 "measured;
0x2=predicted;";
VAL_ 369 FC_Obj12_objCutInFlag 0 "invalid" 1 "cutin_hostLane" 2 "cutin_fov";
VAL_ 369 FC_Obj12_LaneAssignment 0 "UNKNOWN    
1=LEFT_LEFT    
2=LEFT    
3=HOST    
4=RIGHT     
5=RIGHT_RIGHT
0x6-0x7=Reserved";
VAL_ 369 FC_Obj12_MotionType 0 "Unknown" 1 "Moving" 2 "Stationary" 3 "Stopped" 4 "Moving Slowly";
VAL_ 369 FC_obj12_Brakelight_Info 0 "off" 1 "on ";
VAL_ 369 FC_Obj12_HeadOrientation 0 "Unknown" 1 "Head Front" 2 "Head Left Front" 3 "Head Left" 4 "Head Left Back" 5 "Head Back" 6 "Head Right Back" 7 "Head Right" 8 "Head right front" 9 "Reserved";
VAL_ 369 FC_Obj12_Type 0 "Not Detected;
0x1=car" 2 "truck" 3 "cyclist/tricycle" 4 "pedestrian" 5 "bicycle/motorbike（无人）" 6 "animal" 7 "uncertain" 8 " bus; 
 0x9~0xF = Reserved;";

VAL_ 370 FC_Obj13_VehicleDir 0 "Unknown" 1 "同向车辆" 2 "对向来车
0x3-0x7=预留";
VAL_ 370 FC_Obj13ReDoorSts 0 "关闭" 1 "全开" 2 "半开（预留）";
VAL_ 370 FC_Obj13RiDoorSts 0 "关闭" 1 "全开" 2 "半开（预留）";
VAL_ 370 FC_Obj13LeDoorSts 0 "关闭" 1 "全开" 2 "半开（预留）";
VAL_ 370 FC_Obj13WSInfoPosType 0 "Unknown" 1 "RearLeft" 2 "RearCenter" 3 "RearRgiht" 4 "FrontLeft" 5 "FrontCenter" 6 "FrontRgiht" 7 "LeftCenter" 8 "RgihtCenter" 9 "Center" 10 "预留;";
VAL_ 370 FC_Obj13_TurnLight 0 "";
VAL_ 370 FC_Obj13_valid 0 "";
VAL_ 370 FC_Obj13_objCutInLane 0 "invalid" 1 "measured;
0x2=predicted;";
VAL_ 370 FC_Obj13_objCutInFlag 0 "invalid" 1 "cutin_hostLane" 2 "cutin_fov";
VAL_ 370 FC_Obj13_LaneAssignment 0 "UNKNOWN    
1=LEFT_LEFT    
2=LEFT    
3=HOST    
4=RIGHT     
5=RIGHT_RIGHT
0x6-0x7=Reserved";
VAL_ 370 FC_Obj13_MotionType 0 "Unknown" 1 "Moving" 2 "Stationary" 3 "Stopped" 4 "Moving Slowly";
VAL_ 370 FC_obj13_Brakelight_Info 0 "off" 1 "on ";
VAL_ 370 FC_Obj13_HeadOrientation 0 "Unknown" 1 "Head Front" 2 "Head Left Front" 3 "Head Left" 4 "Head Left Back" 5 "Head Back" 6 "Head Right Back" 7 "Head Right" 8 "Head right front" 9 "Reserved";
VAL_ 370 FC_Obj13_Type 0 "Not Detected;
0x1=car" 2 "truck" 3 "cyclist/tricycle" 4 "pedestrian" 5 "bicycle/motorbike（无人）" 6 "animal" 7 "uncertain" 8 " bus; 
 0x9~0xF = Reserved;";

VAL_ 371 FC_Obj14_VehicleDir 0 "Unknown" 1 "同向车辆" 2 "对向来车
0x3-0x7=预留";
VAL_ 371 FC_Obj14ReDoorSts 0 "关闭" 1 "全开" 2 "半开（预留）";
VAL_ 371 FC_Obj14RiDoorSts 0 "关闭" 1 "全开" 2 "半开（预留）";
VAL_ 371 FC_Obj14LeDoorSts 0 "关闭" 1 "全开" 2 "半开（预留）";
VAL_ 371 FC_Obj14WSInfoPosType 0 "Unknown" 1 "RearLeft" 2 "RearCenter" 3 "RearRgiht" 4 "FrontLeft" 5 "FrontCenter" 6 "FrontRgiht" 7 "LeftCenter" 8 "RgihtCenter" 9 "Center" 10 "预留;";
VAL_ 371 FC_Obj14_TurnLight 0 "";
VAL_ 371 FC_Obj14_valid 0 "";
VAL_ 371 FC_Obj14_objCutInLane 0 "invalid" 1 "measured;
0x2=predicted;";
VAL_ 371 FC_Obj14_objCutInFlag 0 "invalid" 1 "cutin_hostLane" 2 "cutin_fov";
VAL_ 371 FC_Obj14_LaneAssignment 0 "UNKNOWN    
1=LEFT_LEFT    
2=LEFT    
3=HOST    
4=RIGHT     
5=RIGHT_RIGHT
0x6-0x7=Reserved";
VAL_ 371 FC_Obj14_MotionType 0 "Unknown" 1 "Moving" 2 "Stationary" 3 "Stopped" 4 "Moving Slowly";
VAL_ 371 FC_obj14_Brakelight_Info 0 "off" 1 "on ";
VAL_ 371 FC_Obj14_HeadOrientation 0 "Unknown" 1 "Head Front" 2 "Head Left Front" 3 "Head Left" 4 "Head Left Back" 5 "Head Back" 6 "Head Right Back" 7 "Head Right" 8 "Head right front" 9 "Reserved";
VAL_ 371 FC_Obj14_Type 0 "Not Detected;
0x1=car" 2 "truck" 3 "cyclist/tricycle" 4 "pedestrian" 5 "bicycle/motorbike（无人）" 6 "animal" 7 "uncertain" 8 " bus; 
 0x9~0xF = Reserved;";

VAL_ 372 FC_Obj15_VehicleDir 0 "Unknown" 1 "同向车辆" 2 "对向来车
0x3-0x7=预留";
VAL_ 372 FC_Obj15ReDoorSts 0 "关闭" 1 "全开" 2 "半开（预留）";
VAL_ 372 FC_Obj15RiDoorSts 0 "关闭" 1 "全开" 2 "半开（预留）";
VAL_ 372 FC_Obj15LeDoorSts 0 "关闭" 1 "全开" 2 "半开（预留）";
VAL_ 372 FC_Obj15WSInfoPosType 0 "Unknown" 1 "RearLeft" 2 "RearCenter" 3 "RearRgiht" 4 "FrontLeft" 5 "FrontCenter" 6 "FrontRgiht" 7 "LeftCenter" 8 "RgihtCenter" 9 "Center" 10 "预留;";
VAL_ 372 FC_Obj15_TurnLight 0 "";
VAL_ 372 FC_Obj15_valid 0 "";
VAL_ 372 FC_Obj15_objCutInLane 0 "invalid" 1 "measured;
0x2=predicted;";
VAL_ 372 FC_Obj15_objCutInFlag 0 "invalid" 1 "cutin_hostLane" 2 "cutin_fov";
VAL_ 372 FC_Obj15_LaneAssignment 0 "UNKNOWN    
1=LEFT_LEFT    
2=LEFT    
3=HOST    
4=RIGHT     
5=RIGHT_RIGHT
0x6-0x7=Reserved";
VAL_ 372 FC_Obj15_MotionType 0 "Unknown" 1 "Moving" 2 "Stationary" 3 "Stopped" 4 "Moving Slowly";
VAL_ 372 FC_obj15_Brakelight_Info 0 "off" 1 "on ";
VAL_ 372 FC_Obj15_HeadOrientation 0 "Unknown" 1 "Head Front" 2 "Head Left Front" 3 "Head Left" 4 "Head Left Back" 5 "Head Back" 6 "Head Right Back" 7 "Head Right" 8 "Head right front" 9 "Reserved";
VAL_ 372 FC_Obj15_Type 0 "Not Detected;
0x1=car" 2 "truck" 3 "cyclist/tricycle" 4 "pedestrian" 5 "bicycle/motorbike（无人）" 6 "animal" 7 "uncertain" 8 " bus; 
 0x9~0xF = Reserved;";

VAL_ 373 FC_Obj16_VehicleDir 0 "Unknown" 1 "同向车辆" 2 "对向来车
0x3-0x7=预留";
VAL_ 373 FC_Obj16ReDoorSts 0 "关闭" 1 "全开" 2 "半开（预留）";
VAL_ 373 FC_Obj16RiDoorSts 0 "关闭" 1 "全开" 2 "半开（预留）";
VAL_ 373 FC_Obj16LeDoorSts 0 "关闭" 1 "全开" 2 "半开（预留）";
VAL_ 373 FC_Obj16WSInfoPosType 0 "Unknown" 1 "RearLeft" 2 "RearCenter" 3 "RearRgiht" 4 "FrontLeft" 5 "FrontCenter" 6 "FrontRgiht" 7 "LeftCenter" 8 "RgihtCenter" 9 "Center" 10 "预留;";
VAL_ 373 FC_Obj16_TurnLight 0 "";
VAL_ 373 FC_Obj16_valid 0 "";
VAL_ 373 FC_Obj16_objCutInLane 0 "invalid" 1 "measured;
0x2=predicted;";
VAL_ 373 FC_Obj16_objCutInFlag 0 "invalid" 1 "cutin_hostLane" 2 "cutin_fov";
VAL_ 373 FC_Obj16_LaneAssignment 0 "UNKNOWN    
1=LEFT_LEFT    
2=LEFT    
3=HOST    
4=RIGHT     
5=RIGHT_RIGHT
0x6-0x7=Reserved";
VAL_ 373 FC_Obj16_MotionType 0 "Unknown" 1 "Moving" 2 "Stationary" 3 "Stopped" 4 "Moving Slowly";
VAL_ 373 FC_obj16_Brakelight_Info 0 "off" 1 "on ";
VAL_ 373 FC_Obj16_HeadOrientation 0 "Unknown" 1 "Head Front" 2 "Head Left Front" 3 "Head Left" 4 "Head Left Back" 5 "Head Back" 6 "Head Right Back" 7 "Head Right" 8 "Head right front" 9 "Reserved";
VAL_ 373 FC_Obj16_Type 0 "Not Detected;
0x1=car" 2 "truck" 3 "cyclist/tricycle" 4 "pedestrian" 5 "bicycle/motorbike（无人）" 6 "animal" 7 "uncertain" 8 " bus; 
 0x9~0xF = Reserved;";

VAL_ 374 FC_Obj17_VehicleDir 0 "Unknown" 1 "同向车辆" 2 "对向来车
0x3-0x7=预留";
VAL_ 374 FC_Obj17ReDoorSts 0 "关闭" 1 "全开" 2 "半开（预留）";
VAL_ 374 FC_Obj17RiDoorSts 0 "关闭" 1 "全开" 2 "半开（预留）";
VAL_ 374 FC_Obj17LeDoorSts 0 "关闭" 1 "全开" 2 "半开（预留）";
VAL_ 374 FC_Obj17WSInfoPosType 0 "Unknown" 1 "RearLeft" 2 "RearCenter" 3 "RearRgiht" 4 "FrontLeft" 5 "FrontCenter" 6 "FrontRgiht" 7 "LeftCenter" 8 "RgihtCenter" 9 "Center" 10 "预留;";
VAL_ 374 FC_Obj17_TurnLight 0 "";
VAL_ 374 FC_Obj17_valid 0 "";
VAL_ 374 FC_Obj17_objCutInLane 0 "invalid" 1 "measured;
0x2=predicted;";
VAL_ 374 FC_Obj17_objCutInFlag 0 "invalid" 1 "cutin_hostLane" 2 "cutin_fov";
VAL_ 374 FC_Obj17_LaneAssignment 0 "UNKNOWN    
1=LEFT_LEFT    
2=LEFT    
3=HOST    
4=RIGHT     
5=RIGHT_RIGHT
0x6-0x7=Reserved";
VAL_ 374 FC_Obj17_MotionType 0 "Unknown" 1 "Moving" 2 "Stationary" 3 "Stopped" 4 "Moving Slowly";
VAL_ 374 FC_obj17_Brakelight_Info 0 "off" 1 "on ";
VAL_ 374 FC_Obj17_HeadOrientation 0 "Unknown" 1 "Head Front" 2 "Head Left Front" 3 "Head Left" 4 "Head Left Back" 5 "Head Back" 6 "Head Right Back" 7 "Head Right" 8 "Head right front" 9 "Reserved";
VAL_ 374 FC_Obj17_Type 0 "Not Detected;
0x1=car" 2 "truck" 3 "cyclist/tricycle" 4 "pedestrian" 5 "bicycle/motorbike（无人）" 6 "animal" 7 "uncertain" 8 " bus; 
 0x9~0xF = Reserved;";

VAL_ 375 FC_Obj18_VehicleDir 0 "Unknown" 1 "同向车辆" 2 "对向来车
0x3-0x7=预留";
VAL_ 375 FC_Obj18ReDoorSts 0 "关闭" 1 "全开" 2 "半开（预留）";
VAL_ 375 FC_Obj18RiDoorSts 0 "关闭" 1 "全开" 2 "半开（预留）";
VAL_ 375 FC_Obj18LeDoorSts 0 "关闭" 1 "全开" 2 "半开（预留）";
VAL_ 375 FC_Obj18WSInfoPosType 0 "Unknown" 1 "RearLeft" 2 "RearCenter" 3 "RearRgiht" 4 "FrontLeft" 5 "FrontCenter" 6 "FrontRgiht" 7 "LeftCenter" 8 "RgihtCenter" 9 "Center" 10 "预留;";
VAL_ 375 FC_Obj18_TurnLight 0 "";
VAL_ 375 FC_Obj18_valid 0 "";
VAL_ 375 FC_Obj18_objCutInLane 0 "invalid" 1 "measured;
0x2=predicted;";
VAL_ 375 FC_Obj18_objCutInFlag 0 "invalid" 1 "cutin_hostLane" 2 "cutin_fov";
VAL_ 375 FC_Obj18_LaneAssignment 0 "UNKNOWN    
1=LEFT_LEFT    
2=LEFT    
3=HOST    
4=RIGHT     
5=RIGHT_RIGHT
0x6-0x7=Reserved";
VAL_ 375 FC_Obj18_MotionType 0 "Unknown" 1 "Moving" 2 "Stationary" 3 "Stopped" 4 "Moving Slowly";
VAL_ 375 FC_obj18_Brakelight_Info 0 "off" 1 "on ";
VAL_ 375 FC_Obj18_HeadOrientation 0 "Unknown" 1 "Head Front" 2 "Head Left Front" 3 "Head Left" 4 "Head Left Back" 5 "Head Back" 6 "Head Right Back" 7 "Head Right" 8 "Head right front" 9 "Reserved";
VAL_ 375 FC_Obj18_Type 0 "Not Detected;
0x1=car" 2 "truck" 3 "cyclist/tricycle" 4 "pedestrian" 5 "bicycle/motorbike（无人）" 6 "animal" 7 "uncertain" 8 " bus; 
 0x9~0xF = Reserved;";
