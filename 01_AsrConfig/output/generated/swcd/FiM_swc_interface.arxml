AUTOSAR XML (schema 4-0-3)
package /AUTOSAR_FiM/PortInterfaces
  client server interface FunctionInhibition: is-service=true
    operation GetFunctionPermission: possible-error=E_NOT_OK
      arg Permission: type=boolean, direction=OUT
    error E_NOT_OK: error-code=1
