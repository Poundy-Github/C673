AUTOSAR XML (schema 4-0-3)
package /AUTOSAR_BswM/BswModuleDescriptions
  bsw module description BswM: module-id=042
    provided-entrys:
      BswM_MainFunction
      BswM_Init
      BswM_MRPFunc_BswMBswModeNotification_DcmCommunicationControl_DCM_ENABLE_RX_DISABLE_TX_NM
      BswM_MRPFunc_BswMBswModeNotification_DcmCommunicationControl_DCM_ENABLE_RX_TX_NORM_NM
      BswM_MRPFunc_BswMBswModeNotification_DcmCommunicationControl_DCM_DISABLE_RX_ENABLE_TX_NORM_NM
      BswM_MRPFunc_BswMBswModeNotification_DcmCommunicationControl_DCM_ENABLE_RX_TX_NORM
      BswM_MRPFunc_BswMModeRequestPort_Slave_BSWM_STARTUP_TWO_B
      BswM_MRPFunc_BswMBswModeNotification_DcmEcuReset_HARD
      BswM_MRPFunc_BswMBswModeNotification_DcmEcuReset_EXECUTE
      BswM_MRPFunc_BswMBswModeNotification_DcmEcuReset_KEYONOFF
      BswM_MRPFunc_BswMBswModeNotification_DcmCommunicationControl_DCM_DISABLE_RX_TX_NM
      BswM_MRPFunc_BswMModeRequestPort_Slave_BSWM_SWC_CYCLIC_SHUTDOWN_C1
      BswM_MRPFunc_BswMBswModeNotification_DcmCommunicationControl_DCM_ENABLE_RX_TX_NM
      BswM_MRPFunc_BswMModeRequestPort_Slave_BSWM_GO_OFF_ONE_D
      BswM_MRPFunc_BswMBswModeNotification_DcmCommunicationControl_DCM_DISABLE_RX_TX_NORM
      BswM_MRPFunc_BswMBswModeNotification_DcmEcuReset_SOFT
      BswM_MRPFunc_BswMBswModeNotification_DcmCommunicationControl_DCM_DISABLE_RX_ENABLE_TX_NORM
      BswM_MRPFunc_BswMModeRequestPort_Slave_BSWM_STARTUP_TWO_D
      BswM_MRPFunc_BswMBswModeNotification_DcmEcuReset_JUMPTOBOOTLOADER
      BswM_MRPFunc_BswMBswModeNotification_DcmEcuReset_NONE
      BswM_MRPFunc_BswMBswModeNotification_DcmCommunicationControl_DCM_DISABLE_RX_ENABLE_TX_NM
      BswM_MRPFunc_BswMBswModeNotification_DcmCommunicationControl_DCM_DISABLE_RX_TX_NORM_NM
      BswM_MRPFunc_BswMBswModeNotification_DcmEcuReset_JUMPTOSYSSUPPLIERBOOTLOADER
      BswM_MRPFunc_BswMBswModeNotification_DcmCommunicationControl_DCM_ENABLE_RX_DISABLE_TX_NORM
      BswM_MRPFunc_BswMBswModeNotification_DcmCommunicationControl_DCM_ENABLE_RX_DISABLE_TX_NORM_NM
    provided-mode-groups:
      mode declaration group prototype BswM_ModeSwitchPort_OsApplication_C0_BswMSwitchPort_Master: type=BSWM_ModeGroupCrossCore
    required-mode-groups:
      5 x mode declaration group prototype:
        BswM_ModeNotificationPort_OsApplication_C0_BswMBswModeNotification_DcmEcuReset: type=DcmEcuReset
        BswM_ModeNotificationPort_OsApplication_C0_BswMBswModeNotification_DcmCommunicationControl: type=DcmCommunicationControl
        BswM_ModeNotificationPort_OsApplication_C{1..3}_BswMModeRequestPort_Slave: type=BSWM_ModeGroupCrossCore
    5 x bsw internal behavior, all with data-type-mapping=[DataTypeMappingSet_0, ModeMapping, BswMModeMapping, BswMModeMapping_CrossCore, DataTypeMappingSet_CanSM]:
      InternalBehavior_0
        exclusive area SCHM_BSWM_EXCLUSIVE_AREA
        20 x bsw schedulable entity:
          SE_BswMBswModeNotification_DcmEcuReset_NONE: accessed-mode-groups=BswM_ModeNotificationPort_OsApplication_C0_BswMBswModeNotification_DcmEcuReset, implemented-entry=BswM_MRPFunc_BswMBswModeNotification_DcmEcuReset_NONE
          SE_BswMBswModeNotification_DcmEcuReset_HARD: accessed-mode-groups=BswM_ModeNotificationPort_OsApplication_C0_BswMBswModeNotification_DcmEcuReset, implemented-entry=BswM_MRPFunc_BswMBswModeNotification_DcmEcuReset_HARD
          SE_BswMBswModeNotification_DcmEcuReset_KEYONOFF: accessed-mode-groups=BswM_ModeNotificationPort_OsApplication_C0_BswMBswModeNotification_DcmEcuReset, implemented-entry=BswM_MRPFunc_BswMBswModeNotification_DcmEcuReset_KEYONOFF
          SE_BswMBswModeNotification_DcmEcuReset_SOFT: accessed-mode-groups=BswM_ModeNotificationPort_OsApplication_C0_BswMBswModeNotification_DcmEcuReset, implemented-entry=BswM_MRPFunc_BswMBswModeNotification_DcmEcuReset_SOFT
          SE_BswMBswModeNotification_DcmEcuReset_JUMPTOBOOTLOADER: accessed-mode-groups=BswM_ModeNotificationPort_OsApplication_C0_BswMBswModeNotification_DcmEcuReset, implemented-entry=BswM_MRPFunc_BswMBswModeNotification_DcmEcuReset_JUMPTOBOOTLOADER
          SE_BswMBswModeNotification_DcmEcuReset_JUMPTOSYSSUPPLIERBOOTLOADER: accessed-mode-groups=BswM_ModeNotificationPort_OsApplication_C0_BswMBswModeNotification_DcmEcuReset, implemented-entry=BswM_MRPFunc_BswMBswModeNotification_DcmEcuReset_JUMPTOSYSSUPPLIERBOOTLOADER
          SE_BswMBswModeNotification_DcmEcuReset_EXECUTE: accessed-mode-groups=BswM_ModeNotificationPort_OsApplication_C0_BswMBswModeNotification_DcmEcuReset, implemented-entry=BswM_MRPFunc_BswMBswModeNotification_DcmEcuReset_EXECUTE
          SE_BswMBswModeNotification_DcmCommunicationControl_DCM_ENABLE_RX_TX_NORM: accessed-mode-groups=BswM_ModeNotificationPort_OsApplication_C0_BswMBswModeNotification_DcmCommunicationControl, implemented-entry=BswM_MRPFunc_BswMBswModeNotification_DcmCommunicationControl_DCM_ENABLE_RX_TX_NORM
          SE_BswMBswModeNotification_DcmCommunicationControl_DCM_ENABLE_RX_DISABLE_TX_NORM: accessed-mode-groups=BswM_ModeNotificationPort_OsApplication_C0_BswMBswModeNotification_DcmCommunicationControl, implemented-entry=BswM_MRPFunc_BswMBswModeNotification_DcmCommunicationControl_DCM_ENABLE_RX_DISABLE_TX_NORM
          SE_BswMBswModeNotification_DcmCommunicationControl_DCM_DISABLE_RX_ENABLE_TX_NORM: accessed-mode-groups=BswM_ModeNotificationPort_OsApplication_C0_BswMBswModeNotification_DcmCommunicationControl, implemented-entry=BswM_MRPFunc_BswMBswModeNotification_DcmCommunicationControl_DCM_DISABLE_RX_ENABLE_TX_NORM
          SE_BswMBswModeNotification_DcmCommunicationControl_DCM_DISABLE_RX_TX_NORM: accessed-mode-groups=BswM_ModeNotificationPort_OsApplication_C0_BswMBswModeNotification_DcmCommunicationControl, implemented-entry=BswM_MRPFunc_BswMBswModeNotification_DcmCommunicationControl_DCM_DISABLE_RX_TX_NORM
          SE_BswMBswModeNotification_DcmCommunicationControl_DCM_ENABLE_RX_TX_NM: accessed-mode-groups=BswM_ModeNotificationPort_OsApplication_C0_BswMBswModeNotification_DcmCommunicationControl, implemented-entry=BswM_MRPFunc_BswMBswModeNotification_DcmCommunicationControl_DCM_ENABLE_RX_TX_NM
          SE_BswMBswModeNotification_DcmCommunicationControl_DCM_ENABLE_RX_DISABLE_TX_NM: accessed-mode-groups=BswM_ModeNotificationPort_OsApplication_C0_BswMBswModeNotification_DcmCommunicationControl, implemented-entry=BswM_MRPFunc_BswMBswModeNotification_DcmCommunicationControl_DCM_ENABLE_RX_DISABLE_TX_NM
          SE_BswMBswModeNotification_DcmCommunicationControl_DCM_DISABLE_RX_ENABLE_TX_NM: accessed-mode-groups=BswM_ModeNotificationPort_OsApplication_C0_BswMBswModeNotification_DcmCommunicationControl, implemented-entry=BswM_MRPFunc_BswMBswModeNotification_DcmCommunicationControl_DCM_DISABLE_RX_ENABLE_TX_NM
          SE_BswMBswModeNotification_DcmCommunicationControl_DCM_DISABLE_RX_TX_NM: accessed-mode-groups=BswM_ModeNotificationPort_OsApplication_C0_BswMBswModeNotification_DcmCommunicationControl, implemented-entry=BswM_MRPFunc_BswMBswModeNotification_DcmCommunicationControl_DCM_DISABLE_RX_TX_NM
          SE_BswMBswModeNotification_DcmCommunicationControl_DCM_ENABLE_RX_TX_NORM_NM: accessed-mode-groups=BswM_ModeNotificationPort_OsApplication_C0_BswMBswModeNotification_DcmCommunicationControl, implemented-entry=BswM_MRPFunc_BswMBswModeNotification_DcmCommunicationControl_DCM_ENABLE_RX_TX_NORM_NM
          SE_BswMBswModeNotification_DcmCommunicationControl_DCM_ENABLE_RX_DISABLE_TX_NORM_NM: accessed-mode-groups=BswM_ModeNotificationPort_OsApplication_C0_BswMBswModeNotification_DcmCommunicationControl, implemented-entry=BswM_MRPFunc_BswMBswModeNotification_DcmCommunicationControl_DCM_ENABLE_RX_DISABLE_TX_NORM_NM
          SE_BswMBswModeNotification_DcmCommunicationControl_DCM_DISABLE_RX_ENABLE_TX_NORM_NM: accessed-mode-groups=BswM_ModeNotificationPort_OsApplication_C0_BswMBswModeNotification_DcmCommunicationControl, implemented-entry=BswM_MRPFunc_BswMBswModeNotification_DcmCommunicationControl_DCM_DISABLE_RX_ENABLE_TX_NORM_NM
          SE_BswMBswModeNotification_DcmCommunicationControl_DCM_DISABLE_RX_TX_NORM_NM: accessed-mode-groups=BswM_ModeNotificationPort_OsApplication_C0_BswMBswModeNotification_DcmCommunicationControl, implemented-entry=BswM_MRPFunc_BswMBswModeNotification_DcmCommunicationControl_DCM_DISABLE_RX_TX_NORM_NM
          BswM_MainFunction: can-enter-exclusive-area=InternalBehavior_0/SCHM_BSWM_EXCLUSIVE_AREA, implemented-entry=BswM_MainFunction, managed-mode-groups=BswM_ModeSwitchPort_OsApplication_C0_BswMSwitchPort_Master
        19 x bsw mode switch event, all with activation=ON-ENTRY:
          MSE_BswMBswModeNotification_DcmEcuReset_NONE: starts-on-event=SE_BswMBswModeNotification_DcmEcuReset_NONE, mode=BswM_ModeNotificationPort_OsApplication_C0_BswMBswModeNotification_DcmEcuReset.NONE
          MSE_BswMBswModeNotification_DcmEcuReset_HARD: starts-on-event=SE_BswMBswModeNotification_DcmEcuReset_HARD, mode=BswM_ModeNotificationPort_OsApplication_C0_BswMBswModeNotification_DcmEcuReset.HARD
          MSE_BswMBswModeNotification_DcmEcuReset_KEYONOFF: starts-on-event=SE_BswMBswModeNotification_DcmEcuReset_KEYONOFF, mode=BswM_ModeNotificationPort_OsApplication_C0_BswMBswModeNotification_DcmEcuReset.KEYONOFF
          MSE_BswMBswModeNotification_DcmEcuReset_SOFT: starts-on-event=SE_BswMBswModeNotification_DcmEcuReset_SOFT, mode=BswM_ModeNotificationPort_OsApplication_C0_BswMBswModeNotification_DcmEcuReset.SOFT
          MSE_BswMBswModeNotification_DcmEcuReset_JUMPTOBOOTLOADER: starts-on-event=SE_BswMBswModeNotification_DcmEcuReset_JUMPTOBOOTLOADER, mode=BswM_ModeNotificationPort_OsApplication_C0_BswMBswModeNotification_DcmEcuReset.JUMPTOBOOTLOADER
          MSE_BswMBswModeNotification_DcmEcuReset_JUMPTOSYSSUPPLIERBOOTLOADER: starts-on-event=SE_BswMBswModeNotification_DcmEcuReset_JUMPTOSYSSUPPLIERBOOTLOADER, mode=BswM_ModeNotificationPort_OsApplication_C0_BswMBswModeNotification_DcmEcuReset.JUMPTOSYSSUPPLIERBOOTLOADER
          MSE_BswMBswModeNotification_DcmEcuReset_EXECUTE: starts-on-event=SE_BswMBswModeNotification_DcmEcuReset_EXECUTE, mode=BswM_ModeNotificationPort_OsApplication_C0_BswMBswModeNotification_DcmEcuReset.EXECUTE
          MSE_BswMBswModeNotification_DcmCommunicationControl_DCM_ENABLE_RX_TX_NORM: starts-on-event=SE_BswMBswModeNotification_DcmCommunicationControl_DCM_ENABLE_RX_TX_NORM, mode=BswM_ModeNotificationPort_OsApplication_C0_BswMBswModeNotification_DcmCommunicationControl.DCM_ENABLE_RX_TX_NORM
          MSE_BswMBswModeNotification_DcmCommunicationControl_DCM_ENABLE_RX_DISABLE_TX_NORM: starts-on-event=SE_BswMBswModeNotification_DcmCommunicationControl_DCM_ENABLE_RX_DISABLE_TX_NORM, mode=BswM_ModeNotificationPort_OsApplication_C0_BswMBswModeNotification_DcmCommunicationControl.DCM_ENABLE_RX_DISABLE_TX_NORM
          MSE_BswMBswModeNotification_DcmCommunicationControl_DCM_DISABLE_RX_ENABLE_TX_NORM: starts-on-event=SE_BswMBswModeNotification_DcmCommunicationControl_DCM_DISABLE_RX_ENABLE_TX_NORM, mode=BswM_ModeNotificationPort_OsApplication_C0_BswMBswModeNotification_DcmCommunicationControl.DCM_DISABLE_RX_ENABLE_TX_NORM
          MSE_BswMBswModeNotification_DcmCommunicationControl_DCM_DISABLE_RX_TX_NORM: starts-on-event=SE_BswMBswModeNotification_DcmCommunicationControl_DCM_DISABLE_RX_TX_NORM, mode=BswM_ModeNotificationPort_OsApplication_C0_BswMBswModeNotification_DcmCommunicationControl.DCM_DISABLE_RX_TX_NORM
          MSE_BswMBswModeNotification_DcmCommunicationControl_DCM_ENABLE_RX_TX_NM: starts-on-event=SE_BswMBswModeNotification_DcmCommunicationControl_DCM_ENABLE_RX_TX_NM, mode=BswM_ModeNotificationPort_OsApplication_C0_BswMBswModeNotification_DcmCommunicationControl.DCM_ENABLE_RX_TX_NM
          MSE_BswMBswModeNotification_DcmCommunicationControl_DCM_ENABLE_RX_DISABLE_TX_NM: starts-on-event=SE_BswMBswModeNotification_DcmCommunicationControl_DCM_ENABLE_RX_DISABLE_TX_NM, mode=BswM_ModeNotificationPort_OsApplication_C0_BswMBswModeNotification_DcmCommunicationControl.DCM_ENABLE_RX_DISABLE_TX_NM
          MSE_BswMBswModeNotification_DcmCommunicationControl_DCM_DISABLE_RX_ENABLE_TX_NM: starts-on-event=SE_BswMBswModeNotification_DcmCommunicationControl_DCM_DISABLE_RX_ENABLE_TX_NM, mode=BswM_ModeNotificationPort_OsApplication_C0_BswMBswModeNotification_DcmCommunicationControl.DCM_DISABLE_RX_ENABLE_TX_NM
          MSE_BswMBswModeNotification_DcmCommunicationControl_DCM_DISABLE_RX_TX_NM: starts-on-event=SE_BswMBswModeNotification_DcmCommunicationControl_DCM_DISABLE_RX_TX_NM, mode=BswM_ModeNotificationPort_OsApplication_C0_BswMBswModeNotification_DcmCommunicationControl.DCM_DISABLE_RX_TX_NM
          MSE_BswMBswModeNotification_DcmCommunicationControl_DCM_ENABLE_RX_TX_NORM_NM: starts-on-event=SE_BswMBswModeNotification_DcmCommunicationControl_DCM_ENABLE_RX_TX_NORM_NM, mode=BswM_ModeNotificationPort_OsApplication_C0_BswMBswModeNotification_DcmCommunicationControl.DCM_ENABLE_RX_TX_NORM_NM
          MSE_BswMBswModeNotification_DcmCommunicationControl_DCM_ENABLE_RX_DISABLE_TX_NORM_NM: starts-on-event=SE_BswMBswModeNotification_DcmCommunicationControl_DCM_ENABLE_RX_DISABLE_TX_NORM_NM, mode=BswM_ModeNotificationPort_OsApplication_C0_BswMBswModeNotification_DcmCommunicationControl.DCM_ENABLE_RX_DISABLE_TX_NORM_NM
          MSE_BswMBswModeNotification_DcmCommunicationControl_DCM_DISABLE_RX_ENABLE_TX_NORM_NM: starts-on-event=SE_BswMBswModeNotification_DcmCommunicationControl_DCM_DISABLE_RX_ENABLE_TX_NORM_NM, mode=BswM_ModeNotificationPort_OsApplication_C0_BswMBswModeNotification_DcmCommunicationControl.DCM_DISABLE_RX_ENABLE_TX_NORM_NM
          MSE_BswMBswModeNotification_DcmCommunicationControl_DCM_DISABLE_RX_TX_NORM_NM: starts-on-event=SE_BswMBswModeNotification_DcmCommunicationControl_DCM_DISABLE_RX_TX_NORM_NM, mode=BswM_ModeNotificationPort_OsApplication_C0_BswMBswModeNotification_DcmCommunicationControl.DCM_DISABLE_RX_TX_NORM_NM
        bsw timing event TimingEvent_MainFunction: starts-on-event=InternalBehavior_0/BswM_MainFunction, period=0.01
      InternalBehavior_1
        exclusive area SCHM_BSWM_EXCLUSIVE_AREA
        5 x bsw schedulable entity:
          SE_BswMModeRequestPort_Slave_BSWM_GO_OFF_ONE_D: accessed-mode-groups=BswM_ModeNotificationPort_OsApplication_C1_BswMModeRequestPort_Slave, implemented-entry=BswM_MRPFunc_BswMModeRequestPort_Slave_BSWM_GO_OFF_ONE_D
          SE_BswMModeRequestPort_Slave_BSWM_STARTUP_TWO_B: accessed-mode-groups=BswM_ModeNotificationPort_OsApplication_C1_BswMModeRequestPort_Slave, implemented-entry=BswM_MRPFunc_BswMModeRequestPort_Slave_BSWM_STARTUP_TWO_B
          SE_BswMModeRequestPort_Slave_BSWM_STARTUP_TWO_D: accessed-mode-groups=BswM_ModeNotificationPort_OsApplication_C1_BswMModeRequestPort_Slave, implemented-entry=BswM_MRPFunc_BswMModeRequestPort_Slave_BSWM_STARTUP_TWO_D
          SE_BswMModeRequestPort_Slave_BSWM_SWC_CYCLIC_SHUTDOWN_C1: accessed-mode-groups=BswM_ModeNotificationPort_OsApplication_C1_BswMModeRequestPort_Slave, implemented-entry=BswM_MRPFunc_BswMModeRequestPort_Slave_BSWM_SWC_CYCLIC_SHUTDOWN_C1
          BswM_MainFunction: can-enter-exclusive-area=InternalBehavior_1/SCHM_BSWM_EXCLUSIVE_AREA, implemented-entry=BswM_MainFunction
        4 x bsw mode switch event, all with activation=ON-ENTRY:
          MSE_BswMModeRequestPort_Slave_BSWM_GO_OFF_ONE_D: starts-on-event=InternalBehavior_1/SE_BswMModeRequestPort_Slave_BSWM_GO_OFF_ONE_D, mode=BswM_ModeNotificationPort_OsApplication_C1_BswMModeRequestPort_Slave.BSWM_GO_OFF_ONE_D
          MSE_BswMModeRequestPort_Slave_BSWM_STARTUP_TWO_B: starts-on-event=InternalBehavior_1/SE_BswMModeRequestPort_Slave_BSWM_STARTUP_TWO_B, mode=BswM_ModeNotificationPort_OsApplication_C1_BswMModeRequestPort_Slave.BSWM_STARTUP_TWO_B
          MSE_BswMModeRequestPort_Slave_BSWM_STARTUP_TWO_D: starts-on-event=InternalBehavior_1/SE_BswMModeRequestPort_Slave_BSWM_STARTUP_TWO_D, mode=BswM_ModeNotificationPort_OsApplication_C1_BswMModeRequestPort_Slave.BSWM_STARTUP_TWO_D
          MSE_BswMModeRequestPort_Slave_BSWM_SWC_CYCLIC_SHUTDOWN_C1: starts-on-event=InternalBehavior_1/SE_BswMModeRequestPort_Slave_BSWM_SWC_CYCLIC_SHUTDOWN_C1, mode=BswM_ModeNotificationPort_OsApplication_C1_BswMModeRequestPort_Slave.BSWM_SWC_CYCLIC_SHUTDOWN_C1
        bsw timing event TimingEvent_MainFunction: starts-on-event=InternalBehavior_1/BswM_MainFunction, period=0.01
      InternalBehavior_2
        exclusive area SCHM_BSWM_EXCLUSIVE_AREA
        5 x bsw schedulable entity:
          SE_BswMModeRequestPort_Slave_BSWM_GO_OFF_ONE_D: accessed-mode-groups=BswM_ModeNotificationPort_OsApplication_C2_BswMModeRequestPort_Slave, implemented-entry=BswM_MRPFunc_BswMModeRequestPort_Slave_BSWM_GO_OFF_ONE_D
          SE_BswMModeRequestPort_Slave_BSWM_STARTUP_TWO_B: accessed-mode-groups=BswM_ModeNotificationPort_OsApplication_C2_BswMModeRequestPort_Slave, implemented-entry=BswM_MRPFunc_BswMModeRequestPort_Slave_BSWM_STARTUP_TWO_B
          SE_BswMModeRequestPort_Slave_BSWM_STARTUP_TWO_D: accessed-mode-groups=BswM_ModeNotificationPort_OsApplication_C2_BswMModeRequestPort_Slave, implemented-entry=BswM_MRPFunc_BswMModeRequestPort_Slave_BSWM_STARTUP_TWO_D
          SE_BswMModeRequestPort_Slave_BSWM_SWC_CYCLIC_SHUTDOWN_C1: accessed-mode-groups=BswM_ModeNotificationPort_OsApplication_C2_BswMModeRequestPort_Slave, implemented-entry=BswM_MRPFunc_BswMModeRequestPort_Slave_BSWM_SWC_CYCLIC_SHUTDOWN_C1
          BswM_MainFunction: can-enter-exclusive-area=InternalBehavior_2/SCHM_BSWM_EXCLUSIVE_AREA, implemented-entry=BswM_MainFunction
        4 x bsw mode switch event, all with activation=ON-ENTRY:
          MSE_BswMModeRequestPort_Slave_BSWM_GO_OFF_ONE_D: starts-on-event=InternalBehavior_2/SE_BswMModeRequestPort_Slave_BSWM_GO_OFF_ONE_D, mode=BswM_ModeNotificationPort_OsApplication_C2_BswMModeRequestPort_Slave.BSWM_GO_OFF_ONE_D
          MSE_BswMModeRequestPort_Slave_BSWM_STARTUP_TWO_B: starts-on-event=InternalBehavior_2/SE_BswMModeRequestPort_Slave_BSWM_STARTUP_TWO_B, mode=BswM_ModeNotificationPort_OsApplication_C2_BswMModeRequestPort_Slave.BSWM_STARTUP_TWO_B
          MSE_BswMModeRequestPort_Slave_BSWM_STARTUP_TWO_D: starts-on-event=InternalBehavior_2/SE_BswMModeRequestPort_Slave_BSWM_STARTUP_TWO_D, mode=BswM_ModeNotificationPort_OsApplication_C2_BswMModeRequestPort_Slave.BSWM_STARTUP_TWO_D
          MSE_BswMModeRequestPort_Slave_BSWM_SWC_CYCLIC_SHUTDOWN_C1: starts-on-event=InternalBehavior_2/SE_BswMModeRequestPort_Slave_BSWM_SWC_CYCLIC_SHUTDOWN_C1, mode=BswM_ModeNotificationPort_OsApplication_C2_BswMModeRequestPort_Slave.BSWM_SWC_CYCLIC_SHUTDOWN_C1
        bsw timing event TimingEvent_MainFunction: starts-on-event=InternalBehavior_2/BswM_MainFunction, period=0.01
      InternalBehavior_3
        exclusive area SCHM_BSWM_EXCLUSIVE_AREA
        5 x bsw schedulable entity:
          SE_BswMModeRequestPort_Slave_BSWM_GO_OFF_ONE_D: accessed-mode-groups=BswM_ModeNotificationPort_OsApplication_C3_BswMModeRequestPort_Slave, implemented-entry=BswM_MRPFunc_BswMModeRequestPort_Slave_BSWM_GO_OFF_ONE_D
          SE_BswMModeRequestPort_Slave_BSWM_STARTUP_TWO_B: accessed-mode-groups=BswM_ModeNotificationPort_OsApplication_C3_BswMModeRequestPort_Slave, implemented-entry=BswM_MRPFunc_BswMModeRequestPort_Slave_BSWM_STARTUP_TWO_B
          SE_BswMModeRequestPort_Slave_BSWM_STARTUP_TWO_D: accessed-mode-groups=BswM_ModeNotificationPort_OsApplication_C3_BswMModeRequestPort_Slave, implemented-entry=BswM_MRPFunc_BswMModeRequestPort_Slave_BSWM_STARTUP_TWO_D
          SE_BswMModeRequestPort_Slave_BSWM_SWC_CYCLIC_SHUTDOWN_C1: accessed-mode-groups=BswM_ModeNotificationPort_OsApplication_C3_BswMModeRequestPort_Slave, implemented-entry=BswM_MRPFunc_BswMModeRequestPort_Slave_BSWM_SWC_CYCLIC_SHUTDOWN_C1
          BswM_MainFunction: can-enter-exclusive-area=InternalBehavior_3/SCHM_BSWM_EXCLUSIVE_AREA, implemented-entry=BswM_MainFunction
        4 x bsw mode switch event, all with activation=ON-ENTRY:
          MSE_BswMModeRequestPort_Slave_BSWM_GO_OFF_ONE_D: starts-on-event=InternalBehavior_3/SE_BswMModeRequestPort_Slave_BSWM_GO_OFF_ONE_D, mode=BswM_ModeNotificationPort_OsApplication_C3_BswMModeRequestPort_Slave.BSWM_GO_OFF_ONE_D
          MSE_BswMModeRequestPort_Slave_BSWM_STARTUP_TWO_B: starts-on-event=InternalBehavior_3/SE_BswMModeRequestPort_Slave_BSWM_STARTUP_TWO_B, mode=BswM_ModeNotificationPort_OsApplication_C3_BswMModeRequestPort_Slave.BSWM_STARTUP_TWO_B
          MSE_BswMModeRequestPort_Slave_BSWM_STARTUP_TWO_D: starts-on-event=InternalBehavior_3/SE_BswMModeRequestPort_Slave_BSWM_STARTUP_TWO_D, mode=BswM_ModeNotificationPort_OsApplication_C3_BswMModeRequestPort_Slave.BSWM_STARTUP_TWO_D
          MSE_BswMModeRequestPort_Slave_BSWM_SWC_CYCLIC_SHUTDOWN_C1: starts-on-event=InternalBehavior_3/SE_BswMModeRequestPort_Slave_BSWM_SWC_CYCLIC_SHUTDOWN_C1, mode=BswM_ModeNotificationPort_OsApplication_C3_BswMModeRequestPort_Slave.BSWM_SWC_CYCLIC_SHUTDOWN_C1
        bsw timing event TimingEvent_MainFunction: starts-on-event=InternalBehavior_3/BswM_MainFunction, period=0.01
      GenericInternalBehavior
        bsw schedulable entity BswM_MainFunction: implemented-entry=BswM_MainFunction
package /AUTOSAR_BswM/BswModuleEntrys
  25 x bsw module entry, all with is-reentrant=false, sw-service-impl-policy=STANDARD:
    BswM_MainFunction: service-id=3, is-synchronous=true, call-type=SCHEDULED, execution-context=TASK
    BswM_Init: service-id=0, is-synchronous=true, call-type=REGULAR, execution-context=UNSPECIFIED
    BswM_MRPFunc_BswMBswModeNotification_DcmCommunicationControl_DCM_ENABLE_RX_DISABLE_TX_NM: service-id=0, is-synchronous=false, call-type=SCHEDULED, execution-context=TASK
    BswM_MRPFunc_BswMBswModeNotification_DcmCommunicationControl_DCM_ENABLE_RX_TX_NORM_NM: service-id=0, is-synchronous=false, call-type=SCHEDULED, execution-context=TASK
    BswM_MRPFunc_BswMBswModeNotification_DcmCommunicationControl_DCM_DISABLE_RX_ENABLE_TX_NORM_NM: service-id=0, is-synchronous=false, call-type=SCHEDULED, execution-context=TASK
    BswM_MRPFunc_BswMBswModeNotification_DcmCommunicationControl_DCM_ENABLE_RX_TX_NORM: service-id=0, is-synchronous=false, call-type=SCHEDULED, execution-context=TASK
    BswM_MRPFunc_BswMModeRequestPort_Slave_BSWM_STARTUP_TWO_B: service-id=0, is-synchronous=false, call-type=SCHEDULED, execution-context=TASK
    BswM_MRPFunc_BswMBswModeNotification_DcmEcuReset_HARD: service-id=0, is-synchronous=false, call-type=SCHEDULED, execution-context=TASK
    BswM_MRPFunc_BswMBswModeNotification_DcmEcuReset_EXECUTE: service-id=0, is-synchronous=false, call-type=SCHEDULED, execution-context=TASK
    BswM_MRPFunc_BswMBswModeNotification_DcmEcuReset_KEYONOFF: service-id=0, is-synchronous=false, call-type=SCHEDULED, execution-context=TASK
    BswM_MRPFunc_BswMBswModeNotification_DcmCommunicationControl_DCM_DISABLE_RX_TX_NM: service-id=0, is-synchronous=false, call-type=SCHEDULED, execution-context=TASK
    BswM_MRPFunc_BswMModeRequestPort_Slave_BSWM_SWC_CYCLIC_SHUTDOWN_C1: service-id=0, is-synchronous=false, call-type=SCHEDULED, execution-context=TASK
    BswM_MRPFunc_BswMBswModeNotification_DcmCommunicationControl_DCM_ENABLE_RX_TX_NM: service-id=0, is-synchronous=false, call-type=SCHEDULED, execution-context=TASK
    BswM_MRPFunc_BswMModeRequestPort_Slave_BSWM_GO_OFF_ONE_D: service-id=0, is-synchronous=false, call-type=SCHEDULED, execution-context=TASK
    BswM_MRPFunc_BswMBswModeNotification_DcmCommunicationControl_DCM_DISABLE_RX_TX_NORM: service-id=0, is-synchronous=false, call-type=SCHEDULED, execution-context=TASK
    BswM_MRPFunc_BswMBswModeNotification_DcmEcuReset_SOFT: service-id=0, is-synchronous=false, call-type=SCHEDULED, execution-context=TASK
    BswM_MRPFunc_BswMBswModeNotification_DcmCommunicationControl_DCM_DISABLE_RX_ENABLE_TX_NORM: service-id=0, is-synchronous=false, call-type=SCHEDULED, execution-context=TASK
    BswM_MRPFunc_BswMModeRequestPort_Slave_BSWM_STARTUP_TWO_D: service-id=0, is-synchronous=false, call-type=SCHEDULED, execution-context=TASK
    BswM_MRPFunc_BswMBswModeNotification_DcmEcuReset_JUMPTOBOOTLOADER: service-id=0, is-synchronous=false, call-type=SCHEDULED, execution-context=TASK
    BswM_MRPFunc_BswMBswModeNotification_DcmEcuReset_NONE: service-id=0, is-synchronous=false, call-type=SCHEDULED, execution-context=TASK
    BswM_MRPFunc_BswMBswModeNotification_DcmCommunicationControl_DCM_DISABLE_RX_ENABLE_TX_NM: service-id=0, is-synchronous=false, call-type=SCHEDULED, execution-context=TASK
    BswM_MRPFunc_BswMBswModeNotification_DcmCommunicationControl_DCM_DISABLE_RX_TX_NORM_NM: service-id=0, is-synchronous=false, call-type=SCHEDULED, execution-context=TASK
    BswM_MRPFunc_BswMBswModeNotification_DcmEcuReset_JUMPTOSYSSUPPLIERBOOTLOADER: service-id=0, is-synchronous=false, call-type=SCHEDULED, execution-context=TASK
    BswM_MRPFunc_BswMBswModeNotification_DcmCommunicationControl_DCM_ENABLE_RX_DISABLE_TX_NORM: service-id=0, is-synchronous=false, call-type=SCHEDULED, execution-context=TASK
    BswM_MRPFunc_BswMBswModeNotification_DcmCommunicationControl_DCM_ENABLE_RX_DISABLE_TX_NORM_NM: service-id=0, is-synchronous=false, call-type=SCHEDULED, execution-context=TASK
package /AUTOSAR_BswM/SwcBswMappings
  4 x swc bsw mapping, all with swc-behavior=BswMInternalBehavior:
    SwcBswMapping_{0..3}: bsw-behavior=InternalBehavior_{0..3}, swc-bsw-runnable-mapping{bsw-entity=InternalBehavior_{0..3}/BswM_MainFunction, swc-runnable=RES_MainFunction}
package /EB_BswM/Implementations
  5 x bsw implementation, all with programming-language=C, sw-version=1.15.7, vendor-id=1, ar-release-version=4.0.3, vendor-specific-module-def=BswM:
    BswImplementation_0: swc-bsw-mapping=SwcBswMapping_0, behavior=InternalBehavior_0, vendor-api-infix=OsApplication_C0
      code-descriptors:
        code Files
          artifact-descriptors:
            short-label=Autosar::src::BswM.c, category=SWSRC
            short-label=generated::src::BswM_Cfg.c, category=SWSRC
            short-label=generated::src::BswM_PBcfg.c, category=SWSRC
            short-label=generated::src::BswM_OsApplication_C0_Lcfg.c, category=SWSRC
            short-label=Autosar::include::BswM.h, category=SWHDR
            short-label=Autosar::include::BswM_Int.h, category=SWHDR
            short-label=Autosar::include::BswM_SymbolicNames_PBcfg.h, category=SWHDR
            short-label=Autosar::include::BswM_Types.h, category=SWHDR
            short-label=Autosar::include::BswM_Version.h, category=SWHDR
            short-label=generated::include::BswM_Cfg.h, category=SWHDR
            short-label=generated::include::BswM_Int_Cfg.h, category=SWHDR
            short-label=generated::include::BswM_CfgTypes.h, category=SWHDR
            short-label=generated::include::BswM_PBcfg.h, category=SWHDR
            short-label=generated::include::BswM_MemMap.h, category=SWHDR
            short-label=generated::include::BswM_Trace.h, category=SWHDR
            short-label=generated::include::BswM_OsApplication_C0_Lcfg.h, category=SWHDR
            short-label=generated::include::BswM_CanSM.h, category=SWHDR
            short-label=generated::include::BswM_ComM.h, category=SWHDR
            short-label=generated::include::BswM_DCM.h, category=SWHDR
            short-label=generated::include::BswM_EcuM.h, category=SWHDR
            short-label=generated::include::BswM_Nm.h, category=SWHDR
            short-label=make::BswM_defs.mak, category=SWMAKE
            short-label=make::BswM_rules.mak, category=SWMAKE
      resource consumption ResourceConsumption
        5 x memory section:
          CONFIG_DATA_UNSPECIFIED: alignment=UNSPECIFIED, sw-addrmethod=CONFIG_DATA
          VAR_INIT_UNSPECIFIED: alignment=UNSPECIFIED, sw-addrmethod=VAR_INIT
          VAR_CLEARED_UNSPECIFIED: alignment=UNSPECIFIED, sw-addrmethod=VAR_CLEARED
          CONST_UNSPECIFIED: alignment=UNSPECIFIED, sw-addrmethod=CONST
          CODE: sw-addrmethod=CODE
    BswImplementation_1: swc-bsw-mapping=SwcBswMapping_1, behavior=InternalBehavior_1, vendor-api-infix=OsApplication_C1
      code-descriptors:
        code Files
          artifact-descriptors:
            short-label=Autosar::src::BswM.c, category=SWSRC
            short-label=generated::src::BswM_Cfg.c, category=SWSRC
            short-label=generated::src::BswM_PBcfg.c, category=SWSRC
            short-label=generated::src::BswM_OsApplication_C1_Lcfg.c, category=SWSRC
            short-label=Autosar::include::BswM.h, category=SWHDR
            short-label=Autosar::include::BswM_Int.h, category=SWHDR
            short-label=Autosar::include::BswM_SymbolicNames_PBcfg.h, category=SWHDR
            short-label=Autosar::include::BswM_Types.h, category=SWHDR
            short-label=Autosar::include::BswM_Version.h, category=SWHDR
            short-label=generated::include::BswM_Cfg.h, category=SWHDR
            short-label=generated::include::BswM_Int_Cfg.h, category=SWHDR
            short-label=generated::include::BswM_CfgTypes.h, category=SWHDR
            short-label=generated::include::BswM_PBcfg.h, category=SWHDR
            short-label=generated::include::BswM_MemMap.h, category=SWHDR
            short-label=generated::include::BswM_Trace.h, category=SWHDR
            short-label=generated::include::BswM_OsApplication_C1_Lcfg.h, category=SWHDR
            short-label=generated::include::BswM_CanSM.h, category=SWHDR
            short-label=generated::include::BswM_ComM.h, category=SWHDR
            short-label=generated::include::BswM_DCM.h, category=SWHDR
            short-label=generated::include::BswM_EcuM.h, category=SWHDR
            short-label=generated::include::BswM_Nm.h, category=SWHDR
            short-label=make::BswM_defs.mak, category=SWMAKE
            short-label=make::BswM_rules.mak, category=SWMAKE
      resource consumption ResourceConsumption
        5 x memory section:
          CONFIG_DATA_UNSPECIFIED: alignment=UNSPECIFIED, sw-addrmethod=CONFIG_DATA
          VAR_INIT_UNSPECIFIED: alignment=UNSPECIFIED, sw-addrmethod=VAR_INIT
          VAR_CLEARED_UNSPECIFIED: alignment=UNSPECIFIED, sw-addrmethod=VAR_CLEARED
          CONST_UNSPECIFIED: alignment=UNSPECIFIED, sw-addrmethod=CONST
          CODE: sw-addrmethod=CODE
    BswImplementation_2: swc-bsw-mapping=SwcBswMapping_2, behavior=InternalBehavior_2, vendor-api-infix=OsApplication_C2
      code-descriptors:
        code Files
          artifact-descriptors:
            short-label=Autosar::src::BswM.c, category=SWSRC
            short-label=generated::src::BswM_Cfg.c, category=SWSRC
            short-label=generated::src::BswM_PBcfg.c, category=SWSRC
            short-label=generated::src::BswM_OsApplication_C2_Lcfg.c, category=SWSRC
            short-label=Autosar::include::BswM.h, category=SWHDR
            short-label=Autosar::include::BswM_Int.h, category=SWHDR
            short-label=Autosar::include::BswM_SymbolicNames_PBcfg.h, category=SWHDR
            short-label=Autosar::include::BswM_Types.h, category=SWHDR
            short-label=Autosar::include::BswM_Version.h, category=SWHDR
            short-label=generated::include::BswM_Cfg.h, category=SWHDR
            short-label=generated::include::BswM_Int_Cfg.h, category=SWHDR
            short-label=generated::include::BswM_CfgTypes.h, category=SWHDR
            short-label=generated::include::BswM_PBcfg.h, category=SWHDR
            short-label=generated::include::BswM_MemMap.h, category=SWHDR
            short-label=generated::include::BswM_Trace.h, category=SWHDR
            short-label=generated::include::BswM_OsApplication_C2_Lcfg.h, category=SWHDR
            short-label=generated::include::BswM_CanSM.h, category=SWHDR
            short-label=generated::include::BswM_ComM.h, category=SWHDR
            short-label=generated::include::BswM_DCM.h, category=SWHDR
            short-label=generated::include::BswM_EcuM.h, category=SWHDR
            short-label=generated::include::BswM_Nm.h, category=SWHDR
            short-label=make::BswM_defs.mak, category=SWMAKE
            short-label=make::BswM_rules.mak, category=SWMAKE
      resource consumption ResourceConsumption
        5 x memory section:
          CONFIG_DATA_UNSPECIFIED: alignment=UNSPECIFIED, sw-addrmethod=CONFIG_DATA
          VAR_INIT_UNSPECIFIED: alignment=UNSPECIFIED, sw-addrmethod=VAR_INIT
          VAR_CLEARED_UNSPECIFIED: alignment=UNSPECIFIED, sw-addrmethod=VAR_CLEARED
          CONST_UNSPECIFIED: alignment=UNSPECIFIED, sw-addrmethod=CONST
          CODE: sw-addrmethod=CODE
    BswImplementation_3: swc-bsw-mapping=SwcBswMapping_3, behavior=InternalBehavior_3, vendor-api-infix=OsApplication_C3
      code-descriptors:
        code Files
          artifact-descriptors:
            short-label=Autosar::src::BswM.c, category=SWSRC
            short-label=generated::src::BswM_Cfg.c, category=SWSRC
            short-label=generated::src::BswM_PBcfg.c, category=SWSRC
            short-label=generated::src::BswM_OsApplication_C3_Lcfg.c, category=SWSRC
            short-label=Autosar::include::BswM.h, category=SWHDR
            short-label=Autosar::include::BswM_Int.h, category=SWHDR
            short-label=Autosar::include::BswM_SymbolicNames_PBcfg.h, category=SWHDR
            short-label=Autosar::include::BswM_Types.h, category=SWHDR
            short-label=Autosar::include::BswM_Version.h, category=SWHDR
            short-label=generated::include::BswM_Cfg.h, category=SWHDR
            short-label=generated::include::BswM_Int_Cfg.h, category=SWHDR
            short-label=generated::include::BswM_CfgTypes.h, category=SWHDR
            short-label=generated::include::BswM_PBcfg.h, category=SWHDR
            short-label=generated::include::BswM_MemMap.h, category=SWHDR
            short-label=generated::include::BswM_Trace.h, category=SWHDR
            short-label=generated::include::BswM_OsApplication_C3_Lcfg.h, category=SWHDR
            short-label=generated::include::BswM_CanSM.h, category=SWHDR
            short-label=generated::include::BswM_ComM.h, category=SWHDR
            short-label=generated::include::BswM_DCM.h, category=SWHDR
            short-label=generated::include::BswM_EcuM.h, category=SWHDR
            short-label=generated::include::BswM_Nm.h, category=SWHDR
            short-label=make::BswM_defs.mak, category=SWMAKE
            short-label=make::BswM_rules.mak, category=SWMAKE
      resource consumption ResourceConsumption
        5 x memory section:
          CONFIG_DATA_UNSPECIFIED: alignment=UNSPECIFIED, sw-addrmethod=CONFIG_DATA
          VAR_INIT_UNSPECIFIED: alignment=UNSPECIFIED, sw-addrmethod=VAR_INIT
          VAR_CLEARED_UNSPECIFIED: alignment=UNSPECIFIED, sw-addrmethod=VAR_CLEARED
          CONST_UNSPECIFIED: alignment=UNSPECIFIED, sw-addrmethod=CONST
          CODE: sw-addrmethod=CODE
    GenericBswImplementation: behavior=GenericInternalBehavior
      code-descriptors:
        code Files
          artifact-descriptors:
            short-label=Autosar::src::BswM.c, category=SWSRC
            short-label=generated::src::BswM_Cfg.c, category=SWSRC
            short-label=generated::src::BswM_PBcfg.c, category=SWSRC
            short-label=Autosar::include::BswM.h, category=SWHDR
            short-label=Autosar::include::BswM_Int.h, category=SWHDR
            short-label=Autosar::include::BswM_SymbolicNames_PBcfg.h, category=SWHDR
            short-label=Autosar::include::BswM_Types.h, category=SWHDR
            short-label=Autosar::include::BswM_Version.h, category=SWHDR
            short-label=generated::include::BswM_Cfg.h, category=SWHDR
            short-label=generated::include::BswM_Int_Cfg.h, category=SWHDR
            short-label=generated::include::BswM_CfgTypes.h, category=SWHDR
            short-label=generated::include::BswM_PBcfg.h, category=SWHDR
            short-label=generated::include::BswM_MemMap.h, category=SWHDR
            short-label=generated::include::BswM_Trace.h, category=SWHDR
            short-label=generated::include::BswM_CanSM.h, category=SWHDR
            short-label=generated::include::BswM_ComM.h, category=SWHDR
            short-label=generated::include::BswM_DCM.h, category=SWHDR
            short-label=generated::include::BswM_EcuM.h, category=SWHDR
            short-label=generated::include::BswM_Nm.h, category=SWHDR
            short-label=make::BswM_defs.mak, category=SWMAKE
            short-label=make::BswM_rules.mak, category=SWMAKE
      resource consumption ResourceConsumption
        5 x memory section:
          CONFIG_DATA_UNSPECIFIED: alignment=UNSPECIFIED, sw-addrmethod=CONFIG_DATA
          VAR_INIT_UNSPECIFIED: alignment=UNSPECIFIED, sw-addrmethod=VAR_INIT
          VAR_CLEARED_UNSPECIFIED: alignment=UNSPECIFIED, sw-addrmethod=VAR_CLEARED
          CONST_UNSPECIFIED: alignment=UNSPECIFIED, sw-addrmethod=CONST
          CODE: sw-addrmethod=CODE
