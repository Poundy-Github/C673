AUTOSAR XML (schema 4-0-3)
package /AUTOSAR_EcuC/BswModuleDescriptions
  bsw module description EcuC: module-id=10, provided-entrys=EcuC_InitRx
    bsw internal behavior InternalBehavior_0
      bsw called entity EcuC_InitRx: implemented-entry=EcuC_InitRx
package /AUTOSAR_EcuC/BswModuleEntrys
  bsw module entry EcuC_InitRx: service-id=0, is-reentrant=false, is-synchronous=true, call-type=REGULAR, execution-context=UNSPECIFIED, sw-service-impl-policy=STANDARD
package /EB_EcuC/Implementations
  bsw implementation BswImplementation_0: programming-language=C, sw-version=5.0.22, vendor-id=1, ar-release-version=4.0.3, behavior=InternalBehavior_0, vendor-specific-module-def=EcuC
    code-descriptors:
      code Files
        artifact-descriptors:
          short-label=Autosar::include::EcuC.h, category=SWHDR
          short-label=Autosar::include::EcuC_Types.h, category=SWHDR
          short-label=Autosar::include::EcuC_Version.h, category=SWHDR
          short-label=Autosar::src::EcuC.c, category=SWSRC
          short-label=Autosar::src::EcuC_MetaData.c, category=SWSRC
          short-label=make::EcuC_defs.mak, category=SWMAKE
          short-label=make::EcuC_rules.mak, category=SWMAKE
    resource consumption ResourceConsumption
      memory section CODE: sw-addrmethod=CODE
      memory section VAR_CLEARED_UNSPECIFIED: alignment=UNSPECIFIED, sw-addrmethod=VAR_CLEARED
      memory section CONST_UNSPECIFIED: alignment=UNSPECIFIED, sw-addrmethod=CONST
