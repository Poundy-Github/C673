AUTOSAR XML (schema 4-0-3)
package /AUTOSAR_Spi/BswModuleDescriptions
  bsw module description Spi: module-id=83, provided-entrys=[Spi_Init, Spi_MainFunction_Handling]
    bsw internal behavior InternalBehavior_0
      exclusive area Queue_Update
      exclusive area SyncLock
      bsw called entity Spi_Init: can-enter-exclusive-area=[Queue_Update, SyncLock], implemented-entry=Spi_Init
      bsw schedulable entity Spi_MainFunction_Handling: implemented-entry=Spi_MainFunction_Handling
      bsw timing event TimingEvent_MainFunction: starts-on-event=Spi_MainFunction_Handling, period=0.005
package /AUTOSAR_Spi/BswModuleEntrys
  bsw module entry Spi_Init: service-id=1000, is-reentrant=false, is-synchronous=true, call-type=REGULAR, execution-context=UNSPECIFIED, sw-service-impl-policy=STANDARD
  bsw module entry Spi_MainFunction_Handling: service-id=16, is-reentrant=false, is-synchronous=true, call-type=SCHEDULED, execution-context=TASK, sw-service-impl-policy=STANDARD
package /Spi_Aurix2GAS422/Implementations
  bsw implementation BswImplementation_0: programming-language=C, sw-version=20.0.2, vendor-id=17, ar-release-version=4.2.2, behavior=InternalBehavior_0, vendor-specific-module-def=Spi
    code-descriptors:
      code Files: artifact-descriptors=[{short-label=make::Spi_defs.mak, category=SWMAKE}, {short-label=make::Spi_rules.mak, category=SWMAKE}]
    resource consumption ResourceConsumption
      17 x memory section:
        VAR_CLEARED_ASIL_B_CORE0_32: alignment=32, options=safetyAsilB, sw-addrmethod=VAR_CLEARED_ASIL_B
        VAR_CLEARED_ASIL_B_CORE0_256: alignment=256, options=safetyAsilB, sw-addrmethod=VAR_CLEARED_ASIL_B
        CONFIG_DATA_ASIL_B_CORE0_32: alignment=32, options=safetyAsilB, sw-addrmethod=CONFIG_DATA_ASIL_B
        VAR_CLEARED_ASIL_B_CORE1_32: alignment=32, options=safetyAsilB, sw-addrmethod=VAR_CLEARED_ASIL_B
        VAR_CLEARED_ASIL_B_CORE1_256: alignment=256, options=safetyAsilB, sw-addrmethod=VAR_CLEARED_ASIL_B
        CONFIG_DATA_ASIL_B_CORE1_32: alignment=32, options=safetyAsilB, sw-addrmethod=CONFIG_DATA_ASIL_B
        VAR_CLEARED_ASIL_B_CORE2_32: alignment=32, options=safetyAsilB, sw-addrmethod=VAR_CLEARED_ASIL_B
        VAR_CLEARED_ASIL_B_CORE2_256: alignment=256, options=safetyAsilB, sw-addrmethod=VAR_CLEARED_ASIL_B
        CONFIG_DATA_ASIL_B_CORE2_32: alignment=32, options=safetyAsilB, sw-addrmethod=CONFIG_DATA_ASIL_B
        VAR_CLEARED_ASIL_B_CORE3_32: alignment=32, options=safetyAsilB, sw-addrmethod=VAR_CLEARED_ASIL_B
        VAR_CLEARED_ASIL_B_CORE3_256: alignment=256, options=safetyAsilB, sw-addrmethod=VAR_CLEARED_ASIL_B
        CONFIG_DATA_ASIL_B_CORE3_32: alignment=32, options=safetyAsilB, sw-addrmethod=CONFIG_DATA_ASIL_B
        CONFIG_DATA_ASIL_B_GLOBAL_32: alignment=32, options=safetyAsilB, sw-addrmethod=CONFIG_DATA_ASIL_B
        CONFIG_DATA_ASIL_B_GLOBAL_UNSPECIFIED: alignment=UNSPECIFIED, options=safetyAsilB, sw-addrmethod=CONFIG_DATA_ASIL_B
        VAR_CLEARED_ASIL_B_GLOBAL_32: alignment=32, options=safetyAsilB, sw-addrmethod=VAR_CLEARED_ASIL_B
        CODE_ASIL_B_GLOBAL: alignment=UNSPECIFIED, options=safetyAsilB, sw-addrmethod=CODE_ASIL_B
        CODE: sw-addrmethod=CODE
      section name prefix SPI
