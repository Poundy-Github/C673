AUTOSAR XML (schema 4-0-3)
package /AUTOSAR_CanTSyn/BswModuleDescriptions
  bsw module description CanTSyn: module-id=161, provided-entrys=CanTSyn_MainFunction
    bsw internal behavior InternalBehavior_0
      exclusive area SCHM_CANTSYN_EXCLUSIVE_AREA_0
      exclusive area SCHM_CANTSYN_EXCLUSIVE_AREA_1
      bsw schedulable entity CanTSyn_MainFunction: can-enter-exclusive-area=[SCHM_CANTSYN_EXCLUSIVE_AREA_0, SCHM_CANTSYN_EXCLUSIVE_AREA_1], implemented-entry=CanTSyn_MainFunction
      bsw timing event TimingEvent_MainFunction: starts-on-event=CanTSyn_MainFunction, period=0.005
package /AUTOSAR_CanTSyn/BswModuleEntrys
  bsw module entry CanTSyn_MainFunction: service-id=255, is-reentrant=false, is-synchronous=true, call-type=SCHEDULED, execution-context=TASK, sw-service-impl-policy=STANDARD
package /EB_CanTSyn/Implementations
  bsw implementation BswImplementation_0: programming-language=C, sw-version=3.0.0, vendor-id=1, ar-release-version=4.6.0, behavior=InternalBehavior_0, vendor-specific-module-def=CanTSyn
    code-descriptors:
      code Files
        artifact-descriptors:
          short-label=Autosar::include::CanTSyn.h, category=SWHDR
          short-label=Autosar::include::CanTSyn_Trace.h, category=SWHDR
          short-label=Autosar::include::CanTSyn_Version.h, category=SWHDR
          short-label=Autosar::src::CanTSyn.c, category=SWSRC
          short-label=make::CanTSyn_defs.mak, category=SWMAKE
          short-label=make::CanTSyn_rules.mak, category=SWMAKE
    resource consumption ResourceConsumption
      6 x memory section:
        CONFIG_DATA_UNSPECIFIED: alignment=UNSPECIFIED, sw-addrmethod=CONFIG_DATA
        CONST_8: alignment=8, sw-addrmethod=CONST
        VAR_INIT_8: alignment=8, sw-addrmethod=VAR
        VAR_CLEARED_UNSPECIFIED: alignment=UNSPECIFIED, sw-addrmethod=VAR_CLEARED
        VAR_CLEARED_8: alignment=8, sw-addrmethod=VAR_CLEARED
        CODE: sw-addrmethod=CODE
