AUTOSAR XML (schema 4-1-3)
package /AUTOSAR_FiM/BswModuleDescriptions
  bsw module description FiM: module-id=11, provided-entrys=FiM_MainFunction_Dummy
    bsw internal behavior InternalBehavior_0
      bsw schedulable entity FiM_MainFunction_Dummy: implemented-entry=FiM_MainFunction_Dummy
      bsw timing event TimingEvent_MainFunction: starts-on-event=FiM_MainFunction_Dummy, period=0.01
package /AUTOSAR_FiM/BswModuleEntrys
  bsw module entry FiM_MainFunction_Dummy: service-id=5, is-reentrant=false, is-synchronous=true, call-type=SCHEDULED, execution-context=TASK, sw-service-impl-policy=STANDARD
package /EB_FiM/Implementations
  bsw implementation BswImplementation_0: programming-language=C, sw-version=2.5.4, vendor-id=1, ar-release-version=4.0.3, behavior=InternalBehavior_0
    code-descriptors:
      code Files
        artifact-descriptors:
          short-label=Autosar::include::FiM.h, category=SWHDR
          short-label=Autosar::include::FiM_Int.h, category=SWHDR
          short-label=Autosar::include::FiM_Types.h, category=SWHDR
          short-label=Autosar::include::FiM_Version.h, category=SWHDR
          short-label=Autosar::src::FiM.c, category=SWSRC
          short-label=make::FiM_defs.mak, category=SWMAKE
          short-label=make::FiM_rules.mak, category=SWMAKE
    resource consumption ResourceConsumption
