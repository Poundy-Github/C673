AUTOSAR XML (schema 4-2-1)
package /AUTOSAR_EcuM/SwcBswMappings
  swc bsw mapping SwcBswMapping_0: bsw-behavior=InternalBehavior_0, swc-behavior=EcuMIntBeh
    runnable-mappings:
      bsw-entity=InternalBehavior_0/EcuM_MainFunction, swc-runnable=RE_Main
      bsw-entity=BswCalledEntity_EcuM_SelectShutdownTarget, swc-runnable=RE_SelectShutdownTarget
package /AUTOSAR_EcuM/ImplementationDataTypes
  impl type EcuM_StateType: compu {16=ECUM_STATE_STARTUP, 17=ECUM_STATE_STARTUP_ONE, 18=ECUM_STATE_STARTUP_TWO, 32=ECUM_STATE_WAKEUP, 33=ECUM_STATE_WAKEUP_ONE, 34=ECUM_STATE_WAKEUP_VALIDATION, 35=ECUM_STATE_WAKEUP_REACTION, 36=ECUM_STATE_WAKEUP_TWO, 37=ECUM_STATE_WAKEUP_WAKESLEEP, 38=ECUM_STATE_WAKEUP_TTII, 48=ECUM_STATE_RUN, 50=ECUM_STATE_APP_RUN, 51=ECUM_STATE_APP_POST_RUN, 64=ECUM_STATE_SHUTDOWN, 68=ECUM_STATE_PREP_SHUTDOWN, 73=ECUM_STATE_GO_SLEEP, 77=ECUM_STATE_GO_OFF_ONE, 78=ECUM_STATE_GO_OFF_TWO, 80=ECUM_STATE_SLEEP, 128=ECUM_STATE_OFF, 144=ECUM_STATE_RESET}, implementation-data-type=uint8
package /AUTOSAR_EcuM/BswModuleDescriptions
  bsw module description EcuM: module-id=10, provided-entrys=[EcuM_MainFunction, EcuM_UpdateSleepMode, EcuM_SelectShutdownTarget, EcuM_GoDown, EcuM_GoHalt, EcuM_GoPoll]
    provided-datas:
      data EcuM_MasterCoreReadyPort: type=boolean
      data EcuM_SlaveCoreReadyPort: type=uint8
      data EcuM_SetSleepMode: type=uint8
    required-datas:
      data EcuM_MasterCoreSyncPort: type=boolean
      data EcuM_SlaveCoreSyncPort: type=uint8
      data EcuM_GetSleepMode: type=uint8
    4 x bsw internal behavior:
      InternalBehavior_0: bsw-queued-data-reception-policy{enable-take-address=true, received-data=EcuM_SlaveCoreSyncPort, queue-length=3}
        exclusive area SCHM_ECUM_EXCLUSIVE_AREA_0
        bsw called entity BswCalledEntity_EcuM_GoHalt: implemented-entry=EcuM_GoHalt
          data-receive-points:
            bsw variable access BswVariableAccess_EcuM_SlaveCoreSyncPort: accessed-variable=EcuM_SlaveCoreSyncPort
          data-send-points:
            bsw variable access BswVariableAccess_EcuM_MasterCoreReadyPort: accessed-variable=EcuM_MasterCoreReadyPort
        bsw called entity BswCalledEntity_EcuM_GoDown: implemented-entry=EcuM_GoDown
          data-receive-points:
            bsw variable access BswVariableAccess_EcuM_SlaveCoreSyncPort: accessed-variable=EcuM_SlaveCoreSyncPort
        bsw called entity BswCalledEntity_EcuM_SelectShutdownTarget: implemented-entry=EcuM_SelectShutdownTarget
          data-send-points:
            bsw variable access BswVariableAccess_EcuM_SetSleepMode: accessed-variable=EcuM_SetSleepMode
        bsw schedulable entity EcuM_MainFunction: can-enter-exclusive-area=SCHM_ECUM_EXCLUSIVE_AREA_0, implemented-entry=EcuM_MainFunction
        bsw timing event TimingEvent_MainFunction: starts-on-event=InternalBehavior_0/EcuM_MainFunction, period=0.02
      InternalBehavior_1
        exclusive area SCHM_ECUM_EXCLUSIVE_AREA_1
        bsw called entity BswCalledEntity_EcuM_GoHalt: implemented-entry=EcuM_GoHalt
          data-receive-points:
            bsw variable access BswVariableAccess_EcuM_MasterCoreSyncPort: accessed-variable=EcuM_MasterCoreSyncPort
          data-send-points:
            bsw variable access BswVariableAccess_EcuM_SlaveCoreReadyPort: accessed-variable=EcuM_SlaveCoreReadyPort
        bsw called entity BswCalledEntity_EcuM_GoPoll: implemented-entry=EcuM_GoPoll
          data-receive-points:
            bsw variable access BswVariableAccess_EcuM_MasterCoreSyncPort: accessed-variable=EcuM_MasterCoreSyncPort
        bsw called entity BswCalledEntity_EcuM_GoDown: implemented-entry=EcuM_GoDown
          data-send-points:
            bsw variable access BswVariableAccess_EcuM_SlaveCoreReadyPort: accessed-variable=EcuM_SlaveCoreReadyPort
        bsw schedulable entity EcuM_MainFunction: can-enter-exclusive-area=SCHM_ECUM_EXCLUSIVE_AREA_1, implemented-entry=EcuM_MainFunction
        bsw schedulable entity EcuM_UpdateSleepMode: can-enter-exclusive-area=SCHM_ECUM_EXCLUSIVE_AREA_1, implemented-entry=EcuM_UpdateSleepMode
          data-receive-points:
            bsw variable access BswVariableAccess_EcuM_GetSleepMode: accessed-variable=EcuM_GetSleepMode
        bsw timing event TimingEvent_MainFunction: starts-on-event=InternalBehavior_1/EcuM_MainFunction, period=0.02
        bsw data received event DataReceivedEvent_UpdateSleepMode: starts-on-event=InternalBehavior_1/EcuM_UpdateSleepMode, data=EcuM_GetSleepMode
      InternalBehavior_2
        exclusive area SCHM_ECUM_EXCLUSIVE_AREA_2
        bsw called entity BswCalledEntity_EcuM_GoHalt: implemented-entry=EcuM_GoHalt
          data-receive-points:
            bsw variable access BswVariableAccess_EcuM_MasterCoreSyncPort: accessed-variable=EcuM_MasterCoreSyncPort
          data-send-points:
            bsw variable access BswVariableAccess_EcuM_SlaveCoreReadyPort: accessed-variable=EcuM_SlaveCoreReadyPort
        bsw called entity BswCalledEntity_EcuM_GoPoll: implemented-entry=EcuM_GoPoll
          data-receive-points:
            bsw variable access BswVariableAccess_EcuM_MasterCoreSyncPort: accessed-variable=EcuM_MasterCoreSyncPort
        bsw called entity BswCalledEntity_EcuM_GoDown: implemented-entry=EcuM_GoDown
          data-send-points:
            bsw variable access BswVariableAccess_EcuM_SlaveCoreReadyPort: accessed-variable=EcuM_SlaveCoreReadyPort
        bsw schedulable entity EcuM_MainFunction: can-enter-exclusive-area=SCHM_ECUM_EXCLUSIVE_AREA_2, implemented-entry=EcuM_MainFunction
        bsw schedulable entity EcuM_UpdateSleepMode: can-enter-exclusive-area=SCHM_ECUM_EXCLUSIVE_AREA_2, implemented-entry=EcuM_UpdateSleepMode
          data-receive-points:
            bsw variable access BswVariableAccess_EcuM_GetSleepMode: accessed-variable=EcuM_GetSleepMode
        bsw timing event TimingEvent_MainFunction: starts-on-event=InternalBehavior_2/EcuM_MainFunction, period=0.02
        bsw data received event DataReceivedEvent_UpdateSleepMode: starts-on-event=InternalBehavior_2/EcuM_UpdateSleepMode, data=EcuM_GetSleepMode
      InternalBehavior_3
        exclusive area SCHM_ECUM_EXCLUSIVE_AREA_3
        bsw called entity BswCalledEntity_EcuM_GoHalt: implemented-entry=EcuM_GoHalt
          data-receive-points:
            bsw variable access BswVariableAccess_EcuM_MasterCoreSyncPort: accessed-variable=EcuM_MasterCoreSyncPort
          data-send-points:
            bsw variable access BswVariableAccess_EcuM_SlaveCoreReadyPort: accessed-variable=EcuM_SlaveCoreReadyPort
        bsw called entity BswCalledEntity_EcuM_GoPoll: implemented-entry=EcuM_GoPoll
          data-receive-points:
            bsw variable access BswVariableAccess_EcuM_MasterCoreSyncPort: accessed-variable=EcuM_MasterCoreSyncPort
        bsw called entity BswCalledEntity_EcuM_GoDown: implemented-entry=EcuM_GoDown
          data-send-points:
            bsw variable access BswVariableAccess_EcuM_SlaveCoreReadyPort: accessed-variable=EcuM_SlaveCoreReadyPort
        bsw schedulable entity EcuM_MainFunction: can-enter-exclusive-area=SCHM_ECUM_EXCLUSIVE_AREA_3, implemented-entry=EcuM_MainFunction
        bsw schedulable entity EcuM_UpdateSleepMode: can-enter-exclusive-area=SCHM_ECUM_EXCLUSIVE_AREA_3, implemented-entry=EcuM_UpdateSleepMode
          data-receive-points:
            bsw variable access BswVariableAccess_EcuM_GetSleepMode: accessed-variable=EcuM_GetSleepMode
        bsw timing event TimingEvent_MainFunction: starts-on-event=InternalBehavior_3/EcuM_MainFunction, period=0.02
        bsw data received event DataReceivedEvent_UpdateSleepMode: starts-on-event=InternalBehavior_3/EcuM_UpdateSleepMode, data=EcuM_GetSleepMode
package /AUTOSAR_EcuM/BswModuleEntrys
  6 x bsw module entry, all with is-synchronous=true, sw-service-impl-policy=STANDARD:
    EcuM_MainFunction: service-id=24, is-reentrant=false, call-type=SCHEDULED, execution-context=TASK
    EcuM_UpdateSleepMode: service-id=0, is-reentrant=true, call-type=SCHEDULED, execution-context=TASK
    EcuM_SelectShutdownTarget: service-id=6, is-reentrant=true, call-type=REGULAR, execution-context=UNSPECIFIED
      return type returnType: direction=OUT, implementation-data-type=Std_ReturnType
      sw service arg target: direction=IN, implementation-data-type=EcuM_StateType
      sw service arg mode: direction=IN, implementation-data-type=uint8
    EcuM_GoDown: service-id=31, is-reentrant=true, call-type=REGULAR, execution-context=UNSPECIFIED
    EcuM_GoHalt: service-id=32, is-reentrant=true, call-type=REGULAR, execution-context=UNSPECIFIED
    EcuM_GoPoll: service-id=33, is-reentrant=true, call-type=REGULAR, execution-context=UNSPECIFIED
package /EB_EcuM/Implementations
  4 x bsw implementation, all with programming-language=C, sw-version=5.15.8, vendor-id=1, ar-release-version=4.0.3, vendor-specific-module-def=EcuM:
    BswImplementation_0: swc-bsw-mapping=SwcBswMapping_0, behavior=InternalBehavior_0
      code-descriptors:
        code Files
          artifact-descriptors:
            short-label=Autosar::include::EcuM.h, category=SWHDR
            short-label=Autosar::include::EcuM_BSW.h, category=SWHDR
            short-label=Autosar::include::EcuM_BSW_Types.h, category=SWHDR
            short-label=Autosar::include::EcuM_BootTarget.h, category=SWHDR
            short-label=Autosar::include::EcuM_Cbk.h, category=SWHDR
            short-label=Autosar::include::EcuM_Externals.h, category=SWHDR
            short-label=Autosar::include::EcuM_Int.h, category=SWHDR
            short-label=Autosar::include::EcuM_Trace.h, category=SWHDR
            short-label=Autosar::include::EcuM_Trace_Internal.h, category=SWHDR
            short-label=Autosar::include::EcuM_Types.h, category=SWHDR
            short-label=Autosar::include::EcuM_Version.h, category=SWHDR
            short-label=Autosar::src::EcuM.c, category=SWSRC
            short-label=Autosar::src::EcuM_ASR32_Rte.c, category=SWSRC
            short-label=Autosar::src::EcuM_ASR40_Rte.c, category=SWSRC
            short-label=Autosar::src::EcuM_BootTarget.c, category=SWSRC
            short-label=Autosar::src::EcuM_Rte.c, category=SWSRC
            short-label=make::EcuM_defs.mak, category=SWMAKE
            short-label=make::EcuM_rules.mak, category=SWMAKE
      resource consumption ResourceConsumption
        13 x memory section:
          INTERNAL_VAR_POWER_ON_INIT_UNSPECIFIED: alignment=UNSPECIFIED, sw-addrmethod=VAR_POWER_ON_INIT
          VAR_POWER_ON_INIT_8: alignment=8, sw-addrmethod=VAR_POWER_ON_INIT
          VAR_CLEARED_8: alignment=8, sw-addrmethod=VAR_CLEARED
          VAR_CLEARED_16: alignment=16, sw-addrmethod=VAR_CLEARED
          CONST_8: alignment=8, sw-addrmethod=CONST
          VAR_INIT_8: alignment=8, sw-addrmethod=VAR
          CONST_16: alignment=16, sw-addrmethod=CONST
          VAR_CLEARED_UNSPECIFIED: alignment=UNSPECIFIED, sw-addrmethod=VAR_CLEARED
          VAR_INIT_UNSPECIFIED: alignment=UNSPECIFIED, sw-addrmethod=VAR
          CONST_32: alignment=32, sw-addrmethod=CONST
          CONST_UNSPECIFIED: alignment=UNSPECIFIED, sw-addrmethod=CONST
          CONFIG_DATA_UNSPECIFIED: alignment=UNSPECIFIED, sw-addrmethod=CONFIG_DATA
          CODE: sw-addrmethod=CODE
    BswImplementation_1: behavior=InternalBehavior_1, vendor-api-infix=Core_1
      code-descriptors:
        code Files
          artifact-descriptors:
            short-label=Autosar::include::EcuM.h, category=SWHDR
            short-label=Autosar::include::EcuM_BSW.h, category=SWHDR
            short-label=Autosar::include::EcuM_BSW_Types.h, category=SWHDR
            short-label=Autosar::include::EcuM_BootTarget.h, category=SWHDR
            short-label=Autosar::include::EcuM_Cbk.h, category=SWHDR
            short-label=Autosar::include::EcuM_Externals.h, category=SWHDR
            short-label=Autosar::include::EcuM_Int.h, category=SWHDR
            short-label=Autosar::include::EcuM_Trace.h, category=SWHDR
            short-label=Autosar::include::EcuM_Trace_Internal.h, category=SWHDR
            short-label=Autosar::include::EcuM_Types.h, category=SWHDR
            short-label=Autosar::include::EcuM_Version.h, category=SWHDR
            short-label=Autosar::src::EcuM.c, category=SWSRC
            short-label=Autosar::src::EcuM_ASR32_Rte.c, category=SWSRC
            short-label=Autosar::src::EcuM_ASR40_Rte.c, category=SWSRC
            short-label=Autosar::src::EcuM_BootTarget.c, category=SWSRC
            short-label=Autosar::src::EcuM_Rte.c, category=SWSRC
            short-label=make::EcuM_defs.mak, category=SWMAKE
            short-label=make::EcuM_rules.mak, category=SWMAKE
      resource consumption ResourceConsumption
        11 x memory section:
          INTERNAL_VAR_POWER_ON_INIT_UNSPECIFIED: alignment=UNSPECIFIED, sw-addrmethod=VAR_POWER_ON_INIT
          VAR_POWER_ON_INIT_8: alignment=8, sw-addrmethod=VAR_POWER_ON_INIT
          VAR_CLEARED_8: alignment=8, sw-addrmethod=VAR_CLEARED
          VAR_CLEARED_16: alignment=16, sw-addrmethod=VAR_CLEARED
          CONST_8: alignment=8, sw-addrmethod=CONST
          VAR_INIT_8: alignment=8, sw-addrmethod=VAR
          CONST_16: alignment=16, sw-addrmethod=CONST
          VAR_INIT_UNSPECIFIED: alignment=UNSPECIFIED, sw-addrmethod=VAR
          VAR_CLEARED_UNSPECIFIED: alignment=UNSPECIFIED, sw-addrmethod=VAR_CLEARED
          CONST_UNSPECIFIED: alignment=UNSPECIFIED, sw-addrmethod=CONST
          CODE: sw-addrmethod=CODE
    BswImplementation_2: behavior=InternalBehavior_2, vendor-api-infix=Core_2
      code-descriptors:
        code Files
          artifact-descriptors:
            short-label=Autosar::include::EcuM.h, category=SWHDR
            short-label=Autosar::include::EcuM_BSW.h, category=SWHDR
            short-label=Autosar::include::EcuM_BSW_Types.h, category=SWHDR
            short-label=Autosar::include::EcuM_BootTarget.h, category=SWHDR
            short-label=Autosar::include::EcuM_Cbk.h, category=SWHDR
            short-label=Autosar::include::EcuM_Externals.h, category=SWHDR
            short-label=Autosar::include::EcuM_Int.h, category=SWHDR
            short-label=Autosar::include::EcuM_Trace.h, category=SWHDR
            short-label=Autosar::include::EcuM_Trace_Internal.h, category=SWHDR
            short-label=Autosar::include::EcuM_Types.h, category=SWHDR
            short-label=Autosar::include::EcuM_Version.h, category=SWHDR
            short-label=Autosar::src::EcuM.c, category=SWSRC
            short-label=Autosar::src::EcuM_ASR32_Rte.c, category=SWSRC
            short-label=Autosar::src::EcuM_ASR40_Rte.c, category=SWSRC
            short-label=Autosar::src::EcuM_BootTarget.c, category=SWSRC
            short-label=Autosar::src::EcuM_Rte.c, category=SWSRC
            short-label=make::EcuM_defs.mak, category=SWMAKE
            short-label=make::EcuM_rules.mak, category=SWMAKE
      resource consumption ResourceConsumption
        11 x memory section:
          INTERNAL_VAR_POWER_ON_INIT_UNSPECIFIED: alignment=UNSPECIFIED, sw-addrmethod=VAR_POWER_ON_INIT
          VAR_POWER_ON_INIT_8: alignment=8, sw-addrmethod=VAR_POWER_ON_INIT
          VAR_CLEARED_8: alignment=8, sw-addrmethod=VAR_CLEARED
          VAR_CLEARED_16: alignment=16, sw-addrmethod=VAR_CLEARED
          CONST_8: alignment=8, sw-addrmethod=CONST
          VAR_INIT_8: alignment=8, sw-addrmethod=VAR
          CONST_16: alignment=16, sw-addrmethod=CONST
          VAR_INIT_UNSPECIFIED: alignment=UNSPECIFIED, sw-addrmethod=VAR
          VAR_CLEARED_UNSPECIFIED: alignment=UNSPECIFIED, sw-addrmethod=VAR_CLEARED
          CONST_UNSPECIFIED: alignment=UNSPECIFIED, sw-addrmethod=CONST
          CODE: sw-addrmethod=CODE
    BswImplementation_3: behavior=InternalBehavior_3, vendor-api-infix=Core_3
      code-descriptors:
        code Files
          artifact-descriptors:
            short-label=Autosar::include::EcuM.h, category=SWHDR
            short-label=Autosar::include::EcuM_BSW.h, category=SWHDR
            short-label=Autosar::include::EcuM_BSW_Types.h, category=SWHDR
            short-label=Autosar::include::EcuM_BootTarget.h, category=SWHDR
            short-label=Autosar::include::EcuM_Cbk.h, category=SWHDR
            short-label=Autosar::include::EcuM_Externals.h, category=SWHDR
            short-label=Autosar::include::EcuM_Int.h, category=SWHDR
            short-label=Autosar::include::EcuM_Trace.h, category=SWHDR
            short-label=Autosar::include::EcuM_Trace_Internal.h, category=SWHDR
            short-label=Autosar::include::EcuM_Types.h, category=SWHDR
            short-label=Autosar::include::EcuM_Version.h, category=SWHDR
            short-label=Autosar::src::EcuM.c, category=SWSRC
            short-label=Autosar::src::EcuM_ASR32_Rte.c, category=SWSRC
            short-label=Autosar::src::EcuM_ASR40_Rte.c, category=SWSRC
            short-label=Autosar::src::EcuM_BootTarget.c, category=SWSRC
            short-label=Autosar::src::EcuM_Rte.c, category=SWSRC
            short-label=make::EcuM_defs.mak, category=SWMAKE
            short-label=make::EcuM_rules.mak, category=SWMAKE
      resource consumption ResourceConsumption
        11 x memory section:
          INTERNAL_VAR_POWER_ON_INIT_UNSPECIFIED: alignment=UNSPECIFIED, sw-addrmethod=VAR_POWER_ON_INIT
          VAR_POWER_ON_INIT_8: alignment=8, sw-addrmethod=VAR_POWER_ON_INIT
          VAR_CLEARED_8: alignment=8, sw-addrmethod=VAR_CLEARED
          VAR_CLEARED_16: alignment=16, sw-addrmethod=VAR_CLEARED
          CONST_8: alignment=8, sw-addrmethod=CONST
          VAR_INIT_8: alignment=8, sw-addrmethod=VAR
          CONST_16: alignment=16, sw-addrmethod=CONST
          VAR_INIT_UNSPECIFIED: alignment=UNSPECIFIED, sw-addrmethod=VAR
          VAR_CLEARED_UNSPECIFIED: alignment=UNSPECIFIED, sw-addrmethod=VAR_CLEARED
          CONST_UNSPECIFIED: alignment=UNSPECIFIED, sw-addrmethod=CONST
          CODE: sw-addrmethod=CODE
