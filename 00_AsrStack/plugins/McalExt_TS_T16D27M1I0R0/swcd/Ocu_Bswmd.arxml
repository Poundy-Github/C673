<?xml version="1.0" encoding="ISO-8859-1"?>
[!AUTOSPACING!][!//
<AUTOSAR xmlns="http://autosar.org/schema/r4.0"
  xmlns:xsi="http://www.w3.org/2001/XMLSchema-instance"
  xsi:schemaLocation="http://autosar.org/schema/r4.0 AUTOSAR_4-0-3_STRICT_COMPACT.xsd">
  <AR-PACKAGES>
    <AR-PACKAGE>
      <SHORT-NAME>AUTOSAR_Ocu</SHORT-NAME>
      <AR-PACKAGES>
            <AR-PACKAGE>
              <SHORT-NAME>BswModuleDescriptions</SHORT-NAME>
              <ELEMENTS>
                <BSW-MODULE-DESCRIPTION>
                  <SHORT-NAME>Ocu</SHORT-NAME>
                  <MODULE-ID>125</MODULE-ID>
                  <PROVIDED-ENTRYS>
                    <BSW-MODULE-ENTRY-REF-CONDITIONAL>
                      <BSW-MODULE-ENTRY-REF DEST="BSW-MODULE-ENTRY">/AUTOSAR_Ocu/BswModuleEntrys/Ocu_Init</BSW-MODULE-ENTRY-REF>
                    </BSW-MODULE-ENTRY-REF-CONDITIONAL>
                  </PROVIDED-ENTRYS>
                  <INTERNAL-BEHAVIORS>
                    <BSW-INTERNAL-BEHAVIOR>
                      <SHORT-NAME>InternalBehavior_0</SHORT-NAME>
                      <EXCLUSIVE-AREAS>
                        <EXCLUSIVE-AREA>
                          <SHORT-NAME>EnDisCCU1Irq</SHORT-NAME>
                        </EXCLUSIVE-AREA>
                        <EXCLUSIVE-AREA>
                          <SHORT-NAME>SetPinAction</SHORT-NAME>
                        </EXCLUSIVE-AREA>
                        <EXCLUSIVE-AREA>
                          <SHORT-NAME>SetThresholdValue</SHORT-NAME>
                        </EXCLUSIVE-AREA>
                      </EXCLUSIVE-AREAS>
                      <ENTITYS>
                        <BSW-CALLED-ENTITY>
                          <SHORT-NAME>Ocu_Init</SHORT-NAME>
                          <CAN-ENTER-EXCLUSIVE-AREA-REFS>
                            <CAN-ENTER-EXCLUSIVE-AREA-REF DEST="EXCLUSIVE-AREA">/AUTOSAR_Ocu/BswModuleDescriptions/Ocu/InternalBehavior_0/EnDisCCU1Irq</CAN-ENTER-EXCLUSIVE-AREA-REF>
                            <CAN-ENTER-EXCLUSIVE-AREA-REF DEST="EXCLUSIVE-AREA">/AUTOSAR_Ocu/BswModuleDescriptions/Ocu/InternalBehavior_0/SetPinAction</CAN-ENTER-EXCLUSIVE-AREA-REF>
                            <CAN-ENTER-EXCLUSIVE-AREA-REF DEST="EXCLUSIVE-AREA">/AUTOSAR_Ocu/BswModuleDescriptions/Ocu/InternalBehavior_0/SetThresholdValue</CAN-ENTER-EXCLUSIVE-AREA-REF>
                          </CAN-ENTER-EXCLUSIVE-AREA-REFS>
                          <MINIMUM-START-INTERVAL>0.0</MINIMUM-START-INTERVAL>
                          <IMPLEMENTED-ENTRY-REF DEST="BSW-MODULE-ENTRY">/AUTOSAR_Ocu/BswModuleEntrys/Ocu_Init</IMPLEMENTED-ENTRY-REF>
                        </BSW-CALLED-ENTITY>
                      </ENTITYS>
                    </BSW-INTERNAL-BEHAVIOR>
                  </INTERNAL-BEHAVIORS>
                </BSW-MODULE-DESCRIPTION>
              </ELEMENTS>
            </AR-PACKAGE>
            <AR-PACKAGE>
              <SHORT-NAME>BswModuleEntrys</SHORT-NAME>
              <ELEMENTS>
                <BSW-MODULE-ENTRY>
                  <SHORT-NAME>Ocu_Init</SHORT-NAME>
                  <SERVICE-ID>1000</SERVICE-ID>
                  <IS-REENTRANT>false</IS-REENTRANT>
                  <IS-SYNCHRONOUS>true</IS-SYNCHRONOUS>
                  <CALL-TYPE>REGULAR</CALL-TYPE>
                  <EXECUTION-CONTEXT>UNSPECIFIED</EXECUTION-CONTEXT>
                  <SW-SERVICE-IMPL-POLICY>STANDARD</SW-SERVICE-IMPL-POLICY>
                </BSW-MODULE-ENTRY>
              </ELEMENTS>
            </AR-PACKAGE>
      </AR-PACKAGES>
    </AR-PACKAGE>
    <AR-PACKAGE>
      <SHORT-NAME>Ocu_Aurix2GAS422</SHORT-NAME>
      <AR-PACKAGES>
        <AR-PACKAGE>
          <SHORT-NAME>Implementations</SHORT-NAME>
          <ELEMENTS>
            <BSW-IMPLEMENTATION>
              <SHORT-NAME>BswImplementation_0</SHORT-NAME>
              <CODE-DESCRIPTORS>
                <CODE>
                  <SHORT-NAME>Files</SHORT-NAME>
                  <ARTIFACT-DESCRIPTORS>
                    <AUTOSAR-ENGINEERING-OBJECT>
                      <SHORT-LABEL>make::Ocu_defs.mak</SHORT-LABEL>
                      <CATEGORY>SWMAKE</CATEGORY>
                    </AUTOSAR-ENGINEERING-OBJECT>
                    <AUTOSAR-ENGINEERING-OBJECT>
                      <SHORT-LABEL>make::Ocu_rules.mak</SHORT-LABEL>
                      <CATEGORY>SWMAKE</CATEGORY>
                    </AUTOSAR-ENGINEERING-OBJECT>
                  </ARTIFACT-DESCRIPTORS>
                </CODE>
              </CODE-DESCRIPTORS>
              <PROGRAMMING-LANGUAGE>C</PROGRAMMING-LANGUAGE>
            <RESOURCE-CONSUMPTION>
              <SHORT-NAME>ResourceConsumption</SHORT-NAME>
                <MEMORY-SECTIONS>
                  [!FOR "CoreId" = "num:i(1)" TO "ecu:get('Mcu.NoOfCoreAvailable')"!][!//

                  <MEMORY-SECTION>
                    <SHORT-NAME>VAR_CLEARED_ASIL_B_CORE[!"num:i(($CoreId) - num:i(1))"!]_32</SHORT-NAME>
                    <ALIGNMENT>32</ALIGNMENT>
                    <OPTIONS>
                    	<OPTION>safetyAsilB</OPTION>
                    </OPTIONS>
                    <SW-ADDRMETHOD-REF DEST="SW-ADDR-METHOD">/AUTOSAR_MemMap/SwAddrMethods/VAR_CLEARED_ASIL_B</SW-ADDRMETHOD-REF>
                  </MEMORY-SECTION>
                  <MEMORY-SECTION>
                    <SHORT-NAME>CONFIG_DATA_ASIL_B_CORE[!"num:i(($CoreId) - num:i(1))"!]_UNSPECIFIED</SHORT-NAME>
                    <ALIGNMENT>UNSPECIFIED</ALIGNMENT>
                    <OPTIONS>
                    	<OPTION>safetyAsilB</OPTION>
                    </OPTIONS>
                    <SW-ADDRMETHOD-REF DEST="SW-ADDR-METHOD">/AUTOSAR_MemMap/SwAddrMethods/CONFIG_DATA_ASIL_B</SW-ADDRMETHOD-REF>
                  </MEMORY-SECTION>

                  [!ENDFOR!]
                <MEMORY-SECTION>
                  <SHORT-NAME>CONST_ASIL_B_GLOBAL_32</SHORT-NAME>
                  <ALIGNMENT>32</ALIGNMENT>
                    <OPTIONS>
                    	<OPTION>safetyAsilB</OPTION>
                    </OPTIONS>
                  <SW-ADDRMETHOD-REF DEST="SW-ADDR-METHOD">/AUTOSAR_MemMap/SwAddrMethods/CONST_ASIL_B</SW-ADDRMETHOD-REF>
                </MEMORY-SECTION>
                  <MEMORY-SECTION>
                    <SHORT-NAME>VAR_CLEARED_ASIL_B_GLOBAL_32</SHORT-NAME>
                    <ALIGNMENT>32</ALIGNMENT>
                    <OPTIONS>
                    	<OPTION>safetyAsilB</OPTION>
                    </OPTIONS>
                    <SW-ADDRMETHOD-REF DEST="SW-ADDR-METHOD">/AUTOSAR_MemMap/SwAddrMethods/VAR_CLEARED_ASIL_B</SW-ADDRMETHOD-REF>
                  </MEMORY-SECTION>
                  <MEMORY-SECTION>
                    <SHORT-NAME>CONFIG_DATA_ASIL_B_GLOBAL_UNSPECIFIED</SHORT-NAME>
                    <ALIGNMENT>UNSPECIFIED</ALIGNMENT>
                    <OPTIONS>
                    	<OPTION>safetyAsilB</OPTION>
                    </OPTIONS>
                    <SW-ADDRMETHOD-REF DEST="SW-ADDR-METHOD">/AUTOSAR_MemMap/SwAddrMethods/CONFIG_DATA_ASIL_B</SW-ADDRMETHOD-REF>
                  </MEMORY-SECTION>
                  <MEMORY-SECTION>
                    <SHORT-NAME>CODE_ASIL_B_GLOBAL</SHORT-NAME>
                    <ALIGNMENT>UNSPECIFIED</ALIGNMENT>
                    <OPTIONS>
                    	<OPTION>safetyAsilB</OPTION>
                    </OPTIONS>
                    <SW-ADDRMETHOD-REF DEST="SW-ADDR-METHOD">/AUTOSAR_MemMap/SwAddrMethods/CODE_ASIL_B</SW-ADDRMETHOD-REF>
                  </MEMORY-SECTION>
                </MEMORY-SECTIONS>
              <SECTION-NAME-PREFIXS>
                <SECTION-NAME-PREFIX>
                  <SHORT-NAME>OCU</SHORT-NAME>
                  <SYMBOL>OCU</SYMBOL>
                </SECTION-NAME-PREFIX>
              </SECTION-NAME-PREFIXS>
            </RESOURCE-CONSUMPTION>
              <SW-VERSION>20.0.1</SW-VERSION>
              <VENDOR-ID>17</VENDOR-ID>
              <AR-RELEASE-VERSION>4.2.2</AR-RELEASE-VERSION>
              <BEHAVIOR-REF DEST="BSW-INTERNAL-BEHAVIOR">/AUTOSAR_Ocu/BswModuleDescriptions/Ocu/InternalBehavior_0</BEHAVIOR-REF>
              <VENDOR-SPECIFIC-MODULE-DEF-REFS>
                <VENDOR-SPECIFIC-MODULE-DEF-REF DEST="ECUC-MODULE-DEF">/AURIX2G/EcucDefs/Ocu</VENDOR-SPECIFIC-MODULE-DEF-REF>
              </VENDOR-SPECIFIC-MODULE-DEF-REFS>
            </BSW-IMPLEMENTATION>
          </ELEMENTS>
        </AR-PACKAGE>
      </AR-PACKAGES>
    </AR-PACKAGE>
  </AR-PACKAGES>
</AUTOSAR>
