entry &CORENAME
global &gCORENAME &gBASEPATH &gPROJECTNAME &gPLATFORM

&gCORENAME="&CORENAME"
&gBASEPATH="../.."
&gPROJECTNAME="mfs430"
&gPLATFORM="tda1dual"

do &(gBASEPATH)\common\init.cmm
