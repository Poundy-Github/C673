<?xml version="1.0" encoding="ISO-8859-1"?>
<!-- !LINKSTO UdpNm.EB.BSWMDGeneration_1,1, UdpNm.EB.BSWMDGeneration_2,1, UdpNm.EB.BSWMDGeneration_3,1 -->
[!VAR "VAR_UDPNM_NUMBER_OF_CHANNELS"="num:i(count(UdpNmGlobalConfig/*[1]/UdpNmChannelConfig/*))"!][!//
[!AUTOSPACING!][!//
[!IF "not(node:exists(as:modconf('UdpNm')[1]/UdpNmGlobalConfig/*[1]))"!][!//
[!ERROR "Configuration not exist!"!][!//
[!ENDIF!][!//
<AUTOSAR xmlns="http://autosar.org/schema/r4.0"
  xmlns:xsi="http://www.w3.org/2001/XMLSchema-instance"
  xsi:schemaLocation="http://autosar.org/schema/r4.0 AUTOSAR_4-2-1_STRICT_COMPACT.xsd">
  <AR-PACKAGES>
    <AR-PACKAGE>
      <SHORT-NAME>AUTOSAR_UdpNm</SHORT-NAME>
      <AR-PACKAGES>
        <AR-PACKAGE>
          <SHORT-NAME>BswModuleDescriptions</SHORT-NAME>
          <ELEMENTS>
            <BSW-MODULE-DESCRIPTION>
              <SHORT-NAME>UdpNm</SHORT-NAME>
              <MODULE-ID>33</MODULE-ID>
              <PROVIDED-ENTRYS>
[!LOOP "node:order(as:modconf('UdpNm')[1]/UdpNmGlobalConfig/*[1]/UdpNmChannelConfig/*, 'UdpNmRxPdu/*[1]/UdpNmRxPduId')"!]
                <BSW-MODULE-ENTRY-REF-CONDITIONAL>
                  <BSW-MODULE-ENTRY-REF DEST="BSW-MODULE-ENTRY">/AUTOSAR_UdpNm/BswModuleEntrys/UdpNm_MainFunction_[!"num:i(UdpNmRxPdu/*[1]/UdpNmRxPduId)"!]</BSW-MODULE-ENTRY-REF>
                </BSW-MODULE-ENTRY-REF-CONDITIONAL>
[!ENDLOOP!]

[!IF "as:modconf('UdpNm')[1]/UdpNmGeneral/UdpNmMultiCoreSupport = 'true'"!]
                <BSW-MODULE-ENTRY-REF-CONDITIONAL>
                  <BSW-MODULE-ENTRY-REF DEST="BSW-MODULE-ENTRY">/AUTOSAR_UdpNm/BswModuleEntrys/UdpNm_Dummy_RxIndication</BSW-MODULE-ENTRY-REF>
                </BSW-MODULE-ENTRY-REF-CONDITIONAL>
[!IF "as:modconf('UdpNm')[1]/UdpNmGlobalConfig/*[1]/UdpNmPassiveModeEnabled='false'"!]
                <BSW-MODULE-ENTRY-REF-CONDITIONAL>
                  <BSW-MODULE-ENTRY-REF DEST="BSW-MODULE-ENTRY">/AUTOSAR_UdpNm/BswModuleEntrys/UdpNm_NetworkRequest</BSW-MODULE-ENTRY-REF>
                </BSW-MODULE-ENTRY-REF-CONDITIONAL>
[!ENDIF!]
[!IF "as:modconf('UdpNm')[1]/UdpNmGlobalConfig/*[1]/UdpNmPassiveModeEnabled='false'"!]
                <BSW-MODULE-ENTRY-REF-CONDITIONAL>
                  <BSW-MODULE-ENTRY-REF DEST="BSW-MODULE-ENTRY">/AUTOSAR_UdpNm/BswModuleEntrys/UdpNm_NetworkGwEraRequest</BSW-MODULE-ENTRY-REF>
                </BSW-MODULE-ENTRY-REF-CONDITIONAL>
[!ENDIF!]
[!IF "as:modconf('UdpNm')[1]/UdpNmGlobalConfig/*[1]/UdpNmPassiveModeEnabled='false'"!]
                <BSW-MODULE-ENTRY-REF-CONDITIONAL>
                  <BSW-MODULE-ENTRY-REF DEST="BSW-MODULE-ENTRY">/AUTOSAR_UdpNm/BswModuleEntrys/UdpNm_NetworkRelease</BSW-MODULE-ENTRY-REF>
                </BSW-MODULE-ENTRY-REF-CONDITIONAL>
[!ENDIF!]

[!IF "as:modconf('UdpNm')[1]/UdpNmGlobalConfig/*[1]/UdpNmBusSynchronizationEnabled='true'"!]
                <BSW-MODULE-ENTRY-REF-CONDITIONAL>
                  <BSW-MODULE-ENTRY-REF DEST="BSW-MODULE-ENTRY">/AUTOSAR_UdpNm/BswModuleEntrys/UdpNm_RequestBusSynchronization</BSW-MODULE-ENTRY-REF>
                </BSW-MODULE-ENTRY-REF-CONDITIONAL>
[!ENDIF!]
                <BSW-MODULE-ENTRY-REF-CONDITIONAL>
                  <BSW-MODULE-ENTRY-REF DEST="BSW-MODULE-ENTRY">/AUTOSAR_UdpNm/BswModuleEntrys/UdpNm_PassiveStartUp</BSW-MODULE-ENTRY-REF>
                </BSW-MODULE-ENTRY-REF-CONDITIONAL>
[!ENDIF!][!//

              </PROVIDED-ENTRYS>

[!IF "as:modconf('UdpNm')[1]/UdpNmGeneral/UdpNmMultiCoreSupport = 'true'"!]
              <PROVIDED-CLIENT-SERVER-ENTRYS>
[!LOOP "as:modconf('UdpNm')[1]/UdpNmGlobalConfig/*[1]/UdpNmChannelConfig/*"!]
                <BSW-MODULE-CLIENT-SERVER-ENTRY>
                  <SHORT-NAME>ProvidedCSEntry_UdpNm_PassiveStartUp_[!"node:name(.)"!]</SHORT-NAME>
                  <ENCAPSULATED-ENTRY-REF DEST="BSW-MODULE-ENTRY">/AUTOSAR_UdpNm/BswModuleEntrys/UdpNm_PassiveStartUp</ENCAPSULATED-ENTRY-REF>
                  <IS-SYNCHRONOUS>false</IS-SYNCHRONOUS>
                </BSW-MODULE-CLIENT-SERVER-ENTRY>

[!IF "as:modconf('UdpNm')[1]/UdpNmGlobalConfig/*[1]/UdpNmPassiveModeEnabled='false'"!]
                <BSW-MODULE-CLIENT-SERVER-ENTRY>
                  <SHORT-NAME>ProvidedCSEntry_UdpNm_NetworkRelease_[!"node:name(.)"!]</SHORT-NAME>
                  <ENCAPSULATED-ENTRY-REF DEST="BSW-MODULE-ENTRY">/AUTOSAR_UdpNm/BswModuleEntrys/UdpNm_NetworkRelease</ENCAPSULATED-ENTRY-REF>
                  <IS-SYNCHRONOUS>false</IS-SYNCHRONOUS>
                </BSW-MODULE-CLIENT-SERVER-ENTRY>
[!ENDIF!]

[!IF "as:modconf('UdpNm')[1]/UdpNmGlobalConfig/*[1]/UdpNmBusSynchronizationEnabled='true'"!]
                <BSW-MODULE-CLIENT-SERVER-ENTRY>
                  <SHORT-NAME>ProvidedCSEntry_UdpNm_RequestBusSynchronization_[!"node:name(.)"!]</SHORT-NAME>
                  <ENCAPSULATED-ENTRY-REF DEST="BSW-MODULE-ENTRY">/AUTOSAR_UdpNm/BswModuleEntrys/UdpNm_RequestBusSynchronization</ENCAPSULATED-ENTRY-REF>
                  <IS-SYNCHRONOUS>false</IS-SYNCHRONOUS>
                </BSW-MODULE-CLIENT-SERVER-ENTRY>
[!ENDIF!]

[!IF "as:modconf('UdpNm')[1]/UdpNmGlobalConfig/*[1]/UdpNmPassiveModeEnabled='false'"!]
                <BSW-MODULE-CLIENT-SERVER-ENTRY>
                  <SHORT-NAME>ProvidedCSEntry_UdpNm_NetworkRequest_[!"node:name(.)"!]</SHORT-NAME>
                  <ENCAPSULATED-ENTRY-REF DEST="BSW-MODULE-ENTRY">/AUTOSAR_UdpNm/BswModuleEntrys/UdpNm_NetworkRequest</ENCAPSULATED-ENTRY-REF>
                  <IS-SYNCHRONOUS>false</IS-SYNCHRONOUS>
                </BSW-MODULE-CLIENT-SERVER-ENTRY>
[!ENDIF!]
[!IF "as:modconf('UdpNm')[1]/UdpNmGlobalConfig/*[1]/UdpNmPassiveModeEnabled='false'"!]
                <BSW-MODULE-CLIENT-SERVER-ENTRY>
                  <SHORT-NAME>ProvidedCSEntry_UdpNm_NetworkGwEraRequest_[!"node:name(.)"!]</SHORT-NAME>
                  <ENCAPSULATED-ENTRY-REF DEST="BSW-MODULE-ENTRY">/AUTOSAR_UdpNm/BswModuleEntrys/UdpNm_NetworkGwEraRequest</ENCAPSULATED-ENTRY-REF>
                  <IS-SYNCHRONOUS>false</IS-SYNCHRONOUS>
                </BSW-MODULE-CLIENT-SERVER-ENTRY>
[!ENDIF!]
[!ENDLOOP!]
              </PROVIDED-CLIENT-SERVER-ENTRYS>
[!ENDIF!][!//
[!IF "as:modconf('UdpNm')[1]/UdpNmGeneral/UdpNmMultiCoreSupport = 'true'"!]
              <REQUIRED-CLIENT-SERVER-ENTRYS>
[!LOOP "as:modconf('UdpNm')[1]/UdpNmGlobalConfig/*[1]/UdpNmChannelConfig/*"!]
                <BSW-MODULE-CLIENT-SERVER-ENTRY>
                  <SHORT-NAME>RequiredCSEntry_Nm_NetworkStartIndication_[!"node:name(.)"!]</SHORT-NAME>
                  <ENCAPSULATED-ENTRY-REF DEST="BSW-MODULE-ENTRY">/AUTOSAR_UdpNm/BswModuleEntrys/UdpNm_MainFunction_[!"num:i(UdpNmRxPdu/*[1]/UdpNmRxPduId)"!]</ENCAPSULATED-ENTRY-REF>
                  <IS-SYNCHRONOUS>false</IS-SYNCHRONOUS>
                </BSW-MODULE-CLIENT-SERVER-ENTRY>

                <BSW-MODULE-CLIENT-SERVER-ENTRY>
                  <SHORT-NAME>RequiredCSEntry_Nm_NetworkMode_[!"node:name(.)"!]</SHORT-NAME>
                  <ENCAPSULATED-ENTRY-REF DEST="BSW-MODULE-ENTRY">/AUTOSAR_UdpNm/BswModuleEntrys/UdpNm_MainFunction_[!"num:i(UdpNmRxPdu/*[1]/UdpNmRxPduId)"!]</ENCAPSULATED-ENTRY-REF>
                  <IS-SYNCHRONOUS>false</IS-SYNCHRONOUS>
                </BSW-MODULE-CLIENT-SERVER-ENTRY>

                <BSW-MODULE-CLIENT-SERVER-ENTRY>
                  <SHORT-NAME>RequiredCSEntry_Nm_BusSleepMode_[!"node:name(.)"!]</SHORT-NAME>
                  <ENCAPSULATED-ENTRY-REF DEST="BSW-MODULE-ENTRY">/AUTOSAR_UdpNm/BswModuleEntrys/UdpNm_MainFunction_[!"num:i(UdpNmRxPdu/*[1]/UdpNmRxPduId)"!]</ENCAPSULATED-ENTRY-REF>
                  <IS-SYNCHRONOUS>false</IS-SYNCHRONOUS>
                </BSW-MODULE-CLIENT-SERVER-ENTRY>

                <BSW-MODULE-CLIENT-SERVER-ENTRY>
                  <SHORT-NAME>RequiredCSEntry_Nm_PrepareBusSleepMode_[!"node:name(.)"!]</SHORT-NAME>
                  <ENCAPSULATED-ENTRY-REF DEST="BSW-MODULE-ENTRY">/AUTOSAR_UdpNm/BswModuleEntrys/UdpNm_MainFunction_[!"num:i(UdpNmRxPdu/*[1]/UdpNmRxPduId)"!]</ENCAPSULATED-ENTRY-REF>
                  <IS-SYNCHRONOUS>false</IS-SYNCHRONOUS>
                </BSW-MODULE-CLIENT-SERVER-ENTRY>

[!IF "as:modconf('UdpNm')[1]/UdpNmGlobalConfig/*[1]/UdpNmRemoteSleepIndEnabled='true'"!]
                <BSW-MODULE-CLIENT-SERVER-ENTRY>
                  <SHORT-NAME>RequiredCSEntry_Nm_RemoteSleepIndication_[!"node:name(.)"!]</SHORT-NAME>
                  <ENCAPSULATED-ENTRY-REF DEST="BSW-MODULE-ENTRY">/AUTOSAR_UdpNm/BswModuleEntrys/UdpNm_MainFunction_[!"num:i(UdpNmRxPdu/*[1]/UdpNmRxPduId)"!]</ENCAPSULATED-ENTRY-REF>
                  <IS-SYNCHRONOUS>false</IS-SYNCHRONOUS>
                </BSW-MODULE-CLIENT-SERVER-ENTRY>
[!ENDIF!]

[!IF "as:modconf('UdpNm')[1]/UdpNmGlobalConfig/*[1]/UdpNmRemoteSleepIndEnabled='true'"!]
                <BSW-MODULE-CLIENT-SERVER-ENTRY>
                  <SHORT-NAME>RequiredCSEntry_Nm_RemoteSleepCancellation_[!"node:name(.)"!]</SHORT-NAME>
                  <ENCAPSULATED-ENTRY-REF DEST="BSW-MODULE-ENTRY">/AUTOSAR_UdpNm/BswModuleEntrys/UdpNm_MainFunction_[!"num:i(UdpNmRxPdu/*[1]/UdpNmRxPduId)"!]</ENCAPSULATED-ENTRY-REF>
                  <IS-SYNCHRONOUS>false</IS-SYNCHRONOUS>
                </BSW-MODULE-CLIENT-SERVER-ENTRY>
[!ENDIF!]

[!IF "as:modconf('UdpNm')[1]/UdpNmGlobalConfig/*[1]/UdpNmPduRxIndicationEnabled='true'"!]
                <BSW-MODULE-CLIENT-SERVER-ENTRY>
                  <SHORT-NAME>RequiredCSEntry_Nm_PduRxIndication_[!"node:name(.)"!]</SHORT-NAME>
                  <ENCAPSULATED-ENTRY-REF DEST="BSW-MODULE-ENTRY">/AUTOSAR_UdpNm/BswModuleEntrys/UdpNm_MainFunction_[!"num:i(UdpNmRxPdu/*[1]/UdpNmRxPduId)"!]</ENCAPSULATED-ENTRY-REF>
                  <IS-SYNCHRONOUS>false</IS-SYNCHRONOUS>
                </BSW-MODULE-CLIENT-SERVER-ENTRY>
[!ENDIF!]

[!IF "as:modconf('UdpNm')[1]/UdpNmGlobalConfig/*[1]/UdpNmStateChangeIndEnabled='true'"!]
                <BSW-MODULE-CLIENT-SERVER-ENTRY>
                  <SHORT-NAME>RequiredCSEntry_Nm_StateChangeNotification_[!"node:name(.)"!]</SHORT-NAME>
                  <ENCAPSULATED-ENTRY-REF DEST="BSW-MODULE-ENTRY">/AUTOSAR_UdpNm/BswModuleEntrys/UdpNm_MainFunction_[!"num:i(UdpNmRxPdu/*[1]/UdpNmRxPduId)"!]</ENCAPSULATED-ENTRY-REF>
                  <IS-SYNCHRONOUS>false</IS-SYNCHRONOUS>
                </BSW-MODULE-CLIENT-SERVER-ENTRY>
[!ENDIF!]

[!IF "UdpNmRepeatMsgIndEnabled='true'"!]
                <BSW-MODULE-CLIENT-SERVER-ENTRY>
                  <SHORT-NAME>RequiredCSEntry_Nm_RepeatMessageIndication_[!"node:name(.)"!]</SHORT-NAME>
                  <ENCAPSULATED-ENTRY-REF DEST="BSW-MODULE-ENTRY">/AUTOSAR_UdpNm/BswModuleEntrys/UdpNm_Dummy_RxIndication</ENCAPSULATED-ENTRY-REF>
                  <IS-SYNCHRONOUS>false</IS-SYNCHRONOUS>
                </BSW-MODULE-CLIENT-SERVER-ENTRY>
[!ENDIF!]

[!IF "UdpNmCarWakeUpRxEnabled='true'"!]
                <BSW-MODULE-CLIENT-SERVER-ENTRY>
                  <SHORT-NAME>RequiredCSEntry_Nm_CarWakeUpIndication_[!"node:name(.)"!]</SHORT-NAME>
                  <ENCAPSULATED-ENTRY-REF DEST="BSW-MODULE-ENTRY">/AUTOSAR_UdpNm/BswModuleEntrys/UdpNm_Dummy_RxIndication</ENCAPSULATED-ENTRY-REF>
                  <IS-SYNCHRONOUS>false</IS-SYNCHRONOUS>
                </BSW-MODULE-CLIENT-SERVER-ENTRY>
[!ENDIF!]
[!ENDLOOP!]
              </REQUIRED-CLIENT-SERVER-ENTRYS>
[!ENDIF!][!//

              <INTERNAL-BEHAVIORS>
                <BSW-INTERNAL-BEHAVIOR>
                  <SHORT-NAME>InternalBehavior_0</SHORT-NAME>
                  <EXCLUSIVE-AREAS>
                    <EXCLUSIVE-AREA>
                      <SHORT-NAME>SCHM_UDPNM_EXCLUSIVE_AREA_0</SHORT-NAME>
                    </EXCLUSIVE-AREA>
                  </EXCLUSIVE-AREAS>
                  <STATIC-MEMORYS>
[!FOR "ChannelIndex"="0" TO "num:i($VAR_UDPNM_NUMBER_OF_CHANNELS)-1"!][!//
                    <VARIABLE-DATA-PROTOTYPE>
                      <SHORT-NAME>UdpNm_HsmInstUdpNm_StateId_[!"$ChannelIndex"!]</SHORT-NAME>
                        <ADMIN-DATA>
                          <SDGS>
                            <SDG GID="EB:DnT">
                              <SD GID="StateGroup">UdpNm_HsmInstUdpNm_StateId</SD>
                              <SD GID="StateId">[!"$ChannelIndex"!]</SD>
                              <SD GID="EnableTracing">true</SD>
                            </SDG>
                          </SDGS>
                        </ADMIN-DATA>
                      <SW-DATA-DEF-PROPS>
                        <SW-DATA-DEF-PROPS-VARIANTS>
                          <SW-DATA-DEF-PROPS-CONDITIONAL>
                            <SW-IMPL-POLICY>STANDARD</SW-IMPL-POLICY>
                          </SW-DATA-DEF-PROPS-CONDITIONAL>
                        </SW-DATA-DEF-PROPS-VARIANTS>
                      </SW-DATA-DEF-PROPS>
                      <TYPE-TREF DEST="IMPLEMENTATION-DATA-TYPE">/AUTOSAR_UdpNm/ImplementationDataTypes/UdpNm_HsmStateIdxType</TYPE-TREF>
                    </VARIABLE-DATA-PROTOTYPE>
[!ENDFOR!][!//
                  </STATIC-MEMORYS>
[!IF "as:modconf('UdpNm')[1]/UdpNmGeneral/UdpNmMultiCoreSupport = 'true'"!]
                  <INTERNAL-TRIGGERING-POINTS>
[!LOOP "as:modconf('UdpNm')[1]/UdpNmGlobalConfig/*[1]/UdpNmChannelConfig/*"!]
[!IF "(UdpNmRepeatMsgIndEnabled='true') or (UdpNmCarWakeUpRxEnabled='true')"!]
                    <BSW-INTERNAL-TRIGGERING-POINT>
                      <SHORT-NAME>TriggeringPoint_RxIndication_[!"node:name(.)"!]</SHORT-NAME>
                    </BSW-INTERNAL-TRIGGERING-POINT>
[!ENDIF!]
[!ENDLOOP!]
                  </INTERNAL-TRIGGERING-POINTS>
[!ENDIF!]
                  <ENTITYS>
[!LOOP "node:order(as:modconf('UdpNm')[1]/UdpNmGlobalConfig/*[1]/UdpNmChannelConfig/*, 'UdpNmRxPdu/*[1]/UdpNmRxPduId')"!]
                    <BSW-SCHEDULABLE-ENTITY>
                      <SHORT-NAME>UdpNm_MainFunction_[!"num:i(UdpNmRxPdu/*[1]/UdpNmRxPduId)"!]</SHORT-NAME>
                      <CAN-ENTER-EXCLUSIVE-AREA-REFS>
                        <CAN-ENTER-EXCLUSIVE-AREA-REF DEST="EXCLUSIVE-AREA">/AUTOSAR_UdpNm/BswModuleDescriptions/UdpNm/InternalBehavior_0/SCHM_UDPNM_EXCLUSIVE_AREA_0</CAN-ENTER-EXCLUSIVE-AREA-REF>
                      </CAN-ENTER-EXCLUSIVE-AREA-REFS>
                      <MINIMUM-START-INTERVAL>0.0</MINIMUM-START-INTERVAL>
[!IF "as:modconf('UdpNm')[1]/UdpNmGeneral/UdpNmMultiCoreSupport = 'true'"!]
                      <CALL-POINTS>
                        <BSW-ASYNCHRONOUS-SERVER-CALL-POINT>
                          <SHORT-NAME>AsynchCallPoint_Nm_NetworkStartIndication_[!"node:name(.)"!]</SHORT-NAME>
                          <CALLED-ENTRY-REF DEST="BSW-MODULE-CLIENT-SERVER-ENTRY">/AUTOSAR_UdpNm/BswModuleDescriptions/UdpNm/RequiredCSEntry_Nm_NetworkStartIndication_[!"node:name(.)"!]</CALLED-ENTRY-REF>
                        </BSW-ASYNCHRONOUS-SERVER-CALL-POINT>
                        <BSW-ASYNCHRONOUS-SERVER-CALL-POINT>
                          <SHORT-NAME>AsynchCallPoint_Nm_NetworkMode_[!"node:name(.)"!]</SHORT-NAME>
                          <CALLED-ENTRY-REF DEST="BSW-MODULE-CLIENT-SERVER-ENTRY">/AUTOSAR_UdpNm/BswModuleDescriptions/UdpNm/RequiredCSEntry_Nm_NetworkMode_[!"node:name(.)"!]</CALLED-ENTRY-REF>
                        </BSW-ASYNCHRONOUS-SERVER-CALL-POINT>
                        <BSW-ASYNCHRONOUS-SERVER-CALL-POINT>
                          <SHORT-NAME>AsynchCallPoint_Nm_BusSleepMode_[!"node:name(.)"!]</SHORT-NAME>
                          <CALLED-ENTRY-REF DEST="BSW-MODULE-CLIENT-SERVER-ENTRY">/AUTOSAR_UdpNm/BswModuleDescriptions/UdpNm/RequiredCSEntry_Nm_BusSleepMode_[!"node:name(.)"!]</CALLED-ENTRY-REF>
                        </BSW-ASYNCHRONOUS-SERVER-CALL-POINT>
                        <BSW-ASYNCHRONOUS-SERVER-CALL-POINT>
                          <SHORT-NAME>AsynchCallPoint_Nm_PrepareBusSleepMode_[!"node:name(.)"!]</SHORT-NAME>
                          <CALLED-ENTRY-REF DEST="BSW-MODULE-CLIENT-SERVER-ENTRY">/AUTOSAR_UdpNm/BswModuleDescriptions/UdpNm/RequiredCSEntry_Nm_PrepareBusSleepMode_[!"node:name(.)"!]</CALLED-ENTRY-REF>
                        </BSW-ASYNCHRONOUS-SERVER-CALL-POINT>
[!IF "as:modconf('UdpNm')[1]/UdpNmGlobalConfig/*[1]/UdpNmRemoteSleepIndEnabled='true'"!]
                        <BSW-ASYNCHRONOUS-SERVER-CALL-POINT>
                          <SHORT-NAME>AsynchCallPoint_Nm_RemoteSleepIndication_[!"node:name(.)"!]</SHORT-NAME>
                          <CALLED-ENTRY-REF DEST="BSW-MODULE-CLIENT-SERVER-ENTRY">/AUTOSAR_UdpNm/BswModuleDescriptions/UdpNm/RequiredCSEntry_Nm_RemoteSleepIndication_[!"node:name(.)"!]</CALLED-ENTRY-REF>
                        </BSW-ASYNCHRONOUS-SERVER-CALL-POINT>
[!ENDIF!]
[!IF "as:modconf('UdpNm')[1]/UdpNmGlobalConfig/*[1]/UdpNmRemoteSleepIndEnabled='true'"!]
                        <BSW-ASYNCHRONOUS-SERVER-CALL-POINT>
                          <SHORT-NAME>AsynchCallPoint_Nm_RemoteSleepCancellation_[!"node:name(.)"!]</SHORT-NAME>
                          <CALLED-ENTRY-REF DEST="BSW-MODULE-CLIENT-SERVER-ENTRY">/AUTOSAR_UdpNm/BswModuleDescriptions/UdpNm/RequiredCSEntry_Nm_RemoteSleepCancellation_[!"node:name(.)"!]</CALLED-ENTRY-REF>
                        </BSW-ASYNCHRONOUS-SERVER-CALL-POINT>
[!ENDIF!]
[!IF "as:modconf('UdpNm')[1]/UdpNmGlobalConfig/*[1]/UdpNmPduRxIndicationEnabled='true'"!]
                        <BSW-ASYNCHRONOUS-SERVER-CALL-POINT>
                          <SHORT-NAME>AsynchCallPoint_Nm_PduRxIndication_[!"node:name(.)"!]</SHORT-NAME>
                          <CALLED-ENTRY-REF DEST="BSW-MODULE-CLIENT-SERVER-ENTRY">/AUTOSAR_UdpNm/BswModuleDescriptions/UdpNm/RequiredCSEntry_Nm_PduRxIndication_[!"node:name(.)"!]</CALLED-ENTRY-REF>
                        </BSW-ASYNCHRONOUS-SERVER-CALL-POINT>
[!ENDIF!]
[!IF "as:modconf('UdpNm')[1]/UdpNmGlobalConfig/*[1]/UdpNmStateChangeIndEnabled='true'"!]
                        <BSW-ASYNCHRONOUS-SERVER-CALL-POINT>
                          <SHORT-NAME>AsynchCallPoint_Nm_StateChangeNotification_[!"node:name(.)"!]</SHORT-NAME>
                          <CALLED-ENTRY-REF DEST="BSW-MODULE-CLIENT-SERVER-ENTRY">/AUTOSAR_UdpNm/BswModuleDescriptions/UdpNm/RequiredCSEntry_Nm_StateChangeNotification_[!"node:name(.)"!]</CALLED-ENTRY-REF>
                        </BSW-ASYNCHRONOUS-SERVER-CALL-POINT>
[!ENDIF!]
                      </CALL-POINTS>
[!ENDIF!][!//
                      <IMPLEMENTED-ENTRY-REF DEST="BSW-MODULE-ENTRY">/AUTOSAR_UdpNm/BswModuleEntrys/UdpNm_MainFunction_[!"num:i(UdpNmRxPdu/*[1]/UdpNmRxPduId)"!]</IMPLEMENTED-ENTRY-REF>
                    </BSW-SCHEDULABLE-ENTITY>
[!ENDLOOP!]

[!IF "as:modconf('UdpNm')[1]/UdpNmGeneral/UdpNmMultiCoreSupport = 'true'"!]
[!LOOP "as:modconf('UdpNm')[1]/UdpNmGlobalConfig/*[1]/UdpNmChannelConfig/*"!]
[!IF "(UdpNmRepeatMsgIndEnabled='true') or (UdpNmCarWakeUpRxEnabled='true')"!]
                    <BSW-SCHEDULABLE-ENTITY>
                      <SHORT-NAME>Entity_Nm_RxInidcation_[!"node:name(.)"!]</SHORT-NAME>
                      <MINIMUM-START-INTERVAL>0.0</MINIMUM-START-INTERVAL>
                      <CALL-POINTS>
[!IF "UdpNmRepeatMsgIndEnabled='true'"!]
                        <BSW-ASYNCHRONOUS-SERVER-CALL-POINT>
                          <SHORT-NAME>AsynchCallPoint_Nm_RepeatMessageIndication_[!"node:name(.)"!]</SHORT-NAME>
                          <CALLED-ENTRY-REF DEST="BSW-MODULE-CLIENT-SERVER-ENTRY">/AUTOSAR_UdpNm/BswModuleDescriptions/UdpNm/RequiredCSEntry_Nm_RepeatMessageIndication_[!"node:name(.)"!]</CALLED-ENTRY-REF>
                        </BSW-ASYNCHRONOUS-SERVER-CALL-POINT>
[!ENDIF!]
[!IF "UdpNmCarWakeUpRxEnabled='true'"!]
                        <BSW-ASYNCHRONOUS-SERVER-CALL-POINT>
                          <SHORT-NAME>AsynchCallPoint_Nm_CarWakeUpIndication_[!"node:name(.)"!]</SHORT-NAME>
                          <CALLED-ENTRY-REF DEST="BSW-MODULE-CLIENT-SERVER-ENTRY">/AUTOSAR_UdpNm/BswModuleDescriptions/UdpNm/RequiredCSEntry_Nm_CarWakeUpIndication_[!"node:name(.)"!]</CALLED-ENTRY-REF>
                        </BSW-ASYNCHRONOUS-SERVER-CALL-POINT>
[!ENDIF!]
                      </CALL-POINTS>
                      <IMPLEMENTED-ENTRY-REF DEST="BSW-MODULE-ENTRY">/AUTOSAR_UdpNm/BswModuleEntrys/UdpNm_Dummy_RxIndication</IMPLEMENTED-ENTRY-REF>
                    </BSW-SCHEDULABLE-ENTITY>
[!ENDIF!]
[!ENDLOOP!]
[!ENDIF!][!//
[!IF "as:modconf('UdpNm')[1]/UdpNmGeneral/UdpNmMultiCoreSupport = 'true'"!]
[!LOOP "as:modconf('UdpNm')[1]/UdpNmGlobalConfig/*[1]/UdpNmChannelConfig/*"!]
                    <BSW-CALLED-ENTITY>
                      <SHORT-NAME>UdpNm_PassiveStartUp_CalledEntity_[!"node:name(.)"!]</SHORT-NAME>
                      <MINIMUM-START-INTERVAL>0.0</MINIMUM-START-INTERVAL>
                      <IMPLEMENTED-ENTRY-REF DEST="BSW-MODULE-ENTRY">/AUTOSAR_UdpNm/BswModuleEntrys/UdpNm_PassiveStartUp</IMPLEMENTED-ENTRY-REF>
                    </BSW-CALLED-ENTITY>
[!IF "as:modconf('UdpNm')[1]/UdpNmGlobalConfig/*[1]/UdpNmPassiveModeEnabled='false'"!]
                    <BSW-CALLED-ENTITY>
                      <SHORT-NAME>UdpNm_NetworkRequest_CalledEntity_[!"node:name(.)"!]</SHORT-NAME>
                      <MINIMUM-START-INTERVAL>0.0</MINIMUM-START-INTERVAL>
                      <IMPLEMENTED-ENTRY-REF DEST="BSW-MODULE-ENTRY">/AUTOSAR_UdpNm/BswModuleEntrys/UdpNm_NetworkRequest</IMPLEMENTED-ENTRY-REF>
                    </BSW-CALLED-ENTITY>
[!ENDIF!]
[!IF "as:modconf('UdpNm')[1]/UdpNmGlobalConfig/*[1]/UdpNmPassiveModeEnabled='false'"!]
                    <BSW-CALLED-ENTITY>
                      <SHORT-NAME>UdpNm_NetworkGwEraRequest_CalledEntity_[!"node:name(.)"!]</SHORT-NAME>
                      <MINIMUM-START-INTERVAL>0.0</MINIMUM-START-INTERVAL>
                      <IMPLEMENTED-ENTRY-REF DEST="BSW-MODULE-ENTRY">/AUTOSAR_UdpNm/BswModuleEntrys/UdpNm_NetworkGwEraRequest</IMPLEMENTED-ENTRY-REF>
                    </BSW-CALLED-ENTITY>
[!ENDIF!]
[!IF "as:modconf('UdpNm')[1]/UdpNmGlobalConfig/*[1]/UdpNmPassiveModeEnabled='false'"!]
                    <BSW-CALLED-ENTITY>
                      <SHORT-NAME>UdpNm_NetworkRelease_CalledEntity_[!"node:name(.)"!]</SHORT-NAME>
                      <MINIMUM-START-INTERVAL>0.0</MINIMUM-START-INTERVAL>
                      <IMPLEMENTED-ENTRY-REF DEST="BSW-MODULE-ENTRY">/AUTOSAR_UdpNm/BswModuleEntrys/UdpNm_NetworkRelease</IMPLEMENTED-ENTRY-REF>
                    </BSW-CALLED-ENTITY>
[!ENDIF!]
[!IF "as:modconf('UdpNm')[1]/UdpNmGlobalConfig/*[1]/UdpNmBusSynchronizationEnabled='true'"!]
                    <BSW-CALLED-ENTITY>
                      <SHORT-NAME>UdpNm_RequestBusSynchronization_CalledEntity_[!"node:name(.)"!]</SHORT-NAME>
                      <MINIMUM-START-INTERVAL>0.0</MINIMUM-START-INTERVAL>
                      <IMPLEMENTED-ENTRY-REF DEST="BSW-MODULE-ENTRY">/AUTOSAR_UdpNm/BswModuleEntrys/UdpNm_RequestBusSynchronization</IMPLEMENTED-ENTRY-REF>
                    </BSW-CALLED-ENTITY>
[!ENDIF!]
[!ENDLOOP!]
[!ENDIF!][!//


                  </ENTITYS>
                  <EVENTS>
[!LOOP "node:order(as:modconf('UdpNm')[1]/UdpNmGlobalConfig/*[1]/UdpNmChannelConfig/*, 'UdpNmRxPdu/*[1]/UdpNmRxPduId')"!]
                    <BSW-TIMING-EVENT>
                      <SHORT-NAME>TimingEvent_MainFunction_[!"num:i(UdpNmRxPdu/*[1]/UdpNmRxPduId)"!]</SHORT-NAME>
                      <STARTS-ON-EVENT-REF DEST="BSW-SCHEDULABLE-ENTITY">/AUTOSAR_UdpNm/BswModuleDescriptions/UdpNm/InternalBehavior_0/UdpNm_MainFunction_[!"num:i(UdpNmRxPdu/*[1]/UdpNmRxPduId)"!]</STARTS-ON-EVENT-REF>
                      <PERIOD>[!"as:modconf('UdpNm')[1]/UdpNmGlobalConfig/*[1]/UdpNmMainFunctionPeriod"!]</PERIOD>
                    </BSW-TIMING-EVENT>
[!ENDLOOP!]

[!IF "as:modconf('UdpNm')[1]/UdpNmGeneral/UdpNmMultiCoreSupport = 'true'"!]
[!LOOP "as:modconf('UdpNm')[1]/UdpNmGlobalConfig/*[1]/UdpNmChannelConfig/*"!]
[!IF "(UdpNmRepeatMsgIndEnabled='true') or (UdpNmCarWakeUpRxEnabled='true')"!]
                    <BSW-INTERNAL-TRIGGER-OCCURRED-EVENT>
                      <SHORT-NAME>IntTrigggering_RxIndication_Event_[!"node:name(.)"!]</SHORT-NAME>
                      <STARTS-ON-EVENT-REF DEST="BSW-SCHEDULABLE-ENTITY">/AUTOSAR_UdpNm/BswModuleDescriptions/UdpNm/InternalBehavior_0/Entity_Nm_RxInidcation_[!"node:name(.)"!]</STARTS-ON-EVENT-REF>
                      <EVENT-SOURCE-REF DEST="BSW-INTERNAL-TRIGGERING-POINT">/AUTOSAR_UdpNm/BswModuleDescriptions/UdpNm/InternalBehavior_0/TriggeringPoint_RxIndication_[!"node:name(.)"!]</EVENT-SOURCE-REF>
                    </BSW-INTERNAL-TRIGGER-OCCURRED-EVENT>
[!ENDIF!]
                    <BSW-OPERATION-INVOKED-EVENT>
                      <SHORT-NAME>OpInokedEv_UdpNm_PassiveStartUp_[!"node:name(.)"!]</SHORT-NAME>
                      <STARTS-ON-EVENT-REF DEST="BSW-CALLED-ENTITY">/AUTOSAR_UdpNm/BswModuleDescriptions/UdpNm/InternalBehavior_0/UdpNm_PassiveStartUp_CalledEntity_[!"node:name(.)"!]</STARTS-ON-EVENT-REF>
                      <ENTRY-REF DEST="BSW-MODULE-CLIENT-SERVER-ENTRY">/AUTOSAR_UdpNm/BswModuleDescriptions/UdpNm/ProvidedCSEntry_UdpNm_PassiveStartUp_[!"node:name(.)"!]</ENTRY-REF>
                    </BSW-OPERATION-INVOKED-EVENT>
[!IF "as:modconf('UdpNm')[1]/UdpNmGlobalConfig/*[1]/UdpNmPassiveModeEnabled='false'"!]
                    <BSW-OPERATION-INVOKED-EVENT>
                      <SHORT-NAME>OpInokedEv_UdpNm_NetworkRequest_[!"node:name(.)"!]</SHORT-NAME>
                      <STARTS-ON-EVENT-REF DEST="BSW-CALLED-ENTITY">/AUTOSAR_UdpNm/BswModuleDescriptions/UdpNm/InternalBehavior_0/UdpNm_NetworkRequest_CalledEntity_[!"node:name(.)"!]</STARTS-ON-EVENT-REF>
                      <ENTRY-REF DEST="BSW-MODULE-CLIENT-SERVER-ENTRY">/AUTOSAR_UdpNm/BswModuleDescriptions/UdpNm/ProvidedCSEntry_UdpNm_NetworkRequest_[!"node:name(.)"!]</ENTRY-REF>
                    </BSW-OPERATION-INVOKED-EVENT>
[!ENDIF!]
[!IF "as:modconf('UdpNm')[1]/UdpNmGlobalConfig/*[1]/UdpNmPassiveModeEnabled='false'"!]
                    <BSW-OPERATION-INVOKED-EVENT>
                      <SHORT-NAME>OpInokedEv_UdpNm_NetworkGwEraRequest_[!"node:name(.)"!]</SHORT-NAME>
                      <STARTS-ON-EVENT-REF DEST="BSW-CALLED-ENTITY">/AUTOSAR_UdpNm/BswModuleDescriptions/UdpNm/InternalBehavior_0/UdpNm_NetworkGwEraRequest_CalledEntity_[!"node:name(.)"!]</STARTS-ON-EVENT-REF>
                      <ENTRY-REF DEST="BSW-MODULE-CLIENT-SERVER-ENTRY">/AUTOSAR_UdpNm/BswModuleDescriptions/UdpNm/ProvidedCSEntry_UdpNm_NetworkGwEraRequest_[!"node:name(.)"!]</ENTRY-REF>
                    </BSW-OPERATION-INVOKED-EVENT>
[!ENDIF!]
[!IF "as:modconf('UdpNm')[1]/UdpNmGlobalConfig/*[1]/UdpNmPassiveModeEnabled='false'"!]
                    <BSW-OPERATION-INVOKED-EVENT>
                      <SHORT-NAME>OpInokedEv_UdpNm_NetworkRelease_[!"node:name(.)"!]</SHORT-NAME>
                      <STARTS-ON-EVENT-REF DEST="BSW-CALLED-ENTITY">/AUTOSAR_UdpNm/BswModuleDescriptions/UdpNm/InternalBehavior_0/UdpNm_NetworkRelease_CalledEntity_[!"node:name(.)"!]</STARTS-ON-EVENT-REF>
                      <ENTRY-REF DEST="BSW-MODULE-CLIENT-SERVER-ENTRY">/AUTOSAR_UdpNm/BswModuleDescriptions/UdpNm/ProvidedCSEntry_UdpNm_NetworkRelease_[!"node:name(.)"!]</ENTRY-REF>
                    </BSW-OPERATION-INVOKED-EVENT>
[!ENDIF!]
[!IF "as:modconf('UdpNm')[1]/UdpNmGlobalConfig/*[1]/UdpNmBusSynchronizationEnabled='true'"!]
                    <BSW-OPERATION-INVOKED-EVENT>
                      <SHORT-NAME>OpInokedEv_UdpNm_RequestBusSynchronization_[!"node:name(.)"!]</SHORT-NAME>
                      <STARTS-ON-EVENT-REF DEST="BSW-CALLED-ENTITY">/AUTOSAR_UdpNm/BswModuleDescriptions/UdpNm/InternalBehavior_0/UdpNm_RequestBusSynchronization_CalledEntity_[!"node:name(.)"!]</STARTS-ON-EVENT-REF>
                      <ENTRY-REF DEST="BSW-MODULE-CLIENT-SERVER-ENTRY">/AUTOSAR_UdpNm/BswModuleDescriptions/UdpNm/ProvidedCSEntry_UdpNm_RequestBusSynchronization_[!"node:name(.)"!]</ENTRY-REF>
                    </BSW-OPERATION-INVOKED-EVENT>
[!ENDIF!]
[!ENDLOOP!]
[!ENDIF!][!//
                  </EVENTS>
                </BSW-INTERNAL-BEHAVIOR>
              </INTERNAL-BEHAVIORS>
            </BSW-MODULE-DESCRIPTION>
          </ELEMENTS>
        </AR-PACKAGE>
        <AR-PACKAGE>
          <SHORT-NAME>BswModuleEntrys</SHORT-NAME>
          <ELEMENTS>
[!LOOP "node:order(as:modconf('UdpNm')[1]/UdpNmGlobalConfig/*[1]/UdpNmChannelConfig/*, 'UdpNmRxPdu/*[1]/UdpNmRxPduId')"!]
            <BSW-MODULE-ENTRY>
              <SHORT-NAME>UdpNm_MainFunction_[!"num:i(UdpNmRxPdu/*[1]/UdpNmRxPduId)"!]</SHORT-NAME>
              <SERVICE-ID>0x13</SERVICE-ID>
              <IS-REENTRANT>false</IS-REENTRANT>
              <IS-SYNCHRONOUS>true</IS-SYNCHRONOUS>
              <CALL-TYPE>SCHEDULED</CALL-TYPE>
              <EXECUTION-CONTEXT>TASK</EXECUTION-CONTEXT>
              <SW-SERVICE-IMPL-POLICY>STANDARD</SW-SERVICE-IMPL-POLICY>
              <ARGUMENTS>
              </ARGUMENTS>
            </BSW-MODULE-ENTRY>
[!ENDLOOP!]

[!IF "as:modconf('UdpNm')[1]/UdpNmGeneral/UdpNmMultiCoreSupport = 'true'"!]

            <BSW-MODULE-ENTRY>
              <SHORT-NAME>UdpNm_Dummy_RxIndication</SHORT-NAME>
              <ADMIN-DATA>
                <SDGS>
                  <SDG GID="EB:DnT">
                    <SD GID="FunctionGroup">Extern</SD>
                    <SD GID="EnableTracing">true</SD>
                  </SDG>
                 </SDGS>
              </ADMIN-DATA>
              <SERVICE-ID>255</SERVICE-ID>
              <IS-REENTRANT>true</IS-REENTRANT>
              <IS-SYNCHRONOUS>false</IS-SYNCHRONOUS>
              <CALL-TYPE>SCHEDULED</CALL-TYPE>
              <EXECUTION-CONTEXT>TASK</EXECUTION-CONTEXT>
              <SW-SERVICE-IMPL-POLICY>STANDARD</SW-SERVICE-IMPL-POLICY>
              <ARGUMENTS>
              </ARGUMENTS>
            </BSW-MODULE-ENTRY>

            <BSW-MODULE-ENTRY>
              <SHORT-NAME>UdpNm_PassiveStartUp</SHORT-NAME>
              <ADMIN-DATA>
                <SDGS>
                  <SDG GID="EB:DnT">
                    <SD GID="FunctionGroup">Extern</SD>
                    <SD GID="EnableTracing">true</SD>
                  </SDG>
                 </SDGS>
              </ADMIN-DATA>
              <SERVICE-ID>14</SERVICE-ID>
              <IS-REENTRANT>false</IS-REENTRANT>
              <IS-SYNCHRONOUS>false</IS-SYNCHRONOUS>
              <CALL-TYPE>REGULAR</CALL-TYPE>
              <EXECUTION-CONTEXT>TASK</EXECUTION-CONTEXT>
              <SW-SERVICE-IMPL-POLICY>STANDARD</SW-SERVICE-IMPL-POLICY>
              <RETURN-TYPE>
                <SHORT-NAME>RetVal</SHORT-NAME>
                <DIRECTION>OUT</DIRECTION>
                <SW-DATA-DEF-PROPS>
                  <SW-DATA-DEF-PROPS-VARIANTS>
                    <SW-DATA-DEF-PROPS-CONDITIONAL>
                      <IMPLEMENTATION-DATA-TYPE-REF DEST="IMPLEMENTATION-DATA-TYPE">/AUTOSAR_Std/ImplementationDataTypes/Std_ReturnType</IMPLEMENTATION-DATA-TYPE-REF>
                    </SW-DATA-DEF-PROPS-CONDITIONAL>
                  </SW-DATA-DEF-PROPS-VARIANTS>
                </SW-DATA-DEF-PROPS>
              </RETURN-TYPE>
              <ARGUMENTS>
                <SW-SERVICE-ARG>
                  <SHORT-NAME>nmNetworkHandle</SHORT-NAME>
                  <DIRECTION>IN</DIRECTION>
                  <SW-DATA-DEF-PROPS>
                    <SW-DATA-DEF-PROPS-VARIANTS>
                      <SW-DATA-DEF-PROPS-CONDITIONAL>
                        <IMPLEMENTATION-DATA-TYPE-REF DEST="IMPLEMENTATION-DATA-TYPE">/AUTOSAR_Platform/ImplementationDataTypes/uint8</IMPLEMENTATION-DATA-TYPE-REF>
                      </SW-DATA-DEF-PROPS-CONDITIONAL>
                    </SW-DATA-DEF-PROPS-VARIANTS>
                  </SW-DATA-DEF-PROPS>
                </SW-SERVICE-ARG>
              </ARGUMENTS>
            </BSW-MODULE-ENTRY>
[!IF "as:modconf('UdpNm')[1]/UdpNmGlobalConfig/*[1]/UdpNmPassiveModeEnabled='false'"!]
            <BSW-MODULE-ENTRY>
              <SHORT-NAME>UdpNm_NetworkRequest</SHORT-NAME>
              <ADMIN-DATA>
                <SDGS>
                  <SDG GID="EB:DnT">
                    <SD GID="FunctionGroup">Extern</SD>
                    <SD GID="EnableTracing">true</SD>
                  </SDG>
                 </SDGS>
              </ADMIN-DATA>
              <SERVICE-ID>2</SERVICE-ID>
              <IS-REENTRANT>false</IS-REENTRANT>
              <IS-SYNCHRONOUS>false</IS-SYNCHRONOUS>
              <CALL-TYPE>REGULAR</CALL-TYPE>
              <EXECUTION-CONTEXT>TASK</EXECUTION-CONTEXT>
              <SW-SERVICE-IMPL-POLICY>STANDARD</SW-SERVICE-IMPL-POLICY>
              <RETURN-TYPE>
                <SHORT-NAME>RetVal</SHORT-NAME>
                <DIRECTION>OUT</DIRECTION>
                <SW-DATA-DEF-PROPS>
                  <SW-DATA-DEF-PROPS-VARIANTS>
                    <SW-DATA-DEF-PROPS-CONDITIONAL>
                      <IMPLEMENTATION-DATA-TYPE-REF DEST="IMPLEMENTATION-DATA-TYPE">/AUTOSAR_Std/ImplementationDataTypes/Std_ReturnType</IMPLEMENTATION-DATA-TYPE-REF>
                    </SW-DATA-DEF-PROPS-CONDITIONAL>
                  </SW-DATA-DEF-PROPS-VARIANTS>
                </SW-DATA-DEF-PROPS>
              </RETURN-TYPE>
              <ARGUMENTS>
                <SW-SERVICE-ARG>
                  <SHORT-NAME>nmNetworkHandle</SHORT-NAME>
                  <DIRECTION>IN</DIRECTION>
                  <SW-DATA-DEF-PROPS>
                    <SW-DATA-DEF-PROPS-VARIANTS>
                      <SW-DATA-DEF-PROPS-CONDITIONAL>
                        <IMPLEMENTATION-DATA-TYPE-REF DEST="IMPLEMENTATION-DATA-TYPE">/AUTOSAR_Platform/ImplementationDataTypes/uint8</IMPLEMENTATION-DATA-TYPE-REF>
                      </SW-DATA-DEF-PROPS-CONDITIONAL>
                    </SW-DATA-DEF-PROPS-VARIANTS>
                  </SW-DATA-DEF-PROPS>
                </SW-SERVICE-ARG>
              </ARGUMENTS>
            </BSW-MODULE-ENTRY>
[!ENDIF!]
[!IF "as:modconf('UdpNm')[1]/UdpNmGlobalConfig/*[1]/UdpNmPassiveModeEnabled='false'"!]
            <BSW-MODULE-ENTRY>
              <SHORT-NAME>UdpNm_NetworkGwEraRequest</SHORT-NAME>
              <ADMIN-DATA>
                <SDGS>
                  <SDG GID="EB:DnT">
                    <SD GID="FunctionGroup">Extern</SD>
                    <SD GID="EnableTracing">true</SD>
                  </SDG>
                 </SDGS>
              </ADMIN-DATA>
              <SERVICE-ID>254</SERVICE-ID>
              <IS-REENTRANT>false</IS-REENTRANT>
              <IS-SYNCHRONOUS>false</IS-SYNCHRONOUS>
              <CALL-TYPE>REGULAR</CALL-TYPE>
              <EXECUTION-CONTEXT>TASK</EXECUTION-CONTEXT>
              <SW-SERVICE-IMPL-POLICY>STANDARD</SW-SERVICE-IMPL-POLICY>
              <RETURN-TYPE>
                <SHORT-NAME>RetVal</SHORT-NAME>
                <DIRECTION>OUT</DIRECTION>
                <SW-DATA-DEF-PROPS>
                  <SW-DATA-DEF-PROPS-VARIANTS>
                    <SW-DATA-DEF-PROPS-CONDITIONAL>
                      <IMPLEMENTATION-DATA-TYPE-REF DEST="IMPLEMENTATION-DATA-TYPE">/AUTOSAR_Std/ImplementationDataTypes/Std_ReturnType</IMPLEMENTATION-DATA-TYPE-REF>
                    </SW-DATA-DEF-PROPS-CONDITIONAL>
                  </SW-DATA-DEF-PROPS-VARIANTS>
                </SW-DATA-DEF-PROPS>
              </RETURN-TYPE>
              <ARGUMENTS>
                <SW-SERVICE-ARG>
                  <SHORT-NAME>nmNetworkHandle</SHORT-NAME>
                  <DIRECTION>IN</DIRECTION>
                  <SW-DATA-DEF-PROPS>
                    <SW-DATA-DEF-PROPS-VARIANTS>
                      <SW-DATA-DEF-PROPS-CONDITIONAL>
                        <IMPLEMENTATION-DATA-TYPE-REF DEST="IMPLEMENTATION-DATA-TYPE">/AUTOSAR_Platform/ImplementationDataTypes/uint8</IMPLEMENTATION-DATA-TYPE-REF>
                      </SW-DATA-DEF-PROPS-CONDITIONAL>
                    </SW-DATA-DEF-PROPS-VARIANTS>
                  </SW-DATA-DEF-PROPS>
                </SW-SERVICE-ARG>
              </ARGUMENTS>
            </BSW-MODULE-ENTRY>
[!ENDIF!]
[!IF "as:modconf('UdpNm')[1]/UdpNmGlobalConfig/*[1]/UdpNmPassiveModeEnabled='false'"!]
            <BSW-MODULE-ENTRY>
              <SHORT-NAME>UdpNm_NetworkRelease</SHORT-NAME>
              <ADMIN-DATA>
                <SDGS>
                  <SDG GID="EB:DnT">
                    <SD GID="FunctionGroup">Extern</SD>
                    <SD GID="EnableTracing">true</SD>
                  </SDG>
                 </SDGS>
              </ADMIN-DATA>
              <SERVICE-ID>3</SERVICE-ID>
              <IS-REENTRANT>false</IS-REENTRANT>
              <IS-SYNCHRONOUS>false</IS-SYNCHRONOUS>
              <CALL-TYPE>REGULAR</CALL-TYPE>
              <EXECUTION-CONTEXT>TASK</EXECUTION-CONTEXT>
              <SW-SERVICE-IMPL-POLICY>STANDARD</SW-SERVICE-IMPL-POLICY>
              <RETURN-TYPE>
                <SHORT-NAME>RetVal</SHORT-NAME>
                <DIRECTION>OUT</DIRECTION>
                <SW-DATA-DEF-PROPS>
                  <SW-DATA-DEF-PROPS-VARIANTS>
                    <SW-DATA-DEF-PROPS-CONDITIONAL>
                      <IMPLEMENTATION-DATA-TYPE-REF DEST="IMPLEMENTATION-DATA-TYPE">/AUTOSAR_Std/ImplementationDataTypes/Std_ReturnType</IMPLEMENTATION-DATA-TYPE-REF>
                    </SW-DATA-DEF-PROPS-CONDITIONAL>
                  </SW-DATA-DEF-PROPS-VARIANTS>
                </SW-DATA-DEF-PROPS>
              </RETURN-TYPE>
              <ARGUMENTS>
                <SW-SERVICE-ARG>
                  <SHORT-NAME>nmNetworkHandle</SHORT-NAME>
                  <DIRECTION>IN</DIRECTION>
                  <SW-DATA-DEF-PROPS>
                    <SW-DATA-DEF-PROPS-VARIANTS>
                      <SW-DATA-DEF-PROPS-CONDITIONAL>
                        <IMPLEMENTATION-DATA-TYPE-REF DEST="IMPLEMENTATION-DATA-TYPE">/AUTOSAR_Platform/ImplementationDataTypes/uint8</IMPLEMENTATION-DATA-TYPE-REF>
                      </SW-DATA-DEF-PROPS-CONDITIONAL>
                    </SW-DATA-DEF-PROPS-VARIANTS>
                  </SW-DATA-DEF-PROPS>
                </SW-SERVICE-ARG>
              </ARGUMENTS>
            </BSW-MODULE-ENTRY>
[!ENDIF!]
[!IF "as:modconf('UdpNm')[1]/UdpNmGlobalConfig/*[1]/UdpNmBusSynchronizationEnabled='true'"!]
            <BSW-MODULE-ENTRY>
              <SHORT-NAME>UdpNm_RequestBusSynchronization</SHORT-NAME>
              <ADMIN-DATA>
                <SDGS>
                  <SDG GID="EB:DnT">
                    <SD GID="FunctionGroup">Extern</SD>
                    <SD GID="EnableTracing">true</SD>
                  </SDG>
                 </SDGS>
              </ADMIN-DATA>
              <SERVICE-ID>20</SERVICE-ID>
              <IS-REENTRANT>false</IS-REENTRANT>
              <IS-SYNCHRONOUS>false</IS-SYNCHRONOUS>
              <CALL-TYPE>REGULAR</CALL-TYPE>
              <EXECUTION-CONTEXT>TASK</EXECUTION-CONTEXT>
              <SW-SERVICE-IMPL-POLICY>STANDARD</SW-SERVICE-IMPL-POLICY>
              <RETURN-TYPE>
                <SHORT-NAME>RetVal</SHORT-NAME>
                <DIRECTION>OUT</DIRECTION>
                <SW-DATA-DEF-PROPS>
                  <SW-DATA-DEF-PROPS-VARIANTS>
                    <SW-DATA-DEF-PROPS-CONDITIONAL>
                      <IMPLEMENTATION-DATA-TYPE-REF DEST="IMPLEMENTATION-DATA-TYPE">/AUTOSAR_Std/ImplementationDataTypes/Std_ReturnType</IMPLEMENTATION-DATA-TYPE-REF>
                    </SW-DATA-DEF-PROPS-CONDITIONAL>
                  </SW-DATA-DEF-PROPS-VARIANTS>
                </SW-DATA-DEF-PROPS>
              </RETURN-TYPE>
              <ARGUMENTS>
                <SW-SERVICE-ARG>
                  <SHORT-NAME>nmNetworkHandle</SHORT-NAME>
                  <DIRECTION>IN</DIRECTION>
                  <SW-DATA-DEF-PROPS>
                    <SW-DATA-DEF-PROPS-VARIANTS>
                      <SW-DATA-DEF-PROPS-CONDITIONAL>
                        <IMPLEMENTATION-DATA-TYPE-REF DEST="IMPLEMENTATION-DATA-TYPE">/AUTOSAR_Platform/ImplementationDataTypes/uint8</IMPLEMENTATION-DATA-TYPE-REF>
                      </SW-DATA-DEF-PROPS-CONDITIONAL>
                    </SW-DATA-DEF-PROPS-VARIANTS>
                  </SW-DATA-DEF-PROPS>
                </SW-SERVICE-ARG>
              </ARGUMENTS>
            </BSW-MODULE-ENTRY>
[!ENDIF!]
[!ENDIF!][!//

          </ELEMENTS>
        </AR-PACKAGE>
        <AR-PACKAGE>
          <SHORT-NAME>ImplementationDataTypes</SHORT-NAME>
          <ELEMENTS>
            <IMPLEMENTATION-DATA-TYPE>
              <SHORT-NAME>UdpNm_HsmStatechartPtrType</SHORT-NAME>
              <CATEGORY>TYPE_REFERENCE</CATEGORY>
              <ADMIN-DATA>
                <SDGS>
                  <SDG GID="EB:DnT">
                    <SD GID="TypeGroup">UdpNm_Types</SD>
                  </SDG>
                </SDGS>
              </ADMIN-DATA>
              <SW-DATA-DEF-PROPS>
                <SW-DATA-DEF-PROPS-VARIANTS>
                  <SW-DATA-DEF-PROPS-CONDITIONAL>
                    <IMPLEMENTATION-DATA-TYPE-REF
                      DEST="IMPLEMENTATION-DATA-TYPE">/AUTOSAR_Platform/ImplementationDataTypes/VoidPtr</IMPLEMENTATION-DATA-TYPE-REF>
                  </SW-DATA-DEF-PROPS-CONDITIONAL>
                </SW-DATA-DEF-PROPS-VARIANTS>
              </SW-DATA-DEF-PROPS>
              <TYPE-EMITTER>BSW</TYPE-EMITTER>
            </IMPLEMENTATION-DATA-TYPE>
            <IMPLEMENTATION-DATA-TYPE>
              <SHORT-NAME>UdpNm_HsmEventType</SHORT-NAME>
              <CATEGORY>TYPE_REFERENCE</CATEGORY>
              <ADMIN-DATA>
                <SDGS>
                  <SDG GID="EB:DnT">
                    <SD GID="TypeGroup">UdpNm_Types</SD>
                  </SDG>
                </SDGS>
              </ADMIN-DATA>
              <SW-DATA-DEF-PROPS>
                <SW-DATA-DEF-PROPS-VARIANTS>
                  <SW-DATA-DEF-PROPS-CONDITIONAL>
                    <IMPLEMENTATION-DATA-TYPE-REF
                      DEST="IMPLEMENTATION-DATA-TYPE">/AUTOSAR_Platform/ImplementationDataTypes/uint8</IMPLEMENTATION-DATA-TYPE-REF>
                  </SW-DATA-DEF-PROPS-CONDITIONAL>
                </SW-DATA-DEF-PROPS-VARIANTS>
              </SW-DATA-DEF-PROPS>
              <TYPE-EMITTER>BSW</TYPE-EMITTER>
            </IMPLEMENTATION-DATA-TYPE>
            <IMPLEMENTATION-DATA-TYPE>
              <SHORT-NAME>UdpNm_TimeType</SHORT-NAME>
              <CATEGORY>TYPE_REFERENCE</CATEGORY>
              <ADMIN-DATA>
                <SDGS>
                  <SDG GID="EB:DnT">
                    <SD GID="TypeGroup">UdpNm_Types</SD>
                  </SDG>
                </SDGS>
              </ADMIN-DATA>
              <SW-DATA-DEF-PROPS>
                <SW-DATA-DEF-PROPS-VARIANTS>
                  <SW-DATA-DEF-PROPS-CONDITIONAL>
                    <IMPLEMENTATION-DATA-TYPE-REF
                      DEST="IMPLEMENTATION-DATA-TYPE">/AUTOSAR_Platform/ImplementationDataTypes/uint16</IMPLEMENTATION-DATA-TYPE-REF>
                  </SW-DATA-DEF-PROPS-CONDITIONAL>
                </SW-DATA-DEF-PROPS-VARIANTS>
              </SW-DATA-DEF-PROPS>
              <TYPE-EMITTER>BSW</TYPE-EMITTER>
            </IMPLEMENTATION-DATA-TYPE>
            <IMPLEMENTATION-DATA-TYPE>
              <SHORT-NAME>UdpNm_HsmStateIdxType</SHORT-NAME>
              <CATEGORY>TYPE_REFERENCE</CATEGORY>
              <ADMIN-DATA>
                <SDGS>
                  <SDG GID="EB:DnT">
                    <SD GID="TypeGroup">UdpNm_Types</SD>
                  </SDG>
                </SDGS>
              </ADMIN-DATA>
              <SW-DATA-DEF-PROPS>
                <SW-DATA-DEF-PROPS-VARIANTS>
                  <SW-DATA-DEF-PROPS-CONDITIONAL>
                    <IMPLEMENTATION-DATA-TYPE-REF
                      DEST="IMPLEMENTATION-DATA-TYPE">/AUTOSAR_Platform/ImplementationDataTypes/uint8</IMPLEMENTATION-DATA-TYPE-REF>
                  </SW-DATA-DEF-PROPS-CONDITIONAL>
                </SW-DATA-DEF-PROPS-VARIANTS>
              </SW-DATA-DEF-PROPS>
              <TYPE-EMITTER>BSW</TYPE-EMITTER>
            </IMPLEMENTATION-DATA-TYPE>
          </ELEMENTS>
        </AR-PACKAGE>
      </AR-PACKAGES>
    </AR-PACKAGE>

    <AR-PACKAGE>
      <SHORT-NAME>EB_UdpNm</SHORT-NAME>
      <AR-PACKAGES>
        <AR-PACKAGE>
          <SHORT-NAME>Implementations</SHORT-NAME>
          <ELEMENTS>
            <BSW-IMPLEMENTATION>
              <SHORT-NAME>BswImplementation_0</SHORT-NAME>
              <CODE-DESCRIPTORS>
                <CODE>
                  <SHORT-NAME>Files</SHORT-NAME>
                  <ARTIFACT-DESCRIPTORS>
                    <AUTOSAR-ENGINEERING-OBJECT>
                      <SHORT-LABEL>Autosar::include::UdpNm.h</SHORT-LABEL>
                      <CATEGORY>SWHDR</CATEGORY>
                    </AUTOSAR-ENGINEERING-OBJECT>
                    <AUTOSAR-ENGINEERING-OBJECT>
                      <SHORT-LABEL>Autosar::include::UdpNm_Api.h</SHORT-LABEL>
                      <CATEGORY>SWHDR</CATEGORY>
                    </AUTOSAR-ENGINEERING-OBJECT>
                    <AUTOSAR-ENGINEERING-OBJECT>
                      <SHORT-LABEL>Autosar::include::UdpNm_Cbk.h</SHORT-LABEL>
                      <CATEGORY>SWHDR</CATEGORY>
                    </AUTOSAR-ENGINEERING-OBJECT>
                    <AUTOSAR-ENGINEERING-OBJECT>
                      <SHORT-LABEL>Autosar::include::UdpNm_Hsm.h</SHORT-LABEL>
                      <CATEGORY>SWHDR</CATEGORY>
                    </AUTOSAR-ENGINEERING-OBJECT>
                    <AUTOSAR-ENGINEERING-OBJECT>
                      <SHORT-LABEL>Autosar::include::UdpNm_HsmCfg.h</SHORT-LABEL>
                      <CATEGORY>SWHDR</CATEGORY>
                    </AUTOSAR-ENGINEERING-OBJECT>
                    <AUTOSAR-ENGINEERING-OBJECT>
                      <SHORT-LABEL>Autosar::include::UdpNm_HsmUdpNm.h</SHORT-LABEL>
                      <CATEGORY>SWHDR</CATEGORY>
                    </AUTOSAR-ENGINEERING-OBJECT>
                    <AUTOSAR-ENGINEERING-OBJECT>
                      <SHORT-LABEL>Autosar::include::UdpNm_HsmUdpNmInt.h</SHORT-LABEL>
                      <CATEGORY>SWHDR</CATEGORY>
                    </AUTOSAR-ENGINEERING-OBJECT>
                    <AUTOSAR-ENGINEERING-OBJECT>
                      <SHORT-LABEL>Autosar::include::UdpNm_Int.h</SHORT-LABEL>
                      <CATEGORY>SWHDR</CATEGORY>
                    </AUTOSAR-ENGINEERING-OBJECT>
                    <AUTOSAR-ENGINEERING-OBJECT>
                      <SHORT-LABEL>Autosar::include::UdpNm_Lcfg_Static.h</SHORT-LABEL>
                      <CATEGORY>SWHDR</CATEGORY>
                    </AUTOSAR-ENGINEERING-OBJECT>
                    <AUTOSAR-ENGINEERING-OBJECT>
                      <SHORT-LABEL>Autosar::include::UdpNm_Trace.h</SHORT-LABEL>
                      <CATEGORY>SWHDR</CATEGORY>
                    </AUTOSAR-ENGINEERING-OBJECT>
                    <AUTOSAR-ENGINEERING-OBJECT>
                      <SHORT-LABEL>Autosar::include::UdpNm_Trace_Internal.h</SHORT-LABEL>
                      <CATEGORY>SWHDR</CATEGORY>
                    </AUTOSAR-ENGINEERING-OBJECT>
                    <AUTOSAR-ENGINEERING-OBJECT>
                      <SHORT-LABEL>Autosar::include::UdpNm_Version.h</SHORT-LABEL>
                      <CATEGORY>SWHDR</CATEGORY>
                    </AUTOSAR-ENGINEERING-OBJECT>
                    <AUTOSAR-ENGINEERING-OBJECT>
                      <SHORT-LABEL>Autosar::src::UdpNm.c</SHORT-LABEL>
                      <CATEGORY>SWSRC</CATEGORY>
                    </AUTOSAR-ENGINEERING-OBJECT>
                    <AUTOSAR-ENGINEERING-OBJECT>
                      <SHORT-LABEL>Autosar::src::UdpNm_Hsm.c</SHORT-LABEL>
                      <CATEGORY>SWSRC</CATEGORY>
                    </AUTOSAR-ENGINEERING-OBJECT>
                    <AUTOSAR-ENGINEERING-OBJECT>
                      <SHORT-LABEL>Autosar::src::UdpNm_HsmUdpNmData.c</SHORT-LABEL>
                      <CATEGORY>SWSRC</CATEGORY>
                    </AUTOSAR-ENGINEERING-OBJECT>
                    <AUTOSAR-ENGINEERING-OBJECT>
                      <SHORT-LABEL>Autosar::src::UdpNm_HsmUdpNmFnct.c</SHORT-LABEL>
                      <CATEGORY>SWSRC</CATEGORY>
                    </AUTOSAR-ENGINEERING-OBJECT>
                    <AUTOSAR-ENGINEERING-OBJECT>
                      <SHORT-LABEL>make::UdpNm_defs.mak</SHORT-LABEL>
                      <CATEGORY>SWMAKE</CATEGORY>
                    </AUTOSAR-ENGINEERING-OBJECT>
                    <AUTOSAR-ENGINEERING-OBJECT>
                      <SHORT-LABEL>make::UdpNm_rules.mak</SHORT-LABEL>
                      <CATEGORY>SWMAKE</CATEGORY>
                    </AUTOSAR-ENGINEERING-OBJECT>
                  </ARTIFACT-DESCRIPTORS>
                </CODE>
              </CODE-DESCRIPTORS>
              <PROGRAMMING-LANGUAGE>C</PROGRAMMING-LANGUAGE>
              <RESOURCE-CONSUMPTION>
                <SHORT-NAME>ResourceConsumption</SHORT-NAME>
                <MEMORY-SECTIONS>
                  <MEMORY-SECTION>
                    <SHORT-NAME>CONST_8</SHORT-NAME>
                    <ALIGNMENT>8</ALIGNMENT>
                    <SW-ADDRMETHOD-REF DEST="SW-ADDR-METHOD">/AUTOSAR_MemMap/SwAddrMethods/CONST</SW-ADDRMETHOD-REF>
                  </MEMORY-SECTION>
                  <MEMORY-SECTION>
                    <SHORT-NAME>CONST_32</SHORT-NAME>
                    <ALIGNMENT>32</ALIGNMENT>
                    <SW-ADDRMETHOD-REF DEST="SW-ADDR-METHOD">/AUTOSAR_MemMap/SwAddrMethods/CONST</SW-ADDRMETHOD-REF>
                  </MEMORY-SECTION>
                  <MEMORY-SECTION>
                    <SHORT-NAME>VAR_INIT_8</SHORT-NAME>
                    <ALIGNMENT>8</ALIGNMENT>
                    <SW-ADDRMETHOD-REF DEST="SW-ADDR-METHOD">/AUTOSAR_MemMap/SwAddrMethods/VAR</SW-ADDRMETHOD-REF>
                  </MEMORY-SECTION>
                  <MEMORY-SECTION>
                    <SHORT-NAME>CONST_UNSPECIFIED</SHORT-NAME>
                    <ALIGNMENT>UNSPECIFIED</ALIGNMENT>
                    <SW-ADDRMETHOD-REF DEST="SW-ADDR-METHOD">/AUTOSAR_MemMap/SwAddrMethods/CONST</SW-ADDRMETHOD-REF>
                  </MEMORY-SECTION>
                  <MEMORY-SECTION>
                    <SHORT-NAME>CODE</SHORT-NAME>
                    <SW-ADDRMETHOD-REF DEST="SW-ADDR-METHOD">/AUTOSAR_MemMap/SwAddrMethods/CODE</SW-ADDRMETHOD-REF>
                  </MEMORY-SECTION>
                  <MEMORY-SECTION>
                    <SHORT-NAME>VAR_INIT_UNSPECIFIED</SHORT-NAME>
                    <ALIGNMENT>UNSPECIFIED</ALIGNMENT>
                    <SW-ADDRMETHOD-REF DEST="SW-ADDR-METHOD">/AUTOSAR_MemMap/SwAddrMethods/VAR</SW-ADDRMETHOD-REF>
                  </MEMORY-SECTION>
                  <MEMORY-SECTION>
                    <SHORT-NAME>VAR_CLEARED_8</SHORT-NAME>
                    <ALIGNMENT>8</ALIGNMENT>
                    <SW-ADDRMETHOD-REF DEST="SW-ADDR-METHOD">/AUTOSAR_MemMap/SwAddrMethods/VAR_CLEARED</SW-ADDRMETHOD-REF>
                  </MEMORY-SECTION>
                  <MEMORY-SECTION>
                    <SHORT-NAME>VAR_CLEARED_UNSPECIFIED</SHORT-NAME>
                    <ALIGNMENT>UNSPECIFIED</ALIGNMENT>
                    <SW-ADDRMETHOD-REF DEST="SW-ADDR-METHOD">/AUTOSAR_MemMap/SwAddrMethods/VAR_CLEARED</SW-ADDRMETHOD-REF>
                  </MEMORY-SECTION>
                  <MEMORY-SECTION>
                    <SHORT-NAME>VAR_INIT_BOOLEAN</SHORT-NAME>
                    <ALIGNMENT>8</ALIGNMENT>
                    <SW-ADDRMETHOD-REF DEST="SW-ADDR-METHOD">/AUTOSAR_MemMap/SwAddrMethods/VAR</SW-ADDRMETHOD-REF>
                  </MEMORY-SECTION>
                  <MEMORY-SECTION>
                    <SHORT-NAME>CONFIG_DATA_UNSPECIFIED</SHORT-NAME>
                    <ALIGNMENT>UNSPECIFIED</ALIGNMENT>
                    <SW-ADDRMETHOD-REF DEST="SW-ADDR-METHOD">/AUTOSAR_MemMap/SwAddrMethods/CONFIG_DATA</SW-ADDRMETHOD-REF>
                  </MEMORY-SECTION>
                </MEMORY-SECTIONS>
              </RESOURCE-CONSUMPTION>
              <SW-VERSION>2.9.8</SW-VERSION>
              <VENDOR-ID>1</VENDOR-ID>
              <AR-RELEASE-VERSION>4.1.3</AR-RELEASE-VERSION>
              <BEHAVIOR-REF DEST="BSW-INTERNAL-BEHAVIOR">/AUTOSAR_UdpNm/BswModuleDescriptions/UdpNm/InternalBehavior_0</BEHAVIOR-REF>
              <VENDOR-SPECIFIC-MODULE-DEF-REFS>
                <VENDOR-SPECIFIC-MODULE-DEF-REF DEST="ECUC-MODULE-DEF">/TS_TxDxM2I9R0/UdpNm</VENDOR-SPECIFIC-MODULE-DEF-REF>
              </VENDOR-SPECIFIC-MODULE-DEF-REFS>
            </BSW-IMPLEMENTATION>
          </ELEMENTS>
        </AR-PACKAGE>
      </AR-PACKAGES>
    </AR-PACKAGE>
  </AR-PACKAGES>
</AUTOSAR>
