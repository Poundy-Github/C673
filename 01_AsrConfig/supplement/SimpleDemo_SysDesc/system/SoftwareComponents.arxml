AUTOSAR XML (schema 4-0-3)
package /DemoApplication/ConstantSpecifications
  constant specification CONST_0c0f918b8f394b8586f853bd5: value-spec=CONST_0c0f918b8f394b8586f853bd5:0
  constant specification CONST_951406b330e947ed9394eb477: value-spec=CONST_951406b330e947ed9394eb477:0
package /DemoApplication/ImplementationDataTypes
  impl type ComM_ModeType: compu {0=NO_COMMUNICATION, 1=SILENT_COMMUNICATION, 2=FULL_COMMUNICATION}, implementation-data-type=uint8
package /DemoApplication/SwComponentTypes
  complex device driver sw component type CtCdSPI
    behavior CtCdSPI_IB: handle-termination-and-restart=NO-SUPPORT
      timing event CtCdSPI_5ms_Event: start-on-event=CtCdSPI_5ms, period=0.005
      runnable CtCdSPI_5ms
      runnable CtCdSPI_Init
  composition sw component type TopLevelComposition
    component CtCdSPI: type=CtCdSPI
package /DemoApplication/SwcImplementations
  swc implementation Impl_CtCdSPI: programming-language=C, sw-version=1.0.0, vendor-id=0, behavior=CtCdSPI_IB
    code-descriptors:
      code SRC: artifact-descriptors=autosar-engineering-object={short-label=EngObject, category=SWSRC}
    resource consumption Resource
      memory section CODE: sw-addrmethod=CODE
