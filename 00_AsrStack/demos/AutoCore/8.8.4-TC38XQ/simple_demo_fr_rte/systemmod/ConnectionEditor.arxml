AUTOSAR XML (schema 4-2-1)
package /DemoApplication/SwComponentTypes
  composition sw component type TopLevelComposition
    component BswM_Prototype: type=BswM
    component ComM_Prototype: type=ComM
    component DevelopmentErrorTracer_Prototype: type=DevelopmentErrorTracer
    connect BswM_Prototype.BswM_ModeSwitchPort_BswMSwitchPort_Rte -> SWC_CyclicCounter.ModeSwitchPort_BSWM_COMBINEDACTION_BswMMode_PortInterfaces_BswMMode
    connect DevelopmentErrorTracer_Prototype.DS_SWC_0 -> SWC_CyclicCounter.R_CyclicCounterDet
    connect ComM_Prototype.UR_ComMUser_0 -> SWC_CyclicCounter.UR_ComMUser_0
package /FlexraySystem
  system FlexraySystem
    system mapping EBConnectionEditorMappings
      sw-mappings:
        swc to ecu mapping EBConnectionEditorSwcMappings: ecu-instance=EcuTestNode
          component:
            TopLevelComposition.BswM_Prototype
            TopLevelComposition.DevelopmentErrorTracer_Prototype
            TopLevelComposition.ComM_Prototype
